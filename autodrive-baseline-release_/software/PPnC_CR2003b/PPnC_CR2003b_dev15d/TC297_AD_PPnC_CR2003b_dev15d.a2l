/* -------------------------------------------------------------------------
Visu-IT!
ASAP2Toolkit DEMO
- ASAP2 export -
Version 13.2.R0
Component-Version Build<000000.18> 2017/07/24 18:34:50
CreationDate 31 May 2019, 16:17:58
Project hj_adcu
Number -
Structure -
Serial Nr. -
Option Project (DataBase) D:\Workspace\TC29x\TC297_FreeRTOS\tools\ASAP2
Option Verbose false
Option ASAP2File D:\Workspace\TC29x\TC297_FreeRTOS\tools\ASAP2\gen\adcu_calibration.a2l
Option IgnoreAddressCheck false
Option ASAP2Version 1.60
Option PartialExportViaFunction
Option PartialExportViaFunctionMode <2>
Option CompuMethodName <0>
Option ExportUnitDisplayName <0>
Option IfDataTemplateList
Option A2MLMode <0>
Option CalibrationMethodList
Option MemoryRegionAutoAssignment <0>
Option AddressOffset <0>
Option A2LName EntityName
Option ExportHiddenData false
Option ExportInvisibleData false
Option ExportSoftwareGrouping false
Option ExportComponentGrouping false
Option SuppressFunctionGrouping false
Option SuppressAxisFunctionGrouping false
Option SuppressDefaultFunction false
Option ExportDisplayIdentifier <1>
Option ExportLongIdentifier <0>
Option ExportAnnotation false
Option ExportReference2MemorySegment false
Option ExportSystemConstants <0>
Option CreateVirtualCharacteristics.. false
Option CreateVirtualMeasurements4In.. false
Option CreateSymbolLink false
Option SuppressEcuAddress false
Option SuppressFloat false
Option SuppressVariantCoding false
Option VariantCodingMode <0>
Option OnlineOnly false
Option Map2PointLinearConv2RatFunc false
Option NonLinearConvMode <0>
Option MapVTabRange2VTab false
Option MaxCompuTabValuePairs <255>
Option DefaultFormat4VerbalConvers...
Option WriteEscapeCharacters false
Option SASList
Option SAS4All false
Option ApplyOldIdentSyntax4NonInstr.. false
Option IgnorePartialIdentLengthCheck false
Option AllowEmptyContainer false
Option CreateAddressOffsetFile <0>
Option SupportEdicMobileV3 false
Option SuppressBitfieldCarrier false
Option DefaultLanguage en
Option SkipInputDefinitions false
Option Force1DValBlks false
Option ExportMaxRefresh <0>
Option SuppressRefUnit false
Option ExportUnusedAttributes false
Option CustomAmlFiles
------------------------------------------------------------------------- */
ASAP2_VERSION 1 60
/begin PROJECT hj_adcu "_default_ProjectLongIdentifier"
/begin HEADER "_default_HeaderComment" PROJECT_NO _default_ProjectNr /end HEADER
/begin MODULE _default_ModuleName "_default_ModuleLongIdentifier"
/begin MOD_PAR "_default_ModParComment"
 /begin MEMORY_SEGMENT _RAM "" VARIABLES RAM EXTERN 0x50000000 0x3a000 -1 -1 -1 -1 -1 /end MEMORY_SEGMENT
 /begin MEMORY_SEGMENT _CALWP "" DATA FLASH 0x70100000 0x8000 -1 -1 -1 -1 -1
  /begin IF_DATA XCP
   /begin SEGMENT 0 1 0 0 0 /begin CHECKSUM XCP_ADD_14 MAX_BLOCK_SIZE 256 /end CHECKSUM
    /begin PAGE 0 ECU_ACCESS_WITH_XCP_ONLY XCP_READ_ACCESS_WITH_ECU_ONLY XCP_WRITE_ACCESS_WITH_ECU_ONLY INIT_SEGMENT 0 /end PAGE
   /end SEGMENT
  /end IF_DATA
 /end MEMORY_SEGMENT
/end MOD_PAR
/begin MOD_COMMON "_default_ModCommonComment" DEPOSIT ABSOLUTE BYTE_ORDER MSB_LAST ALIGNMENT_BYTE 1 ALIGNMENT_WORD 2 ALIGNMENT_LONG 4 ALIGNMENT_FLOAT32_IEEE 4 ALIGNMENT_FLOAT64_IEEE 4 /end MOD_COMMON
/begin IF_DATA XCP
 /begin PROTOCOL_LAYER 256 2000 2000 2000 2000 2000 5 5 255 256 BYTE_ORDER_MSB_LAST ADDRESS_GRANULARITY_BYTE OPTIONAL_CMD SET_REQUEST OPTIONAL_CMD SET_MTA OPTIONAL_CMD UPLOAD OPTIONAL_CMD BUILD_CHECKSUM OPTIONAL_CMD TRANSPORT_LAYER_CMD OPTIONAL_CMD CLEAR_DAQ_LIST OPTIONAL_CMD SET_DAQ_PTR OPTIONAL_CMD WRITE_DAQ OPTIONAL_CMD SET_DAQ_LIST_MODE OPTIONAL_CMD START_STOP_DAQ_LIST OPTIONAL_CMD START_STOP_SYNCH OPTIONAL_CMD GET_DAQ_CLOCK OPTIONAL_CMD MODIFY_BITS OPTIONAL_CMD DOWNLOAD OPTIONAL_CMD DOWNLOAD_NEXT OPTIONAL_CMD SET_CAL_PAGE OPTIONAL_CMD GET_CAL_PAGE OPTIONAL_CMD COPY_CAL_PAGE OPTIONAL_CMD DOWNLOAD_MAX OPTIONAL_CMD GET_PAG_PROCESSOR_INFO OPTIONAL_CMD GET_COMM_MODE_INFO OPTIONAL_CMD GET_DAQ_LIST_INFO OPTIONAL_CMD GET_DAQ_PROCESSOR_INFO OPTIONAL_CMD GET_DAQ_RESOLUTION_INFO OPTIONAL_CMD GET_DAQ_EVENT_INFO OPTIONAL_CMD GET_ID OPTIONAL_CMD SHORT_UPLOAD OPTIONAL_CMD GET_DAQ_LIST_MODE COMMUNICATION_MODE_SUPPORTED BLOCK SLAVE MASTER 255 100 /end PROTOCOL_LAYER
 /begin DAQ STATIC 2 2 0 OPTIMISATION_TYPE_DEFAULT ADDRESS_EXTENSION_DAQ IDENTIFICATION_FIELD_TYPE_ABSOLUTE GRANULARITY_ODT_ENTRY_SIZE_DAQ_BYTE 127 NO_OVERLOAD_INDICATION /begin TIMESTAMP_SUPPORTED 1 SIZE_DWORD UNIT_1MS /end TIMESTAMP_SUPPORTED
  /begin DAQ_LIST 0 DAQ_LIST_TYPE DAQ MAX_ODT 10 MAX_ODT_ENTRIES 8 FIRST_PID 0 EVENT_FIXED 0 /end DAQ_LIST
  /begin DAQ_LIST 1 DAQ_LIST_TYPE DAQ MAX_ODT 10 MAX_ODT_ENTRIES 8 FIRST_PID 10 EVENT_FIXED 1 /end DAQ_LIST
  /begin EVENT "10ms_Raster" "10msRstr" 0 DAQ_STIM 255 10 6 0 /end EVENT
  /begin EVENT "100ms_Raster" "100msRstr" 1 DAQ_STIM 255 10 7 0 /end EVENT
 /end DAQ
 /begin PAG 1 FREEZE_SUPPORTED /end PAG
 /begin PGM PGM_MODE_ABSOLUTE 0 8 COMMUNICATION_MODE_SUPPORTED BLOCK SLAVE MASTER 255 100 /end PGM
 /begin XCP_ON_UDP_IP 256 18017 ADDRESS "192.168.195.170" /end XCP_ON_UDP_IP
/end IF_DATA
/begin MOD_COMMON "Mod Common Comment Here" BYTE_ORDER MSB_LAST /end MOD_COMMON
/begin RECORD_LAYOUT Scalar_BOOLEAN FNC_VALUES 1 UBYTE COLUMN_DIR DIRECT /end RECORD_LAYOUT
/begin RECORD_LAYOUT Scalar_UBYTE FNC_VALUES 1 UBYTE COLUMN_DIR DIRECT /end RECORD_LAYOUT
/begin RECORD_LAYOUT Scalar_SWORD FNC_VALUES 1 SWORD COLUMN_DIR DIRECT /end RECORD_LAYOUT
/begin RECORD_LAYOUT Scalar_ULONG FNC_VALUES 1 ULONG COLUMN_DIR DIRECT /end RECORD_LAYOUT
/begin RECORD_LAYOUT Scalar_LONG FNC_VALUES 1 SLONG COLUMN_DIR DIRECT /end RECORD_LAYOUT
/begin RECORD_LAYOUT Scalar_FLOAT32_IEEE FNC_VALUES 1 FLOAT32_IEEE COLUMN_DIR DIRECT /end RECORD_LAYOUT
/begin RECORD_LAYOUT Scalar_FLOAT64_IEEE FNC_VALUES 1 FLOAT64_IEEE COLUMN_DIR DIRECT /end RECORD_LAYOUT
/begin RECORD_LAYOUT Lookup1D_BOOLEAN FNC_VALUES 1 UBYTE COLUMN_DIR DIRECT /end RECORD_LAYOUT
/begin RECORD_LAYOUT Lookup1D_X_BOOLEAN AXIS_PTS_X 1 UBYTE INDEX_INCR DIRECT /end RECORD_LAYOUT
/begin RECORD_LAYOUT Lookup1D_BYTE FNC_VALUES 1 SBYTE COLUMN_DIR DIRECT /end RECORD_LAYOUT
/begin RECORD_LAYOUT Lookup1D_X_BYTE AXIS_PTS_X 1 SBYTE INDEX_INCR DIRECT /end RECORD_LAYOUT
/begin RECORD_LAYOUT Lookup1D_FLOAT32_IEEE FNC_VALUES 1 FLOAT32_IEEE COLUMN_DIR DIRECT /end RECORD_LAYOUT
/begin RECORD_LAYOUT Lookup1D_X_FLOAT32_IEEE AXIS_PTS_X 1 FLOAT32_IEEE INDEX_INCR DIRECT /end RECORD_LAYOUT
/begin RECORD_LAYOUT Lookup2D_FLOAT32_IEEE FNC_VALUES 1 FLOAT32_IEEE COLUMN_DIR DIRECT /end RECORD_LAYOUT
/begin RECORD_LAYOUT Lookup2D_X_FLOAT32_IEEE AXIS_PTS_X 1 FLOAT32_IEEE INDEX_INCR DIRECT /end RECORD_LAYOUT
/begin CHARACTERISTIC KtACCS_d_RespDCSNStopThrshHi "Only when stop distance from DCSN smaller than this calibration, ACCS response this stop requirement" CURVE 0x70100898 /* @ECU_Address@KtACCS_d_RespDCSNStopThrshHi@ */ Lookup1D_FLOAT32_IEEE 0 ACCS_subsystem_integrated_CM_single_m 0.0 200.0
 /begin AXIS_DESCR COM_AXIS NO_INPUT_QUANTITY ACCS_subsystem_integrated_CM_single_m_s 6 0.0 50.0 AXIS_PTS_REF KtACCS_AXIS_DCSNStopThrshHi_Spd /end AXIS_DESCR
/end CHARACTERISTIC
/begin CHARACTERISTIC KtACCS_d_CIPVTargtRange "As keACCS_TargetRangeCalType =0, use this cal to define the target range" MAP 0x701008b0 /* @ECU_Address@KtACCS_d_CIPVTargtRange@ */ Lookup2D_FLOAT32_IEEE 0 ACCS_subsystem_integrated_CM_single_m 0.0 200.0
 /begin AXIS_DESCR COM_AXIS NO_INPUT_QUANTITY ACCS_subsystem_integrated_CM_single 4 1.0 6.0 AXIS_PTS_REF KtACCS_AXIS_TargtRange_Timegap /end AXIS_DESCR
 /begin AXIS_DESCR COM_AXIS NO_INPUT_QUANTITY ACCS_subsystem_integrated_CM_single_m_s 10 0.0 50.0 AXIS_PTS_REF KtACCS_AXIS_TargetRange_Speed /end AXIS_DESCR
/end CHARACTERISTIC
/begin CHARACTERISTIC KtACCS_r_DCSNStopDistanceGain "This gain is for stop distance from DCSN" MAP 0x7010065c /* @ECU_Address@KtACCS_r_DCSNStopDistanceGain@ */ Lookup2D_FLOAT32_IEEE 0 ACCS_subsystem_integrated_CM_single -10.0 10.0
 /begin AXIS_DESCR COM_AXIS NO_INPUT_QUANTITY ACCS_subsystem_integrated_CM_single_m_s 11 0.0 50.0 AXIS_PTS_REF KtACCS_AXIS_DCSNStopGain_VehSpd /end AXIS_DESCR
 /begin AXIS_DESCR COM_AXIS NO_INPUT_QUANTITY ACCS_subsystem_integrated_CM_single_m 13 -20.0 200.0 AXIS_PTS_REF KtACCS_AXIS_DCSNStopDisGain_d /end AXIS_DESCR
/end CHARACTERISTIC
/begin CHARACTERISTIC KtACCS_r_DCSNStopSpdGain "This gain is for stop speed error from DCSN" MAP 0x70100478 /* @ECU_Address@KtACCS_r_DCSNStopSpdGain@ */ Lookup2D_FLOAT32_IEEE 0 ACCS_subsystem_integrated_CM_single -10.0 10.0
 /begin AXIS_DESCR COM_AXIS NO_INPUT_QUANTITY ACCS_subsystem_integrated_CM_single_m_s 11 0.0 50.0 AXIS_PTS_REF KtACCS_AXIS_DCSNStopGain_VehSpd /end AXIS_DESCR
 /begin AXIS_DESCR COM_AXIS NO_INPUT_QUANTITY ACCS_subsystem_integrated_CM_single_m_s 11 -50.0 50.0 AXIS_PTS_REF KtACCS_AXIS_DCSNStopGainSpd_SpdErr /end AXIS_DESCR
/end CHARACTERISTIC
/begin CHARACTERISTIC KtACCS_a_OpenAccel_FollowCtrl "This is open acceleration table under following control mode,it is the function of range error and speed error" MAP 0x701009c8 /* @ECU_Address@KtACCS_a_OpenAccel_FollowCtrl@ */ Lookup2D_FLOAT32_IEEE 0 ACCS_subsystem_integrated_CM_single_m_s2 -4.0 4.0
 /begin AXIS_DESCR COM_AXIS VfACCS_Input_Obs_Rangerate ACCS_subsystem_integrated_CM_single_m_s 7 -30.0 30.0 AXIS_PTS_REF KtACCS_AXIS_OpenAccelFwCtrl_RR /end AXIS_DESCR
 /begin AXIS_DESCR COM_AXIS NO_INPUT_QUANTITY ACCS_subsystem_integrated_CM_single_m 9 -100.0 100.0 AXIS_PTS_REF KtACCS_AXIS_OpenAccelFwCtrl_RangeErr /end AXIS_DESCR
/end CHARACTERISTIC
/begin CHARACTERISTIC KtACCS_Pct_AccelToGasPedal "This cal is used to transfer acceleration to gas pedal or torq(percent)" MAP 0x70100ac4 /* @ECU_Address@KtACCS_Pct_AccelToGasPedal@ */ Lookup2D_FLOAT32_IEEE 0 ACCS_subsystem_integrated_CM_single_pct -100.0 100.0
 /begin AXIS_DESCR COM_AXIS NO_INPUT_QUANTITY ACCS_subsystem_integrated_CM_single_m_s2 17 -8.0 8.0 AXIS_PTS_REF KtACCS_AXIS_AccelToGasPedal_Accel /end AXIS_DESCR
 /begin AXIS_DESCR COM_AXIS NO_INPUT_QUANTITY ACCS_subsystem_integrated_CM_single_m_s 10 0.0 50.0 AXIS_PTS_REF KtACCS_AXIS_AccelToGasPedal_VehSpd /end AXIS_DESCR
/end CHARACTERISTIC
/begin CHARACTERISTIC KtACCS_r_RangeCtrlPGain "This is Prop gain for Range PID contrl" MAP 0x70100310 /* @ECU_Address@KtACCS_r_RangeCtrlPGain@ */ Lookup2D_FLOAT32_IEEE 0 ACCS_subsystem_integrated_CM_single -10.0 10.0
 /begin AXIS_DESCR COM_AXIS NO_INPUT_QUANTITY ACCS_subsystem_integrated_CM_single_m 9 -100.0 100.0 AXIS_PTS_REF KtACCS_AXIS_RangeCtrlPGain_Err /end AXIS_DESCR
 /begin AXIS_DESCR COM_AXIS NO_INPUT_QUANTITY ACCS_subsystem_integrated_CM_single_m_s 10 0.0 50.0 AXIS_PTS_REF KtACCS_AXIS_RangeCtrlPGain_VehSpd /end AXIS_DESCR
/end CHARACTERISTIC
/begin CHARACTERISTIC KtACCS_r_SpeedCtrlPGain "This is Prop gain for speed PID contrl" MAP 0x701001a8 /* @ECU_Address@KtACCS_r_SpeedCtrlPGain@ */ Lookup2D_FLOAT32_IEEE 0 ACCS_subsystem_integrated_CM_single -10.0 10.0
 /begin AXIS_DESCR COM_AXIS NO_INPUT_QUANTITY ACCS_subsystem_integrated_CM_single_m_s 9 -30.0 30.0 AXIS_PTS_REF KtACCS_AXIS_SpeedCtrlPGain_Err /end AXIS_DESCR
 /begin AXIS_DESCR COM_AXIS NO_INPUT_QUANTITY ACCS_subsystem_integrated_CM_single_m_s 10 0.0 50.0 AXIS_PTS_REF KtACCS_AXIS_RangeCtrlPGain_VehSpd /end AXIS_DESCR
/end CHARACTERISTIC
/begin CHARACTERISTIC KtACCS_r_TorqCtrlProp "Torq control PID p gain" MAP 0x70100040 /* @ECU_Address@KtACCS_r_TorqCtrlProp@ */ Lookup2D_FLOAT32_IEEE 0 ACCS_subsystem_integrated_CM_single 0.0 100.0
 /begin AXIS_DESCR COM_AXIS NO_INPUT_QUANTITY ACCS_subsystem_integrated_CM_single_m_s 10 0.0 45.0 AXIS_PTS_REF KtACCS_AXIS_TorqCtrlProp_EgoSpeed /end AXIS_DESCR
 /begin AXIS_DESCR COM_AXIS NO_INPUT_QUANTITY ACCS_subsystem_integrated_CM_single_m_s2 9 -8.0 8.0 AXIS_PTS_REF KtACCS_AXIS_TorqCtrlProp_DeltaAccel /end AXIS_DESCR
/end CHARACTERISTIC
/begin CHARACTERISTIC KaACCS_t_TimeGapFrmDriver "Time gap from driver" VAL_BLK 0x70101190 /* @ECU_Address@KaACCS_t_TimeGapFrmDriver@ */ Scalar_FLOAT32_IEEE 0 ACCS_subsystem_integrated_CM_single_s 0.0 20.0 NUMBER 4 /end CHARACTERISTIC
/begin CHARACTERISTIC KcACCS_ABSActvieCntDisableACCThrsh "ABS active timer is bigger than this calibration, ACCS will enter standby" VALUE 0x7010118c /* @ECU_Address@KcACCS_ABSActvieCntDisableACCThrsh@ */ Scalar_FLOAT32_IEEE 0 ACCS_subsystem_integrated_CM_single 0.0 100000.0 /end CHARACTERISTIC
/begin CHARACTERISTIC KcACCS_DtrmFlickerThresh "Rnage flicker count thresh" VALUE 0x70101188 /* @ECU_Address@KcACCS_DtrmFlickerThresh@ */ Scalar_FLOAT32_IEEE 0 ACCS_subsystem_integrated_CM_single 0.0 200.0 /end CHARACTERISTIC
/begin CHARACTERISTIC KfACCS_Ang_DtrmSelfChangeLane "Thie is the steering angle to determine whether vehicle is changing lane" VALUE 0x70101184 /* @ECU_Address@KfACCS_Ang_DtrmSelfChangeLane@ */ Scalar_FLOAT32_IEEE 0 ACCS_subsystem_integrated_CM_single_rad 0.0 6.2831853071795862 /end CHARACTERISTIC
/begin CHARACTERISTIC KfACCS_M_StandardTorqForPercent "This is standard torr for calculate percent" VALUE 0x70101180 /* @ECU_Address@KfACCS_M_StandardTorqForPercent@ */ Scalar_FLOAT32_IEEE 0 ACCS_subsystem_integrated_CM_single_NM 0.0 3000.0 /end CHARACTERISTIC
/begin CHARACTERISTIC KfACCS_Pct_DriverPressGasPedalThrsh "If the gas pedal is bigger than this calibration,determine driver preee the pedal" VALUE 0x7010117c /* @ECU_Address@KfACCS_Pct_DriverPressGasPedalThrsh@ */ Scalar_FLOAT32_IEEE 0 ACCS_subsystem_integrated_CM_single_pct 0.0 100.0 /end CHARACTERISTIC
/begin CHARACTERISTIC KfACCS_Pct_ExitStandbyPedalLoThrsh "If incorm driver to press the gas pedal, the Gas pedal need bigger than this cal" VALUE 0x70101178 /* @ECU_Address@KfACCS_Pct_ExitStandbyPedalLoThrsh@ */ Scalar_FLOAT32_IEEE 0 ACCS_subsystem_integrated_CM_single_pct 0.0 100.0 /end CHARACTERISTIC
/begin CHARACTERISTIC KfACCS_Pct_GasPedalOverrideThrsh "As KbACCS_DirectlyUsePedalToJudgeOverride=True,if gas pedal is bigger than this calibration, ACCS will enter pedal override standby status" VALUE 0x70101174 /* @ECU_Address@KfACCS_Pct_GasPedalOverrideThrsh@ */ Scalar_FLOAT32_IEEE 0 ACCS_subsystem_integrated_CM_single_pct 0.0 100.0 /end CHARACTERISTIC
/begin CHARACTERISTIC KfACCS_Pct_VirtualGasPedal "This is only for test.As KbACCS_UseVirtualPedal=True, use this calibration as the Gas pedal" VALUE 0x70101170 /* @ECU_Address@KfACCS_Pct_VirtualGasPedal@ */ Scalar_FLOAT32_IEEE 0 ACCS_subsystem_integrated_CM_single_pct 0.0 100.0 /end CHARACTERISTIC
/begin CHARACTERISTIC KfACCS_a_AccelCmdDeadZone "When want to accelerate, the acceleration must bigger than this cal." VALUE 0x7010116c /* @ECU_Address@KfACCS_a_AccelCmdDeadZone@ */ Scalar_FLOAT32_IEEE 0 ACCS_subsystem_integrated_CM_single_m_s2 -4.0 4.0 /end CHARACTERISTIC
/begin CHARACTERISTIC KfACCS_a_BrakeCmdDeadZone "When want to decelerate, the acceleration must bigger than this cal." VALUE 0x70101168 /* @ECU_Address@KfACCS_a_BrakeCmdDeadZone@ */ Scalar_FLOAT32_IEEE 0 ACCS_subsystem_integrated_CM_single_m_s2 -4.0 4.0 /end CHARACTERISTIC
/begin CHARACTERISTIC KfACCS_a_LinearAcc_PreSet "when KbACCS_UseVirtualObject=true, object linearAcc is from this calibration" VALUE 0x70101164 /* @ECU_Address@KfACCS_a_LinearAcc_PreSet@ */ Scalar_FLOAT32_IEEE 0 ACCS_subsystem_integrated_CM_single_m_s2 -4.0 4.0 /end CHARACTERISTIC
/begin CHARACTERISTIC KfACCS_a_LowSpdToTempStpAccelThrsh "If want from low speed to Temp stop, desired acceleration need bigger than thhi calibration" VALUE 0x70101160 /* @ECU_Address@KfACCS_a_LowSpdToTempStpAccelThrsh@ */ Scalar_FLOAT32_IEEE 0 ACCS_subsystem_integrated_CM_single_m_s2 -4.0 4.0 /end CHARACTERISTIC
/begin CHARACTERISTIC KfACCS_a_ObjectAccelUpdateThrsh "Only object acceleration change is bigger than this calibration, set the new acceleration" VALUE 0x7010115c /* @ECU_Address@KfACCS_a_ObjectAccelUpdateThrsh@ */ Scalar_FLOAT32_IEEE 0 ACCS_subsystem_integrated_CM_single_m_s2 -4.0 4.0 /end CHARACTERISTIC
/begin CHARACTERISTIC KfACCS_a_OutAccelHiThrsh "The Max threshold for output acceleration" VALUE 0x70101158 /* @ECU_Address@KfACCS_a_OutAccelHiThrsh@ */ Scalar_FLOAT32_IEEE 0 ACCS_subsystem_integrated_CM_single_m_s2 -4.0 4.0 /end CHARACTERISTIC
/begin CHARACTERISTIC KfACCS_a_OutAccelLoThrsh "The Min threshold for output acceleration" VALUE 0x70101154 /* @ECU_Address@KfACCS_a_OutAccelLoThrsh@ */ Scalar_FLOAT32_IEEE 0 ACCS_subsystem_integrated_CM_single_m_s2 -4.0 4.0 /end CHARACTERISTIC
/begin CHARACTERISTIC KfACCS_a_TempStpToLaunchAccelThrsh "If want to from temp stop to launch, the acceleration need bigger than this calibration" VALUE 0x70101150 /* @ECU_Address@KfACCS_a_TempStpToLaunchAccelThrsh@ */ Scalar_FLOAT32_IEEE 0 ACCS_subsystem_integrated_CM_single_m_s2 -4.0 4.0 /end CHARACTERISTIC
/begin CHARACTERISTIC KfACCS_d_ChangedObsRangeLatDiff "This is the lateral range difference to determine whether the target is a changed target" VALUE 0x7010114c /* @ECU_Address@KfACCS_d_ChangedObsRangeLatDiff@ */ Scalar_FLOAT32_IEEE 0 ACCS_subsystem_integrated_CM_single_m 0.0 5.0 /end CHARACTERISTIC
/begin CHARACTERISTIC KfACCS_d_ChangedObsRangeLongDiff "This is the longitudinal range difference to determine whether the target is a changed target" VALUE 0x70101148 /* @ECU_Address@KfACCS_d_ChangedObsRangeLongDiff@ */ Scalar_FLOAT32_IEEE 0 ACCS_subsystem_integrated_CM_single_m 0.0 100.0 /end CHARACTERISTIC
/begin CHARACTERISTIC KfACCS_d_CurvatureRadius_Max "If curvature radius is bigger than this calibration, the road is set straight roade" VALUE 0x70101144 /* @ECU_Address@KfACCS_d_CurvatureRadius_Max@ */ Scalar_FLOAT32_IEEE 0 ACCS_subsystem_integrated_CM_single_m 0.0 10000.0 /end CHARACTERISTIC
/begin CHARACTERISTIC KfACCS_d_DisToLeadSur "The distance between the vehicle head and Rear axle center" VALUE 0x70101140 /* @ECU_Address@KfACCS_d_DisToLeadSur@ */ Scalar_FLOAT32_IEEE 0 ACCS_subsystem_integrated_CM_single_m 0.0 50.0 /end CHARACTERISTIC
/begin CHARACTERISTIC KfACCS_d_DisToSideSur "The distance between the vehicle side and Rear axle center" VALUE 0x7010113c /* @ECU_Address@KfACCS_d_DisToSideSur@ */ Scalar_FLOAT32_IEEE 0 ACCS_subsystem_integrated_CM_single_m 0.0 5.0 /end CHARACTERISTIC
/begin CHARACTERISTIC KfACCS_d_FlickerRangeLatLimit "This is the lateral range limit for detecting range flicker function" VALUE 0x70101138 /* @ECU_Address@KfACCS_d_FlickerRangeLatLimit@ */ Scalar_FLOAT32_IEEE 0 ACCS_subsystem_integrated_CM_single_m -20.0 20.0 /end CHARACTERISTIC
/begin CHARACTERISTIC KfACCS_d_FlickerRangeLongLimit "This is the longitude range limit for detecting range flicker function" VALUE 0x70101134 /* @ECU_Address@KfACCS_d_FlickerRangeLongLimit@ */ Scalar_FLOAT32_IEEE 0 ACCS_subsystem_integrated_CM_single_m 0.0 200.0 /end CHARACTERISTIC
/begin CHARACTERISTIC KfACCS_d_FollowingToLowSpdRRThrsh "If want from following control to low speed mode ,the CIPV range rate need smaller than this calibration" VALUE 0x70101130 /* @ECU_Address@KfACCS_d_FollowingToLowSpdRRThrsh@ */ Scalar_FLOAT32_IEEE 0 ACCS_subsystem_integrated_CM_single_m_s 0.0 30.0 /end CHARACTERISTIC
/begin CHARACTERISTIC KfACCS_d_LowSpdToTempStpDisThrsh "If want from low speed to Temp stop, the stop distance need smaller than this calibration" VALUE 0x7010112c /* @ECU_Address@KfACCS_d_LowSpdToTempStpDisThrsh@ */ Scalar_FLOAT32_IEEE 0 ACCS_subsystem_integrated_CM_single_m 0.0 100.0 /end CHARACTERISTIC
/begin CHARACTERISTIC KfACCS_d_MaxRange "CIPV target range will be limit by this cal" VALUE 0x70101128 /* @ECU_Address@KfACCS_d_MaxRange@ */ Scalar_FLOAT32_IEEE 0 ACCS_subsystem_integrated_CM_single_m 2.0 200.0 /end CHARACTERISTIC
/begin CHARACTERISTIC KfACCS_d_MinimumRange "The drive set target range and this cal to chose max as target range" VALUE 0x70101124 /* @ECU_Address@KfACCS_d_MinimumRange@ */ Scalar_FLOAT32_IEEE 0 ACCS_subsystem_integrated_CM_single_m 0.0 100.0 /end CHARACTERISTIC
/begin CHARACTERISTIC KfACCS_d_RangeForApproaching "This is the range to determine the status of approaching" VALUE 0x70101120 /* @ECU_Address@KfACCS_d_RangeForApproaching@ */ Scalar_FLOAT32_IEEE 0 ACCS_subsystem_integrated_CM_single_m 0.0 200.0 /end CHARACTERISTIC
/begin CHARACTERISTIC KfACCS_d_RangeForAway "This is the range to determine the status of away." VALUE 0x7010111c /* @ECU_Address@KfACCS_d_RangeForAway@ */ Scalar_FLOAT32_IEEE 0 ACCS_subsystem_integrated_CM_single_m 0.0 200.0 /end CHARACTERISTIC
/begin CHARACTERISTIC KfACCS_d_RangePIDCtrl_RangeErrlimit "Range error limit for Range Pid control" VALUE 0x70101118 /* @ECU_Address@KfACCS_d_RangePIDCtrl_RangeErrlimit@ */ Scalar_FLOAT32_IEEE 0 ACCS_subsystem_integrated_CM_single_m 0.0 100.0 /end CHARACTERISTIC
/begin CHARACTERISTIC KfACCS_d_Range_PreSet "when KbACCS_UseVirtualObject=true, object range is from this calibration" VALUE 0x70101114 /* @ECU_Address@KfACCS_d_Range_PreSet@ */ Scalar_FLOAT32_IEEE 0 ACCS_subsystem_integrated_CM_single_m 0.0 200.0 /end CHARACTERISTIC
/begin CHARACTERISTIC KfACCS_d_TempStopToLaunchRRThrsh "Under Temp stop and there is CIPV, if want from Temp stop to launch ,the CIPV range rate
      need bigger than this calibration" VALUE 0x70101110 /* @ECU_Address@KfACCS_d_TempStopToLaunchRRThrsh@ */ Scalar_FLOAT32_IEEE 0 ACCS_subsystem_integrated_CM_single_m_s -30.0 30.0 /end CHARACTERISTIC
/begin CHARACTERISTIC KfACCS_d_TempStpToLaunchDisThrsh "If want from Temp stop to launch, the stop distance need bigger than this calibration" VALUE 0x7010110c /* @ECU_Address@KfACCS_d_TempStpToLaunchDisThrsh@ */ Scalar_FLOAT32_IEEE 0 ACCS_subsystem_integrated_CM_single_m 0.0 500.0 /end CHARACTERISTIC
/begin CHARACTERISTIC KfACCS_d_VitualStopDisFrmDCSN "This is only for test
      Vitual Stop distance as KbACCS_UseVitualDCSNInfo=True" VALUE 0x70101108 /* @ECU_Address@KfACCS_d_VitualStopDisFrmDCSN@ */ Scalar_FLOAT32_IEEE 0 ACCS_subsystem_integrated_CM_single_m 0.0 255.0 /end CHARACTERISTIC
/begin CHARACTERISTIC KfACCS_k_DrsdAccelFilter "Filter for acceleration" VALUE 0x70101104 /* @ECU_Address@KfACCS_k_DrsdAccelFilter@ */ Scalar_FLOAT32_IEEE 0 ACCS_subsystem_integrated_CM_single 0.0 1.0 /end CHARACTERISTIC
/begin CHARACTERISTIC KfACCS_k_EgoPitchFilter "Filter for Pitch" VALUE 0x70101100 /* @ECU_Address@KfACCS_k_EgoPitchFilter@ */ Scalar_FLOAT32_IEEE 0 ACCS_subsystem_integrated_CM_single 0.0 1.0 /end CHARACTERISTIC
/begin CHARACTERISTIC KfACCS_k_ObjectAccelFilter "Filter for object acceleration" VALUE 0x701010fc /* @ECU_Address@KfACCS_k_ObjectAccelFilter@ */ Scalar_FLOAT32_IEEE 0 ACCS_subsystem_integrated_CM_single 0.0 1.0 /end CHARACTERISTIC
/begin CHARACTERISTIC KfACCS_k_ObjectRangeFilter "Filter for object range" VALUE 0x701010f8 /* @ECU_Address@KfACCS_k_ObjectRangeFilter@ */ Scalar_FLOAT32_IEEE 0 ACCS_subsystem_integrated_CM_single 0.0 1.0 /end CHARACTERISTIC
/begin CHARACTERISTIC KfACCS_k_ObjectSpdFilter "Filter for object speed" VALUE 0x701010f4 /* @ECU_Address@KfACCS_k_ObjectSpdFilter@ */ Scalar_FLOAT32_IEEE 0 ACCS_subsystem_integrated_CM_single 0.0 1.0 /end CHARACTERISTIC
/begin CHARACTERISTIC KfACCS_t_CIPVChangedTypeDelay "This is the time to determin how long the state of the obstacle change will last" VALUE 0x701010f0 /* @ECU_Address@KfACCS_t_CIPVChangedTypeDelay@ */ Scalar_FLOAT32_IEEE 0 ACCS_subsystem_integrated_CM_single_s 0.0 1200.0 /end CHARACTERISTIC
/begin CHARACTERISTIC KfACCS_t_DtrmSelfChangeLane "If wheel steering bigger than KfACCS_Ang_DtrmSelfChangeLane,timer++, as timer>this calibration, sriver seft change lane" VALUE 0x701010ec /* @ECU_Address@KfACCS_t_DtrmSelfChangeLane@ */ Scalar_FLOAT32_IEEE 0 ACCS_subsystem_integrated_CM_single_s 0.0 100.0 /end CHARACTERISTIC
/begin CHARACTERISTIC KfACCS_t_DtrmSelfChangeLaneDelay "This is delay time to determine whether vehicle is changing lane " VALUE 0x701010e8 /* @ECU_Address@KfACCS_t_DtrmSelfChangeLaneDelay@ */ Scalar_FLOAT32_IEEE 0 ACCS_subsystem_integrated_CM_single_s 0.0 50.0 /end CHARACTERISTIC
/begin CHARACTERISTIC KfACCS_t_EnterLowSpeedDelay "If the Ego speed is smaller than KfACCS_SpdToLowSpdCtrlSpdThrsh under Speed control or KfACCS_FollowingToLowSpdThrsh under following control, the timer will increase,
      as the timer is bingger than this calibration, will enter low speed mode." VALUE 0x701010e4 /* @ECU_Address@KfACCS_t_EnterLowSpeedDelay@ */ Scalar_FLOAT32_IEEE 0 ACCS_subsystem_integrated_CM_single_s 0.0 10.0 /end CHARACTERISTIC
/begin CHARACTERISTIC KfACCS_t_ExitLaunchTimer "If at the launch mode timer than this calibration, will exit launch mode " VALUE 0x701010e0 /* @ECU_Address@KfACCS_t_ExitLaunchTimer@ */ Scalar_FLOAT32_IEEE 0 ACCS_subsystem_integrated_CM_single_s 0.0 1200.0 /end CHARACTERISTIC
/begin CHARACTERISTIC KfACCS_t_ExitLowSpeedDelay "If Ego speed is bigger than KfACCS_LowSpdToSpdCtrlSpdThrsh under speed control or KfACCS_LowSpdToFollowingSpdThrsh under following control, 
      the timer will increase, and timer is bigger than this calibration,will exit low speed mode" VALUE 0x701010dc /* @ECU_Address@KfACCS_t_ExitLowSpeedDelay@ */ Scalar_FLOAT32_IEEE 0 ACCS_subsystem_integrated_CM_single_s 0.0 10.0 /end CHARACTERISTIC
/begin CHARACTERISTIC KfACCS_t_LaunchToLowSpdTm "Under launch mode,Ego_CurrentSpeed<=KfACCS_LaunchToLowSpdSpeedThrsh)and (Ego_CurrentSpeed>KfACCS_MovingMinSpeedThrsh,
      the timer will increase, when the timer is bigger than this calibration, will from launch change to Low speed" VALUE 0x701010d8 /* @ECU_Address@KfACCS_t_LaunchToLowSpdTm@ */ Scalar_FLOAT32_IEEE 0 ACCS_subsystem_integrated_CM_single_s 0.0 1200.0 /end CHARACTERISTIC
/begin CHARACTERISTIC KfACCS_t_LaunchToTempStpTm "Under launch , if Ego_CurrentSpeed<=KfACCS_MovingMinSpeedThrsh, the timer will increase, if 
      the timer is bigger than this calibration, will from launch to Temp stop" VALUE 0x701010d4 /* @ECU_Address@KfACCS_t_LaunchToTempStpTm@ */ Scalar_FLOAT32_IEEE 0 ACCS_subsystem_integrated_CM_single_s 0.0 100.0 /end CHARACTERISTIC
/begin CHARACTERISTIC KfACCS_t_MaxTimerAllowAutoResume "When stop timer bigger than this timer, if the driver want to launch the vehicle, he need
      Press resume switch" VALUE 0x701010d0 /* @ECU_Address@KfACCS_t_MaxTimerAllowAutoResume@ */ Scalar_FLOAT32_IEEE 0 ACCS_subsystem_integrated_CM_single_s 0.0 1200.0 /end CHARACTERISTIC
/begin CHARACTERISTIC KfACCS_t_PressGasPedalHoldTm "If driver has press the gas pedal, we think driver presss the gas pedal during this calibratin timer." VALUE 0x701010cc /* @ECU_Address@KfACCS_t_PressGasPedalHoldTm@ */ Scalar_FLOAT32_IEEE 0 ACCS_subsystem_integrated_CM_single_s 0.0 100.0 /end CHARACTERISTIC
/begin CHARACTERISTIC KfACCS_t_PressResumeHoldTm "If driver has press the resume switch, we think driver presss the resume switch during this calibratin timer." VALUE 0x701010c8 /* @ECU_Address@KfACCS_t_PressResumeHoldTm@ */ Scalar_FLOAT32_IEEE 0 ACCS_subsystem_integrated_CM_single_s 0.0 100.0 /end CHARACTERISTIC
/begin CHARACTERISTIC KfACCS_t_StopTooLongThrsh "If the stop timer is bigger than this calibration, will from stop to enter standby" VALUE 0x701010c4 /* @ECU_Address@KfACCS_t_StopTooLongThrsh@ */ Scalar_FLOAT32_IEEE 0 ACCS_subsystem_integrated_CM_single_s 0.0 1200.0 /end CHARACTERISTIC
/begin CHARACTERISTIC KfACCS_t_TempStpToStpDelay "If the stop timer is bigger than this calibration, will from Temp stop to stop" VALUE 0x701010c0 /* @ECU_Address@KfACCS_t_TempStpToStpDelay@ */ Scalar_FLOAT32_IEEE 0 ACCS_subsystem_integrated_CM_single_s 0.0 1200.0 /end CHARACTERISTIC
/begin CHARACTERISTIC KfACCS_t_TimeGapToCalcRange "This is only for logic test.When KbACCS_CalTimeGap=true,useing this calibration to calculate the range" VALUE 0x701010bc /* @ECU_Address@KfACCS_t_TimeGapToCalcRange@ */ Scalar_FLOAT32_IEEE 0 ACCS_subsystem_integrated_CM_single_s 0.0 10.0 /end CHARACTERISTIC
/begin CHARACTERISTIC KfACCS_t_TimeOffset "This is only for logic test.Please hold the default value" VALUE 0x701010b8 /* @ECU_Address@KfACCS_t_TimeOffset@ */ Scalar_FLOAT32_IEEE 0 ACCS_subsystem_integrated_CM_single_s 0.0 0.5 /end CHARACTERISTIC
/begin CHARACTERISTIC KfACCS_v_CalDriverSetSpeed "When KbACCS_CalDriverSetSpeed=True, the drive speed is from this calibration" VALUE 0x701010b4 /* @ECU_Address@KfACCS_v_CalDriverSetSpeed@ */ Scalar_FLOAT32_IEEE 0 ACCS_subsystem_integrated_CM_single_m_s 0.0 50.0 /end CHARACTERISTIC
/begin CHARACTERISTIC KfACCS_v_ChangedObsVelDiff "This is the velocity difference to determine whether the target is a changed target" VALUE 0x701010b0 /* @ECU_Address@KfACCS_v_ChangedObsVelDiff@ */ Scalar_FLOAT32_IEEE 0 ACCS_subsystem_integrated_CM_single_m_s 0.0 30.0 /end CHARACTERISTIC
/begin CHARACTERISTIC KfACCS_v_DeltaSped_EGMOAndCanThrsh "If speed error beween EGMO and Can bigger than this calibration,ACCS will use Can vehilce speed " VALUE 0x701010ac /* @ECU_Address@KfACCS_v_DeltaSped_EGMOAndCanThrsh@ */ Scalar_FLOAT32_IEEE 0 ACCS_subsystem_integrated_CM_single_m_s 0.0 45.0 /end CHARACTERISTIC
/begin CHARACTERISTIC KfACCS_v_DriverSetSpeedMinThrsh "Driver set speed need bigger than this calibration to enable ACCS control" VALUE 0x701010a8 /* @ECU_Address@KfACCS_v_DriverSetSpeedMinThrsh@ */ Scalar_FLOAT32_IEEE 0 ACCS_subsystem_integrated_CM_single_m_s 0.0 50.0 /end CHARACTERISTIC
/begin CHARACTERISTIC KfACCS_v_EnableACCHiSpdThrsh "The max speed for enable ACCS" VALUE 0x701010a4 /* @ECU_Address@KfACCS_v_EnableACCHiSpdThrsh@ */ Scalar_FLOAT32_IEEE 0 ACCS_subsystem_integrated_CM_single_m_s 0.0 50.0 /end CHARACTERISTIC
/begin CHARACTERISTIC KfACCS_v_EnableACCLoSpdThrsh "The min speed for ACCS" VALUE 0x701010a0 /* @ECU_Address@KfACCS_v_EnableACCLoSpdThrsh@ */ Scalar_FLOAT32_IEEE 0 ACCS_subsystem_integrated_CM_single_m_s 0.0 50.0 /end CHARACTERISTIC
/begin CHARACTERISTIC KfACCS_v_ExitLaunchSpeedThrsh "If the Ego speed is bigger than this cal, will exit launch mode." VALUE 0x7010109c /* @ECU_Address@KfACCS_v_ExitLaunchSpeedThrsh@ */ Scalar_FLOAT32_IEEE 0 ACCS_subsystem_integrated_CM_single_m_s 0.0 50.0 /end CHARACTERISTIC
/begin CHARACTERISTIC KfACCS_v_FlickerRangeEgoSpd "This is the maximum speed of ego car for range flicker function" VALUE 0x70101098 /* @ECU_Address@KfACCS_v_FlickerRangeEgoSpd@ */ Scalar_FLOAT32_IEEE 0 ACCS_subsystem_integrated_CM_single_m_s 0.0 100.0 /end CHARACTERISTIC
/begin CHARACTERISTIC KfACCS_v_FlickerRangeRRForReset "This is the maximum range rate for reset range flicker function" VALUE 0x70101094 /* @ECU_Address@KfACCS_v_FlickerRangeRRForReset@ */ Scalar_FLOAT32_IEEE 0 ACCS_subsystem_integrated_CM_single_m_s -50.0 50.0 /end CHARACTERISTIC
/begin CHARACTERISTIC KfACCS_v_FlickerRangeRateDiffLimit "This is the range rate difference limit of last loop for detecting range flicker function" VALUE 0x70101090 /* @ECU_Address@KfACCS_v_FlickerRangeRateDiffLimit@ */ Scalar_FLOAT32_IEEE 0 ACCS_subsystem_integrated_CM_single_m_s -50.0 50.0 /end CHARACTERISTIC
/begin CHARACTERISTIC KfACCS_v_FlickerRangeRateLimit "This is the range rate limit for detecting range flicker function" VALUE 0x7010108c /* @ECU_Address@KfACCS_v_FlickerRangeRateLimit@ */ Scalar_FLOAT32_IEEE 0 ACCS_subsystem_integrated_CM_single_m_s -50.0 50.0 /end CHARACTERISTIC
/begin CHARACTERISTIC KfACCS_v_FollowingToLowSpdThrsh "If want from following control to low speed mode ,the Ego speed need smaller than this calibration" VALUE 0x70101088 /* @ECU_Address@KfACCS_v_FollowingToLowSpdThrsh@ */ Scalar_FLOAT32_IEEE 0 ACCS_subsystem_integrated_CM_single_m_s 0.0 50.0 /end CHARACTERISTIC
/begin CHARACTERISTIC KfACCS_v_LatSpdDeadband_Max "If the object latteral speed bigger than this calibration, use latteral speed" VALUE 0x70101084 /* @ECU_Address@KfACCS_v_LatSpdDeadband_Max@ */ Scalar_FLOAT32_IEEE 0 ACCS_subsystem_integrated_CM_single_m_s 0.0 50.0 /end CHARACTERISTIC
/begin CHARACTERISTIC KfACCS_v_LatSpdDeadband_Min "If the object latteral speed smaller than this calibration, set latteral speed to 0" VALUE 0x70101080 /* @ECU_Address@KfACCS_v_LatSpdDeadband_Min@ */ Scalar_FLOAT32_IEEE 0 ACCS_subsystem_integrated_CM_single_m_s 0.0 50.0 /end CHARACTERISTIC
/begin CHARACTERISTIC KfACCS_v_LatSpdUpdateThrsh "Only object latteral speed change is bigger than this calibration, set the new latteral speed" VALUE 0x7010107c /* @ECU_Address@KfACCS_v_LatSpdUpdateThrsh@ */ Scalar_FLOAT32_IEEE 0 ACCS_subsystem_integrated_CM_single_m_s -30.0 30.0 /end CHARACTERISTIC
/begin CHARACTERISTIC KfACCS_v_LaunchToLowSpdSpeedThrsh "If want from launch to low speed, the ego speed need smaller tham this calibration" VALUE 0x70101078 /* @ECU_Address@KfACCS_v_LaunchToLowSpdSpeedThrsh@ */ Scalar_FLOAT32_IEEE 0 ACCS_subsystem_integrated_CM_single_m_s 0.0 50.0 /end CHARACTERISTIC
/begin CHARACTERISTIC KfACCS_v_LinearVelocity_PreSet "when KbACCS_UseVirtualObject=true, object LinearVelocity is from this calibration" VALUE 0x70101074 /* @ECU_Address@KfACCS_v_LinearVelocity_PreSet@ */ Scalar_FLOAT32_IEEE 0 ACCS_subsystem_integrated_CM_single_m_s 0.0 50.0 /end CHARACTERISTIC
/begin CHARACTERISTIC KfACCS_v_LowSpdToFollowingSpdThrsh "If want from low speed to following control, the ego and CIPV speed need bigger than this calibration" VALUE 0x70101070 /* @ECU_Address@KfACCS_v_LowSpdToFollowingSpdThrsh@ */ Scalar_FLOAT32_IEEE 0 ACCS_subsystem_integrated_CM_single_m_s 0.0 50.0 /end CHARACTERISTIC
/begin CHARACTERISTIC KfACCS_v_LowSpdToSpdCtrlSpdThrsh "If want from low speed to speed control, the ego current need bigger than this calibration" VALUE 0x7010106c /* @ECU_Address@KfACCS_v_LowSpdToSpdCtrlSpdThrsh@ */ Scalar_FLOAT32_IEEE 0 ACCS_subsystem_integrated_CM_single_m_s 0.0 50.0 /end CHARACTERISTIC
/begin CHARACTERISTIC KfACCS_v_LowSpdToTempStpSpdThrsh "If want from low speed to Temp stop, the ego speed need smaller than this calibration" VALUE 0x70101068 /* @ECU_Address@KfACCS_v_LowSpdToTempStpSpdThrsh@ */ Scalar_FLOAT32_IEEE 0 ACCS_subsystem_integrated_CM_single_m_s 0.0 50.0 /end CHARACTERISTIC
/begin CHARACTERISTIC KfACCS_v_MovingMinSpeedThrsh "If the Ego speed is bigger than this calibration, we think the vehicle is moving" VALUE 0x70101064 /* @ECU_Address@KfACCS_v_MovingMinSpeedThrsh@ */ Scalar_FLOAT32_IEEE 0 ACCS_subsystem_integrated_CM_single_m_s 0.0 50.0 /end CHARACTERISTIC
/begin CHARACTERISTIC KfACCS_v_ObjectSpdUpdateThrsh "Only object Long speed change is bigger than this calibration, set the new long speed" VALUE 0x70101060 /* @ECU_Address@KfACCS_v_ObjectSpdUpdateThrsh@ */ Scalar_FLOAT32_IEEE 0 ACCS_subsystem_integrated_CM_single_m_s -30.0 30.0 /end CHARACTERISTIC
/begin CHARACTERISTIC KfACCS_v_OnToSpdCtrlSpdThrsh "If want from status_on to speed control,the ego current speed need bigger than this calibration" VALUE 0x7010105c /* @ECU_Address@KfACCS_v_OnToSpdCtrlSpdThrsh@ */ Scalar_FLOAT32_IEEE 0 ACCS_subsystem_integrated_CM_single_m_s 0.0 50.0 /end CHARACTERISTIC
/begin CHARACTERISTIC KfACCS_v_RangeRateForApproaching "This is the range rate to determine the status of approaching" VALUE 0x70101058 /* @ECU_Address@KfACCS_v_RangeRateForApproaching@ */ Scalar_FLOAT32_IEEE 0 ACCS_subsystem_integrated_CM_single_m_s -50.0 50.0 /end CHARACTERISTIC
/begin CHARACTERISTIC KfACCS_v_RangeRateForAway "This is the range rate to determine the status of away" VALUE 0x70101054 /* @ECU_Address@KfACCS_v_RangeRateForAway@ */ Scalar_FLOAT32_IEEE 0 ACCS_subsystem_integrated_CM_single_m_s -5.0 5.0 /end CHARACTERISTIC
/begin CHARACTERISTIC KfACCS_v_RangeRate_PreSet "when KbACCS_UseVirtualObject=true, object range rate is from this calibration" VALUE 0x70101050 /* @ECU_Address@KfACCS_v_RangeRate_PreSet@ */ Scalar_FLOAT32_IEEE 0 ACCS_subsystem_integrated_CM_single_m_s -30.0 30.0 /end CHARACTERISTIC
/begin CHARACTERISTIC KfACCS_v_SpdPIDCtrl_SpdErrlimit "Speed error limit for Speed Pid control" VALUE 0x7010104c /* @ECU_Address@KfACCS_v_SpdPIDCtrl_SpdErrlimit@ */ Scalar_FLOAT32_IEEE 0 ACCS_subsystem_integrated_CM_single_m_s 0.0 30.0 /end CHARACTERISTIC
/begin CHARACTERISTIC KfACCS_v_SpdToLowSpdCtrlSpdThrsh "If want from speed control to low speed control, the ego speed need smaller than this calibration" VALUE 0x70101048 /* @ECU_Address@KfACCS_v_SpdToLowSpdCtrlSpdThrsh@ */ Scalar_FLOAT32_IEEE 0 ACCS_subsystem_integrated_CM_single_m_s 0.0 50.0 /end CHARACTERISTIC
/begin CHARACTERISTIC KfACCS_v_TempStpToLaunchSpdThrsh "If want from Temp stop to launch, the driver speed need bigger than this calibration" VALUE 0x70101044 /* @ECU_Address@KfACCS_v_TempStpToLaunchSpdThrsh@ */ Scalar_FLOAT32_IEEE 0 ACCS_subsystem_integrated_CM_single_m_s 0.0 50.0 /end CHARACTERISTIC
/begin CHARACTERISTIC KfACCS_v_VitualSpeedLimitFrmDCSN "This is only for test
      Vitual Speed limit as KbACCS_UseVitualDCSNInfo=True" VALUE 0x70101040 /* @ECU_Address@KfACCS_v_VitualSpeedLimitFrmDCSN@ */ Scalar_FLOAT32_IEEE 0 ACCS_subsystem_integrated_CM_single_m_s 0.0 45.0 /end CHARACTERISTIC
/begin CHARACTERISTIC kfACCS_v_TargetVehicleSpeedHi "The max target speed will limit by this calibration" VALUE 0x70100024 /* @ECU_Address@kfACCS_v_TargetVehicleSpeedHi@ */ Scalar_FLOAT32_IEEE 0 ACCS_subsystem_integrated_CM_single_m_s 0.0 45.0 /end CHARACTERISTIC
/begin CHARACTERISTIC kfACCS_v_TargetVehicleSpeedLo "The min target speed limit by this calibration" VALUE 0x70100020 /* @ECU_Address@kfACCS_v_TargetVehicleSpeedLo@ */ Scalar_FLOAT32_IEEE 0 ACCS_subsystem_integrated_CM_single_m_s 0.0 45.0 /end CHARACTERISTIC
/begin CHARACTERISTIC KeACCS_CalFaultTypeOnlyForTest "This is only for logic test" VALUE 0x7010001d /* @ECU_Address@KeACCS_CalFaultTypeOnlyForTest@ */ Scalar_UBYTE 0 ACCS_subsystem_integrated_CM_uint8 0.0 5.0 /end CHARACTERISTIC
/begin CHARACTERISTIC KeACCS_DriverMode_AllowACCSNum "This is only for logic test.Please hold the default value" VALUE 0x7010001c /* @ECU_Address@KeACCS_DriverMode_AllowACCSNum@ */ Scalar_UBYTE 0 ACCS_subsystem_integrated_CM_uint8 0.0 15.0 /end CHARACTERISTIC
/begin CHARACTERISTIC KeACCS_GearDriveNum "The cal need equal to the D gear value from Can bus
      At current period, it is only for logic test" VALUE 0x7010001b /* @ECU_Address@KeACCS_GearDriveNum@ */ Scalar_UBYTE 0 ACCS_subsystem_integrated_CM_uint8 0.0 15.0 /end CHARACTERISTIC
/begin CHARACTERISTIC KeACCS_OutPutControlSignal "0:Acceleration
      1:Torq" VALUE 0x7010001a /* @ECU_Address@KeACCS_OutPutControlSignal@ */ Scalar_UBYTE 0 ACCS_subsystem_integrated_CM_uint8 0.0 4.0 /end CHARACTERISTIC
/begin CHARACTERISTIC KeACCS_RRCalMetdType "0:Frist cal delta V_x and delta V_y, then cal range rate
      1:Directly use CIPV speed sub Ego speed" VALUE 0x70100019 /* @ECU_Address@KeACCS_RRCalMetdType@ */ Scalar_UBYTE 0 ACCS_subsystem_integrated_CM_uint8 0.0 2.0 /end CHARACTERISTIC
/begin CHARACTERISTIC KeACCS_TargetRangeCalType "0:Use lookup table KtACCS_d_CIPVTargtRange
      1: Use CIPV velocity * Timegap" VALUE 0x70100018 /* @ECU_Address@KeACCS_TargetRangeCalType@ */ Scalar_UBYTE 0 ACCS_subsystem_integrated_CM_uint8 0.0 4.0 /end CHARACTERISTIC
/begin CHARACTERISTIC KeACCS_VehicleSpeedSource "0:Vehicle speed from EGMO
      1:Vehicle speed from Can bus" VALUE 0x70100017 /* @ECU_Address@KeACCS_VehicleSpeedSource@ */ Scalar_UBYTE 0 ACCS_subsystem_integrated_CM_uint8 0.0 4.0 /end CHARACTERISTIC
/begin CHARACTERISTIC KbACCS_AEBStateFrmCal "This cal is only for logic Test.Ture: AEB active for ACC,False: AEB inactive for ACC." VALUE 0x70100016 /* @ECU_Address@KbACCS_AEBStateFrmCal@ */ Scalar_BOOLEAN 0 ACCS_subsystem_integrated_CM_boolean 0.0 1.0 /end CHARACTERISTIC
/begin CHARACTERISTIC KbACCS_AllowOnToStop "True: Allow enable ACC during vehicle speed=0" VALUE 0x70100015 /* @ECU_Address@KbACCS_AllowOnToStop@ */ Scalar_BOOLEAN 0 ACCS_subsystem_integrated_CM_boolean 0.0 1.0 /end CHARACTERISTIC
/begin CHARACTERISTIC KbACCS_CalCIPV_FlickState "This cal is only for logic Test.True: Object fick, Run status woudle from following ctrl to Speeed ctrl" VALUE 0x70100014 /* @ECU_Address@KbACCS_CalCIPV_FlickState@ */ Scalar_BOOLEAN 0 ACCS_subsystem_integrated_CM_boolean 0.0 1.0 /end CHARACTERISTIC
/begin CHARACTERISTIC KbACCS_CalDriverSetSpeed "True: Driver set speed is from calibration KfACCS_CalDriverSetSpeed.
      False: Driver set speed is from can." VALUE 0x70100013 /* @ECU_Address@KbACCS_CalDriverSetSpeed@ */ Scalar_BOOLEAN 0 ACCS_subsystem_integrated_CM_boolean 0.0 1.0 /end CHARACTERISTIC
/begin CHARACTERISTIC KbACCS_CalFaultTypeOnlyForTest "This cal is only for logic Test.True: Has fault to ACCS." VALUE 0x70100012 /* @ECU_Address@KbACCS_CalFaultTypeOnlyForTest@ */ Scalar_BOOLEAN 0 ACCS_subsystem_integrated_CM_boolean 0.0 1.0 /end CHARACTERISTIC
/begin CHARACTERISTIC KbACCS_CalTimeGap "True: Time gap is from calibration kfACCS_TimeGapToCalcRange.
      False: Time gap is from can." VALUE 0x70100011 /* @ECU_Address@KbACCS_CalTimeGap@ */ Scalar_BOOLEAN 0 ACCS_subsystem_integrated_CM_boolean 0.0 1.0 /end CHARACTERISTIC
/begin CHARACTERISTIC KbACCS_CancelSwitch "True: Cancel switch is set.
      " VALUE 0x70100010 /* @ECU_Address@KbACCS_CancelSwitch@ */ Scalar_BOOLEAN 0 ACCS_subsystem_integrated_CM_boolean 0.0 1.0 /end CHARACTERISTIC
/begin CHARACTERISTIC KbACCS_ConsiderSIPVforACC "True:Will consider CIPV and SIPV as calculating acceleration.
      At current period, please hold False" VALUE 0x7010000f /* @ECU_Address@KbACCS_ConsiderSIPVforACC@ */ Scalar_BOOLEAN 0 ACCS_subsystem_integrated_CM_boolean 0.0 1.0 /end CHARACTERISTIC
/begin CHARACTERISTIC KbACCS_ConsiderWithEPB "0: EPB allways Release status;
      1: Will use real EPB signal" VALUE 0x7010000e /* @ECU_Address@KbACCS_ConsiderWithEPB@ */ Scalar_BOOLEAN 0 ACCS_subsystem_integrated_CM_boolean 0.0 1.0 /end CHARACTERISTIC
/begin CHARACTERISTIC KbACCS_ConsiderWithoutGear "0: Will consider Gear, only D can enable ACCS control;
      1: Will bypass Gear conditions." VALUE 0x7010000d /* @ECU_Address@KbACCS_ConsiderWithoutGear@ */ Scalar_BOOLEAN 0 ACCS_subsystem_integrated_CM_boolean 0.0 1.0 /end CHARACTERISTIC
/begin CHARACTERISTIC KbACCS_DriverDoorBeltState "Ture:Door and belt is engaged
      False:Door open
      This is only for logic test" VALUE 0x7010000c /* @ECU_Address@KbACCS_DriverDoorBeltState@ */ Scalar_BOOLEAN 0 ACCS_subsystem_integrated_CM_boolean 0.0 1.0 /end CHARACTERISTIC
/begin CHARACTERISTIC KbACCS_EnableLowSpeedCtrl "True:Allow Low speed ctrl" VALUE 0x7010000b /* @ECU_Address@KbACCS_EnableLowSpeedCtrl@ */ Scalar_BOOLEAN 0 ACCS_subsystem_integrated_CM_boolean 0.0 1.0 /end CHARACTERISTIC
/begin CHARACTERISTIC KbACCS_EnblSlopeOfst "True:Will consider with pitch as calculation acceleration." VALUE 0x7010000a /* @ECU_Address@KbACCS_EnblSlopeOfst@ */ Scalar_BOOLEAN 0 ACCS_subsystem_integrated_CM_boolean 0.0 1.0 /end CHARACTERISTIC
/begin CHARACTERISTIC KbACCS_ForceExitStandby "This is only for test
      If Ture, force exit standby mode" VALUE 0x70100009 /* @ECU_Address@KbACCS_ForceExitStandby@ */ Scalar_BOOLEAN 0 ACCS_subsystem_integrated_CM_boolean 0.0 1.0 /end CHARACTERISTIC
/begin CHARACTERISTIC KbACCS_MainSwitch "Ture:Main switch is on" VALUE 0x70100008 /* @ECU_Address@KbACCS_MainSwitch@ */ Scalar_BOOLEAN 0 ACCS_subsystem_integrated_CM_boolean 0.0 1.0 /end CHARACTERISTIC
/begin CHARACTERISTIC KbACCS_NotAllowEnterStandbyForUSDemo "This calibration is only for US demo.US demo should set 1;Other normal project should hold the default value 0." VALUE 0x70100007 /* @ECU_Address@KbACCS_NotAllowEnterStandbyForUSDemo@ */ Scalar_BOOLEAN 0 ACCS_subsystem_integrated_CM_boolean 0.0 1.0 /end CHARACTERISTIC
/begin CHARACTERISTIC KbACCS_ResumeSwitch "True:Resume switch is set" VALUE 0x70100006 /* @ECU_Address@KbACCS_ResumeSwitch@ */ Scalar_BOOLEAN 0 ACCS_subsystem_integrated_CM_boolean 0.0 1.0 /end CHARACTERISTIC
/begin CHARACTERISTIC KbACCS_UseCIPVAccelToCalOpenAccel "True: Directly use CIPV acceleration as open acceleration" VALUE 0x70100005 /* @ECU_Address@KbACCS_UseCIPVAccelToCalOpenAccel@ */ Scalar_BOOLEAN 0 ACCS_subsystem_integrated_CM_boolean 0.0 1.0 /end CHARACTERISTIC
/begin CHARACTERISTIC KbACCS_UseStopStatus_Accel "True:Set accel to the calibration during stop mode" VALUE 0x70100004 /* @ECU_Address@KbACCS_UseStopStatus_Accel@ */ Scalar_BOOLEAN 0 ACCS_subsystem_integrated_CM_boolean 0.0 1.0 /end CHARACTERISTIC
/begin CHARACTERISTIC KbACCS_UseVirtualObject "This is noly for logic test.
      True: Use virtual object.
      False: Use the actual object.
      " VALUE 0x70100003 /* @ECU_Address@KbACCS_UseVirtualObject@ */ Scalar_BOOLEAN 0 ACCS_subsystem_integrated_CM_boolean 0.0 1.0 /end CHARACTERISTIC
/begin CHARACTERISTIC KbACCS_UseVirtualPedal "This is only for test
      If Ture,the gas pedal is from the calibration KfACCS_Pct_VirtualGasPedal" VALUE 0x70100002 /* @ECU_Address@KbACCS_UseVirtualPedal@ */ Scalar_BOOLEAN 0 ACCS_subsystem_integrated_CM_boolean 0.0 1.0 /end CHARACTERISTIC
/begin CHARACTERISTIC KbACCS_UseVitualDCSNInfo "This is only for test
      True: Use virtula information, not from DCSN" VALUE 0x70100001 /* @ECU_Address@KbACCS_UseVitualDCSNInfo@ */ Scalar_BOOLEAN 0 ACCS_subsystem_integrated_CM_boolean 0.0 1.0 /end CHARACTERISTIC
/begin CHARACTERISTIC KbACCS_VitualStopReqFrmDCSN "This is only for test.
      True: Stop request is true" VALUE 0x70100000 /* @ECU_Address@KbACCS_VitualStopReqFrmDCSN@ */ Scalar_BOOLEAN 0 ACCS_subsystem_integrated_CM_boolean 0.0 1.0 /end CHARACTERISTIC
/begin CHARACTERISTIC KtAEBS_DoRbIW_width_tb "" CURVE 0x7010138c /* @ECU_Address@KtAEBS_DoRbIW_width_tb@ */ Lookup1D_FLOAT32_IEEE 0 AEBS_subsystem_integrated_CM_single -3.4E+38 3.4E+38
 /begin AXIS_DESCR COM_AXIS NO_INPUT_QUANTITY AEBS_subsystem_integrated_CM_single 10 -3.4E+38 3.4E+38 AXIS_PTS_REF KaAEBS_AXIS_Veh_Curvature_vec /end AXIS_DESCR
/end CHARACTERISTIC
/begin CHARACTERISTIC KtAEBS_InnerRadiusOffset_tb "" MAP 0x70101224 /* @ECU_Address@KtAEBS_InnerRadiusOffset_tb@ */ Lookup2D_FLOAT32_IEEE 0 AEBS_subsystem_integrated_CM_single -3.4E+38 3.4E+38
 /begin AXIS_DESCR COM_AXIS VfAEBS_veh_speed_used AEBS_subsystem_integrated_CM_single 9 -3.4E+38 3.4E+38 AXIS_PTS_REF KaAEBS_AXIS_Veh_Speed_vec /end AXIS_DESCR
 /begin AXIS_DESCR COM_AXIS NO_INPUT_QUANTITY AEBS_subsystem_integrated_CM_single 10 -3.4E+38 3.4E+38 AXIS_PTS_REF KaAEBS_AXIS_Veh_Curvature_vec /end AXIS_DESCR
/end CHARACTERISTIC
/begin CHARACTERISTIC KtAEBS_veh_widthGain "" CURVE 0x701011d8 /* @ECU_Address@KtAEBS_veh_widthGain@ */ Lookup1D_FLOAT32_IEEE 0 AEBS_subsystem_integrated_CM_single -3.4E+38 3.4E+38
 /begin AXIS_DESCR COM_AXIS VfAEBS_veh_speed_used AEBS_subsystem_integrated_CM_single 9 -3.4E+38 3.4E+38 AXIS_PTS_REF KaAEBS_AXIS_Veh_Speed_vec /end AXIS_DESCR
/end CHARACTERISTIC
/begin CHARACTERISTIC KfAEBS_CTRL_PeriodFunctionCall "System sample period." VALUE 0x70101548 /* @ECU_Address@KfAEBS_CTRL_PeriodFunctionCall@ */ Scalar_FLOAT32_IEEE 0 AEBS_subsystem_integrated_CM_single -3.4E+38 3.4E+38 /end CHARACTERISTIC
/begin CHARACTERISTIC KfAEBS_CoeffStrwhl2Radius "When there's no EGMO, steer wheel angle is used to calculate Radius,
      Coefficent correction of radius." VALUE 0x7010153c /* @ECU_Address@KfAEBS_CoeffStrwhl2Radius@ */ Scalar_FLOAT32_IEEE 0 AEBS_subsystem_integrated_CM_single -3.4E+38 3.4E+38 /end CHARACTERISTIC
/begin CHARACTERISTIC KfAEBS_Cur_LeftTurnThrshHi "Curvature left turn threshold High" VALUE 0x70101538 /* @ECU_Address@KfAEBS_Cur_LeftTurnThrshHi@ */ Scalar_FLOAT32_IEEE 0 AEBS_subsystem_integrated_CM_single -3.4E+38 3.4E+38 /end CHARACTERISTIC
/begin CHARACTERISTIC KfAEBS_Cur_LeftTurnThrshLo "Curvature left turn threshold low" VALUE 0x70101534 /* @ECU_Address@KfAEBS_Cur_LeftTurnThrshLo@ */ Scalar_FLOAT32_IEEE 0 AEBS_subsystem_integrated_CM_single -3.4E+38 3.4E+38 /end CHARACTERISTIC
/begin CHARACTERISTIC KfAEBS_Cur_RightTurnThrshHi "Curvature right turn threshold high" VALUE 0x70101530 /* @ECU_Address@KfAEBS_Cur_RightTurnThrshHi@ */ Scalar_FLOAT32_IEEE 0 AEBS_subsystem_integrated_CM_single -3.4E+38 3.4E+38 /end CHARACTERISTIC
/begin CHARACTERISTIC KfAEBS_Cur_RightTurnThrshLo "Curvature right turn threshold low" VALUE 0x7010152c /* @ECU_Address@KfAEBS_Cur_RightTurnThrshLo@ */ Scalar_FLOAT32_IEEE 0 AEBS_subsystem_integrated_CM_single -3.4E+38 3.4E+38 /end CHARACTERISTIC
/begin CHARACTERISTIC KfAEBS_Default_AEB_acceleration_req "Default AEB acceleration req" VALUE 0x70101528 /* @ECU_Address@KfAEBS_Default_AEB_acceleration_req@ */ Scalar_FLOAT32_IEEE 0 AEBS_subsystem_integrated_CM_single -3.4E+38 3.4E+38 /end CHARACTERISTIC
/begin CHARACTERISTIC KfAEBS_GainTHW "GainTHW" VALUE 0x70101524 /* @ECU_Address@KfAEBS_GainTHW@ */ Scalar_FLOAT32_IEEE 0 AEBS_subsystem_integrated_CM_single -3.4E+38 3.4E+38 /end CHARACTERISTIC
/begin CHARACTERISTIC KfAEBS_GainTTC "GainTTC" VALUE 0x70101520 /* @ECU_Address@KfAEBS_GainTTC@ */ Scalar_FLOAT32_IEEE 0 AEBS_subsystem_integrated_CM_single -3.4E+38 3.4E+38 /end CHARACTERISTIC
/begin CHARACTERISTIC KfAEBS_Obj_BBoxOffsetBicycle "Object Bounding Box offest Bicycle( 1 == not change)" VALUE 0x7010151c /* @ECU_Address@KfAEBS_Obj_BBoxOffsetBicycle@ */ Scalar_FLOAT32_IEEE 0 AEBS_subsystem_integrated_CM_single -3.4E+38 3.4E+38 /end CHARACTERISTIC
/begin CHARACTERISTIC KfAEBS_Obj_BBoxOffsetBus "Object Bounding Box offest Bus( 1 == not change)" VALUE 0x70101518 /* @ECU_Address@KfAEBS_Obj_BBoxOffsetBus@ */ Scalar_FLOAT32_IEEE 0 AEBS_subsystem_integrated_CM_single -3.4E+38 3.4E+38 /end CHARACTERISTIC
/begin CHARACTERISTIC KfAEBS_Obj_BBoxOffsetDefault "Object Bounding Box offest default( 1 == not change)" VALUE 0x70101514 /* @ECU_Address@KfAEBS_Obj_BBoxOffsetDefault@ */ Scalar_FLOAT32_IEEE 0 AEBS_subsystem_integrated_CM_single -3.4E+38 3.4E+38 /end CHARACTERISTIC
/begin CHARACTERISTIC KfAEBS_Obj_BBoxOffsetMotoRcycle "Object Bounding Box offest MotoRcycle( 1 == not change)" VALUE 0x70101510 /* @ECU_Address@KfAEBS_Obj_BBoxOffsetMotoRcycle@ */ Scalar_FLOAT32_IEEE 0 AEBS_subsystem_integrated_CM_single -3.4E+38 3.4E+38 /end CHARACTERISTIC
/begin CHARACTERISTIC KfAEBS_Obj_BBoxOffsetPedstrn "Object Bounding Box offest pedestrain( 1 == not change)" VALUE 0x7010150c /* @ECU_Address@KfAEBS_Obj_BBoxOffsetPedstrn@ */ Scalar_FLOAT32_IEEE 0 AEBS_subsystem_integrated_CM_single -3.4E+38 3.4E+38 /end CHARACTERISTIC
/begin CHARACTERISTIC KfAEBS_Obj_BBoxOffsetPedstrn_turn "" VALUE 0x70101508 /* @ECU_Address@KfAEBS_Obj_BBoxOffsetPedstrn_turn@ */ Scalar_FLOAT32_IEEE 0 AEBS_subsystem_integrated_CM_single -3.4E+38 3.4E+38 /end CHARACTERISTIC
/begin CHARACTERISTIC KfAEBS_Obj_BBoxOffsetTruck "Object Bounding Box offest truck( 1 == not change)" VALUE 0x70101504 /* @ECU_Address@KfAEBS_Obj_BBoxOffsetTruck@ */ Scalar_FLOAT32_IEEE 0 AEBS_subsystem_integrated_CM_single -3.4E+38 3.4E+38 /end CHARACTERISTIC
/begin CHARACTERISTIC KfAEBS_Obj_BBoxOffsetVeh "Object Bounding Box offest vehicle( 1 == not change)" VALUE 0x70101500 /* @ECU_Address@KfAEBS_Obj_BBoxOffsetVeh@ */ Scalar_FLOAT32_IEEE 0 AEBS_subsystem_integrated_CM_single -3.4E+38 3.4E+38 /end CHARACTERISTIC
/begin CHARACTERISTIC KfAEBS_Pedstr_length_Thrsh "" VALUE 0x701014fc /* @ECU_Address@KfAEBS_Pedstr_length_Thrsh@ */ Scalar_FLOAT32_IEEE 0 AEBS_subsystem_integrated_CM_single -3.4E+38 3.4E+38 /end CHARACTERISTIC
/begin CHARACTERISTIC KfAEBS_Pedstr_width_Thrsh "" VALUE 0x701014f8 /* @ECU_Address@KfAEBS_Pedstr_width_Thrsh@ */ Scalar_FLOAT32_IEEE 0 AEBS_subsystem_integrated_CM_single -3.4E+38 3.4E+38 /end CHARACTERISTIC
/begin CHARACTERISTIC KfAEBS_RadiusOffsetOuter "Obj in path, radius offest outer" VALUE 0x701014f4 /* @ECU_Address@KfAEBS_RadiusOffsetOuter@ */ Scalar_FLOAT32_IEEE 0 AEBS_subsystem_integrated_CM_single -3.4E+38 3.4E+38 /end CHARACTERISTIC
/begin CHARACTERISTIC KfAEBS_Veh_DisEnd2OC "" VALUE 0x701014d0 /* @ECU_Address@KfAEBS_Veh_DisEnd2OC@ */ Scalar_FLOAT32_IEEE 0 AEBS_subsystem_integrated_CM_single -3.4E+38 3.4E+38 /end CHARACTERISTIC
/begin CHARACTERISTIC KfAEBS_Veh_DisHead2OC "" VALUE 0x701014cc /* @ECU_Address@KfAEBS_Veh_DisHead2OC@ */ Scalar_FLOAT32_IEEE 0 AEBS_subsystem_integrated_CM_single -3.4E+38 3.4E+38 /end CHARACTERISTIC
/begin CHARACTERISTIC KfAEBS_Veh_DisRear2COM "" VALUE 0x701014c8 /* @ECU_Address@KfAEBS_Veh_DisRear2COM@ */ Scalar_FLOAT32_IEEE 0 AEBS_subsystem_integrated_CM_single -3.4E+38 3.4E+38 /end CHARACTERISTIC
/begin CHARACTERISTIC KfAEBS_Veh_DisRear2OC "" VALUE 0x701014c4 /* @ECU_Address@KfAEBS_Veh_DisRear2OC@ */ Scalar_FLOAT32_IEEE 0 AEBS_subsystem_integrated_CM_single -3.4E+38 3.4E+38 /end CHARACTERISTIC
/begin CHARACTERISTIC KfAEBS_Veh_Length "" VALUE 0x701014c0 /* @ECU_Address@KfAEBS_Veh_Length@ */ Scalar_FLOAT32_IEEE 0 AEBS_subsystem_integrated_CM_single -3.4E+38 3.4E+38 /end CHARACTERISTIC
/begin CHARACTERISTIC KfAEBS_Veh_Strwhl2FrtwhlRatio "" VALUE 0x701014bc /* @ECU_Address@KfAEBS_Veh_Strwhl2FrtwhlRatio@ */ Scalar_FLOAT32_IEEE 0 AEBS_subsystem_integrated_CM_single -3.4E+38 3.4E+38 /end CHARACTERISTIC
/begin CHARACTERISTIC KfAEBS_Veh_WheelBase "" VALUE 0x701014b8 /* @ECU_Address@KfAEBS_Veh_WheelBase@ */ Scalar_FLOAT32_IEEE 0 AEBS_subsystem_integrated_CM_single -3.4E+38 3.4E+38 /end CHARACTERISTIC
/begin CHARACTERISTIC KfAEBS_Veh_Width "" VALUE 0x701014b4 /* @ECU_Address@KfAEBS_Veh_Width@ */ Scalar_FLOAT32_IEEE 0 AEBS_subsystem_integrated_CM_single -3.4E+38 3.4E+38 /end CHARACTERISTIC
/begin CHARACTERISTIC KfAEBS_Veh_WidthBuffer "" VALUE 0x701014b0 /* @ECU_Address@KfAEBS_Veh_WidthBuffer@ */ Scalar_FLOAT32_IEEE 0 AEBS_subsystem_integrated_CM_single -3.4E+38 3.4E+38 /end CHARACTERISTIC
/begin CHARACTERISTIC KfAEBS_Zone_DoRbIW_x_front "" VALUE 0x701014a0 /* @ECU_Address@KfAEBS_Zone_DoRbIW_x_front@ */ Scalar_FLOAT32_IEEE 0 AEBS_subsystem_integrated_CM_single -3.4E+38 3.4E+38 /end CHARACTERISTIC
/begin CHARACTERISTIC KfAEBS_Zone_DoRbIW_x_rear "" VALUE 0x7010149c /* @ECU_Address@KfAEBS_Zone_DoRbIW_x_rear@ */ Scalar_FLOAT32_IEEE 0 AEBS_subsystem_integrated_CM_single -3.4E+38 3.4E+38 /end CHARACTERISTIC
/begin CHARACTERISTIC KfAEBS_a_BrakeHold "Acceleration send when vehicle is standstill" VALUE 0x70101480 /* @ECU_Address@KfAEBS_a_BrakeHold@ */ Scalar_FLOAT32_IEEE 0 AEBS_subsystem_integrated_CM_single -3.4E+38 3.4E+38 /end CHARACTERISTIC
/begin CHARACTERISTIC KfAEBS_d_Dis_BufferTTSP "Distance Buffer when calculate TTSP lateral" VALUE 0x7010145c /* @ECU_Address@KfAEBS_d_Dis_BufferTTSP@ */ Scalar_FLOAT32_IEEE 0 AEBS_subsystem_integrated_CM_single -3.4E+38 3.4E+38 /end CHARACTERISTIC
/begin CHARACTERISTIC KfAEBS_d_Dis_BufferTTSP_length "Distance Buffer when calculate TTSP long" VALUE 0x70101458 /* @ECU_Address@KfAEBS_d_Dis_BufferTTSP_length@ */ Scalar_FLOAT32_IEEE 0 AEBS_subsystem_integrated_CM_single -3.4E+38 3.4E+38 /end CHARACTERISTIC
/begin CHARACTERISTIC KfAEBS_d_Dis_LateralIgnore "Distance Lateral Ignore" VALUE 0x70101454 /* @ECU_Address@KfAEBS_d_Dis_LateralIgnore@ */ Scalar_FLOAT32_IEEE 0 AEBS_subsystem_integrated_CM_single -3.4E+38 3.4E+38 /end CHARACTERISTIC
/begin CHARACTERISTIC KfAEBS_d_min_dis_swap "" VALUE 0x7010144c /* @ECU_Address@KfAEBS_d_min_dis_swap@ */ Scalar_FLOAT32_IEEE 0 AEBS_subsystem_integrated_CM_single -3.4E+38 3.4E+38 /end CHARACTERISTIC
/begin CHARACTERISTIC KfAEBS_t_TimeBrakeConfdConfirmed "" VALUE 0x70101414 /* @ECU_Address@KfAEBS_t_TimeBrakeConfdConfirmed@ */ Scalar_FLOAT32_IEEE 0 AEBS_subsystem_integrated_CM_single -3.4E+38 3.4E+38 /end CHARACTERISTIC
/begin CHARACTERISTIC KfAEBS_t_TimeExitActide "" VALUE 0x7010140c /* @ECU_Address@KfAEBS_t_TimeExitActide@ */ Scalar_FLOAT32_IEEE 0 AEBS_subsystem_integrated_CM_single -3.4E+38 3.4E+38 /end CHARACTERISTIC
/begin CHARACTERISTIC KfAEBS_t_TimeWait2StandbyThrsh "" VALUE 0x70101408 /* @ECU_Address@KfAEBS_t_TimeWait2StandbyThrsh@ */ Scalar_FLOAT32_IEEE 0 AEBS_subsystem_integrated_CM_single -3.4E+38 3.4E+38 /end CHARACTERISTIC
/begin CHARACTERISTIC KfAEBS_t_Time_OBFUNReceivedThrsh "OBFU not receive time out" VALUE 0x701013f4 /* @ECU_Address@KfAEBS_t_Time_OBFUNReceivedThrsh@ */ Scalar_FLOAT32_IEEE 0 AEBS_subsystem_integrated_CM_single -3.4E+38 3.4E+38 /end CHARACTERISTIC
/begin CHARACTERISTIC KfAEBS_t_timeGap_ignore_turn "" VALUE 0x701013d8 /* @ECU_Address@KfAEBS_t_timeGap_ignore_turn@ */ Scalar_FLOAT32_IEEE 0 AEBS_subsystem_integrated_CM_single -3.4E+38 3.4E+38 /end CHARACTERISTIC
/begin CHARACTERISTIC KfAEBS_v_Speed_DeltaWExit "Delta speed warning exit, if front veh's speed is larger than ego, fornt veh can be filterd" VALUE 0x701013c4 /* @ECU_Address@KfAEBS_v_Speed_DeltaWExit@ */ Scalar_FLOAT32_IEEE 0 AEBS_subsystem_integrated_CM_single -3.4E+38 3.4E+38 /end CHARACTERISTIC
/begin CHARACTERISTIC KfAEBS_v_Speed_ObjStillThrsh "Obj speed threshold to be estimated as standstill in long" VALUE 0x701013bc /* @ECU_Address@KfAEBS_v_Speed_ObjStillThrsh@ */ Scalar_FLOAT32_IEEE 0 AEBS_subsystem_integrated_CM_single -3.4E+38 3.4E+38 /end CHARACTERISTIC
/begin CHARACTERISTIC KfAEBS_v_Speed_ObjStillThrshLateral "Obj speed threshold to be estimated as standstill in lateral" VALUE 0x701013b8 /* @ECU_Address@KfAEBS_v_Speed_ObjStillThrshLateral@ */ Scalar_FLOAT32_IEEE 0 AEBS_subsystem_integrated_CM_single -3.4E+38 3.4E+38 /end CHARACTERISTIC
/begin CHARACTERISTIC KfAEBS_Default_AEBS_obj_ID "Default AEBS obj ID" VALUE 0x701011d4 /* @ECU_Address@KfAEBS_Default_AEBS_obj_ID@ */ Scalar_LONG 0 AEBS_subsystem_integrated_CM_int32 -2147483648 2147483647 /end CHARACTERISTIC
/begin CHARACTERISTIC KfAEBS_Default_AEB_enabled_state "Default AEB enabled state" VALUE 0x701011d0 /* @ECU_Address@KfAEBS_Default_AEB_enabled_state@ */ Scalar_LONG 0 AEBS_subsystem_integrated_CM_EnumAEBS_EnblState 0 2 /end CHARACTERISTIC
/begin CHARACTERISTIC KfAEBS_Default_FCW_enable_state "Default FCW enable state" VALUE 0x701011cc /* @ECU_Address@KfAEBS_Default_FCW_enable_state@ */ Scalar_LONG 0 AEBS_subsystem_integrated_CM_EnumAEBS_EnblState 0 2 /end CHARACTERISTIC
/begin CHARACTERISTIC KfAEBS_Default_AEB_actived_state "Default AEB actived state" VALUE 0x701011c8 /* @ECU_Address@KfAEBS_Default_AEB_actived_state@ */ Scalar_LONG 0 AEBS_subsystem_integrated_CM_EnumAEBS_AEBState 0 6 /end CHARACTERISTIC
/begin CHARACTERISTIC KfAEBS_Default_AEB_error "Default AEB error" VALUE 0x701011c5 /* @ECU_Address@KfAEBS_Default_AEB_error@ */ Scalar_UBYTE 0 AEBS_subsystem_integrated_CM_uint8 0 255 /end CHARACTERISTIC
/begin CHARACTERISTIC KfAEBS_Default_FCW_error "Default FCW error" VALUE 0x701011c4 /* @ECU_Address@KfAEBS_Default_FCW_error@ */ Scalar_UBYTE 0 AEBS_subsystem_integrated_CM_uint8 0 255 /end CHARACTERISTIC
/begin CHARACTERISTIC KfAEBS_Default_FCW_warn_level "Default FCW warn level" VALUE 0x701011c3 /* @ECU_Address@KfAEBS_Default_FCW_warn_level@ */ Scalar_UBYTE 0 AEBS_subsystem_integrated_CM_uint8 0 255 /end CHARACTERISTIC
/begin CHARACTERISTIC KbAEBS_Default_AEB_brakeLight_req "Default AEB brakeLight req" VALUE 0x701011bc /* @ECU_Address@KbAEBS_Default_AEB_brakeLight_req@ */ Scalar_BOOLEAN 0 AEBS_subsystem_integrated_CM_boolean 0 1 /end CHARACTERISTIC
/begin CHARACTERISTIC KbAEBS_Default_AEB_prebrake_req "Default AEB prebrake req" VALUE 0x701011bb /* @ECU_Address@KbAEBS_Default_AEB_prebrake_req@ */ Scalar_BOOLEAN 0 AEBS_subsystem_integrated_CM_boolean 0 1 /end CHARACTERISTIC
/begin CHARACTERISTIC KbAEBS_Default_AEB_request "Default AEB request" VALUE 0x701011ba /* @ECU_Address@KbAEBS_Default_AEB_request@ */ Scalar_BOOLEAN 0 AEBS_subsystem_integrated_CM_boolean 0 1 /end CHARACTERISTIC
/begin CHARACTERISTIC KbAEBS_Default_FCW_requset "Default FCW requset" VALUE 0x701011b9 /* @ECU_Address@KbAEBS_Default_FCW_requset@ */ Scalar_BOOLEAN 0 AEBS_subsystem_integrated_CM_boolean 0 1 /end CHARACTERISTIC
/begin CHARACTERISTIC KbAEBS_EnableBrakeHold "The vehicle support control of EPB" VALUE 0x701011b8 /* @ECU_Address@KbAEBS_EnableBrakeHold@ */ Scalar_BOOLEAN 0 AEBS_subsystem_integrated_CM_boolean 0 1 /end CHARACTERISTIC
/begin CHARACTERISTIC KbAEBS_Enable_AEB_feature "" VALUE 0x701011b7 /* @ECU_Address@KbAEBS_Enable_AEB_feature@ */ Scalar_BOOLEAN 0 AEBS_subsystem_integrated_CM_boolean 0 1 /end CHARACTERISTIC
/begin CHARACTERISTIC KbAEBS_Enable_DoRbIW "" VALUE 0x701011b6 /* @ECU_Address@KbAEBS_Enable_DoRbIW@ */ Scalar_BOOLEAN 0 AEBS_subsystem_integrated_CM_boolean 0 1 /end CHARACTERISTIC
/begin CHARACTERISTIC KbAEBS_Enable_DoRbIW_LeftTurn "" VALUE 0x701011b5 /* @ECU_Address@KbAEBS_Enable_DoRbIW_LeftTurn@ */ Scalar_BOOLEAN 0 AEBS_subsystem_integrated_CM_boolean 0 1 /end CHARACTERISTIC
/begin CHARACTERISTIC KbAEBS_Enable_Error "" VALUE 0x701011b4 /* @ECU_Address@KbAEBS_Enable_Error@ */ Scalar_BOOLEAN 0 AEBS_subsystem_integrated_CM_boolean 0 1 /end CHARACTERISTIC
/begin CHARACTERISTIC KbAEBS_Test_Mode "" VALUE 0x701011b1 /* @ECU_Address@KbAEBS_Test_Mode@ */ Scalar_BOOLEAN 0 AEBS_subsystem_integrated_CM_boolean 0 1 /end CHARACTERISTIC
/begin CHARACTERISTIC KbAEBS_Use_OBFU_Acceleration "" VALUE 0x701011b0 /* @ECU_Address@KbAEBS_Use_OBFU_Acceleration@ */ Scalar_BOOLEAN 0 AEBS_subsystem_integrated_CM_boolean 0 1 /end CHARACTERISTIC
/begin CHARACTERISTIC KbAEBS_Use_OBFU_Type "" VALUE 0x701011af /* @ECU_Address@KbAEBS_Use_OBFU_Type@ */ Scalar_BOOLEAN 0 AEBS_subsystem_integrated_CM_boolean 0 1 /end CHARACTERISTIC
/begin CHARACTERISTIC KfAEBS_Default_FCW_active_state "Default FCW active state" VALUE 0x701011ac /* @ECU_Address@KfAEBS_Default_FCW_active_state@ */ Scalar_UBYTE 0 AEBS_subsystem_integrated_CM_EnumAEBS_FCWState 0 5 /end CHARACTERISTIC
/begin AXIS_PTS KtACCS_AXIS_DCSNStopThrshHi_Spd "This is axis for KtACCS_d_RespDCSNStopThrshHi" 0x70100f30 /* @ECU_Address@KtACCS_AXIS_DCSNStopThrshHi_Spd@ */ NO_INPUT_QUANTITY Lookup1D_X_FLOAT32_IEEE 0 ACCS_subsystem_integrated_CM_single_m_s 6 0.0 50.0 /end AXIS_PTS
/begin AXIS_PTS KtACCS_AXIS_TargetRange_Speed "The CIPV speed axis for KtACCS_d_CIPVTargtRange" 0x70100dc8 /* @ECU_Address@KtACCS_AXIS_TargetRange_Speed@ */ NO_INPUT_QUANTITY Lookup2D_X_FLOAT32_IEEE 0 ACCS_subsystem_integrated_CM_single_m_s 10 0.0 50.0 /end AXIS_PTS
/begin AXIS_PTS KtACCS_AXIS_TargtRange_Timegap "The time gap axis for KtACCS_d_CIPVTargtRange" 0x70100db8 /* @ECU_Address@KtACCS_AXIS_TargtRange_Timegap@ */ NO_INPUT_QUANTITY Lookup2D_X_FLOAT32_IEEE 0 ACCS_subsystem_integrated_CM_single 4 1.0 6.0 /end AXIS_PTS
/begin AXIS_PTS KtACCS_AXIS_DCSNStopDisGain_d "This is distance axis for calibration KtACCS_r_DCSNStopDistanceGain" 0x70100fa0 /* @ECU_Address@KtACCS_AXIS_DCSNStopDisGain_d@ */ NO_INPUT_QUANTITY Lookup2D_X_FLOAT32_IEEE 0 ACCS_subsystem_integrated_CM_single_m 13 -20.0 200.0 /end AXIS_PTS
/begin AXIS_PTS KtACCS_AXIS_DCSNStopGain_VehSpd "This is speed axis for KtACCS_r_DCSNStopDistanceGain and KtACCS_r_DCSNStopSpdGain" 0x70100f48 /* @ECU_Address@KtACCS_AXIS_DCSNStopGain_VehSpd@ */ NO_INPUT_QUANTITY Lookup2D_X_FLOAT32_IEEE 0 ACCS_subsystem_integrated_CM_single_m_s 11 0.0 50.0 /end AXIS_PTS
/begin AXIS_PTS KtACCS_AXIS_DCSNStopGainSpd_SpdErr "This is speed error for KtACCS_r_DCSNStopSpdGain" 0x70100f74 /* @ECU_Address@KtACCS_AXIS_DCSNStopGainSpd_SpdErr@ */ NO_INPUT_QUANTITY Lookup2D_X_FLOAT32_IEEE 0 ACCS_subsystem_integrated_CM_single_m_s 11 -50.0 50.0 /end AXIS_PTS
/begin AXIS_PTS KtACCS_AXIS_OpenAccelFwCtrl_RangeErr "This is range error axis for KtACCS_OpenAccel_FollowCtrl" 0x70100ef0 /* @ECU_Address@KtACCS_AXIS_OpenAccelFwCtrl_RangeErr@ */ NO_INPUT_QUANTITY Lookup2D_X_FLOAT32_IEEE 0 ACCS_subsystem_integrated_CM_single_m 9 -100.0 100.0 /end AXIS_PTS
/begin AXIS_PTS KtACCS_AXIS_OpenAccelFwCtrl_RR "This is speed error(Range rate) axis for KtACCS_OpenAccel_FollowCtrl" 0x70100f14 /* @ECU_Address@KtACCS_AXIS_OpenAccelFwCtrl_RR@ */ VfACCS_Input_Obs_Rangerate Lookup2D_X_FLOAT32_IEEE 0 ACCS_subsystem_integrated_CM_single_m_s 7 -30.0 30.0 /end AXIS_PTS
/begin AXIS_PTS KtACCS_AXIS_AccelToGasPedal_VehSpd "This is vehicle speed for KtACCS_AccelToGasPedal" 0x70100fd4 /* @ECU_Address@KtACCS_AXIS_AccelToGasPedal_VehSpd@ */ NO_INPUT_QUANTITY Lookup2D_X_FLOAT32_IEEE 0 ACCS_subsystem_integrated_CM_single_m_s 10 0.0 50.0 /end AXIS_PTS
/begin AXIS_PTS KtACCS_AXIS_AccelToGasPedal_Accel "This is acceleration axis for KtACCS_AccelToGasPedal" 0x70100ffc /* @ECU_Address@KtACCS_AXIS_AccelToGasPedal_Accel@ */ NO_INPUT_QUANTITY Lookup2D_X_FLOAT32_IEEE 0 ACCS_subsystem_integrated_CM_single_m_s2 17 -8.0 8.0 /end AXIS_PTS
/begin AXIS_PTS KtACCS_AXIS_RangeCtrlPGain_VehSpd "This is vehicle speed axis for KtACCS_r_RangeCtrlPGain and KtACCS_r_SpeedCtrlPGain " 0x70100e3c /* @ECU_Address@KtACCS_AXIS_RangeCtrlPGain_VehSpd@ */ NO_INPUT_QUANTITY Lookup2D_X_FLOAT32_IEEE 0 ACCS_subsystem_integrated_CM_single_m_s 10 0.0 50.0 /end AXIS_PTS
/begin AXIS_PTS KtACCS_AXIS_RangeCtrlPGain_Err "This is range error axis for KtACCS_r_RangeCtrlPGain" 0x70100e64 /* @ECU_Address@KtACCS_AXIS_RangeCtrlPGain_Err@ */ NO_INPUT_QUANTITY Lookup2D_X_FLOAT32_IEEE 0 ACCS_subsystem_integrated_CM_single_m 9 -100.0 100.0 /end AXIS_PTS
/begin AXIS_PTS KtACCS_AXIS_SpeedCtrlPGain_Err "This is vehicle speed error axis for KtACCS_r_SpeedCtrlPGain" 0x70100e18 /* @ECU_Address@KtACCS_AXIS_SpeedCtrlPGain_Err@ */ NO_INPUT_QUANTITY Lookup2D_X_FLOAT32_IEEE 0 ACCS_subsystem_integrated_CM_single_m_s 9 -30.0 30.0 /end AXIS_PTS
/begin AXIS_PTS KtACCS_AXIS_TorqCtrlProp_DeltaAccel "This is delta acceleration axis for KtACCS_r_TorqCtrlProp" 0x70100d94 /* @ECU_Address@KtACCS_AXIS_TorqCtrlProp_DeltaAccel@ */ NO_INPUT_QUANTITY Lookup2D_X_FLOAT32_IEEE 0 ACCS_subsystem_integrated_CM_single_m_s2 9 -8.0 8.0 /end AXIS_PTS
/begin AXIS_PTS KtACCS_AXIS_TorqCtrlProp_EgoSpeed "This is ego cunrrent speed axis for KtACCS_r_TorqCtrlProp
      " 0x70100d6c /* @ECU_Address@KtACCS_AXIS_TorqCtrlProp_EgoSpeed@ */ NO_INPUT_QUANTITY Lookup2D_X_FLOAT32_IEEE 0 ACCS_subsystem_integrated_CM_single_m_s 10 0.0 45.0 /end AXIS_PTS
/begin AXIS_PTS KaAEBS_AXIS_Veh_Curvature_vec "" 0x70101570 /* @ECU_Address@KaAEBS_AXIS_Veh_Curvature_vec@ */ NO_INPUT_QUANTITY Lookup1D_X_FLOAT32_IEEE 0 AEBS_subsystem_integrated_CM_single 10 -3.4E+38 3.4E+38 /end AXIS_PTS
/begin AXIS_PTS KaAEBS_AXIS_Veh_Speed_vec "" 0x7010154c /* @ECU_Address@KaAEBS_AXIS_Veh_Speed_vec@ */ VfAEBS_veh_speed_used Lookup2D_X_FLOAT32_IEEE 0 AEBS_subsystem_integrated_CM_single 9 -3.4E+38 3.4E+38 /end AXIS_PTS
/begin MEASUREMENT VfACCS_Range_Actual "The actual range" FLOAT32_IEEE ACCS_subsystem_integrated_CM_single_m 0 0 -100.0 100.0 ECU_ADDRESS 0x7000a44c /* @ECU_Address@VfACCS_Range_Actual@ */ /end MEASUREMENT
/begin MEASUREMENT VfACCS_CombinedSpeedLimit "Speed limit,consider with road and driver set" FLOAT32_IEEE ACCS_subsystem_integrated_CM_single_m_s 0 0 0.0 45.0 ECU_ADDRESS 0x7000a448 /* @ECU_Address@VfACCS_CombinedSpeedLimit@ */ /end MEASUREMENT
/begin MEASUREMENT VfACCS_StopTimer "If enter stop model, this timer will increase" FLOAT32_IEEE ACCS_subsystem_integrated_CM_single_s 0 0 0.0 1200.0 ECU_ADDRESS 0x7000a444 /* @ECU_Address@VfACCS_StopTimer@ */ /end MEASUREMENT
/begin MEASUREMENT VfACCS_SpdErrLim_CIPV "The speed error for speed PID control" FLOAT32_IEEE ACCS_subsystem_integrated_CM_single_m_s 0 0 -30.0 30.0 ECU_ADDRESS 0x7000a440 /* @ECU_Address@VfACCS_SpdErrLim_CIPV@ */ /end MEASUREMENT
/begin MEASUREMENT VfACCS_DrsdAccelFrmRngSped "The acceleration considers with range and speed error" FLOAT32_IEEE ACCS_subsystem_integrated_CM_single_m_s2 0 0 -4.0 4.0 ECU_ADDRESS 0x7000a43c /* @ECU_Address@VfACCS_DrsdAccelFrmRngSped@ */ /end MEASUREMENT
/begin MEASUREMENT VfACCS_RangCtrCL_CIPV "CIPV object range closed loop out" FLOAT32_IEEE ACCS_subsystem_integrated_CM_single_m_s 0 0 -45.0 45.0 ECU_ADDRESS 0x7000a438 /* @ECU_Address@VfACCS_RangCtrCL_CIPV@ */ /end MEASUREMENT
/begin MEASUREMENT VfACCS_Lon_Torq_Req "The ACCS final output torq(%) " FLOAT32_IEEE ACCS_subsystem_integrated_CM_single_pct 0 0 0.0 100.0 ECU_ADDRESS 0x7000a434 /* @ECU_Address@VfACCS_Lon_Torq_Req@ */ /end MEASUREMENT
/begin MEASUREMENT VfACCS_Lon_Accleration "The ACCS final output acceleration " FLOAT32_IEEE ACCS_subsystem_integrated_CM_single_m_s2 0 0 -4.0 4.0 ECU_ADDRESS 0x7000a430 /* @ECU_Address@VfACCS_Lon_Accleration@ */ /end MEASUREMENT
/begin MEASUREMENT VfACCS_DCSNStopAccel "The acceleration is from DCSN stop requirement" FLOAT32_IEEE ACCS_subsystem_integrated_CM_single_m_s2 0 0 -4.0 4.0 ECU_ADDRESS 0x7000a42c /* @ECU_Address@VfACCS_DCSNStopAccel@ */ /end MEASUREMENT
/begin MEASUREMENT VfACCS_DrsdAccelWithDCSN "The acceleration consider with DCSN stop requirement" FLOAT32_IEEE ACCS_subsystem_integrated_CM_single_m_s2 0 0 -4.0 4.0 ECU_ADDRESS 0x7000a428 /* @ECU_Address@VfACCS_DrsdAccelWithDCSN@ */ /end MEASUREMENT
/begin MEASUREMENT VfACCS_DrsdAccelWithPitch "Before override desired acceleraton" FLOAT32_IEEE ACCS_subsystem_integrated_CM_single_m_s2 0 0 -4.0 4.0 ECU_ADDRESS 0x7000a424 /* @ECU_Address@VfACCS_DrsdAccelWithPitch@ */ /end MEASUREMENT
/begin MEASUREMENT VfACCS_Obs_Lat_V_OBFU "" FLOAT32_IEEE ACCS_subsystem_integrated_CM_single_m_s 0 0 -30.0 30.0 ECU_ADDRESS 0x7000a420 /* @ECU_Address@VfACCS_Obs_Lat_V_OBFU@ */ /end MEASUREMENT
/begin MEASUREMENT VfACCS_Obs_Long_V_OBFU "" FLOAT32_IEEE ACCS_subsystem_integrated_CM_single_m_s 0 0 -50.0 50.0 ECU_ADDRESS 0x7000a41c /* @ECU_Address@VfACCS_Obs_Long_V_OBFU@ */ /end MEASUREMENT
/begin MEASUREMENT VfACCS_Obs_Long_A_OBFU "" FLOAT32_IEEE ACCS_subsystem_integrated_CM_single_m_s2 0 0 -30.0 30.0 ECU_ADDRESS 0x7000a418 /* @ECU_Address@VfACCS_Obs_Long_A_OBFU@ */ /end MEASUREMENT
/begin MEASUREMENT VfACCS_Obs_Lat_A_OBFU "" FLOAT32_IEEE ACCS_subsystem_integrated_CM_single_m_s2 0 0 -10.0 10.0 ECU_ADDRESS 0x7000a414 /* @ECU_Address@VfACCS_Obs_Lat_A_OBFU@ */ /end MEASUREMENT
/begin MEASUREMENT VfACCS_Input_Obs_LinearAcc "CIPV object linear speed" FLOAT32_IEEE ACCS_subsystem_integrated_CM_single_m_s 0 0 -45.0 45.0 ECU_ADDRESS 0x7000a410 /* @ECU_Address@VfACCS_Input_Obs_LinearAcc@ */ /end MEASUREMENT
/begin MEASUREMENT VfACCS_Obs_Long_OBFU "" FLOAT32_IEEE ACCS_subsystem_integrated_CM_single_m 0 0 0.0 300.0 ECU_ADDRESS 0x7000a40c /* @ECU_Address@VfACCS_Obs_Long_OBFU@ */ /end MEASUREMENT
/begin MEASUREMENT VfACCS_Obs_Lat_OBFU "" FLOAT32_IEEE ACCS_subsystem_integrated_CM_single_m 0 0 -100.0 100.0 ECU_ADDRESS 0x7000a408 /* @ECU_Address@VfACCS_Obs_Lat_OBFU@ */ /end MEASUREMENT
/begin MEASUREMENT VfACCS_Input_Obs_LatDis "CIPV object lat distance" FLOAT32_IEEE ACCS_subsystem_integrated_CM_single_m 0 0 -20.0 20.0 ECU_ADDRESS 0x7000a404 /* @ECU_Address@VfACCS_Input_Obs_LatDis@ */ /end MEASUREMENT
/begin MEASUREMENT VfACCS_Input_Obs_Range "CIPV object range" FLOAT32_IEEE ACCS_subsystem_integrated_CM_single_m 0 0 -100.0 200.0 ECU_ADDRESS 0x7000a400 /* @ECU_Address@VfACCS_Input_Obs_Range@ */ /end MEASUREMENT
/begin MEASUREMENT VfACCS_Input_Obs_Rangerate "CIPV object range rate" FLOAT32_IEEE ACCS_subsystem_integrated_CM_single_m_s 0 0 -30.0 30.0 ECU_ADDRESS 0x7000a3fc /* @ECU_Address@VfACCS_Input_Obs_Rangerate@ */ /end MEASUREMENT
/begin MEASUREMENT VfACCS_Input_Obs_LinearVelocity "CIPV object linear speed" FLOAT32_IEEE ACCS_subsystem_integrated_CM_single_m_s 0 0 -45.0 45.0 ECU_ADDRESS 0x7000a3f8 /* @ECU_Address@VfACCS_Input_Obs_LinearVelocity@ */ /end MEASUREMENT
/begin MEASUREMENT VfACCS_Input_Obs_Long_VFiltered "CIPV object long velocity" FLOAT32_IEEE ACCS_subsystem_integrated_CM_single_m_s 0 0 -45.0 45.0 ECU_ADDRESS 0x7000a3f4 /* @ECU_Address@VfACCS_Input_Obs_Long_VFiltered@ */ /end MEASUREMENT
/begin MEASUREMENT VfACCS_Input_Obs_Lat_VFiltered "CIPV object lat speed" FLOAT32_IEEE ACCS_subsystem_integrated_CM_single_m_s 0 0 -5.0 5.0 ECU_ADDRESS 0x7000a3f0 /* @ECU_Address@VfACCS_Input_Obs_Lat_VFiltered@ */ /end MEASUREMENT
/begin MEASUREMENT VfACCS_DriverTargetRange "Driver target following range" FLOAT32_IEEE ACCS_subsystem_integrated_CM_single_m 0 0 0.0 200.0 ECU_ADDRESS 0x7000a3ec /* @ECU_Address@VfACCS_DriverTargetRange@ */ /end MEASUREMENT
/begin MEASUREMENT VfACCS_FinalSpeedLimit "Final speed limit, consider with road limit" FLOAT32_IEEE ACCS_subsystem_integrated_CM_single_m_s 0 0 0.0 45.0 ECU_ADDRESS 0x7000a3e8 /* @ECU_Address@VfACCS_FinalSpeedLimit@ */ /end MEASUREMENT
/begin MEASUREMENT VfACCS_FeedForwardAccel "Acceleration open iterm" FLOAT32_IEEE ACCS_subsystem_integrated_CM_single_m_s2 0 0 -4.0 4.0 ECU_ADDRESS 0x7000a3e4 /* @ECU_Address@VfACCS_FeedForwardAccel@ */ /end MEASUREMENT
/begin MEASUREMENT VfACCS_OpenAccel_ForDCSNStop "This is open acceleration for DCSN stop" FLOAT32_IEEE ACCS_subsystem_integrated_CM_single_m_s2 0 0 -4.0 4.0 ECU_ADDRESS 0x7000a3e0 /* @ECU_Address@VfACCS_OpenAccel_ForDCSNStop@ */ /end MEASUREMENT
/begin MEASUREMENT VfACCS_VehSpeed_Tar "The target vehicle speed" FLOAT32_IEEE ACCS_subsystem_integrated_CM_single_m_s 0 0 0.0 50.0 ECU_ADDRESS 0x7000a3dc /* @ECU_Address@VfACCS_VehSpeed_Tar@ */ /end MEASUREMENT
/begin MEASUREMENT VfACCS_DeltaSped_EGMOAndCan "Speed error between Can and EGMO model" FLOAT32_IEEE ACCS_subsystem_integrated_CM_single_m_s 0 0 0.0 150.0 ECU_ADDRESS 0x7000a3d8 /* @ECU_Address@VfACCS_DeltaSped_EGMOAndCan@ */ /end MEASUREMENT
/begin MEASUREMENT VfACCS_Input_linear_velocity_EGMO "Ego linear velocith from EGMO mode" FLOAT32_IEEE ACCS_subsystem_integrated_CM_single_m_s 0 0 0.0 45.0 ECU_ADDRESS 0x7000a3d4 /* @ECU_Address@VfACCS_Input_linear_velocity_EGMO@ */ /end MEASUREMENT
/begin MEASUREMENT VfACCS_Input_EgoPitch_EGMO "Ego pitch from EGMO model" FLOAT32_IEEE ACCS_subsystem_integrated_CM_single_rad 0 0 -3.1415926535897931 3.1415926535897931 ECU_ADDRESS 0x7000a3d0 /* @ECU_Address@VfACCS_Input_EgoPitch_EGMO@ */ /end MEASUREMENT
/begin MEASUREMENT VfACCS_Input_longvelocity_EGMO "Ego vehilce V_x" FLOAT32_IEEE ACCS_subsystem_integrated_CM_single_m_s 0 0 -45.0 45.0 ECU_ADDRESS 0x7000a3cc /* @ECU_Address@VfACCS_Input_longvelocity_EGMO@ */ /end MEASUREMENT
/begin MEASUREMENT VfACCS_Input_latvelocity_EGMO "Ego vehicle V_y" FLOAT32_IEEE ACCS_subsystem_integrated_CM_single_m_s 0 0 -45.0 45.0 ECU_ADDRESS 0x7000a3c8 /* @ECU_Address@VfACCS_Input_latvelocity_EGMO@ */ /end MEASUREMENT
/begin MEASUREMENT VfACCS_Input_linear_Acceleration_EGMO "Ego linear acceleration from EGMO model" FLOAT32_IEEE ACCS_subsystem_integrated_CM_single_m_s2 0 0 -4.0 4.0 ECU_ADDRESS 0x7000a3c4 /* @ECU_Address@VfACCS_Input_linear_Acceleration_EGMO@ */ /end MEASUREMENT
/begin MEASUREMENT VfACCS_Input_stop_s_distance_DCSN "Stop distance from DCSN model" FLOAT32_IEEE ACCS_subsystem_integrated_CM_single_m 0 0 0.0 255.0 ECU_ADDRESS 0x7000a3c0 /* @ECU_Address@VfACCS_Input_stop_s_distance_DCSN@ */ /end MEASUREMENT
/begin MEASUREMENT VfACCS_Input_traffic_speed_limit_DCSN "Speed limit from DCSM model" FLOAT32_IEEE ACCS_subsystem_integrated_CM_single_m_s 0 0 0.0 45.0 ECU_ADDRESS 0x7000a3bc /* @ECU_Address@VfACCS_Input_traffic_speed_limit_DCSN@ */ /end MEASUREMENT
/begin MEASUREMENT VfACCS_Input_PhyGasPedal_POWER "Observe the opening of the accelerator pedal" FLOAT32_IEEE ACCS_subsystem_integrated_CM_single_pct 0 0 0.0 100.0 ECU_ADDRESS 0x7000a3b8 /* @ECU_Address@VfACCS_Input_PhyGasPedal_POWER@ */ /end MEASUREMENT
/begin MEASUREMENT VfACCS_Input_Obs_ID "CIPV object id" SLONG ACCS_subsystem_integrated_CM_int32 0 0 0.0 128.0 ECU_ADDRESS 0x7000a3b4 /* @ECU_Address@VfACCS_Input_Obs_ID@ */ /end MEASUREMENT
/begin MEASUREMENT VeACCS_EnterStandbyType "0:NoEnterStandby
      1:FromModeOffToStandby
      2:FromSpeedCtrlToStandby
      3:FromFollowingCtrlToStandby
      4:FromLowSpeedToStandby
      5:FromTempStopToStandby
      6:FromStopToStandby
      7:FromLaunchToStandby
      8:FromFaultToStandby
      9:DriverGasPedalOverride
      10:PressCancelSwitch" SLONG ACCS_subsystem_integrated_CM_EnumACCS_StandbyType 0 0 0 10 ECU_ADDRESS 0x7000a3b0 /* @ECU_Address@VeACCS_EnterStandbyType@ */ /end MEASUREMENT
/begin MEASUREMENT VeACCS_EnterStandbyState "0:NoEnterStandby
      1:FromModeOffToStandby
      2:FromSpeedCtrlToStandby
      3:FromFollowingCtrlToStandby
      4:FromLowSpeedToStandby
      5:FromTempStopToStandby
      6:FromStopToStandby
      7:FromLaunchToStandby
      8:FromFaultToStandby
      9:DriverGasPedalOverride
      10:PressCancelSwitch" SLONG ACCS_subsystem_integrated_CM_EnumACCS_StandbyType 0 0 0 10 ECU_ADDRESS 0x7000a3ac /* @ECU_Address@VeACCS_EnterStandbyState@ */ /end MEASUREMENT
/begin MEASUREMENT VeACCS_ModeState "0:ACCS_mode_off
      1:ACCS_mode_on
      2:ACCS_mode_standby
      3:ACCS_mode_fault
      " SLONG ACCS_subsystem_integrated_CM_EnumACCS_Mode 0 0 0 3 ECU_ADDRESS 0x7000a3a8 /* @ECU_Address@VeACCS_ModeState@ */ /end MEASUREMENT
/begin MEASUREMENT VeACCS_RunStatus "0:ACCS_status_off
      1:ACCS_status_on
      2:ACCS_status_Standby
      3:ACCS_status_SpeedCtrl
      4:ACCS_status_FollowingCtrl
      5:ACCS_status_TempStop
      6:ACCS_status_Stop
      7:ACCS_status_Launch
      8:ACCS_status_LowSpeed
      9:ACCS_status_Fault" SLONG ACCS_subsystem_integrated_CM_EnumACCS_RunStatus 0 0 0 9 ECU_ADDRESS 0x7000a3a4 /* @ECU_Address@VeACCS_RunStatus@ */ /end MEASUREMENT
/begin MEASUREMENT VeACCS_RunStatusFrmMode "0:ACCS_status_off
      1:ACCS_status_on
      2:ACCS_status_Standby
      3:ACCS_status_SpeedCtrl
      4:ACCS_status_FollowingCtrl
      5:ACCS_status_TempStop
      6:ACCS_status_Stop
      7:ACCS_status_Launch
      8:ACCS_status_LowSpeed
      9:ACCS_status_Fault" SLONG ACCS_subsystem_integrated_CM_EnumACCS_RunStatus 0 0 0 9 ECU_ADDRESS 0x7000a3a0 /* @ECU_Address@VeACCS_RunStatusFrmMode@ */ /end MEASUREMENT
/begin MEASUREMENT VeACCS_RunStatusBeforeFault "0:ACCS_status_off
      1:ACCS_status_on
      2:ACCS_status_Standby
      3:ACCS_status_SpeedCtrl
      4:ACCS_status_FollowingCtrl
      5:ACCS_status_TempStop
      6:ACCS_status_Stop
      7:ACCS_status_Launch
      8:ACCS_status_LowSpeed
      9:ACCS_status_Fault" SLONG ACCS_subsystem_integrated_CM_EnumACCS_RunStatus 0 0 0 9 ECU_ADDRESS 0x7000a39c /* @ECU_Address@VeACCS_RunStatusBeforeFault@ */ /end MEASUREMENT
/begin MEASUREMENT VeACCS_FaultState "0:NoEnterFault
      1:FromStatusOnToFault
      2:FromSpeedCtrlToFault
      3:FromFollowingCtrlToFault
      4:FromLowSpeedToFault
      5:FromTempStopToFault
      6:FromStopToFault
      7:FromLaunchToFault
      8:FromStandbyToFault" SLONG ACCS_subsystem_integrated_CM_EnumACCS_FaultState 0 0 0 8 ECU_ADDRESS 0x7000a398 /* @ECU_Address@VeACCS_FaultState@ */ /end MEASUREMENT
/begin MEASUREMENT VfACCS_Input_Obs_Num "Object num from OBFU" UWORD ACCS_subsystem_integrated_CM_uint16 0 0 0.0 128.0 ECU_ADDRESS 0x7000a394 /* @ECU_Address@VfACCS_Input_Obs_Num@ */ /end MEASUREMENT
/begin MEASUREMENT VbACCS_AEB_Active "AEB active" UBYTE ACCS_subsystem_integrated_CM_boolean 0 0 0.0 1.0 ECU_ADDRESS 0x7000a392 /* @ECU_Address@VbACCS_AEB_Active@ */ /end MEASUREMENT
/begin MEASUREMENT VbACCS_MainSwitch "ACC main switch is ture" UBYTE ACCS_subsystem_integrated_CM_boolean 0 0 0.0 1.0 ECU_ADDRESS 0x7000a391 /* @ECU_Address@VbACCS_MainSwitch@ */ /end MEASUREMENT
/begin MEASUREMENT VbACCS_InformDriverPressResume "Ture:Driver need press resume switch to active ACCS" UBYTE ACCS_subsystem_integrated_CM_boolean 0 0 0.0 1.0 ECU_ADDRESS 0x7000a390 /* @ECU_Address@VbACCS_InformDriverPressResume@ */ /end MEASUREMENT
/begin MEASUREMENT VbACCS_InformDriverPressGasPedal "Ture:Driver need press gas pedal to active ACCS" UBYTE ACCS_subsystem_integrated_CM_boolean 0 0 0.0 1.0 ECU_ADDRESS 0x7000a38f /* @ECU_Address@VbACCS_InformDriverPressGasPedal@ */ /end MEASUREMENT
/begin MEASUREMENT VbACCS_SpdToLowSpeedCtr "The condtion:From speed to low speed control" UBYTE ACCS_subsystem_integrated_CM_boolean 0 0 0.0 1.0 ECU_ADDRESS 0x7000a38e /* @ECU_Address@VbACCS_SpdToLowSpeedCtr@ */ /end MEASUREMENT
/begin MEASUREMENT VbACCS_HasCIPV_Object "Ture: There is following target object" UBYTE ACCS_subsystem_integrated_CM_boolean 0 0 0.0 1.0 ECU_ADDRESS 0x7000a38d /* @ECU_Address@VbACCS_HasCIPV_Object@ */ /end MEASUREMENT
/begin MEASUREMENT VbACCS_LowSpdToSpeedCtr "The condition:From low speed to speed control" UBYTE ACCS_subsystem_integrated_CM_boolean 0 0 0.0 1.0 ECU_ADDRESS 0x7000a38c /* @ECU_Address@VbACCS_LowSpdToSpeedCtr@ */ /end MEASUREMENT
/begin MEASUREMENT VbACCS_FollowingToSpeedCtrl "The condition: from following control to speed control" UBYTE ACCS_subsystem_integrated_CM_boolean 0 0 0.0 1.0 ECU_ADDRESS 0x7000a38b /* @ECU_Address@VbACCS_FollowingToSpeedCtrl@ */ /end MEASUREMENT
/begin MEASUREMENT VbACCS_SpeedToFollowingCtr "The condition:From speed to following control" UBYTE ACCS_subsystem_integrated_CM_boolean 0 0 0.0 1.0 ECU_ADDRESS 0x7000a38a /* @ECU_Address@VbACCS_SpeedToFollowingCtr@ */ /end MEASUREMENT
/begin MEASUREMENT VbACCS_LowSpdToTempStop "The condition:From low speed to temp stop" UBYTE ACCS_subsystem_integrated_CM_boolean 0 0 0.0 1.0 ECU_ADDRESS 0x7000a389 /* @ECU_Address@VbACCS_LowSpdToTempStop@ */ /end MEASUREMENT
/begin MEASUREMENT VbACCS_LowSpdToFollowingCtrl "The condition:From low speed to following control" UBYTE ACCS_subsystem_integrated_CM_boolean 0 0 0.0 1.0 ECU_ADDRESS 0x7000a388 /* @ECU_Address@VbACCS_LowSpdToFollowingCtrl@ */ /end MEASUREMENT
/begin MEASUREMENT VbACCS_TempStopToLaunch "The condition:From temp stop to launch" UBYTE ACCS_subsystem_integrated_CM_boolean 0 0 0.0 1.0 ECU_ADDRESS 0x7000a387 /* @ECU_Address@VbACCS_TempStopToLaunch@ */ /end MEASUREMENT
/begin MEASUREMENT VbACCS_FollowingToLowSpdCtrl "The condition: from following control to low speed control" UBYTE ACCS_subsystem_integrated_CM_boolean 0 0 0.0 1.0 ECU_ADDRESS 0x7000a386 /* @ECU_Address@VbACCS_FollowingToLowSpdCtrl@ */ /end MEASUREMENT
/begin MEASUREMENT VbACCS_StatusOnToSpeedCtrl "The condition:From  status on to speed control" UBYTE ACCS_subsystem_integrated_CM_boolean 0 0 0.0 1.0 ECU_ADDRESS 0x7000a385 /* @ECU_Address@VbACCS_StatusOnToSpeedCtrl@ */ /end MEASUREMENT
/begin MEASUREMENT VbACCS_StatusOnToStop "The condirion:From status on to Stop" UBYTE ACCS_subsystem_integrated_CM_boolean 0 0 0.0 1.0 ECU_ADDRESS 0x7000a384 /* @ECU_Address@VbACCS_StatusOnToStop@ */ /end MEASUREMENT
/begin MEASUREMENT VbACCS_EnterStandbyCommonCod "Ture:enter standby common conditions meet" UBYTE ACCS_subsystem_integrated_CM_boolean 0 0 0.0 1.0 ECU_ADDRESS 0x7000a383 /* @ECU_Address@VbACCS_EnterStandbyCommonCod@ */ /end MEASUREMENT
/begin MEASUREMENT VbACCS_FromStopToStandby "The condition: from Stop to Standby" UBYTE ACCS_subsystem_integrated_CM_boolean 0 0 0.0 1.0 ECU_ADDRESS 0x7000a382 /* @ECU_Address@VbACCS_FromStopToStandby@ */ /end MEASUREMENT
/begin MEASUREMENT VbACCS_FromLowSpeedToStandby "The condition: from Low Speed control to Standby" UBYTE ACCS_subsystem_integrated_CM_boolean 0 0 0.0 1.0 ECU_ADDRESS 0x7000a381 /* @ECU_Address@VbACCS_FromLowSpeedToStandby@ */ /end MEASUREMENT
/begin MEASUREMENT VbACCS_FromLaunchToStandby "The condition: from following control to Standby" UBYTE ACCS_subsystem_integrated_CM_boolean 0 0 0.0 1.0 ECU_ADDRESS 0x7000a380 /* @ECU_Address@VbACCS_FromLaunchToStandby@ */ /end MEASUREMENT
/begin MEASUREMENT VbACCS_FromFollowingCtrlToStandby "The condition: from following control to Standby" UBYTE ACCS_subsystem_integrated_CM_boolean 0 0 0.0 1.0 ECU_ADDRESS 0x7000a37f /* @ECU_Address@VbACCS_FromFollowingCtrlToStandby@ */ /end MEASUREMENT
/begin MEASUREMENT VbACCS_FromSpeedCtrlToStandby "The condition: from Speed control to Standby" UBYTE ACCS_subsystem_integrated_CM_boolean 0 0 0.0 1.0 ECU_ADDRESS 0x7000a37e /* @ECU_Address@VbACCS_FromSpeedCtrlToStandby@ */ /end MEASUREMENT
/begin MEASUREMENT VbACCS_TempStpToStop "The condition: From temp stop to stop" UBYTE ACCS_subsystem_integrated_CM_boolean 0 0 0.0 1.0 ECU_ADDRESS 0x7000a37d /* @ECU_Address@VbACCS_TempStpToStop@ */ /end MEASUREMENT
/begin MEASUREMENT VbACCS_StopToLaunch "The condition:From stop to launch" UBYTE ACCS_subsystem_integrated_CM_boolean 0 0 0.0 1.0 ECU_ADDRESS 0x7000a37c /* @ECU_Address@VbACCS_StopToLaunch@ */ /end MEASUREMENT
/begin MEASUREMENT VbACCS_LaunchToTempStop "The condition:From launch to temp stop" UBYTE ACCS_subsystem_integrated_CM_boolean 0 0 0.0 1.0 ECU_ADDRESS 0x7000a37b /* @ECU_Address@VbACCS_LaunchToTempStop@ */ /end MEASUREMENT
/begin MEASUREMENT VbACCS_LaunchToSpeedCtrl "The condition:From launch to speed control" UBYTE ACCS_subsystem_integrated_CM_boolean 0 0 0.0 1.0 ECU_ADDRESS 0x7000a37a /* @ECU_Address@VbACCS_LaunchToSpeedCtrl@ */ /end MEASUREMENT
/begin MEASUREMENT VbACCS_LaunchToLowSpd "The condition:From launch to low speed control" UBYTE ACCS_subsystem_integrated_CM_boolean 0 0 0.0 1.0 ECU_ADDRESS 0x7000a379 /* @ECU_Address@VbACCS_LaunchToLowSpd@ */ /end MEASUREMENT
/begin MEASUREMENT VbACCS_LaunchToFollowingCtrl "The condition:From launch to following control" UBYTE ACCS_subsystem_integrated_CM_boolean 0 0 0.0 1.0 ECU_ADDRESS 0x7000a378 /* @ECU_Address@VbACCS_LaunchToFollowingCtrl@ */ /end MEASUREMENT
/begin MEASUREMENT VbACCS_ResumeSwitchOld "The previous loop resume switch state" UBYTE ACCS_subsystem_integrated_CM_boolean 0 0 0.0 1.0 ECU_ADDRESS 0x7000a377 /* @ECU_Address@VbACCS_ResumeSwitchOld@ */ /end MEASUREMENT
/begin MEASUREMENT VbACCS_GearPositionIsD "Gear position is D gear" UBYTE ACCS_subsystem_integrated_CM_boolean 0 0 0.0 1.0 ECU_ADDRESS 0x7000a376 /* @ECU_Address@VbACCS_GearPositionIsD@ */ /end MEASUREMENT
/begin MEASUREMENT VbACCS_SpeedOutRange "Ego speed is out of ACCS enable range" UBYTE ACCS_subsystem_integrated_CM_boolean 0 0 0.0 1.0 ECU_ADDRESS 0x7000a375 /* @ECU_Address@VbACCS_SpeedOutRange@ */ /end MEASUREMENT
/begin MEASUREMENT VbACCS_DriverModeAllowACCS "Under the current drive mode, can enable ACCS" UBYTE ACCS_subsystem_integrated_CM_boolean 0 0 0.0 1.0 ECU_ADDRESS 0x7000a374 /* @ECU_Address@VbACCS_DriverModeAllowACCS@ */ /end MEASUREMENT
/begin MEASUREMENT VbACCS_DriverGasPedalOverride "Driver gas pedal is bigger than ACC requirement" UBYTE ACCS_subsystem_integrated_CM_boolean 0 0 0.0 1.0 ECU_ADDRESS 0x7000a373 /* @ECU_Address@VbACCS_DriverGasPedalOverride@ */ /end MEASUREMENT
/begin MEASUREMENT VbACCS_ExitStandbyCommonConds "Exit stanby mode common conditions meet" UBYTE ACCS_subsystem_integrated_CM_boolean 0 0 0.0 1.0 ECU_ADDRESS 0x7000a372 /* @ECU_Address@VbACCS_ExitStandbyCommonConds@ */ /end MEASUREMENT
/begin MEASUREMENT VbACCS_ExitStandbyToOn "Ture: Will exit standby to RunstatusOn" UBYTE ACCS_subsystem_integrated_CM_boolean 0 0 0.0 1.0 ECU_ADDRESS 0x7000a371 /* @ECU_Address@VbACCS_ExitStandbyToOn@ */ /end MEASUREMENT
/begin MEASUREMENT VbACCS_Lon_Torq_Req "Ture means set positve torqerequirement" UBYTE ACCS_subsystem_integrated_CM_boolean 0 0 0.0 1.0 ECU_ADDRESS 0x7000a370 /* @ECU_Address@VbACCS_Lon_Torq_Req@ */ /end MEASUREMENT
/begin MEASUREMENT VbACCS_Lon_Accleration_Req "Only this flag is ture, the output acceleration is valid" UBYTE ACCS_subsystem_integrated_CM_boolean 0 0 0.0 1.0 ECU_ADDRESS 0x7000a36f /* @ECU_Address@VbACCS_Lon_Accleration_Req@ */ /end MEASUREMENT
/begin MEASUREMENT VbACCS_CIPVObsRangeFlicker "This is the flag to show whether the obstacle's range is changing abnormaly" UBYTE ACCS_subsystem_integrated_CM_boolean 0 0 0.0 1.0 ECU_ADDRESS 0x7000a36e /* @ECU_Address@VbACCS_CIPVObsRangeFlicker@ */ /end MEASUREMENT
/begin MEASUREMENT VbACCS_Input_Obs_valid "Has CIPV" UBYTE ACCS_subsystem_integrated_CM_boolean 0 0 0.0 1.0 ECU_ADDRESS 0x7000a36d /* @ECU_Address@VbACCS_Input_Obs_valid@ */ /end MEASUREMENT
/begin MEASUREMENT VbACCS_BrakePedalPress "Driver press brake pedal" UBYTE ACCS_subsystem_integrated_CM_boolean 0 0 0.0 1.0 ECU_ADDRESS 0x7000a36c /* @ECU_Address@VbACCS_BrakePedalPress@ */ /end MEASUREMENT
/begin MEASUREMENT VbACCS_EPB_Engaged "EPB engaged" UBYTE ACCS_subsystem_integrated_CM_boolean 0 0 0.0 1.0 ECU_ADDRESS 0x7000a36b /* @ECU_Address@VbACCS_EPB_Engaged@ */ /end MEASUREMENT
/begin MEASUREMENT VbACCS_EgoLimit "Ego vehicle has some features will limit ACCS" UBYTE ACCS_subsystem_integrated_CM_boolean 0 0 0.0 1.0 ECU_ADDRESS 0x7000a36a /* @ECU_Address@VbACCS_EgoLimit@ */ /end MEASUREMENT
/begin MEASUREMENT VbACCS_ResumeSwitch "Driver press resume switch" UBYTE ACCS_subsystem_integrated_CM_boolean 0 0 0.0 1.0 ECU_ADDRESS 0x7000a369 /* @ECU_Address@VbACCS_ResumeSwitch@ */ /end MEASUREMENT
/begin MEASUREMENT VbACCS_DriverHasSetSpeed "Driver has set speed for ACCS" UBYTE ACCS_subsystem_integrated_CM_boolean 0 0 0.0 1.0 ECU_ADDRESS 0x7000a368 /* @ECU_Address@VbACCS_DriverHasSetSpeed@ */ /end MEASUREMENT
/begin MEASUREMENT VbACCS_NeedRespStopFrmDCSN "Ture: ACCS need response DCSN stop requirement" UBYTE ACCS_subsystem_integrated_CM_boolean 0 0 0.0 1.0 ECU_ADDRESS 0x7000a367 /* @ECU_Address@VbACCS_NeedRespStopFrmDCSN@ */ /end MEASUREMENT
/begin MEASUREMENT VbACCS_Input_stop_request_DCSN "Has Stop request from DCSN model" UBYTE ACCS_subsystem_integrated_CM_boolean 0 0 0.0 1.0 ECU_ADDRESS 0x7000a366 /* @ECU_Address@VbACCS_Input_stop_request_DCSN@ */ /end MEASUREMENT
/begin MEASUREMENT VbACCS_Input_NoSpdLimit "If DCSN module speed limit reason is Nolimit, this flag will set true" UBYTE ACCS_subsystem_integrated_CM_boolean 0 0 0.0 1.0 ECU_ADDRESS 0x7000a365 /* @ECU_Address@VbACCS_Input_NoSpdLimit@ */ /end MEASUREMENT
/begin MEASUREMENT VeACCS_CIPVChangedType "This is the signal to show the CIPV changed type" UBYTE ACCS_subsystem_integrated_CM_ACCS_CIPVChangedType 0 0 0 6 ECU_ADDRESS 0x7000a364 /* @ECU_Address@VeACCS_CIPVChangedType@ */ /end MEASUREMENT
/begin MEASUREMENT VfAEBS_m_1_a_x "" FLOAT32_IEEE AEBS_subsystem_integrated_CM_single 0 0 -3.4E+38 3.4E+38 ECU_ADDRESS 0x70010908 /* @ECU_Address@VfAEBS_m_1_a_x@ */ /end MEASUREMENT
/begin MEASUREMENT VfAEBS_m_1_a_y "" FLOAT32_IEEE AEBS_subsystem_integrated_CM_single 0 0 -3.4E+38 3.4E+38 ECU_ADDRESS 0x70010904 /* @ECU_Address@VfAEBS_m_1_a_y@ */ /end MEASUREMENT
/begin MEASUREMENT VfAEBS_m_1_length "" FLOAT32_IEEE AEBS_subsystem_integrated_CM_single 0 0 -3.4E+38 3.4E+38 ECU_ADDRESS 0x70010900 /* @ECU_Address@VfAEBS_m_1_length@ */ /end MEASUREMENT
/begin MEASUREMENT VfAEBS_m_1_width "" FLOAT32_IEEE AEBS_subsystem_integrated_CM_single 0 0 -3.4E+38 3.4E+38 ECU_ADDRESS 0x700108fc /* @ECU_Address@VfAEBS_m_1_width@ */ /end MEASUREMENT
/begin MEASUREMENT VfAEBS_m_1_center_x "" FLOAT32_IEEE AEBS_subsystem_integrated_CM_single 0 0 -3.4E+38 3.4E+38 ECU_ADDRESS 0x700108f8 /* @ECU_Address@VfAEBS_m_1_center_x@ */ /end MEASUREMENT
/begin MEASUREMENT VfAEBS_m_1_center_y "" FLOAT32_IEEE AEBS_subsystem_integrated_CM_single 0 0 -3.4E+38 3.4E+38 ECU_ADDRESS 0x700108f4 /* @ECU_Address@VfAEBS_m_1_center_y@ */ /end MEASUREMENT
/begin MEASUREMENT VfAEBS_m_1_heading "" FLOAT32_IEEE AEBS_subsystem_integrated_CM_single 0 0 -3.4E+38 3.4E+38 ECU_ADDRESS 0x700108f0 /* @ECU_Address@VfAEBS_m_1_heading@ */ /end MEASUREMENT
/begin MEASUREMENT VfAEBS_m_1_v_x "" FLOAT32_IEEE AEBS_subsystem_integrated_CM_single 0 0 -3.4E+38 3.4E+38 ECU_ADDRESS 0x700108ec /* @ECU_Address@VfAEBS_m_1_v_x@ */ /end MEASUREMENT
/begin MEASUREMENT VfAEBS_m_1_v_y "" FLOAT32_IEEE AEBS_subsystem_integrated_CM_single 0 0 -3.4E+38 3.4E+38 ECU_ADDRESS 0x700108e8 /* @ECU_Address@VfAEBS_m_1_v_y@ */ /end MEASUREMENT
/begin MEASUREMENT VfAEBS_m_EGMO_veh_speed "" FLOAT32_IEEE AEBS_subsystem_integrated_CM_single 0 0 -3.4E+38 3.4E+38 ECU_ADDRESS 0x700108e4 /* @ECU_Address@VfAEBS_m_EGMO_veh_speed@ */ /end MEASUREMENT
/begin MEASUREMENT VfAEBS_m_EGMO_veh_acc "" FLOAT32_IEEE AEBS_subsystem_integrated_CM_single 0 0 -3.4E+38 3.4E+38 ECU_ADDRESS 0x700108e0 /* @ECU_Address@VfAEBS_m_EGMO_veh_acc@ */ /end MEASUREMENT
/begin MEASUREMENT VfAEBS_m_EGMO_v_cur "" FLOAT32_IEEE AEBS_subsystem_integrated_CM_single 0 0 -3.4E+38 3.4E+38 ECU_ADDRESS 0x700108dc /* @ECU_Address@VfAEBS_m_EGMO_v_cur@ */ /end MEASUREMENT
/begin MEASUREMENT VfAEBS_m_EGMO_v_x "" FLOAT32_IEEE AEBS_subsystem_integrated_CM_single 0 0 -3.4E+38 3.4E+38 ECU_ADDRESS 0x700108d8 /* @ECU_Address@VfAEBS_m_EGMO_v_x@ */ /end MEASUREMENT
/begin MEASUREMENT VfAEBS_m_EGMO_v_y "" FLOAT32_IEEE AEBS_subsystem_integrated_CM_single 0 0 -3.4E+38 3.4E+38 ECU_ADDRESS 0x700108d4 /* @ECU_Address@VfAEBS_m_EGMO_v_y@ */ /end MEASUREMENT
/begin MEASUREMENT VfAEBS_veh_speed_used "" FLOAT32_IEEE AEBS_subsystem_integrated_CM_single 0 0 -3.4E+38 3.4E+38 ECU_ADDRESS 0x700108d0 /* @ECU_Address@VfAEBS_veh_speed_used@ */ /end MEASUREMENT
/begin MEASUREMENT VfAEBS_speed_x_used "" FLOAT32_IEEE AEBS_subsystem_integrated_CM_single 0 0 -3.4E+38 3.4E+38 ECU_ADDRESS 0x700108cc /* @ECU_Address@VfAEBS_speed_x_used@ */ /end MEASUREMENT
/begin MEASUREMENT VfAEBS_speed_y_used "" FLOAT32_IEEE AEBS_subsystem_integrated_CM_single 0 0 -3.4E+38 3.4E+38 ECU_ADDRESS 0x700108c8 /* @ECU_Address@VfAEBS_speed_y_used@ */ /end MEASUREMENT
/begin MEASUREMENT VfAEBS_veh_acc_used "" FLOAT32_IEEE AEBS_subsystem_integrated_CM_single 0 0 -3.4E+38 3.4E+38 ECU_ADDRESS 0x700108c4 /* @ECU_Address@VfAEBS_veh_acc_used@ */ /end MEASUREMENT
/begin MEASUREMENT VfAEBS_veh_cur_used "" FLOAT32_IEEE AEBS_subsystem_integrated_CM_single 0 0 -3.4E+38 3.4E+38 ECU_ADDRESS 0x700108c0 /* @ECU_Address@VfAEBS_veh_cur_used@ */ /end MEASUREMENT
/begin MEASUREMENT VfAEBS_obs_delta_dis "" FLOAT32_IEEE AEBS_subsystem_integrated_CM_single 0 0 -3.4E+38 3.4E+38 ARRAY_SIZE 32 ECU_ADDRESS 0x70010840 /* @ECU_Address@VfAEBS_obs_delta_dis@ */ /end MEASUREMENT
/begin MEASUREMENT VfAEBS_obs_delta_speed "" FLOAT32_IEEE AEBS_subsystem_integrated_CM_single 0 0 -3.4E+38 3.4E+38 ARRAY_SIZE 32 ECU_ADDRESS 0x700107c0 /* @ECU_Address@VfAEBS_obs_delta_speed@ */ /end MEASUREMENT
/begin MEASUREMENT VfAEBS_obs_ttc "" FLOAT32_IEEE AEBS_subsystem_integrated_CM_single 0 0 -3.4E+38 3.4E+38 ARRAY_SIZE 32 ECU_ADDRESS 0x70010740 /* @ECU_Address@VfAEBS_obs_ttc@ */ /end MEASUREMENT
/begin MEASUREMENT VfAEBS_obs_dis2adc_long "" FLOAT32_IEEE AEBS_subsystem_integrated_CM_single 0 0 -3.4E+38 3.4E+38 ARRAY_SIZE 32 ECU_ADDRESS 0x700106c0 /* @ECU_Address@VfAEBS_obs_dis2adc_long@ */ /end MEASUREMENT
/begin MEASUREMENT VfAEBS_obs_dis2adc_lateral "" FLOAT32_IEEE AEBS_subsystem_integrated_CM_single 0 0 -3.4E+38 3.4E+38 ARRAY_SIZE 32 ECU_ADDRESS 0x70010640 /* @ECU_Address@VfAEBS_obs_dis2adc_lateral@ */ /end MEASUREMENT
/begin MEASUREMENT VfAEBS_obs_v_long "" FLOAT32_IEEE AEBS_subsystem_integrated_CM_single 0 0 -3.4E+38 3.4E+38 ARRAY_SIZE 32 ECU_ADDRESS 0x700105c0 /* @ECU_Address@VfAEBS_obs_v_long@ */ /end MEASUREMENT
/begin MEASUREMENT VfAEBS_obs_v_lateral "" FLOAT32_IEEE AEBS_subsystem_integrated_CM_single 0 0 -3.4E+38 3.4E+38 ARRAY_SIZE 32 ECU_ADDRESS 0x70010540 /* @ECU_Address@VfAEBS_obs_v_lateral@ */ /end MEASUREMENT
/begin MEASUREMENT VfAEBS_AEB_acceleration_req "" FLOAT32_IEEE AEBS_subsystem_integrated_CM_single 0 0 -3.4E+38 3.4E+38 ECU_ADDRESS 0x700104e0 /* @ECU_Address@VfAEBS_AEB_acceleration_req@ */ /end MEASUREMENT
/begin MEASUREMENT VfAEBS_m_1_id "" SLONG AEBS_subsystem_integrated_CM_int32 0 0 -2147483648 2147483647 ECU_ADDRESS 0x700104c8 /* @ECU_Address@VfAEBS_m_1_id@ */ /end MEASUREMENT
/begin MEASUREMENT VfAEBS_m_timestamp_high "" SLONG AEBS_subsystem_integrated_CM_int32 0 0 -2147483648 2147483647 ECU_ADDRESS 0x700104c4 /* @ECU_Address@VfAEBS_m_timestamp_high@ */ /end MEASUREMENT
/begin MEASUREMENT VfAEBS_m_EGMO_timestamp_h "" SLONG AEBS_subsystem_integrated_CM_int32 0 0 -2147483648 2147483647 ECU_ADDRESS 0x700104c0 /* @ECU_Address@VfAEBS_m_EGMO_timestamp_h@ */ /end MEASUREMENT
/begin MEASUREMENT VfAEBS_m_timestamp_low "" ULONG AEBS_subsystem_integrated_CM_uint32 0 0 0 4294967295 ECU_ADDRESS 0x700104b4 /* @ECU_Address@VfAEBS_m_timestamp_low@ */ /end MEASUREMENT
/begin MEASUREMENT VfAEBS_m_EGMO_timestamp_l "" ULONG AEBS_subsystem_integrated_CM_uint32 0 0 0 4294967295 ECU_ADDRESS 0x700104b0 /* @ECU_Address@VfAEBS_m_EGMO_timestamp_l@ */ /end MEASUREMENT
/begin MEASUREMENT VfAEBS_FCW_enable_state "" SLONG AEBS_subsystem_integrated_CM_EnumAEBS_EnblState 0 0 0 2 ECU_ADDRESS 0x700104ac /* @ECU_Address@VfAEBS_FCW_enable_state@ */ /end MEASUREMENT
/begin MEASUREMENT VeAEBS_AEB_enabled_state "" SLONG AEBS_subsystem_integrated_CM_EnumAEBS_EnblState 0 0 0 2 ECU_ADDRESS 0x700104a8 /* @ECU_Address@VeAEBS_AEB_enabled_state@ */ /end MEASUREMENT
/begin MEASUREMENT VeAEBS_AEB_actived_state "" SLONG AEBS_subsystem_integrated_CM_EnumAEBS_AEBState 0 0 0 6 ECU_ADDRESS 0x700104a4 /* @ECU_Address@VeAEBS_AEB_actived_state@ */ /end MEASUREMENT
/begin MEASUREMENT VfAEBS_m_num_obstacles "" UWORD AEBS_subsystem_integrated_CM_uint16 0 0 0 65535 ECU_ADDRESS 0x700104a2 /* @ECU_Address@VfAEBS_m_num_obstacles@ */ /end MEASUREMENT
/begin MEASUREMENT VfAEBS_m_1_type "" SBYTE AEBS_subsystem_integrated_CM_int8 0 0 -128 127 ECU_ADDRESS 0x700104a1 /* @ECU_Address@VfAEBS_m_1_type@ */ /end MEASUREMENT
/begin MEASUREMENT VfAEBS_m_1_motion_status "" SBYTE AEBS_subsystem_integrated_CM_int8 0 0 -128 127 ECU_ADDRESS 0x700104a0 /* @ECU_Address@VfAEBS_m_1_motion_status@ */ /end MEASUREMENT
/begin MEASUREMENT VfAEBS_obs_position_state "" UBYTE AEBS_subsystem_integrated_CM_uint8 0 0 0 255 ARRAY_SIZE 32 ECU_ADDRESS 0x7001047f /* @ECU_Address@VfAEBS_obs_position_state@ */ /end MEASUREMENT
/begin MEASUREMENT VfAEBS_obs_filtered_type "" UBYTE AEBS_subsystem_integrated_CM_uint8 0 0 0 255 ARRAY_SIZE 32 ECU_ADDRESS 0x7001045f /* @ECU_Address@VfAEBS_obs_filtered_type@ */ /end MEASUREMENT
/begin MEASUREMENT VfAEBS_FCW_error "" UBYTE AEBS_subsystem_integrated_CM_uint8 0 0 0 255 ECU_ADDRESS 0x7001045b /* @ECU_Address@VfAEBS_FCW_error@ */ /end MEASUREMENT
/begin MEASUREMENT VfAEBS_AEB_error "" UBYTE AEBS_subsystem_integrated_CM_uint8 0 0 0 255 ECU_ADDRESS 0x7001045a /* @ECU_Address@VfAEBS_AEB_error@ */ /end MEASUREMENT
/begin MEASUREMENT VfAEBS_FCW_request "" UBYTE AEBS_subsystem_integrated_CM_boolean 0 0 0 1 ECU_ADDRESS 0x70010435 /* @ECU_Address@VfAEBS_FCW_request@ */ /end MEASUREMENT
/begin MEASUREMENT VfAEBS_AEB_request "" UBYTE AEBS_subsystem_integrated_CM_boolean 0 0 0 1 ECU_ADDRESS 0x70010434 /* @ECU_Address@VfAEBS_AEB_request@ */ /end MEASUREMENT
/begin MEASUREMENT VfAEBS_AEB_prebrake_req "" UBYTE AEBS_subsystem_integrated_CM_boolean 0 0 0 1 ECU_ADDRESS 0x70010433 /* @ECU_Address@VfAEBS_AEB_prebrake_req@ */ /end MEASUREMENT
/begin MEASUREMENT VfAEBS_brakeLight_req "" UBYTE AEBS_subsystem_integrated_CM_boolean 0 0 0 1 ECU_ADDRESS 0x70010432 /* @ECU_Address@VfAEBS_brakeLight_req@ */ /end MEASUREMENT
/begin COMPU_METHOD ACCS_subsystem_integrated_CM_single_s "Q = V" RAT_FUNC "%8.6" "s" COEFFS 0 1 0 0 0 1 /end COMPU_METHOD
/begin COMPU_METHOD ACCS_subsystem_integrated_CM_single_m "Q = V" RAT_FUNC "%8.6" "m" COEFFS 0 1 0 0 0 1 /end COMPU_METHOD
/begin COMPU_METHOD ACCS_subsystem_integrated_CM_single_m_s2 "Q = V" RAT_FUNC "%8.6" "m/s2" COEFFS 0 1 0 0 0 1 /end COMPU_METHOD
/begin COMPU_METHOD ACCS_subsystem_integrated_CM_single_m_s "Q = V" RAT_FUNC "%8.6" "m/s" COEFFS 0 1 0 0 0 1 /end COMPU_METHOD
/begin COMPU_METHOD ACCS_subsystem_integrated_CM_single "Q = V" RAT_FUNC "%8.6" "" COEFFS 0 1 0 0 0 1 /end COMPU_METHOD
/begin COMPU_METHOD ACCS_subsystem_integrated_CM_single_pct "Q = V" RAT_FUNC "%8.6" "pct" COEFFS 0 1 0 0 0 1 /end COMPU_METHOD
/begin COMPU_METHOD ACCS_subsystem_integrated_CM_single_rad "Q = V" RAT_FUNC "%8.6" "rad" COEFFS 0 1 0 0 0 1 /end COMPU_METHOD
/begin COMPU_METHOD ACCS_subsystem_integrated_CM_single_NM "Q = V" RAT_FUNC "%8.6" "NM" COEFFS 0 1 0 0 0 1 /end COMPU_METHOD
/begin COMPU_METHOD ACCS_subsystem_integrated_CM_uint8 "Q = V" RAT_FUNC "%3.0" "" COEFFS 0 1 0 0 0 1 /end COMPU_METHOD
/begin COMPU_METHOD ACCS_subsystem_integrated_CM_boolean "Q = V" RAT_FUNC "%1.0" "" COEFFS 0 1 0 0 0 1 /end COMPU_METHOD
/begin COMPU_METHOD ACCS_subsystem_integrated_CM_int32 "Q = V" RAT_FUNC "%10.0" "" COEFFS 0 1 0 0 0 1 /end COMPU_METHOD
/begin COMPU_METHOD ACCS_subsystem_integrated_CM_EnumACCS_StandbyType "Enumerated data type: EnumACCS_StandbyType" TAB_VERB "%0.6" "" COMPU_TAB_REF VTAB_FOR_ACCS_subsystem_integrated_CM_EnumACCS_StandbyType /end COMPU_METHOD
/begin COMPU_METHOD ACCS_subsystem_integrated_CM_EnumACCS_Mode "Enumerated data type: EnumACCS_Mode" TAB_VERB "%0.6" "" COMPU_TAB_REF VTAB_FOR_ACCS_subsystem_integrated_CM_EnumACCS_Mode /end COMPU_METHOD
/begin COMPU_METHOD ACCS_subsystem_integrated_CM_EnumACCS_RunStatus "Enumerated data type: EnumACCS_RunStatus" TAB_VERB "%0.6" "" COMPU_TAB_REF VTAB_FOR_ACCS_subsystem_integrated_CM_EnumACCS_RunStatus /end COMPU_METHOD
/begin COMPU_METHOD ACCS_subsystem_integrated_CM_EnumACCS_FaultState "Enumerated data type: EnumACCS_FaultState" TAB_VERB "%0.6" "" COMPU_TAB_REF VTAB_FOR_ACCS_subsystem_integrated_CM_EnumACCS_FaultState /end COMPU_METHOD
/begin COMPU_METHOD ACCS_subsystem_integrated_CM_uint16 "Q = V" RAT_FUNC "%5.0" "" COEFFS 0 1 0 0 0 1 /end COMPU_METHOD
/begin COMPU_METHOD ACCS_subsystem_integrated_CM_ACCS_CIPVChangedType "Enumerated data type: ACCS_CIPVChangedType" TAB_VERB "%0.6" "" COMPU_TAB_REF VTAB_FOR_ACCS_subsystem_integrated_CM_ACCS_CIPVChangedType /end COMPU_METHOD
/begin COMPU_METHOD AEBS_subsystem_integrated_CM_single "Q = V" RAT_FUNC "%8.6" "" COEFFS 0 1 0 0 0 1 /end COMPU_METHOD
/begin COMPU_METHOD AEBS_subsystem_integrated_CM_int32 "Q = V" RAT_FUNC "%10.0" "" COEFFS 0 1 0 0 0 1 /end COMPU_METHOD
/begin COMPU_METHOD AEBS_subsystem_integrated_CM_EnumAEBS_EnblState "Enumerated data type: EnumAEBS_EnblState" TAB_VERB "%0.6" "" COMPU_TAB_REF VTAB_FOR_AEBS_subsystem_integrated_CM_EnumAEBS_EnblState /end COMPU_METHOD
/begin COMPU_METHOD AEBS_subsystem_integrated_CM_EnumAEBS_AEBState "Enumerated data type: EnumAEBS_AEBState" TAB_VERB "%0.6" "" COMPU_TAB_REF VTAB_FOR_AEBS_subsystem_integrated_CM_EnumAEBS_AEBState /end COMPU_METHOD
/begin COMPU_METHOD AEBS_subsystem_integrated_CM_uint8 "Q = V" RAT_FUNC "%3.0" "" COEFFS 0 1 0 0 0 1 /end COMPU_METHOD
/begin COMPU_METHOD AEBS_subsystem_integrated_CM_boolean "Q = V" RAT_FUNC "%1.0" "" COEFFS 0 1 0 0 0 1 /end COMPU_METHOD
/begin COMPU_METHOD AEBS_subsystem_integrated_CM_EnumAEBS_FCWState "Enumerated data type: EnumAEBS_FCWState" TAB_VERB "%0.6" "" COMPU_TAB_REF VTAB_FOR_AEBS_subsystem_integrated_CM_EnumAEBS_FCWState /end COMPU_METHOD
/begin COMPU_METHOD AEBS_subsystem_integrated_CM_uint32 "Q = V" RAT_FUNC "%10.0" "" COEFFS 0 1 0 0 0 1 /end COMPU_METHOD
/begin COMPU_METHOD AEBS_subsystem_integrated_CM_uint16 "Q = V" RAT_FUNC "%5.0" "" COEFFS 0 1 0 0 0 1 /end COMPU_METHOD
/begin COMPU_METHOD AEBS_subsystem_integrated_CM_int8 "Q = V" RAT_FUNC "%3.0" "" COEFFS 0 1 0 0 0 1 /end COMPU_METHOD
/begin COMPU_VTAB VTAB_FOR_ACCS_subsystem_integrated_CM_EnumACCS_StandbyType "Enumerated data type: EnumACCS_StandbyType" TAB_VERB 11 0 "NoEnterStandby" 1 "FromModeOffToStandby" 2 "FromSpeedCtrlToStandby" 3 "FromFollowingCtrlToStandby" 4 "FromLowSpeedToStandby" 5 "FromTempStopToStandby" 6 "FromStopToStandby" 7 "FromLaunchToStandby" 8 "FromFaultToStandby" 9 "DriverGasPedalOverride" 10 "PressCancelSwitch" /end COMPU_VTAB
/begin COMPU_VTAB VTAB_FOR_ACCS_subsystem_integrated_CM_EnumACCS_Mode "Enumerated data type: EnumACCS_Mode" TAB_VERB 4 0 "ACCS_mode_off" 1 "ACCS_mode_on" 2 "ACCS_mode_standby" 3 "ACCS_mode_fault" /end COMPU_VTAB
/begin COMPU_VTAB VTAB_FOR_ACCS_subsystem_integrated_CM_EnumACCS_RunStatus "Enumerated data type: EnumACCS_RunStatus" TAB_VERB 10 0 "ACCS_status_off" 1 "ACCS_status_on" 2 "ACCS_status_Standby" 3 "ACCS_status_SpeedCtrl" 4 "ACCS_status_FollowingCtrl" 5 "ACCS_status_TempStop" 6 "ACCS_status_Stop" 7 "ACCS_status_Launch" 8 "ACCS_status_LowSpeed" 9 "ACCS_status_Fault" /end COMPU_VTAB
/begin COMPU_VTAB VTAB_FOR_ACCS_subsystem_integrated_CM_EnumACCS_FaultState "Enumerated data type: EnumACCS_FaultState" TAB_VERB 9 0 "NoEnterFault" 1 "FromStatusOnToFault" 2 "FromSpeedCtrlToFault" 3 "FromFollowingCtrlToFault" 4 "FromLowSpeedToFault" 5 "FromTempStopToFault" 6 "FromStopToFault" 7 "FromLaunchToFault" 8 "FromStandbyToFault" /end COMPU_VTAB
/begin COMPU_VTAB VTAB_FOR_ACCS_subsystem_integrated_CM_ACCS_CIPVChangedType "Enumerated data type: ACCS_CIPVChangedType" TAB_VERB 7 0 "Normal" 1 "SelfChangeLane" 2 "CutIn" 3 "CutOut" 4 "Approaching" 5 "Away" 6 "Unknown" /end COMPU_VTAB
/begin COMPU_VTAB VTAB_FOR_AEBS_subsystem_integrated_CM_EnumAEBS_EnblState "Enumerated data type: EnumAEBS_EnblState" TAB_VERB 3 0 "AEBS_EnblState_OFF" 1 "AEBS_EnblState_ON" 2 "AEBS_AEBState_Fault" /end COMPU_VTAB
/begin COMPU_VTAB VTAB_FOR_AEBS_subsystem_integrated_CM_EnumAEBS_AEBState "Enumerated data type: EnumAEBS_AEBState" TAB_VERB 7 0 "AEBS_AEBState_StandBy" 1 "AEBS_AEBState_PreBrakeActived" 2 "AEBS_AEBState_PartialBrakeActived" 3 "AEBS_AEBState_FullBrakeActived" 4 "AEBS_AEBState_ConfidenceConfirmed" 5 "AEBS_AEBState_WaitForEPB" 6 "AEBS_AEBState_WaitForDealy" /end COMPU_VTAB
/begin COMPU_VTAB VTAB_FOR_AEBS_subsystem_integrated_CM_EnumAEBS_FCWState "Enumerated data type: EnumAEBS_FCWState" TAB_VERB 6 0 "AEBS_FCWState_StandBy" 1 "AEBS_FCWState_Level1Actived" 2 "AEBS_FCWState_Level2Actived" 3 "AEBS_FCWState_Level3Actived" 4 "AEBS_FCWState_Level4Actived" 5 "AEBS_FCWState_Level5Actived" /end COMPU_VTAB
/begin GROUP ACCS_subsystem_integrated "ACCS_subsystem_integrated" ROOT /begin SUB_GROUP Root_ACCS /end SUB_GROUP /end GROUP
/begin GROUP Root_ACCS "ACCS_subsystem_integrated/ACCS" /begin SUB_GROUP S1_DtrmnACCS_Input S1_DtrmnACCS_MainLogic /end SUB_GROUP /end GROUP
/begin GROUP S1_DtrmnACCS_Input "ACCS_subsystem_integrated/ACCS/DtrmnACCS_Input"
 /begin SUB_GROUP S3_CheckACCS_FaultState S3_DtrmnACCS_CAN_Information S3_DtrmnACCS_DCSNInformation S3_DtrmnACCS_EGMOInformation /end SUB_GROUP
/end GROUP
/begin GROUP S1_DtrmnACCS_MainLogic "ACCS_subsystem_integrated/ACCS/DtrmnACCS_MainLogic"
 /begin SUB_GROUP S4_DtrmnACCS_DsrdLonControlParm S4_DtrmnACCS_InputSignalConvert S4_DtrmnACCS_Lon_AccelOrTorq S4_DtrmnACCS_ModeManger /end SUB_GROUP
/end GROUP
/begin GROUP S3_CheckACCS_FaultState "ACCS_subsystem_integrated/ACCS/DtrmnACCS_Input/CheckACCS_FaultState"
 /begin REF_CHARACTERISTIC KbACCS_CalFaultTypeOnlyForTest KeACCS_CalFaultTypeOnlyForTest /end REF_CHARACTERISTIC
/end GROUP
/begin GROUP S3_DtrmnACCS_CAN_Information "ACCS_subsystem_integrated/ACCS/DtrmnACCS_Input/DtrmnACCS_CAN_Information"
 /begin REF_CHARACTERISTIC KbACCS_ConsiderWithEPB KbACCS_DriverDoorBeltState KbACCS_UseVirtualPedal KfACCS_Pct_VirtualGasPedal /end REF_CHARACTERISTIC
 /begin REF_MEASUREMENT VfACCS_Input_PhyGasPedal_POWER /end REF_MEASUREMENT
/end GROUP
/begin GROUP S3_DtrmnACCS_DCSNInformation "ACCS_subsystem_integrated/ACCS/DtrmnACCS_Input/DtrmnACCS_DCSNInformation"
 /begin REF_CHARACTERISTIC KbACCS_UseVitualDCSNInfo KbACCS_VitualStopReqFrmDCSN KfACCS_d_VitualStopDisFrmDCSN KfACCS_v_VitualSpeedLimitFrmDCSN /end REF_CHARACTERISTIC
 /begin REF_MEASUREMENT VbACCS_Input_NoSpdLimit VbACCS_Input_stop_request_DCSN VfACCS_Input_stop_s_distance_DCSN VfACCS_Input_traffic_speed_limit_DCSN /end REF_MEASUREMENT
/end GROUP
/begin GROUP S3_DtrmnACCS_EGMOInformation "ACCS_subsystem_integrated/ACCS/DtrmnACCS_Input/DtrmnACCS_EGMOInformation"
 /begin REF_CHARACTERISTIC KeACCS_VehicleSpeedSource KfACCS_v_DeltaSped_EGMOAndCanThrsh /end REF_CHARACTERISTIC
 /begin REF_MEASUREMENT VfACCS_DeltaSped_EGMOAndCan VfACCS_Input_EgoPitch_EGMO VfACCS_Input_latvelocity_EGMO VfACCS_Input_linear_Acceleration_EGMO VfACCS_Input_linear_velocity_EGMO VfACCS_Input_longvelocity_EGMO /end REF_MEASUREMENT
/end GROUP
/begin GROUP S4_DtrmnACCS_DsrdLonControlParm "ACCS_subsystem_integrated/ACCS/DtrmnACCS_MainLogic/DtrmnACCS_DsrdLonControlParm"
 /begin SUB_GROUP S14_CalcACCS_EgoVehicleTargetSpeed S14_CalcACCS_OpenAccel S14_DtrmnACCS_AccelAndSpdLimit /end SUB_GROUP
/end GROUP
/begin GROUP S4_DtrmnACCS_InputSignalConvert "ACCS_subsystem_integrated/ACCS/DtrmnACCS_MainLogic/DtrmnACCS_InputSignalConvert"
 /begin SUB_GROUP S15_DtrmnACCS_EgoStatusFrmCan S15_DtrmnACCS_TargetsSecletion /end SUB_GROUP
/end GROUP
/begin GROUP S4_DtrmnACCS_Lon_AccelOrTorq "ACCS_subsystem_integrated/ACCS/DtrmnACCS_MainLogic/DtrmnACCS_Lon_AccelOrTorq"
 /begin SUB_GROUP S16_ClacACCS_DsrdLonAccel S16_DtrmnACCS_ActuaorControl S16_DtrmnACCS_RangeCtrlPID S16_DtrmnACCS_SpeedCtrlPID /end SUB_GROUP
/end GROUP
/begin GROUP S4_DtrmnACCS_ModeManger "ACCS_subsystem_integrated/ACCS/DtrmnACCS_MainLogic/DtrmnACCS_ModeManger"
 /begin SUB_GROUP S17_DtrmnACCS_FaultState S17_DtrmnACCS_ModeState S17_DtrmnACCS_RunStatus /end SUB_GROUP
 /begin REF_CHARACTERISTIC KbACCS_AEBStateFrmCal KbACCS_CalCIPV_FlickState KbACCS_NotAllowEnterStandbyForUSDemo /end REF_CHARACTERISTIC
 /begin REF_MEASUREMENT VbACCS_AEB_Active VbACCS_InformDriverPressGasPedal VbACCS_InformDriverPressResume VbACCS_MainSwitch VeACCS_EnterStandbyType VeACCS_RunStatus VfACCS_CombinedSpeedLimit VfACCS_Range_Actual /end REF_MEASUREMENT
/end GROUP
/begin GROUP S14_CalcACCS_EgoVehicleTargetSpeed "ACCS_subsystem_integrated/ACCS/DtrmnACCS_MainLogic/DtrmnACCS_DsrdLonControlParm/CalcACCS_EgoVehicleTargetSpeed"
 /begin REF_CHARACTERISTIC kfACCS_v_TargetVehicleSpeedHi kfACCS_v_TargetVehicleSpeedLo /end REF_CHARACTERISTIC
 /begin REF_MEASUREMENT VfACCS_VehSpeed_Tar /end REF_MEASUREMENT
/end GROUP
/begin GROUP S14_CalcACCS_OpenAccel "ACCS_subsystem_integrated/ACCS/DtrmnACCS_MainLogic/DtrmnACCS_DsrdLonControlParm/CalcACCS_OpenAccel" /begin SUB_GROUP S19_If_Action_Subsystem /end SUB_GROUP
 /begin REF_CHARACTERISTIC KfACCS_d_RangePIDCtrl_RangeErrlimit KtACCS_d_RespDCSNStopThrshHi /end REF_CHARACTERISTIC
 /begin REF_MEASUREMENT VbACCS_NeedRespStopFrmDCSN VfACCS_FeedForwardAccel VfACCS_OpenAccel_ForDCSNStop /end REF_MEASUREMENT
/end GROUP
/begin GROUP S14_DtrmnACCS_AccelAndSpdLimit "ACCS_subsystem_integrated/ACCS/DtrmnACCS_MainLogic/DtrmnACCS_DsrdLonControlParm/DtrmnACCS_AccelAndSpdLimit" /begin REF_MEASUREMENT VfACCS_FinalSpeedLimit /end REF_MEASUREMENT /end GROUP
/begin GROUP S15_DtrmnACCS_EgoStatusFrmCan "ACCS_subsystem_integrated/ACCS/DtrmnACCS_MainLogic/DtrmnACCS_InputSignalConvert/DtrmnACCS_EgoStatusFrmCan"
 /begin REF_CHARACTERISTIC KaACCS_t_TimeGapFrmDriver KbACCS_CalDriverSetSpeed KbACCS_CalTimeGap KbACCS_CancelSwitch KbACCS_MainSwitch KbACCS_ResumeSwitch KcACCS_ABSActvieCntDisableACCThrsh KeACCS_TargetRangeCalType KfACCS_d_MaxRange KfACCS_d_MinimumRange KfACCS_t_TimeGapToCalcRange KfACCS_v_CalDriverSetSpeed KfACCS_v_DriverSetSpeedMinThrsh KtACCS_d_CIPVTargtRange /end REF_CHARACTERISTIC
 /begin REF_MEASUREMENT VbACCS_BrakePedalPress VbACCS_DriverHasSetSpeed VbACCS_EPB_Engaged VbACCS_EgoLimit VbACCS_ResumeSwitch VfACCS_DriverTargetRange /end REF_MEASUREMENT
/end GROUP
/begin GROUP S15_DtrmnACCS_TargetsSecletion "ACCS_subsystem_integrated/ACCS/DtrmnACCS_MainLogic/DtrmnACCS_InputSignalConvert/DtrmnACCS_TargetsSecletion" /begin SUB_GROUP S35_DtrmnACCS_TargetObject /end SUB_GROUP /begin REF_MEASUREMENT VbACCS_Input_Obs_valid VfACCS_Input_Obs_Num /end REF_MEASUREMENT /end GROUP
/begin GROUP S16_ClacACCS_DsrdLonAccel "ACCS_subsystem_integrated/ACCS/DtrmnACCS_MainLogic/DtrmnACCS_Lon_AccelOrTorq/ClacACCS_DsrdLonAccel"
 /begin REF_CHARACTERISTIC KbACCS_EnblSlopeOfst KbACCS_UseStopStatus_Accel KfACCS_a_OutAccelHiThrsh KfACCS_a_OutAccelLoThrsh KfACCS_k_DrsdAccelFilter KfACCS_k_EgoPitchFilter KtACCS_r_DCSNStopDistanceGain KtACCS_r_DCSNStopSpdGain /end REF_CHARACTERISTIC
 /begin REF_MEASUREMENT VfACCS_DCSNStopAccel VfACCS_DrsdAccelWithDCSN VfACCS_DrsdAccelWithPitch /end REF_MEASUREMENT
/end GROUP
/begin GROUP S16_DtrmnACCS_ActuaorControl "ACCS_subsystem_integrated/ACCS/DtrmnACCS_MainLogic/DtrmnACCS_Lon_AccelOrTorq/DtrmnACCS_ActuaorControl" /begin SUB_GROUP S94_CalcACCS_FinalAccelReq S94_CalcACCS_FinalTorqReq /end SUB_GROUP /end GROUP
/begin GROUP S16_DtrmnACCS_RangeCtrlPID "ACCS_subsystem_integrated/ACCS/DtrmnACCS_MainLogic/DtrmnACCS_Lon_AccelOrTorq/DtrmnACCS_RangeCtrlPID" /begin SUB_GROUP S95_DtrmnACCS_RangeCtrlProp /end SUB_GROUP /begin REF_MEASUREMENT VfACCS_RangCtrCL_CIPV /end REF_MEASUREMENT /end GROUP
/begin GROUP S16_DtrmnACCS_SpeedCtrlPID "ACCS_subsystem_integrated/ACCS/DtrmnACCS_MainLogic/DtrmnACCS_Lon_AccelOrTorq/DtrmnACCS_SpeedCtrlPID" /begin SUB_GROUP S96_DtrmnACCS_SpeedCtrlProp /end SUB_GROUP /begin REF_CHARACTERISTIC KbACCS_ConsiderSIPVforACC KfACCS_v_SpdPIDCtrl_SpdErrlimit /end REF_CHARACTERISTIC /begin REF_MEASUREMENT VfACCS_DrsdAccelFrmRngSped VfACCS_SpdErrLim_CIPV /end REF_MEASUREMENT /end GROUP
/begin GROUP S17_DtrmnACCS_FaultState "ACCS_subsystem_integrated/ACCS/DtrmnACCS_MainLogic/DtrmnACCS_ModeManger/DtrmnACCS_FaultState" /begin REF_MEASUREMENT VeACCS_FaultState /end REF_MEASUREMENT /end GROUP
/begin GROUP S17_DtrmnACCS_ModeState "ACCS_subsystem_integrated/ACCS/DtrmnACCS_MainLogic/DtrmnACCS_ModeManger/DtrmnACCS_ModeState" /begin SUB_GROUP S123_DtrmnACCS_ModeTransferConds /end SUB_GROUP
 /begin REF_MEASUREMENT VeACCS_EnterStandbyState VeACCS_ModeState VeACCS_RunStatusBeforeFault VeACCS_RunStatusFrmMode /end REF_MEASUREMENT
/end GROUP
/begin GROUP S17_DtrmnACCS_RunStatus "ACCS_subsystem_integrated/ACCS/DtrmnACCS_MainLogic/DtrmnACCS_ModeManger/DtrmnACCS_RunStatus" /begin SUB_GROUP S124_DtrmnACCS_StatusTransferConds /end SUB_GROUP
 /begin REF_CHARACTERISTIC KfACCS_t_ExitLaunchTimer KfACCS_t_LaunchToLowSpdTm KfACCS_t_LaunchToTempStpTm KfACCS_t_MaxTimerAllowAutoResume KfACCS_t_TempStpToStpDelay KfACCS_v_ExitLaunchSpeedThrsh KfACCS_v_LaunchToLowSpdSpeedThrsh KfACCS_v_MovingMinSpeedThrsh /end REF_CHARACTERISTIC
 /begin REF_MEASUREMENT VbACCS_LaunchToFollowingCtrl VbACCS_LaunchToLowSpd VbACCS_LaunchToSpeedCtrl VbACCS_LaunchToTempStop VbACCS_StopToLaunch VbACCS_TempStpToStop VfACCS_StopTimer /end REF_MEASUREMENT
/end GROUP
/begin GROUP S19_If_Action_Subsystem "ACCS_subsystem_integrated/ACCS/DtrmnACCS_MainLogic/DtrmnACCS_DsrdLonControlParm/CalcACCS_OpenAccel/If Action Subsystem"
 /begin REF_CHARACTERISTIC KbACCS_UseCIPVAccelToCalOpenAccel KtACCS_a_OpenAccel_FollowCtrl /end REF_CHARACTERISTIC
/end GROUP
/begin GROUP S35_DtrmnACCS_TargetObject "ACCS_subsystem_integrated/ACCS/DtrmnACCS_MainLogic/DtrmnACCS_InputSignalConvert/DtrmnACCS_TargetsSecletion/DtrmnACCS_TargetObject" /begin SUB_GROUP S37_CIPV S37_CIPVL S37_CIPVR S37_obs_F S37_obs_L S37_obs_R /end SUB_GROUP /end GROUP
/begin GROUP S94_CalcACCS_FinalAccelReq "ACCS_subsystem_integrated/ACCS/DtrmnACCS_MainLogic/DtrmnACCS_Lon_AccelOrTorq/DtrmnACCS_ActuaorControl/CalcACCS_FinalAccelReq"
 /begin REF_CHARACTERISTIC KeACCS_OutPutControlSignal KfACCS_a_AccelCmdDeadZone KfACCS_a_BrakeCmdDeadZone /end REF_CHARACTERISTIC
 /begin REF_MEASUREMENT VbACCS_Lon_Accleration_Req VbACCS_Lon_Torq_Req VfACCS_Lon_Accleration /end REF_MEASUREMENT
/end GROUP
/begin GROUP S94_CalcACCS_FinalTorqReq "ACCS_subsystem_integrated/ACCS/DtrmnACCS_MainLogic/DtrmnACCS_Lon_AccelOrTorq/DtrmnACCS_ActuaorControl/CalcACCS_FinalTorqReq" /begin SUB_GROUP S100_DtrmnACCS_TorqCtrlProp /end SUB_GROUP
 /begin REF_CHARACTERISTIC KeACCS_OutPutControlSignal KfACCS_M_StandardTorqForPercent KtACCS_Pct_AccelToGasPedal /end REF_CHARACTERISTIC
 /begin REF_MEASUREMENT VfACCS_Lon_Torq_Req /end REF_MEASUREMENT
/end GROUP
/begin GROUP S95_DtrmnACCS_RangeCtrlProp "ACCS_subsystem_integrated/ACCS/DtrmnACCS_MainLogic/DtrmnACCS_Lon_AccelOrTorq/DtrmnACCS_RangeCtrlPID/DtrmnACCS_RangeCtrlProp" /begin REF_CHARACTERISTIC KtACCS_r_RangeCtrlPGain /end REF_CHARACTERISTIC /end GROUP
/begin GROUP S96_DtrmnACCS_SpeedCtrlProp "ACCS_subsystem_integrated/ACCS/DtrmnACCS_MainLogic/DtrmnACCS_Lon_AccelOrTorq/DtrmnACCS_SpeedCtrlPID/DtrmnACCS_SpeedCtrlProp" /begin REF_CHARACTERISTIC KtACCS_r_SpeedCtrlPGain /end REF_CHARACTERISTIC /end GROUP
/begin GROUP S123_DtrmnACCS_ModeTransferConds "ACCS_subsystem_integrated/ACCS/DtrmnACCS_MainLogic/DtrmnACCS_ModeManger/DtrmnACCS_ModeState/DtrmnACCS_ModeTransferConds"
 /begin REF_CHARACTERISTIC KbACCS_ConsiderWithoutGear KbACCS_ForceExitStandby KbACCS_NotAllowEnterStandbyForUSDemo KeACCS_DriverMode_AllowACCSNum KeACCS_GearDriveNum KfACCS_Pct_ExitStandbyPedalLoThrsh KfACCS_Pct_GasPedalOverrideThrsh KfACCS_v_EnableACCHiSpdThrsh KfACCS_v_EnableACCLoSpdThrsh /end REF_CHARACTERISTIC
 /begin REF_MEASUREMENT VbACCS_DriverGasPedalOverride VbACCS_DriverModeAllowACCS VbACCS_ExitStandbyCommonConds VbACCS_ExitStandbyToOn VbACCS_GearPositionIsD VbACCS_ResumeSwitchOld VbACCS_SpeedOutRange /end REF_MEASUREMENT
/end GROUP
/begin GROUP S124_DtrmnACCS_StatusTransferConds "ACCS_subsystem_integrated/ACCS/DtrmnACCS_MainLogic/DtrmnACCS_ModeManger/DtrmnACCS_RunStatus/DtrmnACCS_StatusTransferConds" /begin SUB_GROUP S136_DtrmnACCS_WhetherDriverInputDuringStop /end SUB_GROUP
 /begin REF_CHARACTERISTIC KbACCS_AllowOnToStop KbACCS_EnableLowSpeedCtrl KbACCS_NotAllowEnterStandbyForUSDemo KfACCS_a_LowSpdToTempStpAccelThrsh KfACCS_a_TempStpToLaunchAccelThrsh KfACCS_d_FollowingToLowSpdRRThrsh KfACCS_d_LowSpdToTempStpDisThrsh KfACCS_d_TempStopToLaunchRRThrsh KfACCS_d_TempStpToLaunchDisThrsh KfACCS_t_EnterLowSpeedDelay KfACCS_t_ExitLowSpeedDelay KfACCS_t_StopTooLongThrsh KfACCS_v_FollowingToLowSpdThrsh KfACCS_v_LowSpdToFollowingSpdThrsh KfACCS_v_LowSpdToSpdCtrlSpdThrsh KfACCS_v_LowSpdToTempStpSpdThrsh KfACCS_v_OnToSpdCtrlSpdThrsh KfACCS_v_SpdToLowSpdCtrlSpdThrsh KfACCS_v_TempStpToLaunchSpdThrsh /end REF_CHARACTERISTIC
 /begin REF_MEASUREMENT VbACCS_EnterStandbyCommonCod VbACCS_FollowingToLowSpdCtrl VbACCS_FollowingToSpeedCtrl VbACCS_FromFollowingCtrlToStandby VbACCS_FromLaunchToStandby VbACCS_FromLowSpeedToStandby VbACCS_FromSpeedCtrlToStandby VbACCS_FromStopToStandby VbACCS_HasCIPV_Object VbACCS_LowSpdToFollowingCtrl VbACCS_LowSpdToSpeedCtr VbACCS_LowSpdToTempStop VbACCS_SpdToLowSpeedCtr VbACCS_SpeedToFollowingCtr VbACCS_StatusOnToSpeedCtrl VbACCS_StatusOnToStop VbACCS_TempStopToLaunch /end REF_MEASUREMENT
/end GROUP
/begin GROUP S37_CIPV "ACCS_subsystem_integrated/ACCS/DtrmnACCS_MainLogic/DtrmnACCS_InputSignalConvert/DtrmnACCS_TargetsSecletion/DtrmnACCS_TargetObject/CIPV"
 /begin SUB_GROUP S38_Calculate_Obs_Motion_State_ S38_Calculate_Obs_Range S38_Detect_Obs_Change_Status S38_Detect_Obs_Flicker_Status /end SUB_GROUP
 /begin REF_CHARACTERISTIC KbACCS_UseVirtualObject KfACCS_a_LinearAcc_PreSet KfACCS_d_Range_PreSet KfACCS_v_LinearVelocity_PreSet KfACCS_v_RangeRate_PreSet /end REF_CHARACTERISTIC
 /begin REF_MEASUREMENT VbACCS_CIPVObsRangeFlicker VfACCS_Input_Obs_ID VfACCS_Input_Obs_LatDis VfACCS_Input_Obs_Lat_VFiltered VfACCS_Input_Obs_LinearAcc VfACCS_Input_Obs_LinearVelocity VfACCS_Input_Obs_Long_VFiltered VfACCS_Input_Obs_Range VfACCS_Input_Obs_Rangerate VfACCS_Obs_Lat_A_OBFU VfACCS_Obs_Lat_OBFU VfACCS_Obs_Lat_V_OBFU VfACCS_Obs_Long_A_OBFU VfACCS_Obs_Long_OBFU VfACCS_Obs_Long_V_OBFU /end REF_MEASUREMENT
/end GROUP
/begin GROUP S37_CIPVL "ACCS_subsystem_integrated/ACCS/DtrmnACCS_MainLogic/DtrmnACCS_InputSignalConvert/DtrmnACCS_TargetsSecletion/DtrmnACCS_TargetObject/CIPVL" /begin SUB_GROUP S39_Calculate_Obs_Motion_State_ S39_Calculate_Obs_Range /end SUB_GROUP
 /begin REF_CHARACTERISTIC KbACCS_UseVirtualObject KfACCS_a_LinearAcc_PreSet KfACCS_d_Range_PreSet KfACCS_v_LinearVelocity_PreSet KfACCS_v_RangeRate_PreSet /end REF_CHARACTERISTIC
/end GROUP
/begin GROUP S37_CIPVR "ACCS_subsystem_integrated/ACCS/DtrmnACCS_MainLogic/DtrmnACCS_InputSignalConvert/DtrmnACCS_TargetsSecletion/DtrmnACCS_TargetObject/CIPVR" /begin SUB_GROUP S40_Calculate_Obs_Motion_State_ S40_Calculate_Obs_Range /end SUB_GROUP
 /begin REF_CHARACTERISTIC KbACCS_UseVirtualObject KfACCS_a_LinearAcc_PreSet KfACCS_d_Range_PreSet KfACCS_v_LinearVelocity_PreSet KfACCS_v_RangeRate_PreSet /end REF_CHARACTERISTIC
/end GROUP
/begin GROUP S37_obs_F "ACCS_subsystem_integrated/ACCS/DtrmnACCS_MainLogic/DtrmnACCS_InputSignalConvert/DtrmnACCS_TargetsSecletion/DtrmnACCS_TargetObject/obs_F" /begin SUB_GROUP S41_Calculate_Obs_Motion_State_ S41_Calculate_Obs_Range /end SUB_GROUP
 /begin REF_CHARACTERISTIC KbACCS_UseVirtualObject KfACCS_a_LinearAcc_PreSet KfACCS_d_Range_PreSet KfACCS_v_LinearVelocity_PreSet KfACCS_v_RangeRate_PreSet /end REF_CHARACTERISTIC
/end GROUP
/begin GROUP S37_obs_L "ACCS_subsystem_integrated/ACCS/DtrmnACCS_MainLogic/DtrmnACCS_InputSignalConvert/DtrmnACCS_TargetsSecletion/DtrmnACCS_TargetObject/obs_L" /begin SUB_GROUP S42_Calculate_Obs_Motion_State_ S42_Calculate_Obs_Range /end SUB_GROUP
 /begin REF_CHARACTERISTIC KbACCS_UseVirtualObject KfACCS_a_LinearAcc_PreSet KfACCS_d_Range_PreSet KfACCS_v_LinearVelocity_PreSet KfACCS_v_RangeRate_PreSet /end REF_CHARACTERISTIC
/end GROUP
/begin GROUP S37_obs_R "ACCS_subsystem_integrated/ACCS/DtrmnACCS_MainLogic/DtrmnACCS_InputSignalConvert/DtrmnACCS_TargetsSecletion/DtrmnACCS_TargetObject/obs_R" /begin SUB_GROUP S43_Calculate_Obs_Motion_State_ S43_Calculate_Obs_Range /end SUB_GROUP
 /begin REF_CHARACTERISTIC KbACCS_UseVirtualObject KfACCS_a_LinearAcc_PreSet KfACCS_d_Range_PreSet KfACCS_v_LinearVelocity_PreSet KfACCS_v_RangeRate_PreSet /end REF_CHARACTERISTIC
/end GROUP
/begin GROUP S100_DtrmnACCS_TorqCtrlProp "ACCS_subsystem_integrated/ACCS/DtrmnACCS_MainLogic/DtrmnACCS_Lon_AccelOrTorq/DtrmnACCS_ActuaorControl/CalcACCS_FinalTorqReq/DtrmnACCS_TorqCtrlProp" /begin REF_CHARACTERISTIC KtACCS_r_TorqCtrlProp /end REF_CHARACTERISTIC /end GROUP
/begin GROUP S136_DtrmnACCS_WhetherDriverInputDuringStop "ACCS_subsystem_integrated/ACCS/DtrmnACCS_MainLogic/DtrmnACCS_ModeManger/DtrmnACCS_RunStatus/DtrmnACCS_StatusTransferConds/DtrmnACCS_WhetherDriverInputDuringStop"
 /begin REF_CHARACTERISTIC KfACCS_Pct_DriverPressGasPedalThrsh KfACCS_t_PressGasPedalHoldTm KfACCS_t_PressResumeHoldTm /end REF_CHARACTERISTIC
/end GROUP
/begin GROUP S38_Calculate_Obs_Motion_State_ "ACCS_subsystem_integrated/ACCS/DtrmnACCS_MainLogic/DtrmnACCS_InputSignalConvert/DtrmnACCS_TargetsSecletion/DtrmnACCS_TargetObject/CIPV/Calculate Obs Motion State "
 /begin REF_CHARACTERISTIC KeACCS_RRCalMetdType KfACCS_a_ObjectAccelUpdateThrsh KfACCS_k_ObjectAccelFilter KfACCS_k_ObjectSpdFilter KfACCS_v_LatSpdDeadband_Max KfACCS_v_LatSpdDeadband_Min KfACCS_v_LatSpdUpdateThrsh KfACCS_v_ObjectSpdUpdateThrsh /end REF_CHARACTERISTIC
/end GROUP
/begin GROUP S38_Calculate_Obs_Range "ACCS_subsystem_integrated/ACCS/DtrmnACCS_MainLogic/DtrmnACCS_InputSignalConvert/DtrmnACCS_TargetsSecletion/DtrmnACCS_TargetObject/CIPV/Calculate Obs Range"
 /begin REF_CHARACTERISTIC KfACCS_d_CurvatureRadius_Max KfACCS_d_DisToLeadSur KfACCS_d_DisToSideSur KfACCS_k_ObjectRangeFilter KfACCS_t_TimeOffset /end REF_CHARACTERISTIC
/end GROUP
/begin GROUP S38_Detect_Obs_Change_Status "ACCS_subsystem_integrated/ACCS/DtrmnACCS_MainLogic/DtrmnACCS_InputSignalConvert/DtrmnACCS_TargetsSecletion/DtrmnACCS_TargetObject/CIPV/Detect Obs Change Status" /begin SUB_GROUP S46_Dtrmn_CIPVChangedTypeCond /end SUB_GROUP /begin REF_CHARACTERISTIC KfACCS_t_CIPVChangedTypeDelay /end REF_CHARACTERISTIC /begin REF_MEASUREMENT VeACCS_CIPVChangedType /end REF_MEASUREMENT /end GROUP
/begin GROUP S38_Detect_Obs_Flicker_Status "ACCS_subsystem_integrated/ACCS/DtrmnACCS_MainLogic/DtrmnACCS_InputSignalConvert/DtrmnACCS_TargetsSecletion/DtrmnACCS_TargetObject/CIPV/Detect Obs Flicker Status"
 /begin REF_CHARACTERISTIC KcACCS_DtrmFlickerThresh KfACCS_d_FlickerRangeLatLimit KfACCS_d_FlickerRangeLongLimit KfACCS_v_FlickerRangeEgoSpd KfACCS_v_FlickerRangeRRForReset KfACCS_v_FlickerRangeRateDiffLimit KfACCS_v_FlickerRangeRateLimit /end REF_CHARACTERISTIC
/end GROUP
/begin GROUP S39_Calculate_Obs_Motion_State_ "ACCS_subsystem_integrated/ACCS/DtrmnACCS_MainLogic/DtrmnACCS_InputSignalConvert/DtrmnACCS_TargetsSecletion/DtrmnACCS_TargetObject/CIPVL/Calculate Obs Motion State "
 /begin REF_CHARACTERISTIC KeACCS_RRCalMetdType KfACCS_a_ObjectAccelUpdateThrsh KfACCS_k_ObjectAccelFilter KfACCS_k_ObjectSpdFilter KfACCS_v_LatSpdDeadband_Max KfACCS_v_LatSpdDeadband_Min KfACCS_v_LatSpdUpdateThrsh KfACCS_v_ObjectSpdUpdateThrsh /end REF_CHARACTERISTIC
/end GROUP
/begin GROUP S39_Calculate_Obs_Range "ACCS_subsystem_integrated/ACCS/DtrmnACCS_MainLogic/DtrmnACCS_InputSignalConvert/DtrmnACCS_TargetsSecletion/DtrmnACCS_TargetObject/CIPVL/Calculate Obs Range"
 /begin REF_CHARACTERISTIC KfACCS_d_CurvatureRadius_Max KfACCS_d_DisToLeadSur KfACCS_d_DisToSideSur KfACCS_k_ObjectRangeFilter KfACCS_t_TimeOffset /end REF_CHARACTERISTIC
/end GROUP
/begin GROUP S40_Calculate_Obs_Motion_State_ "ACCS_subsystem_integrated/ACCS/DtrmnACCS_MainLogic/DtrmnACCS_InputSignalConvert/DtrmnACCS_TargetsSecletion/DtrmnACCS_TargetObject/CIPVR/Calculate Obs Motion State "
 /begin REF_CHARACTERISTIC KeACCS_RRCalMetdType KfACCS_a_ObjectAccelUpdateThrsh KfACCS_k_ObjectAccelFilter KfACCS_k_ObjectSpdFilter KfACCS_v_LatSpdDeadband_Max KfACCS_v_LatSpdDeadband_Min KfACCS_v_LatSpdUpdateThrsh KfACCS_v_ObjectSpdUpdateThrsh /end REF_CHARACTERISTIC
/end GROUP
/begin GROUP S40_Calculate_Obs_Range "ACCS_subsystem_integrated/ACCS/DtrmnACCS_MainLogic/DtrmnACCS_InputSignalConvert/DtrmnACCS_TargetsSecletion/DtrmnACCS_TargetObject/CIPVR/Calculate Obs Range"
 /begin REF_CHARACTERISTIC KfACCS_d_CurvatureRadius_Max KfACCS_d_DisToLeadSur KfACCS_d_DisToSideSur KfACCS_k_ObjectRangeFilter KfACCS_t_TimeOffset /end REF_CHARACTERISTIC
/end GROUP
/begin GROUP S41_Calculate_Obs_Motion_State_ "ACCS_subsystem_integrated/ACCS/DtrmnACCS_MainLogic/DtrmnACCS_InputSignalConvert/DtrmnACCS_TargetsSecletion/DtrmnACCS_TargetObject/obs_F/Calculate Obs Motion State "
 /begin REF_CHARACTERISTIC KeACCS_RRCalMetdType KfACCS_a_ObjectAccelUpdateThrsh KfACCS_k_ObjectAccelFilter KfACCS_k_ObjectSpdFilter KfACCS_v_LatSpdDeadband_Max KfACCS_v_LatSpdDeadband_Min KfACCS_v_LatSpdUpdateThrsh KfACCS_v_ObjectSpdUpdateThrsh /end REF_CHARACTERISTIC
/end GROUP
/begin GROUP S41_Calculate_Obs_Range "ACCS_subsystem_integrated/ACCS/DtrmnACCS_MainLogic/DtrmnACCS_InputSignalConvert/DtrmnACCS_TargetsSecletion/DtrmnACCS_TargetObject/obs_F/Calculate Obs Range"
 /begin REF_CHARACTERISTIC KfACCS_d_CurvatureRadius_Max KfACCS_d_DisToLeadSur KfACCS_d_DisToSideSur KfACCS_k_ObjectRangeFilter KfACCS_t_TimeOffset /end REF_CHARACTERISTIC
/end GROUP
/begin GROUP S42_Calculate_Obs_Motion_State_ "ACCS_subsystem_integrated/ACCS/DtrmnACCS_MainLogic/DtrmnACCS_InputSignalConvert/DtrmnACCS_TargetsSecletion/DtrmnACCS_TargetObject/obs_L/Calculate Obs Motion State "
 /begin REF_CHARACTERISTIC KeACCS_RRCalMetdType KfACCS_a_ObjectAccelUpdateThrsh KfACCS_k_ObjectAccelFilter KfACCS_k_ObjectSpdFilter KfACCS_v_LatSpdDeadband_Max KfACCS_v_LatSpdDeadband_Min KfACCS_v_LatSpdUpdateThrsh KfACCS_v_ObjectSpdUpdateThrsh /end REF_CHARACTERISTIC
/end GROUP
/begin GROUP S42_Calculate_Obs_Range "ACCS_subsystem_integrated/ACCS/DtrmnACCS_MainLogic/DtrmnACCS_InputSignalConvert/DtrmnACCS_TargetsSecletion/DtrmnACCS_TargetObject/obs_L/Calculate Obs Range"
 /begin REF_CHARACTERISTIC KfACCS_d_CurvatureRadius_Max KfACCS_d_DisToLeadSur KfACCS_d_DisToSideSur KfACCS_k_ObjectRangeFilter KfACCS_t_TimeOffset /end REF_CHARACTERISTIC
/end GROUP
/begin GROUP S43_Calculate_Obs_Motion_State_ "ACCS_subsystem_integrated/ACCS/DtrmnACCS_MainLogic/DtrmnACCS_InputSignalConvert/DtrmnACCS_TargetsSecletion/DtrmnACCS_TargetObject/obs_R/Calculate Obs Motion State "
 /begin REF_CHARACTERISTIC KeACCS_RRCalMetdType KfACCS_a_ObjectAccelUpdateThrsh KfACCS_k_ObjectAccelFilter KfACCS_k_ObjectSpdFilter KfACCS_v_LatSpdDeadband_Max KfACCS_v_LatSpdDeadband_Min KfACCS_v_LatSpdUpdateThrsh KfACCS_v_ObjectSpdUpdateThrsh /end REF_CHARACTERISTIC
/end GROUP
/begin GROUP S43_Calculate_Obs_Range "ACCS_subsystem_integrated/ACCS/DtrmnACCS_MainLogic/DtrmnACCS_InputSignalConvert/DtrmnACCS_TargetsSecletion/DtrmnACCS_TargetObject/obs_R/Calculate Obs Range"
 /begin REF_CHARACTERISTIC KfACCS_d_CurvatureRadius_Max KfACCS_d_DisToLeadSur KfACCS_d_DisToSideSur KfACCS_k_ObjectRangeFilter KfACCS_t_TimeOffset /end REF_CHARACTERISTIC
/end GROUP
/begin GROUP S46_Dtrmn_CIPVChangedTypeCond "ACCS_subsystem_integrated/ACCS/DtrmnACCS_MainLogic/DtrmnACCS_InputSignalConvert/DtrmnACCS_TargetsSecletion/DtrmnACCS_TargetObject/CIPV/Detect Obs Change Status/Dtrmn_CIPVChangedTypeCond"
 /begin REF_CHARACTERISTIC KfACCS_Ang_DtrmSelfChangeLane KfACCS_d_ChangedObsRangeLatDiff KfACCS_d_ChangedObsRangeLongDiff KfACCS_d_RangeForApproaching KfACCS_d_RangeForAway KfACCS_t_DtrmSelfChangeLane KfACCS_t_DtrmSelfChangeLaneDelay KfACCS_v_ChangedObsVelDiff KfACCS_v_RangeRateForApproaching KfACCS_v_RangeRateForAway /end REF_CHARACTERISTIC
/end GROUP
/begin GROUP AEBS_subsystem_integrated "AEBS_subsystem_integrated" ROOT /begin SUB_GROUP Root_AEBS /end SUB_GROUP /end GROUP
/begin GROUP Root_AEBS "AEBS_subsystem_integrated/AEBS" /begin SUB_GROUP S1_AEBS_Default S1_AEBS_Enabled S1_Monitor S1_Monitor1 /end SUB_GROUP /begin REF_CHARACTERISTIC KbAEBS_Enable_AEB_feature /end REF_CHARACTERISTIC /end GROUP
/begin GROUP S1_AEBS_Default "AEBS_subsystem_integrated/AEBS/AEBS_Default"
 /begin REF_CHARACTERISTIC KbAEBS_Default_AEB_brakeLight_req KbAEBS_Default_AEB_prebrake_req KbAEBS_Default_AEB_request KbAEBS_Default_FCW_requset KfAEBS_Default_AEBS_obj_ID KfAEBS_Default_AEB_acceleration_req KfAEBS_Default_AEB_actived_state KfAEBS_Default_AEB_enabled_state KfAEBS_Default_AEB_error KfAEBS_Default_FCW_active_state KfAEBS_Default_FCW_enable_state KfAEBS_Default_FCW_error KfAEBS_Default_FCW_warn_level /end REF_CHARACTERISTIC
/end GROUP
/begin GROUP S1_AEBS_Enabled "AEBS_subsystem_integrated/AEBS/AEBS_Enabled"
 /begin SUB_GROUP S3_AEBS_Input S3_AEBS_Output S3_AEB_Determination S3_AEB_FCWVIPTargetSelection S3_FCW_Determination /end SUB_GROUP
 /begin REF_CHARACTERISTIC KbAEBS_EnableBrakeHold KfAEBS_CTRL_PeriodFunctionCall KfAEBS_a_BrakeHold KfAEBS_t_TimeBrakeConfdConfirmed KfAEBS_t_TimeExitActide KfAEBS_t_TimeWait2StandbyThrsh /end REF_CHARACTERISTIC
/end GROUP
/begin GROUP S1_Monitor "AEBS_subsystem_integrated/AEBS/Monitor"
 /begin REF_MEASUREMENT VfAEBS_m_1_a_x VfAEBS_m_1_a_y VfAEBS_m_1_center_x VfAEBS_m_1_center_y VfAEBS_m_1_heading VfAEBS_m_1_id VfAEBS_m_1_length VfAEBS_m_1_motion_status VfAEBS_m_1_type VfAEBS_m_1_v_x VfAEBS_m_1_v_y VfAEBS_m_1_width VfAEBS_m_num_obstacles VfAEBS_m_timestamp_high VfAEBS_m_timestamp_low /end REF_MEASUREMENT
/end GROUP
/begin GROUP S1_Monitor1 "AEBS_subsystem_integrated/AEBS/Monitor1"
 /begin REF_MEASUREMENT VfAEBS_m_EGMO_timestamp_h VfAEBS_m_EGMO_timestamp_l VfAEBS_m_EGMO_v_cur VfAEBS_m_EGMO_v_x VfAEBS_m_EGMO_v_y VfAEBS_m_EGMO_veh_acc VfAEBS_m_EGMO_veh_speed /end REF_MEASUREMENT
/end GROUP
/begin GROUP S3_AEBS_Input "AEBS_subsystem_integrated/AEBS/AEBS_Enabled/AEBS_Input"
 /begin SUB_GROUP S6_Error_Detection S6_adc_path_prediction S6_veh_FedBck_update /end SUB_GROUP
 /begin REF_CHARACTERISTIC KbAEBS_Enable_Error /end REF_CHARACTERISTIC
/end GROUP
/begin GROUP S3_AEBS_Output "AEBS_subsystem_integrated/AEBS/AEBS_Enabled/AEBS_Output" /begin SUB_GROUP S7_updataFcwWarning S7_updateobsID /end SUB_GROUP
 /begin REF_MEASUREMENT VeAEBS_AEB_actived_state VeAEBS_AEB_enabled_state VfAEBS_AEB_acceleration_req VfAEBS_AEB_error VfAEBS_AEB_prebrake_req VfAEBS_AEB_request VfAEBS_FCW_enable_state VfAEBS_FCW_error VfAEBS_FCW_request VfAEBS_brakeLight_req /end REF_MEASUREMENT
/end GROUP
/begin GROUP S3_AEB_Determination "AEBS_subsystem_integrated/AEBS/AEBS_Enabled/AEB_Determination"
 /begin SUB_GROUP S8_DetermineAEBStatus S8_DtrmnThreatEvaluation S8_QueueOverride /end SUB_GROUP
/end GROUP
/begin GROUP S3_AEB_FCWVIPTargetSelection "AEBS_subsystem_integrated/AEBS/AEBS_Enabled/AEB_FCWVIPTargetSelection" /begin SUB_GROUP S9_Subsystem1 S9_TestMode S9_TurnState /end SUB_GROUP
 /begin REF_CHARACTERISTIC KbAEBS_Enable_DoRbIW KbAEBS_Enable_DoRbIW_LeftTurn KbAEBS_Test_Mode KbAEBS_Use_OBFU_Acceleration KbAEBS_Use_OBFU_Type KfAEBS_Cur_LeftTurnThrshHi KfAEBS_Cur_LeftTurnThrshLo KfAEBS_Cur_RightTurnThrshHi KfAEBS_Cur_RightTurnThrshLo KfAEBS_GainTHW KfAEBS_GainTTC KfAEBS_Obj_BBoxOffsetBicycle KfAEBS_Obj_BBoxOffsetBus KfAEBS_Obj_BBoxOffsetDefault KfAEBS_Obj_BBoxOffsetMotoRcycle KfAEBS_Obj_BBoxOffsetPedstrn KfAEBS_Obj_BBoxOffsetPedstrn_turn KfAEBS_Obj_BBoxOffsetTruck KfAEBS_Obj_BBoxOffsetVeh KfAEBS_Pedstr_length_Thrsh KfAEBS_Pedstr_width_Thrsh KfAEBS_RadiusOffsetOuter KfAEBS_Veh_DisEnd2OC KfAEBS_Veh_DisHead2OC KfAEBS_Veh_DisRear2COM KfAEBS_Veh_DisRear2OC KfAEBS_Veh_Length KfAEBS_Veh_Width KfAEBS_Veh_WidthBuffer KfAEBS_Zone_DoRbIW_x_front KfAEBS_Zone_DoRbIW_x_rear KfAEBS_d_Dis_BufferTTSP KfAEBS_d_Dis_BufferTTSP_length KfAEBS_d_Dis_LateralIgnore KfAEBS_d_min_dis_swap KfAEBS_t_timeGap_ignore_turn KfAEBS_v_Speed_DeltaWExit KfAEBS_v_Speed_ObjStillThrsh KfAEBS_v_Speed_ObjStillThrshLateral KtAEBS_DoRbIW_width_tb KtAEBS_InnerRadiusOffset_tb KtAEBS_veh_widthGain /end REF_CHARACTERISTIC
 /begin REF_MEASUREMENT VfAEBS_obs_delta_dis VfAEBS_obs_delta_speed VfAEBS_obs_dis2adc_lateral VfAEBS_obs_dis2adc_long VfAEBS_obs_filtered_type VfAEBS_obs_position_state VfAEBS_obs_ttc VfAEBS_obs_v_lateral VfAEBS_obs_v_long VfAEBS_speed_x_used VfAEBS_speed_y_used VfAEBS_veh_acc_used VfAEBS_veh_cur_used VfAEBS_veh_speed_used /end REF_MEASUREMENT
/end GROUP
/begin GROUP S3_FCW_Determination "AEBS_subsystem_integrated/AEBS/AEBS_Enabled/FCW_Determination" /begin SUB_GROUP S10_DetermineFCWStatus S10_ThreatEvaluation /end SUB_GROUP /end GROUP
/begin GROUP S6_Error_Detection "AEBS_subsystem_integrated/AEBS/AEBS_Enabled/AEBS_Input/Error Detection" /begin REF_CHARACTERISTIC KfAEBS_t_Time_OBFUNReceivedThrsh /end REF_CHARACTERISTIC /end GROUP
/begin GROUP S6_adc_path_prediction "AEBS_subsystem_integrated/AEBS/AEBS_Enabled/AEBS_Input/adc_path_prediction"
 /begin REF_CHARACTERISTIC KfAEBS_CoeffStrwhl2Radius KfAEBS_Veh_Strwhl2FrtwhlRatio KfAEBS_Veh_WheelBase /end REF_CHARACTERISTIC
/end GROUP
/begin GROUP S8_DtrmnThreatEvaluation "AEBS_subsystem_integrated/AEBS/AEBS_Enabled/AEB_Determination/DtrmnThreatEvaluation" /begin REF_CHARACTERISTIC KfAEBS_CTRL_PeriodFunctionCall /end REF_CHARACTERISTIC /end GROUP
/begin GROUP S10_ThreatEvaluation "AEBS_subsystem_integrated/AEBS/AEBS_Enabled/FCW_Determination/ThreatEvaluation" /begin REF_CHARACTERISTIC KfAEBS_CTRL_PeriodFunctionCall /end REF_CHARACTERISTIC /end GROUP
/begin GROUP S40_CalcObsAreq "AEBS_subsystem_integrated/AEBS/AEBS_Enabled/AEB_Determination/DtrmnThreatEvaluation/CalcObsAreq" /begin REF_CHARACTERISTIC KfAEBS_CTRL_PeriodFunctionCall /end REF_CHARACTERISTIC /end GROUP
/begin GROUP S40_Deactive "AEBS_subsystem_integrated/AEBS/AEBS_Enabled/AEB_Determination/DtrmnThreatEvaluation/Deactive" /begin REF_CHARACTERISTIC KfAEBS_CTRL_PeriodFunctionCall /end REF_CHARACTERISTIC /end GROUP
/begin GROUP S40_FullBrakeThreat "AEBS_subsystem_integrated/AEBS/AEBS_Enabled/AEB_Determination/DtrmnThreatEvaluation/FullBrakeThreat" /begin REF_CHARACTERISTIC KfAEBS_CTRL_PeriodFunctionCall /end REF_CHARACTERISTIC /end GROUP
/begin GROUP S40_PartialBrakeThreat "AEBS_subsystem_integrated/AEBS/AEBS_Enabled/AEB_Determination/DtrmnThreatEvaluation/PartialBrakeThreat" /begin REF_CHARACTERISTIC KfAEBS_CTRL_PeriodFunctionCall /end REF_CHARACTERISTIC /end GROUP
/begin GROUP S41_ConfirmBrakePedlPsd "AEBS_subsystem_integrated/AEBS/AEBS_Enabled/AEB_Determination/QueueOverride/ConfirmBrakePedlPsd" /begin REF_CHARACTERISTIC KfAEBS_CTRL_PeriodFunctionCall /end REF_CHARACTERISTIC /end GROUP
/begin GROUP S143_Deactive "AEBS_subsystem_integrated/AEBS/AEBS_Enabled/FCW_Determination/ThreatEvaluation/Deactive" /begin REF_CHARACTERISTIC KfAEBS_CTRL_PeriodFunctionCall /end REF_CHARACTERISTIC /end GROUP
/begin GROUP S42_AccelReqFilter "AEBS_subsystem_integrated/AEBS/AEBS_Enabled/AEB_Determination/DetermineAEBStatus/CalcAEBSAcceleration/AccelReqFilter" /begin REF_CHARACTERISTIC KfAEBS_CTRL_PeriodFunctionCall /end REF_CHARACTERISTIC /end GROUP
/begin GROUP S42_ClacCurrTime "AEBS_subsystem_integrated/AEBS/AEBS_Enabled/AEB_Determination/DetermineAEBStatus/CalcAEBSAcceleration/ClacCurrTime" /begin REF_CHARACTERISTIC KfAEBS_CTRL_PeriodFunctionCall /end REF_CHARACTERISTIC /end GROUP
/begin GROUP S69_Subsystem "AEBS_subsystem_integrated/AEBS/AEBS_Enabled/AEB_Determination/DtrmnThreatEvaluation/FullBrakeThreat/Subsystem" /begin REF_CHARACTERISTIC KfAEBS_CTRL_PeriodFunctionCall /end REF_CHARACTERISTIC /end GROUP
/begin GROUP S70_Subsystem "AEBS_subsystem_integrated/AEBS/AEBS_Enabled/AEB_Determination/DtrmnThreatEvaluation/PartialBrakeThreat/Subsystem" /begin REF_CHARACTERISTIC KfAEBS_CTRL_PeriodFunctionCall /end REF_CHARACTERISTIC /end GROUP
/begin GROUP S73_Deactive_time "AEBS_subsystem_integrated/AEBS/AEBS_Enabled/AEB_Determination/DtrmnThreatEvaluation/inhibit/Deactive_time" /begin REF_CHARACTERISTIC KfAEBS_CTRL_PeriodFunctionCall /end REF_CHARACTERISTIC /end GROUP
/begin GROUP S85_SpeedReductionASILACheck "AEBS_subsystem_integrated/AEBS/AEBS_Enabled/AEB_Determination/DtrmnThreatEvaluation/Deactive/SpeedReductionMonitoring/SpeedReductionASILACheck" /begin REF_CHARACTERISTIC KfAEBS_CTRL_PeriodFunctionCall /end REF_CHARACTERISTIC /end GROUP
/end MODULE
/end PROJECT
