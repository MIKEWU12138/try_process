ASAP2_VERSION 1 60
/begin PROJECT hj_adcu "_default_ProjectLongIdentifier"
/begin HEADER "_default_HeaderComment" PROJECT_NO _default_ProjectNr /end HEADER
/begin MODULE _default_ModuleName "_default_ModuleLongIdentifier"
/begin MOD_COMMON "_default_ModCommonComment" DEPOSIT ABSOLUTE BYTE_ORDER MSB_LAST ALIGNMENT_BYTE 1 ALIGNMENT_WORD 2 ALIGNMENT_LONG 4 ALIGNMENT_FLOAT32_IEEE 4 ALIGNMENT_FLOAT64_IEEE 4 /end MOD_COMMON
/begin MOD_COMMON "Mod Common Comment Here" BYTE_ORDER MSB_LAST /end MOD_COMMON
/begin RECORD_LAYOUT Scalar_BOOLEAN FNC_VALUES 1 UBYTE COLUMN_DIR DIRECT /end RECORD_LAYOUT
/begin RECORD_LAYOUT Scalar_UBYTE FNC_VALUES 1 UBYTE COLUMN_DIR DIRECT /end RECORD_LAYOUT
/begin RECORD_LAYOUT Scalar_BYTE FNC_VALUES 1 SBYTE COLUMN_DIR DIRECT /end RECORD_LAYOUT
/begin RECORD_LAYOUT Scalar_UWORD FNC_VALUES 1 UWORD COLUMN_DIR DIRECT /end RECORD_LAYOUT
/begin RECORD_LAYOUT Scalar_LONG FNC_VALUES 1 SLONG COLUMN_DIR DIRECT /end RECORD_LAYOUT
/begin RECORD_LAYOUT Scalar_FLOAT32_IEEE FNC_VALUES 1 FLOAT32_IEEE COLUMN_DIR DIRECT /end RECORD_LAYOUT
/begin RECORD_LAYOUT Lookup1D_SLONG FNC_VALUES 1 SLONG COLUMN_DIR DIRECT /end RECORD_LAYOUT
/begin RECORD_LAYOUT Lookup1D_X_LONG AXIS_PTS_X 1 SLONG INDEX_INCR DIRECT /end RECORD_LAYOUT
/begin RECORD_LAYOUT Lookup1D_FLOAT32_IEEE FNC_VALUES 1 FLOAT32_IEEE COLUMN_DIR DIRECT /end RECORD_LAYOUT
/begin RECORD_LAYOUT Lookup1D_X_FLOAT32_IEEE AXIS_PTS_X 1 FLOAT32_IEEE INDEX_INCR DIRECT /end RECORD_LAYOUT
/begin RECORD_LAYOUT Lookup1D_FLOAT64_IEEE FNC_VALUES 1 FLOAT64_IEEE COLUMN_DIR DIRECT /end RECORD_LAYOUT
/begin RECORD_LAYOUT Lookup1D_X_FLOAT64_IEEE AXIS_PTS_X 1 FLOAT64_IEEE INDEX_INCR DIRECT /end RECORD_LAYOUT
/begin RECORD_LAYOUT Lookup2D_BOOLEAN FNC_VALUES 1 UBYTE COLUMN_DIR DIRECT /end RECORD_LAYOUT
/begin RECORD_LAYOUT Lookup2D_X_BOOLEAN AXIS_PTS_X 1 UBYTE INDEX_INCR DIRECT /end RECORD_LAYOUT
/begin RECORD_LAYOUT Lookup2D_UBYTE FNC_VALUES 1 UBYTE COLUMN_DIR DIRECT /end RECORD_LAYOUT
/begin RECORD_LAYOUT Lookup2D_X_UBYTE AXIS_PTS_X 1 UBYTE INDEX_INCR DIRECT /end RECORD_LAYOUT
/begin RECORD_LAYOUT Lookup2D_BYTE FNC_VALUES 1 SBYTE COLUMN_DIR DIRECT /end RECORD_LAYOUT
/begin RECORD_LAYOUT Lookup2D_X_BYTE AXIS_PTS_X 1 SBYTE INDEX_INCR DIRECT /end RECORD_LAYOUT
/begin RECORD_LAYOUT Lookup2D_UWORD FNC_VALUES 1 UWORD COLUMN_DIR DIRECT /end RECORD_LAYOUT
/begin RECORD_LAYOUT Lookup2D_X_UWORD AXIS_PTS_X 1 UWORD INDEX_INCR DIRECT /end RECORD_LAYOUT
/begin RECORD_LAYOUT Lookup2D_WORD FNC_VALUES 1 SWORD COLUMN_DIR DIRECT /end RECORD_LAYOUT
/begin RECORD_LAYOUT Lookup2D_X_WORD AXIS_PTS_X 1 SWORD INDEX_INCR DIRECT /end RECORD_LAYOUT
/begin RECORD_LAYOUT Lookup2D_ULONG FNC_VALUES 1 ULONG COLUMN_DIR DIRECT /end RECORD_LAYOUT
/begin RECORD_LAYOUT Lookup2D_X_ULONG AXIS_PTS_X 1 ULONG INDEX_INCR DIRECT /end RECORD_LAYOUT
/begin RECORD_LAYOUT Lookup2D_LONG FNC_VALUES 1 SLONG COLUMN_DIR DIRECT /end RECORD_LAYOUT
/begin RECORD_LAYOUT Lookup2D_X_LONG AXIS_PTS_X 1 SLONG INDEX_INCR DIRECT /end RECORD_LAYOUT
/begin RECORD_LAYOUT Lookup2D_FLOAT32_IEEE FNC_VALUES 1 FLOAT32_IEEE COLUMN_DIR DIRECT /end RECORD_LAYOUT
/begin RECORD_LAYOUT Lookup2D_X_FLOAT32_IEEE AXIS_PTS_X 1 FLOAT32_IEEE INDEX_INCR DIRECT /end RECORD_LAYOUT
/begin RECORD_LAYOUT Lookup2D_FLOAT64_IEEE FNC_VALUES 1 FLOAT64_IEEE COLUMN_DIR DIRECT /end RECORD_LAYOUT
/begin RECORD_LAYOUT Lookup2D_X_FLOAT64_IEEE AXIS_PTS_X 1 FLOAT64_IEEE INDEX_INCR DIRECT /end RECORD_LAYOUT
/begin CHARACTERISTIC KtACCS_t_CalOpenAccelForStopFrmDCSN "Want how long to stop the vehicle" CURVE 0x70100028 /* @ECU_Address@KtACCS_t_CalOpenAccelForStopFrmDCSN@ */ Lookup1D_FLOAT32_IEEE 0 ACCS_subsystem_integrated_CM_single_s 0.0 1200.0
 /begin AXIS_DESCR COM_AXIS NO_INPUT_QUANTITY ACCS_subsystem_integrated_CM_single_m 6 0.0 200.0 AXIS_PTS_REF KtACCS_AXIS_OpenAccelStop_StopDis /end AXIS_DESCR
/end CHARACTERISTIC
/begin CHARACTERISTIC KtACCS_a_OpenAccel_SpeedCtrl "This is open acceleration table under speed control mode,it is the function of speed error" CURVE 0x70100978 /* @ECU_Address@KtACCS_a_OpenAccel_SpeedCtrl@ */ Lookup1D_FLOAT32_IEEE 0 ACCS_subsystem_integrated_CM_single_m_s2 -4.0 4.0
 /begin AXIS_DESCR COM_AXIS NO_INPUT_QUANTITY ACCS_subsystem_integrated_CM_single_m_s 7 -30.0 30.0 AXIS_PTS_REF KtACCS_AXIS_OpenAccelSpedCtrl_SpedErr /end AXIS_DESCR
/end CHARACTERISTIC
/begin CHARACTERISTIC KtACCS_a_OpenAccel_LowSpeedCtrl "his is open acceleration table under low speed control mode,it is the function of speed error" CURVE 0x70100994 /* @ECU_Address@KtACCS_a_OpenAccel_LowSpeedCtrl@ */ Lookup1D_FLOAT32_IEEE 0 ACCS_subsystem_integrated_CM_single_m_s2 -4.0 4.0
 /begin AXIS_DESCR COM_AXIS NO_INPUT_QUANTITY ACCS_subsystem_integrated_CM_single_m_s 7 -45.0 45.0 AXIS_PTS_REF KtACCS_AXIS_OpenAccelLowSpedCtrl_SpedErr /end AXIS_DESCR
/end CHARACTERISTIC
/begin CHARACTERISTIC KtACCS_a_OpenAccel_Launch "This is open acceleration table under launch control mode,it is the function of Ego current speed" CURVE 0x701009b0 /* @ECU_Address@KtACCS_a_OpenAccel_Launch@ */ Lookup1D_FLOAT32_IEEE 0 ACCS_subsystem_integrated_CM_single_m_s2 -4.0 4.0
 /begin AXIS_DESCR COM_AXIS NO_INPUT_QUANTITY ACCS_subsystem_integrated_CM_single_m_s 6 0.0 50.0 AXIS_PTS_REF KtACCS_AXIS_OpenAccelLaunch_CurSpd /end AXIS_DESCR
/end CHARACTERISTIC
/begin CHARACTERISTIC KtACCS_a_StopStatus_Accel "When KbACCS_UseStopStatus_Accel=true, accel will be form this cal during status is Stop.This cal is the function of pitch" CURVE 0x70100950 /* @ECU_Address@KtACCS_a_StopStatus_Accel@ */ Lookup1D_FLOAT32_IEEE 0 ACCS_subsystem_integrated_CM_single_m_s2 -4.0 0.0
 /begin AXIS_DESCR COM_AXIS NO_INPUT_QUANTITY ACCS_subsystem_integrated_CM_single_deg 10 0.0 90.0 AXIS_PTS_REF KtACCS_AXIS_StopStatus_Accel_Pitch /end AXIS_DESCR
/end CHARACTERISTIC
/begin CHARACTERISTIC KcCOMM_BrakePedalMax "" VALUE 0x70101658 /* @ECU_Address@KcCOMM_BrakePedalMax@ */ Scalar_FLOAT32_IEEE 0 COMM_subsystem_integrated_CM_single -3.4E+38 3.4E+38 /end CHARACTERISTIC
/begin CHARACTERISTIC KcCOMM_BrakePedalMin "" VALUE 0x70101654 /* @ECU_Address@KcCOMM_BrakePedalMin@ */ Scalar_FLOAT32_IEEE 0 COMM_subsystem_integrated_CM_single -3.4E+38 3.4E+38 /end CHARACTERISTIC
/begin CHARACTERISTIC KcCOMM_FirstGearRatio "Gear ratio in 1st gear." VALUE 0x70101650 /* @ECU_Address@KcCOMM_FirstGearRatio@ */ Scalar_FLOAT32_IEEE 0 COMM_subsystem_integrated_CM_single -3.4E+38 3.4E+38 /end CHARACTERISTIC
/begin CHARACTERISTIC KcCOMM_GasPedalMax "" VALUE 0x7010164c /* @ECU_Address@KcCOMM_GasPedalMax@ */ Scalar_FLOAT32_IEEE 0 COMM_subsystem_integrated_CM_single -3.4E+38 3.4E+38 /end CHARACTERISTIC
/begin CHARACTERISTIC KcCOMM_GasPedalMaxEPB "" VALUE 0x70101648 /* @ECU_Address@KcCOMM_GasPedalMaxEPB@ */ Scalar_FLOAT32_IEEE 0 COMM_subsystem_integrated_CM_single -3.4E+38 3.4E+38 /end CHARACTERISTIC
/begin CHARACTERISTIC KcCOMM_GasPedalMin "" VALUE 0x70101644 /* @ECU_Address@KcCOMM_GasPedalMin@ */ Scalar_FLOAT32_IEEE 0 COMM_subsystem_integrated_CM_single -3.4E+38 3.4E+38 /end CHARACTERISTIC
/begin CHARACTERISTIC KcCOMM_GasPedalMinEPB "" VALUE 0x70101640 /* @ECU_Address@KcCOMM_GasPedalMinEPB@ */ Scalar_FLOAT32_IEEE 0 COMM_subsystem_integrated_CM_single -3.4E+38 3.4E+38 /end CHARACTERISTIC
/begin CHARACTERISTIC KcCOMM_GasPedalRampEPB "" VALUE 0x7010163c /* @ECU_Address@KcCOMM_GasPedalRampEPB@ */ Scalar_FLOAT32_IEEE 0 COMM_subsystem_integrated_CM_single -3.4E+38 3.4E+38 /end CHARACTERISTIC
/begin CHARACTERISTIC KcCOMM_Test_Checksum_0x150 "" VALUE 0x70101638 /* @ECU_Address@KcCOMM_Test_Checksum_0x150@ */ Scalar_FLOAT32_IEEE 0 COMM_subsystem_integrated_CM_single -3.4E+38 3.4E+38 /end CHARACTERISTIC
/begin CHARACTERISTIC KcCOMM_Test_Checksum_0x151 "" VALUE 0x70101634 /* @ECU_Address@KcCOMM_Test_Checksum_0x151@ */ Scalar_FLOAT32_IEEE 0 COMM_subsystem_integrated_CM_single -3.4E+38 3.4E+38 /end CHARACTERISTIC
/begin CHARACTERISTIC KcCOMM_Test_Cmd_AccPelPosAct "" VALUE 0x70101630 /* @ECU_Address@KcCOMM_Test_Cmd_AccPelPosAct@ */ Scalar_FLOAT32_IEEE 0 COMM_subsystem_integrated_CM_single -3.4E+38 3.4E+38 /end CHARACTERISTIC
/begin CHARACTERISTIC KcCOMM_Test_Cmd_AccPelPosActInv "" VALUE 0x7010162c /* @ECU_Address@KcCOMM_Test_Cmd_AccPelPosActInv@ */ Scalar_FLOAT32_IEEE 0 COMM_subsystem_integrated_CM_single -3.4E+38 3.4E+38 /end CHARACTERISTIC
/begin CHARACTERISTIC KcCOMM_Test_Cmd_BrkPelPosAct "" VALUE 0x70101628 /* @ECU_Address@KcCOMM_Test_Cmd_BrkPelPosAct@ */ Scalar_FLOAT32_IEEE 0 COMM_subsystem_integrated_CM_single -3.4E+38 3.4E+38 /end CHARACTERISTIC
/begin CHARACTERISTIC KcCOMM_Test_Cmd_BrkPelPosActInv "" VALUE 0x70101624 /* @ECU_Address@KcCOMM_Test_Cmd_BrkPelPosActInv@ */ Scalar_FLOAT32_IEEE 0 COMM_subsystem_integrated_CM_single -3.4E+38 3.4E+38 /end CHARACTERISTIC
/begin CHARACTERISTIC KcCOMM_Test_Cmd_Checksum "" VALUE 0x70101620 /* @ECU_Address@KcCOMM_Test_Cmd_Checksum@ */ Scalar_FLOAT32_IEEE 0 COMM_subsystem_integrated_CM_single -3.4E+38 3.4E+38 /end CHARACTERISTIC
/begin CHARACTERISTIC KcCOMM_Test_Cmd_RCnt "" VALUE 0x7010161c /* @ECU_Address@KcCOMM_Test_Cmd_RCnt@ */ Scalar_FLOAT32_IEEE 0 COMM_subsystem_integrated_CM_single -3.4E+38 3.4E+38 /end CHARACTERISTIC
/begin CHARACTERISTIC KcCOMM_Test_Cmd_StrAngle "" VALUE 0x70101618 /* @ECU_Address@KcCOMM_Test_Cmd_StrAngle@ */ Scalar_FLOAT32_IEEE 0 COMM_subsystem_integrated_CM_single -3.4E+38 3.4E+38 /end CHARACTERISTIC
/begin CHARACTERISTIC KcCOMM_Test_Cmd_StrAngleLimit "" VALUE 0x70101614 /* @ECU_Address@KcCOMM_Test_Cmd_StrAngleLimit@ */ Scalar_FLOAT32_IEEE 0 COMM_subsystem_integrated_CM_single -3.4E+38 3.4E+38 /end CHARACTERISTIC
/begin CHARACTERISTIC KcCOMM_Test_Cmd_StrAngleSpd "" VALUE 0x70101610 /* @ECU_Address@KcCOMM_Test_Cmd_StrAngleSpd@ */ Scalar_FLOAT32_IEEE 0 COMM_subsystem_integrated_CM_single -3.4E+38 3.4E+38 /end CHARACTERISTIC
/begin CHARACTERISTIC KcCOMM_Test_Cmd_VCUCnt "" VALUE 0x7010160c /* @ECU_Address@KcCOMM_Test_Cmd_VCUCnt@ */ Scalar_FLOAT32_IEEE 0 COMM_subsystem_integrated_CM_single -3.4E+38 3.4E+38 /end CHARACTERISTIC
/begin CHARACTERISTIC KcCOMM_Test_Decs_Acc_Value "" VALUE 0x70101608 /* @ECU_Address@KcCOMM_Test_Decs_Acc_Value@ */ Scalar_FLOAT32_IEEE 0 COMM_subsystem_integrated_CM_single -3.4E+38 3.4E+38 /end CHARACTERISTIC
/begin CHARACTERISTIC KcCOMM_Test_Decs_Breake_Value "" VALUE 0x70101604 /* @ECU_Address@KcCOMM_Test_Decs_Breake_Value@ */ Scalar_FLOAT32_IEEE 0 COMM_subsystem_integrated_CM_single -3.4E+38 3.4E+38 /end CHARACTERISTIC
/begin CHARACTERISTIC KcCOMM_Test_RCnt_0x150 "" VALUE 0x70101600 /* @ECU_Address@KcCOMM_Test_RCnt_0x150@ */ Scalar_FLOAT32_IEEE 0 COMM_subsystem_integrated_CM_single -3.4E+38 3.4E+38 /end CHARACTERISTIC
/begin CHARACTERISTIC KcCOMM_Test_RCnt_0x151 "" VALUE 0x701015fc /* @ECU_Address@KcCOMM_Test_RCnt_0x151@ */ Scalar_FLOAT32_IEEE 0 COMM_subsystem_integrated_CM_single -3.4E+38 3.4E+38 /end CHARACTERISTIC
/begin CHARACTERISTIC KcCOMM_Test_Tar_Torq "" VALUE 0x701015f8 /* @ECU_Address@KcCOMM_Test_Tar_Torq@ */ Scalar_FLOAT32_IEEE 0 COMM_subsystem_integrated_CM_single -3.4E+38 3.4E+38 /end CHARACTERISTIC
/begin CHARACTERISTIC KcCOMM_Test_Tar_vehiclespd "" VALUE 0x701015f4 /* @ECU_Address@KcCOMM_Test_Tar_vehiclespd@ */ Scalar_FLOAT32_IEEE 0 COMM_subsystem_integrated_CM_single -3.4E+38 3.4E+38 /end CHARACTERISTIC
/begin CHARACTERISTIC KcCOMM_Test_acceleration_fb "" VALUE 0x701015f0 /* @ECU_Address@KcCOMM_Test_acceleration_fb@ */ Scalar_FLOAT32_IEEE 0 COMM_subsystem_integrated_CM_single -3.4E+38 3.4E+38 /end CHARACTERISTIC
/begin CHARACTERISTIC KcCOMM_Test_cmd_VCUChecksum "" VALUE 0x701015ec /* @ECU_Address@KcCOMM_Test_cmd_VCUChecksum@ */ Scalar_FLOAT32_IEEE 0 COMM_subsystem_integrated_CM_single -3.4E+38 3.4E+38 /end CHARACTERISTIC
/begin CHARACTERISTIC KcCOMM_Test_yaw_rate_fb "" VALUE 0x701015e8 /* @ECU_Address@KcCOMM_Test_yaw_rate_fb@ */ Scalar_FLOAT32_IEEE 0 COMM_subsystem_integrated_CM_single -3.4E+38 3.4E+38 /end CHARACTERISTIC
/begin CHARACTERISTIC KfCOMM_a_VCULongAccOffset "Offset to override Longitudinal Acceleration." VALUE 0x701015e4 /* @ECU_Address@KfCOMM_a_VCULongAccOffset@ */ Scalar_FLOAT32_IEEE 0 COMM_subsystem_integrated_CM_single -3.4E+38 3.4E+38 /end CHARACTERISTIC
/begin CHARACTERISTIC KfCOMM_r_VCULongAccSlope "Slope to override Longitudinal Acceleration." VALUE 0x701015e0 /* @ECU_Address@KfCOMM_r_VCULongAccSlope@ */ Scalar_FLOAT32_IEEE 0 COMM_subsystem_integrated_CM_single -3.4E+38 3.4E+38 /end CHARACTERISTIC
/begin CHARACTERISTIC KcCOMM_Test_BckFogLamp_Req "" VALUE 0x701015de /* @ECU_Address@KcCOMM_Test_BckFogLamp_Req@ */ Scalar_UBYTE 0 COMM_subsystem_integrated_CM_uint8 0 255 /end CHARACTERISTIC
/begin CHARACTERISTIC KcCOMM_Test_Cmd_ATOModEnable "" VALUE 0x701015dd /* @ECU_Address@KcCOMM_Test_Cmd_ATOModEnable@ */ Scalar_UBYTE 0 COMM_subsystem_integrated_CM_uint8 0 255 /end CHARACTERISTIC
/begin CHARACTERISTIC KcCOMM_Test_Cmd_AccPelEnable "" VALUE 0x701015dc /* @ECU_Address@KcCOMM_Test_Cmd_AccPelEnable@ */ Scalar_UBYTE 0 COMM_subsystem_integrated_CM_uint8 0 255 /end CHARACTERISTIC
/begin CHARACTERISTIC KcCOMM_Test_Cmd_BrakeLightReq "" VALUE 0x701015db /* @ECU_Address@KcCOMM_Test_Cmd_BrakeLightReq@ */ Scalar_UBYTE 0 COMM_subsystem_integrated_CM_uint8 0 255 /end CHARACTERISTIC
/begin CHARACTERISTIC KcCOMM_Test_Cmd_BrkPelEnable "" VALUE 0x701015da /* @ECU_Address@KcCOMM_Test_Cmd_BrkPelEnable@ */ Scalar_UBYTE 0 COMM_subsystem_integrated_CM_uint8 0 255 /end CHARACTERISTIC
/begin CHARACTERISTIC KcCOMM_Test_Cmd_EPSDir "" VALUE 0x701015d9 /* @ECU_Address@KcCOMM_Test_Cmd_EPSDir@ */ Scalar_UBYTE 0 COMM_subsystem_integrated_CM_uint8 0 255 /end CHARACTERISTIC
/begin CHARACTERISTIC KcCOMM_Test_Cmd_ICPDTC "" VALUE 0x701015d8 /* @ECU_Address@KcCOMM_Test_Cmd_ICPDTC@ */ Scalar_UBYTE 0 COMM_subsystem_integrated_CM_uint8 0 255 /end CHARACTERISTIC
/begin CHARACTERISTIC KcCOMM_Test_Cmd_TgtSft "" VALUE 0x701015d7 /* @ECU_Address@KcCOMM_Test_Cmd_TgtSft@ */ Scalar_UBYTE 0 COMM_subsystem_integrated_CM_uint8 0 255 /end CHARACTERISTIC
/begin CHARACTERISTIC KcCOMM_Test_Cmd_TgtSftEnable "" VALUE 0x701015d6 /* @ECU_Address@KcCOMM_Test_Cmd_TgtSftEnable@ */ Scalar_UBYTE 0 COMM_subsystem_integrated_CM_uint8 0 255 /end CHARACTERISTIC
/begin CHARACTERISTIC KcCOMM_Test_Decs_Acc_Mod "" VALUE 0x701015d5 /* @ECU_Address@KcCOMM_Test_Decs_Acc_Mod@ */ Scalar_UBYTE 0 COMM_subsystem_integrated_CM_uint8 0 255 /end CHARACTERISTIC
/begin CHARACTERISTIC KcCOMM_Test_Decs_Acc_Req "" VALUE 0x701015d4 /* @ECU_Address@KcCOMM_Test_Decs_Acc_Req@ */ Scalar_UBYTE 0 COMM_subsystem_integrated_CM_uint8 0 255 /end CHARACTERISTIC
/begin CHARACTERISTIC KcCOMM_Test_Decs_DippedBeam_Req "" VALUE 0x701015d3 /* @ECU_Address@KcCOMM_Test_Decs_DippedBeam_Req@ */ Scalar_UBYTE 0 COMM_subsystem_integrated_CM_uint8 0 255 /end CHARACTERISTIC
/begin CHARACTERISTIC KcCOMM_Test_Decs_HighBeam_Req "" VALUE 0x701015d2 /* @ECU_Address@KcCOMM_Test_Decs_HighBeam_Req@ */ Scalar_UBYTE 0 COMM_subsystem_integrated_CM_uint8 0 255 /end CHARACTERISTIC
/begin CHARACTERISTIC KcCOMM_Test_Decs_LftLmp_Req "" VALUE 0x701015d1 /* @ECU_Address@KcCOMM_Test_Decs_LftLmp_Req@ */ Scalar_UBYTE 0 COMM_subsystem_integrated_CM_uint8 0 255 /end CHARACTERISTIC
/begin CHARACTERISTIC KcCOMM_Test_Decs_Light_Req "" VALUE 0x701015d0 /* @ECU_Address@KcCOMM_Test_Decs_Light_Req@ */ Scalar_UBYTE 0 COMM_subsystem_integrated_CM_uint8 0 255 /end CHARACTERISTIC
/begin CHARACTERISTIC KcCOMM_Test_Decs_RihtLmp_Req "" VALUE 0x701015cf /* @ECU_Address@KcCOMM_Test_Decs_RihtLmp_Req@ */ Scalar_UBYTE 0 COMM_subsystem_integrated_CM_uint8 0 255 /end CHARACTERISTIC
/begin CHARACTERISTIC KcCOMM_Test_Decs_iBCM_Req "" VALUE 0x701015ce /* @ECU_Address@KcCOMM_Test_Decs_iBCM_Req@ */ Scalar_UBYTE 0 COMM_subsystem_integrated_CM_uint8 0 255 /end CHARACTERISTIC
/begin CHARACTERISTIC KcCOMM_Test_FrontFogLamp_Req "" VALUE 0x701015cd /* @ECU_Address@KcCOMM_Test_FrontFogLamp_Req@ */ Scalar_UBYTE 0 COMM_subsystem_integrated_CM_uint8 0 255 /end CHARACTERISTIC
/begin CHARACTERISTIC KcCOMM_Test_Horn_Req "" VALUE 0x701015cc /* @ECU_Address@KcCOMM_Test_Horn_Req@ */ Scalar_UBYTE 0 COMM_subsystem_integrated_CM_uint8 0 255 /end CHARACTERISTIC
/begin CHARACTERISTIC KcCOMM_Test_HummerSts "" VALUE 0x701015cb /* @ECU_Address@KcCOMM_Test_HummerSts@ */ Scalar_UBYTE 0 COMM_subsystem_integrated_CM_uint8 0 255 /end CHARACTERISTIC
/begin CHARACTERISTIC KcCOMM_Test_Over_Speed "SLEW value for Over Speed." VALUE 0x701015ca /* @ECU_Address@KcCOMM_Test_Over_Speed@ */ Scalar_UBYTE 0 COMM_subsystem_integrated_CM_uint8 0 255 /end CHARACTERISTIC
/begin CHARACTERISTIC KcCOMM_Test_SlowDown_Indication "SLEW value for SpeedUp_Indication." VALUE 0x701015c9 /* @ECU_Address@KcCOMM_Test_SlowDown_Indication@ */ Scalar_UBYTE 0 COMM_subsystem_integrated_CM_uint8 0 255 /end CHARACTERISTIC
/begin CHARACTERISTIC KcCOMM_Test_SpeedUp_Indication "SLEW value for SpeedUp_Indication." VALUE 0x701015c8 /* @ECU_Address@KcCOMM_Test_SpeedUp_Indication@ */ Scalar_UBYTE 0 COMM_subsystem_integrated_CM_uint8 0 255 /end CHARACTERISTIC
/begin CHARACTERISTIC KcCOMM_Test_Stop_Request "" VALUE 0x701015c7 /* @ECU_Address@KcCOMM_Test_Stop_Request@ */ Scalar_UBYTE 0 COMM_subsystem_integrated_CM_uint8 0 255 /end CHARACTERISTIC
/begin CHARACTERISTIC KcCOMM_Test_WarnLight_Req "" VALUE 0x701015c6 /* @ECU_Address@KcCOMM_Test_WarnLight_Req@ */ Scalar_UBYTE 0 COMM_subsystem_integrated_CM_uint8 0 255 /end CHARACTERISTIC
/begin CHARACTERISTIC KcCOMM_Test_XBR_EBI_Mode "" VALUE 0x701015c5 /* @ECU_Address@KcCOMM_Test_XBR_EBI_Mode@ */ Scalar_UBYTE 0 COMM_subsystem_integrated_CM_uint8 0 255 /end CHARACTERISTIC
/begin CHARACTERISTIC KcCOMM_Test_XBR_Priority "" VALUE 0x701015c4 /* @ECU_Address@KcCOMM_Test_XBR_Priority@ */ Scalar_UBYTE 0 COMM_subsystem_integrated_CM_uint8 0 255 /end CHARACTERISTIC
/begin CHARACTERISTIC KcCOMM_Test_driveoff_Req "" VALUE 0x701015c3 /* @ECU_Address@KcCOMM_Test_driveoff_Req@ */ Scalar_UBYTE 0 COMM_subsystem_integrated_CM_uint8 0 255 /end CHARACTERISTIC
/begin CHARACTERISTIC KcCOMM_Test_mode "" VALUE 0x701015c2 /* @ECU_Address@KcCOMM_Test_mode@ */ Scalar_UBYTE 0 COMM_subsystem_integrated_CM_uint8 0 255 /end CHARACTERISTIC
/begin CHARACTERISTIC KcCOMM_TorqueControlPriority "The priority of the Torque Override Control Mode send to VCU.
      0 - Highest priority.
      1 - High priority.
      2 - Medium priority.
      3 - Low priority." VALUE 0x701015c1 /* @ECU_Address@KcCOMM_TorqueControlPriority@ */ Scalar_UBYTE 0 COMM_subsystem_integrated_CM_uint8 0 255 /end CHARACTERISTIC
/begin CHARACTERISTIC KcCOMM_VehicleCANbusConfig "" VALUE 0x701015c0 /* @ECU_Address@KcCOMM_VehicleCANbusConfig@ */ Scalar_UBYTE 0 COMM_subsystem_integrated_CM_uint8 0 255 /end CHARACTERISTIC
/begin CHARACTERISTIC KcCOMM_Test_Cmd_EPSXBW_En "" VALUE 0x701015bf /* @ECU_Address@KcCOMM_Test_Cmd_EPSXBW_En@ */ Scalar_BOOLEAN 0 COMM_subsystem_integrated_CM_boolean 0 1 /end CHARACTERISTIC
/begin CHARACTERISTIC KcCOMM_Test_Cmd_EPSXBW_En_ovr "" VALUE 0x701015be /* @ECU_Address@KcCOMM_Test_Cmd_EPSXBW_En_ovr@ */ Scalar_BOOLEAN 0 COMM_subsystem_integrated_CM_boolean 0 1 /end CHARACTERISTIC
/begin CHARACTERISTIC KcCOMM_Test_Cmd_StrAngle_ovr "" VALUE 0x701015bd /* @ECU_Address@KcCOMM_Test_Cmd_StrAngle_ovr@ */ Scalar_BOOLEAN 0 COMM_subsystem_integrated_CM_boolean 0 1 /end CHARACTERISTIC
/begin CHARACTERISTIC KcCOMM_Test_Decs_Acc_Req_ovr "" VALUE 0x701015bc /* @ECU_Address@KcCOMM_Test_Decs_Acc_Req_ovr@ */ Scalar_BOOLEAN 0 COMM_subsystem_integrated_CM_boolean 0 1 /end CHARACTERISTIC
/begin CHARACTERISTIC KcCOMM_Test_Decs_Acc_Value_ovr "" VALUE 0x701015bb /* @ECU_Address@KcCOMM_Test_Decs_Acc_Value_ovr@ */ Scalar_BOOLEAN 0 COMM_subsystem_integrated_CM_boolean 0 1 /end CHARACTERISTIC
/begin CHARACTERISTIC KcCOMM_Test_Decs_Breake_Req "" VALUE 0x701015ba /* @ECU_Address@KcCOMM_Test_Decs_Breake_Req@ */ Scalar_BOOLEAN 0 COMM_subsystem_integrated_CM_boolean 0 1 /end CHARACTERISTIC
/begin CHARACTERISTIC KcCOMM_Test_Decs_Breake_Req_ovr "" VALUE 0x701015b9 /* @ECU_Address@KcCOMM_Test_Decs_Breake_Req_ovr@ */ Scalar_BOOLEAN 0 COMM_subsystem_integrated_CM_boolean 0 1 /end CHARACTERISTIC
/begin CHARACTERISTIC KcCOMM_Test_Decs_Breake_Value_ovr "" VALUE 0x701015b8 /* @ECU_Address@KcCOMM_Test_Decs_Breake_Value_ovr@ */ Scalar_BOOLEAN 0 COMM_subsystem_integrated_CM_boolean 0 1 /end CHARACTERISTIC
/begin CHARACTERISTIC KfDCSN_M_adm_temp_steering_ovrd_torque "The torque for driver to override." VALUE 0x701016f4 /* @ECU_Address@KfDCSN_M_adm_temp_steering_ovrd_torque@ */ Scalar_FLOAT32_IEEE 0 DCSN_subsystem_integrated_CM_single_nm -3.4E+38 3.4E+38 /end CHARACTERISTIC
/begin CHARACTERISTIC KfDCSN_M_adm_temp_steering_resume_torque "The torque for driver to override." VALUE 0x701016f0 /* @ECU_Address@KfDCSN_M_adm_temp_steering_resume_torque@ */ Scalar_FLOAT32_IEEE 0 DCSN_subsystem_integrated_CM_single_nm -3.4E+38 3.4E+38 /end CHARACTERISTIC
/begin CHARACTERISTIC KfDCSN_d_Thrsh_request_stop "The maximal distance between vehicle and stop line before sending stop request." VALUE 0x701016ec /* @ECU_Address@KfDCSN_d_Thrsh_request_stop@ */ Scalar_FLOAT32_IEEE 0 DCSN_subsystem_integrated_CM_single_m -3.4E+38 3.4E+38 /end CHARACTERISTIC
/begin CHARACTERISTIC KfDCSN_d_stop_cleared_Thrsh "The extra distance vehicle has to move before receiving new stop request" VALUE 0x701016e8 /* @ECU_Address@KfDCSN_d_stop_cleared_Thrsh@ */ Scalar_FLOAT32_IEEE 0 DCSN_subsystem_integrated_CM_single_m -3.4E+38 3.4E+38 /end CHARACTERISTIC
/begin CHARACTERISTIC KfDCSN_d_stop_close_Thrsh "The threshold whether stop distance is calculated by vehicle speed." VALUE 0x701016e4 /* @ECU_Address@KfDCSN_d_stop_close_Thrsh@ */ Scalar_FLOAT32_IEEE 0 DCSN_subsystem_integrated_CM_single_m -3.4E+38 3.4E+38 /end CHARACTERISTIC
/begin CHARACTERISTIC KfDCSN_d_stop_finished_dis "When ACC finished stop request, the maximal distance between stop point and ego vehicle.
      If the stop distance is larger than the value, the stop request will not be cleared." VALUE 0x701016e0 /* @ECU_Address@KfDCSN_d_stop_finished_dis@ */ Scalar_FLOAT32_IEEE 0 DCSN_subsystem_integrated_CM_single_m -3.4E+38 3.4E+38 /end CHARACTERISTIC
/begin CHARACTERISTIC KfDCSN_d_stop_s_distance_man_value "manual stop control distance, valid only when KbDCSN_stop_man_enbl = true" VALUE 0x701016dc /* @ECU_Address@KfDCSN_d_stop_s_distance_man_value@ */ Scalar_FLOAT32_IEEE 0 DCSN_subsystem_integrated_CM_single_m -3.4E+38 3.4E+38 /end CHARACTERISTIC
/begin CHARACTERISTIC KfDCSN_d_stop_unsuccess_Thrsh "The maximal distance from vehicle to stop line if vehicle had passed the stop line. This will regard current stop action as an unsuccessful stop." VALUE 0x701016d8 /* @ECU_Address@KfDCSN_d_stop_unsuccess_Thrsh@ */ Scalar_FLOAT32_IEEE 0 DCSN_subsystem_integrated_CM_single_m -3.4E+38 3.4E+38 /end CHARACTERISTIC
/begin CHARACTERISTIC KfDCSN_t_adm_temp_steering_ovrd_delay "when override conditions are met, the time to delay before exit." VALUE 0x701016d4 /* @ECU_Address@KfDCSN_t_adm_temp_steering_ovrd_delay@ */ Scalar_FLOAT32_IEEE 0 DCSN_subsystem_integrated_CM_single_s -3.4E+38 3.4E+38 /end CHARACTERISTIC
/begin CHARACTERISTIC KfDCSN_t_adm_temp_steering_resume_delay "When resume conditions are met, the time before re-engaged." VALUE 0x701016d0 /* @ECU_Address@KfDCSN_t_adm_temp_steering_resume_delay@ */ Scalar_FLOAT32_IEEE 0 DCSN_subsystem_integrated_CM_single_s -3.4E+38 3.4E+38 /end CHARACTERISTIC
/begin CHARACTERISTIC KfDCSN_t_autodrive_control_mode_delay "the time that the system keeps sending activating request" VALUE 0x701016cc /* @ECU_Address@KfDCSN_t_autodrive_control_mode_delay@ */ Scalar_FLOAT32_IEEE 0 DCSN_subsystem_integrated_CM_single_s -3.4E+38 3.4E+38 /end CHARACTERISTIC
/begin CHARACTERISTIC KfDCSN_t_autodrive_max_wait_time "the maximal wait time before the vehicle response to our activating request" VALUE 0x701016c8 /* @ECU_Address@KfDCSN_t_autodrive_max_wait_time@ */ Scalar_FLOAT32_IEEE 0 DCSN_subsystem_integrated_CM_single_s -3.4E+38 3.4E+38 /end CHARACTERISTIC
/begin CHARACTERISTIC KfDCSN_t_max_time_fault_warning "allowed reaction time after fault warning and before triggering emergency stop" VALUE 0x701016c4 /* @ECU_Address@KfDCSN_t_max_time_fault_warning@ */ Scalar_FLOAT32_IEEE 0 DCSN_subsystem_integrated_CM_single_s -3.4E+38 3.4E+38 /end CHARACTERISTIC
/begin CHARACTERISTIC KfDCSN_t_max_time_to_takeover "allowed reaction time after both lane markers are missed but before autodrive exit" VALUE 0x701016c0 /* @ECU_Address@KfDCSN_t_max_time_to_takeover@ */ Scalar_FLOAT32_IEEE 0 DCSN_subsystem_integrated_CM_single_s -3.4E+38 3.4E+38 /end CHARACTERISTIC
/begin CHARACTERISTIC KfDCSN_t_sample_time "DCSN calculation sample time" VALUE 0x701016bc /* @ECU_Address@KfDCSN_t_sample_time@ */ Scalar_FLOAT32_IEEE 0 DCSN_subsystem_integrated_CM_single_s -3.4E+38 3.4E+38 /end CHARACTERISTIC
/begin CHARACTERISTIC KfDCSN_t_stop_req_hold "When stop is finished, the stop request will be held for seconds. " VALUE 0x701016b8 /* @ECU_Address@KfDCSN_t_stop_req_hold@ */ Scalar_FLOAT32_IEEE 0 DCSN_subsystem_integrated_CM_single_s -3.4E+38 3.4E+38 /end CHARACTERISTIC
/begin CHARACTERISTIC KfDCSN_v_adm_active_extraspeed "When activating ACC control, max allowed delta speed between actual and ACC speed upper limit" VALUE 0x701016b4 /* @ECU_Address@KfDCSN_v_adm_active_extraspeed@ */ Scalar_FLOAT32_IEEE 0 DCSN_subsystem_integrated_CM_single_m_s -3.4E+38 3.4E+38 /end CHARACTERISTIC
/begin CHARACTERISTIC KfDCSN_v_adm_temp_veh_setspeed "Current vehicle acc set speed. 
      Not connect with ACCS yet" VALUE 0x701016b0 /* @ECU_Address@KfDCSN_v_adm_temp_veh_setspeed@ */ Scalar_FLOAT32_IEEE 0 DCSN_subsystem_integrated_CM_single_m_s -3.4E+38 3.4E+38 /end CHARACTERISTIC
/begin CHARACTERISTIC KfDCSN_v_change_lane_target_speed_man_value "manual change lane target speed, valid only when KbDCSN_change_lane_man_enbl = true" VALUE 0x701016ac /* @ECU_Address@KfDCSN_v_change_lane_target_speed_man_value@ */ Scalar_FLOAT32_IEEE 0 DCSN_subsystem_integrated_CM_single_m_s -3.4E+38 3.4E+38 /end CHARACTERISTIC
/begin CHARACTERISTIC KfDCSN_v_default_warning_speed "The maximal speed allowed when input speed limit is missed before warning request." VALUE 0x701016a8 /* @ECU_Address@KfDCSN_v_default_warning_speed@ */ Scalar_FLOAT32_IEEE 0 DCSN_subsystem_integrated_CM_single_m_s -3.4E+38 3.4E+38 /end CHARACTERISTIC
/begin CHARACTERISTIC KfDCSN_v_overspeed_warning_extra "The extra speed difference allowed when vehicle speed is higher than speed limit before warning request." VALUE 0x701016a4 /* @ECU_Address@KfDCSN_v_overspeed_warning_extra@ */ Scalar_FLOAT32_IEEE 0 DCSN_subsystem_integrated_CM_single_m_s -3.4E+38 3.4E+38 /end CHARACTERISTIC
/begin CHARACTERISTIC KfDCSN_v_setspeed_thrsh_hi "Max speed allowed by Autodrive system" VALUE 0x701016a0 /* @ECU_Address@KfDCSN_v_setspeed_thrsh_hi@ */ Scalar_FLOAT32_IEEE 0 DCSN_subsystem_integrated_CM_single_m_s -3.4E+38 3.4E+38 /end CHARACTERISTIC
/begin CHARACTERISTIC KfDCSN_v_traffic_speed_limit_man_value "manual speed limit, valid only when KbDCSN_traffic_speed_limit_enble = true" VALUE 0x7010169c /* @ECU_Address@KfDCSN_v_traffic_speed_limit_man_value@ */ Scalar_FLOAT32_IEEE 0 DCSN_subsystem_integrated_CM_single_m_s -3.4E+38 3.4E+38 /end CHARACTERISTIC
/begin CHARACTERISTIC KbDCSN_SLEW_DriveModeComd_value "SLEW mode
      the DriveModeComd value" VALUE 0x70101699 /* @ECU_Address@KbDCSN_SLEW_DriveModeComd_value@ */ Scalar_UBYTE 0 DCSN_subsystem_integrated_CM_uint8 0 255 /end CHARACTERISTIC
/begin CHARACTERISTIC KcDCSN_t_usr_activate_cmd_send_count "send count of usr_activate_action, valid when KbDCSN_use_vehicle_activate_switch = true
      unit: seconds" VALUE 0x70101698 /* @ECU_Address@KcDCSN_t_usr_activate_cmd_send_count@ */ Scalar_UBYTE 0 DCSN_subsystem_integrated_CM_uint8 0 255 /end CHARACTERISTIC
/begin CHARACTERISTIC KeDCSN_adm_main_mode_man_value "manual override of adm_main_mode output as uint8:
      
      0 = ADM_OFF
      1 = ADM_STANDBY
      2 = ADM_READY
      3 = ADM_ACTIVE
      4 = ADM_STEER_OVRD
      5 = ADM_TAKEOVER_WARNING
      6 = ADM_FAULT_WARNING76 = ADM_FAULT_REACTION
      8 = ADM_FAULT_DETECTED" VALUE 0x70101697 /* @ECU_Address@KeDCSN_adm_main_mode_man_value@ */ Scalar_UBYTE 0 DCSN_subsystem_integrated_CM_uint8 0 255 /end CHARACTERISTIC
/begin CHARACTERISTIC KeDCSN_adm_temp_diag_system_fault "System faults
      0 = no fault
      1,2 = warning faults
      3,4,5 = exit faults" VALUE 0x70101696 /* @ECU_Address@KeDCSN_adm_temp_diag_system_fault@ */ Scalar_UBYTE 0 DCSN_subsystem_integrated_CM_uint8 0 255 /end CHARACTERISTIC
/begin CHARACTERISTIC KeDCSN_adm_temp_steering_controlmode "steering control active mode
      usually 1" VALUE 0x70101695 /* @ECU_Address@KeDCSN_adm_temp_steering_controlmode@ */ Scalar_UBYTE 0 DCSN_subsystem_integrated_CM_uint8_s 0 255 /end CHARACTERISTIC
/begin CHARACTERISTIC KeDCSN_autodrive_mode_man_value "manual override of adm_main_mode output as uint8:
      
      0 = ADM_OFF
      1 = ADM_STANDBY
      2 = ADM_READY
      3 = ADM_ACTIVE
      4 = ADM_STEER_OVRD
      5 = ADM_TAKEOVER_WARNING
      6 = ADM_FAULT_WARNING
      7 = ADM_FAULT_REACTION
      8 = ADM_FAULT_DETECTED" VALUE 0x70101694 /* @ECU_Address@KeDCSN_autodrive_mode_man_value@ */ Scalar_UBYTE 0 DCSN_subsystem_integrated_CM_uint8 0 255 /end CHARACTERISTIC
/begin CHARACTERISTIC KeDCSN_change_lane_reason_man_value "0 = LC_NO_REQUEST
      1 = LC_USER_CMD
      2 = LC_NAVIGATION_CMD
      3 = LC_FRONT_OBSTACLE" VALUE 0x70101693 /* @ECU_Address@KeDCSN_change_lane_reason_man_value@ */ Scalar_UBYTE 0 DCSN_subsystem_integrated_CM_uint8 0 255 /end CHARACTERISTIC
/begin CHARACTERISTIC KeDCSN_change_lane_req_side_man_value "manual change lane side, valid only when KbDCSN_change_lane_man_enbl = true
      0 = NA
      1 = LEFT
      2 = RIGHT" VALUE 0x70101692 /* @ECU_Address@KeDCSN_change_lane_req_side_man_value@ */ Scalar_UBYTE 0 DCSN_subsystem_integrated_CM_uint8 0 255 /end CHARACTERISTIC
/begin CHARACTERISTIC KeDCSN_inlane_nudge_reason_man_value "0 = NUDGE_NO_REQUEST
      1 = NUDGE_FRONT_OBSTACLE
      2 = NUDGE_SIDE_OBSTACLE" VALUE 0x70101691 /* @ECU_Address@KeDCSN_inlane_nudge_reason_man_value@ */ Scalar_UBYTE 0 DCSN_subsystem_integrated_CM_uint8 0 255 /end CHARACTERISTIC
/begin CHARACTERISTIC KeDCSN_pull_over_reason_man_value "0 = PULLOVER_NO_REQUEST
      1 = PULLOVER_USER_CMD
      2 = PULLOVER_POLICE
      3 = PULLOVER_SYSTEM_FAULT" VALUE 0x70101690 /* @ECU_Address@KeDCSN_pull_over_reason_man_value@ */ Scalar_UBYTE 0 DCSN_subsystem_integrated_CM_uint8 0 255 /end CHARACTERISTIC
/begin CHARACTERISTIC KeDCSN_stop_reason_man_value "0 = NO_STOP_REQUEST
      1 = STOP_FOR_DESTINATION
      2 = STOP_FOR_TRAFFIC_LIGHT
      3 = STOP_FOR_STOP_SIGN
      4 = STOP_FOR_STOP_LINE
      5 = STOP_FOR_CROSSWALK
      6 = STOP_FOR_KEEP_CLEAR" VALUE 0x7010168f /* @ECU_Address@KeDCSN_stop_reason_man_value@ */ Scalar_UBYTE 0 DCSN_subsystem_integrated_CM_uint8 0 255 /end CHARACTERISTIC
/begin CHARACTERISTIC KeDCSN_traffic_speed_reason_man_value "0 = NO_LIMIT
      1 = LIMIT_FOR_EGO_LANE
      2 = LIMIT_FOR_DRIVER_REQ
      3 = LIMIT_FOR_CROSSWALK
      4 = LIMIT_FOR_NUDGE" VALUE 0x7010168e /* @ECU_Address@KeDCSN_traffic_speed_reason_man_value@ */ Scalar_UBYTE 0 DCSN_subsystem_integrated_CM_uint8 0 255 /end CHARACTERISTIC
/begin CHARACTERISTIC KeDCSN_usr_cmd_autodrive_activate_man "0 = Deactivate
      1 = Activate
      2 = Hold" VALUE 0x7010168d /* @ECU_Address@KeDCSN_usr_cmd_autodrive_activate_man@ */ Scalar_UBYTE 0 DCSN_subsystem_integrated_CM_uint8 0 255 /end CHARACTERISTIC
/begin CHARACTERISTIC KfDCSN_d_inlane_nudge_side_man_value "manual inlane nudge side, valid only when KbDCSN_inlane_nudge_man_enbl = true
      0 = NA
      1 = LEFT
      2 = RIGHT" VALUE 0x7010168c /* @ECU_Address@KfDCSN_d_inlane_nudge_side_man_value@ */ Scalar_UBYTE 0 DCSN_subsystem_integrated_CM_uint8 0 255 /end CHARACTERISTIC
/begin CHARACTERISTIC KbDCSN_SLEW_DriveModeComd_enbl "0 = use COMM DriverModeComd
      1 = use SLEW DriverModeComd" VALUE 0x7010168b /* @ECU_Address@KbDCSN_SLEW_DriveModeComd_enbl@ */ Scalar_BOOLEAN 0 DCSN_subsystem_integrated_CM_boolean 0 1 /end CHARACTERISTIC
/begin CHARACTERISTIC KbDCSN_acc_man_enbl "0 = manual override disabled
      1 = manual override enabled" VALUE 0x7010168a /* @ECU_Address@KbDCSN_acc_man_enbl@ */ Scalar_BOOLEAN 0 DCSN_subsystem_integrated_CM_boolean 0 1 /end CHARACTERISTIC
/begin CHARACTERISTIC KbDCSN_active_feature_man_ctrl "For all active features (ACC, LCC, ALCA):
      0 = manual override disabled
      1 = manual override enabled" VALUE 0x70101689 /* @ECU_Address@KbDCSN_active_feature_man_ctrl@ */ Scalar_BOOLEAN 0 DCSN_subsystem_integrated_CM_boolean 0 1 /end CHARACTERISTIC
/begin CHARACTERISTIC KbDCSN_adm_BrkPressDeactivateEnabled "0 = cannot activate when BrkPed is pressed
      1 = can activate when BrkPed is pressed" VALUE 0x70101688 /* @ECU_Address@KbDCSN_adm_BrkPressDeactivateEnabled@ */ Scalar_BOOLEAN 0 DCSN_subsystem_integrated_CM_boolean 0 1 /end CHARACTERISTIC
/begin CHARACTERISTIC KbDCSN_adm_main_mode_man_ctrl "0 = manual override disabled
      1 = manual override enabled" VALUE 0x70101687 /* @ECU_Address@KbDCSN_adm_main_mode_man_ctrl@ */ Scalar_BOOLEAN 0 DCSN_subsystem_integrated_CM_boolean 0 1 /end CHARACTERISTIC
/begin CHARACTERISTIC KbDCSN_adm_temp_stop_finished "0 = not finished
      1 = finished" VALUE 0x70101686 /* @ECU_Address@KbDCSN_adm_temp_stop_finished@ */ Scalar_BOOLEAN 0 DCSN_subsystem_integrated_CM_boolean 0 1 /end CHARACTERISTIC
/begin CHARACTERISTIC KbDCSN_adm_temp_usr_cmd_autodrive_enabled "0 = not enabled
      1 = enabled" VALUE 0x70101685 /* @ECU_Address@KbDCSN_adm_temp_usr_cmd_autodrive_enabled@ */ Scalar_BOOLEAN 0 DCSN_subsystem_integrated_CM_boolean 0 1 /end CHARACTERISTIC
/begin CHARACTERISTIC KbDCSN_aeb_man_enbl "0 = manual override disabled
      1 = manual override enabled" VALUE 0x70101684 /* @ECU_Address@KbDCSN_aeb_man_enbl@ */ Scalar_BOOLEAN 0 DCSN_subsystem_integrated_CM_boolean 0 1 /end CHARACTERISTIC
/begin CHARACTERISTIC KbDCSN_alca_man_enbl "0 = manual override disabled
      1 = manual override enabled" VALUE 0x70101683 /* @ECU_Address@KbDCSN_alca_man_enbl@ */ Scalar_BOOLEAN 0 DCSN_subsystem_integrated_CM_boolean 0 1 /end CHARACTERISTIC
/begin CHARACTERISTIC KbDCSN_autodrive_mode_man_enbl "For all active features (ACC, LCC, ALCA):
      0 = manual override disabled
      1 = manual override enabled" VALUE 0x70101682 /* @ECU_Address@KbDCSN_autodrive_mode_man_enbl@ */ Scalar_BOOLEAN 0 DCSN_subsystem_integrated_CM_boolean 0 1 /end CHARACTERISTIC
/begin CHARACTERISTIC KbDCSN_brake_ctrl_man_enbl "0 = manual override disabled
      1 = manual override enabled" VALUE 0x70101681 /* @ECU_Address@KbDCSN_brake_ctrl_man_enbl@ */ Scalar_BOOLEAN 0 DCSN_subsystem_integrated_CM_boolean 0 1 /end CHARACTERISTIC
/begin CHARACTERISTIC KbDCSN_brake_ctrl_man_value "manual brake control switch, valid only when KbDCSN_brake_ctrl_man_enbl = true
      0 = brake control off
      1 = brake control on" VALUE 0x70101680 /* @ECU_Address@KbDCSN_brake_ctrl_man_value@ */ Scalar_BOOLEAN 0 DCSN_subsystem_integrated_CM_boolean 0 1 /end CHARACTERISTIC
/begin CHARACTERISTIC KbDCSN_change_lane_man_enbl "traffic decider
      0 = manual change lane off
      1 = manual change lane on" VALUE 0x7010167f /* @ECU_Address@KbDCSN_change_lane_man_enbl@ */ Scalar_BOOLEAN 0 DCSN_subsystem_integrated_CM_boolean 0 1 /end CHARACTERISTIC
/begin CHARACTERISTIC KbDCSN_change_lane_request_man_value "manual change lane switch, valid only when KbDCSN_change_lane_man_enbl = true
      0 = no change lane request
      1 = change lane request" VALUE 0x7010167e /* @ECU_Address@KbDCSN_change_lane_request_man_value@ */ Scalar_BOOLEAN 0 DCSN_subsystem_integrated_CM_boolean 0 1 /end CHARACTERISTIC
/begin CHARACTERISTIC KbDCSN_enable_warning_no_input "0 = disable warning if no speed limit input
      1 = use default speed limit to warn if no speed limit input" VALUE 0x7010167d /* @ECU_Address@KbDCSN_enable_warning_no_input@ */ Scalar_BOOLEAN 0 DCSN_subsystem_integrated_CM_boolean 0 1 /end CHARACTERISTIC
/begin CHARACTERISTIC KbDCSN_epb_ctrl_man_enbl "0 = manual override disabled
      1 = manual override enabled" VALUE 0x7010167c /* @ECU_Address@KbDCSN_epb_ctrl_man_enbl@ */ Scalar_BOOLEAN 0 DCSN_subsystem_integrated_CM_boolean 0 1 /end CHARACTERISTIC
/begin CHARACTERISTIC KbDCSN_epb_ctrl_man_value "manual epb control switch, valid only when KbDCSN_epb_ctrl_man_enbl = true
      0 = epb release
      1 = epb engage" VALUE 0x7010167b /* @ECU_Address@KbDCSN_epb_ctrl_man_value@ */ Scalar_BOOLEAN 0 DCSN_subsystem_integrated_CM_boolean 0 1 /end CHARACTERISTIC
/begin CHARACTERISTIC KbDCSN_fcw_man_enbl "0 = manual FCW off
      1 = manual FCW on" VALUE 0x7010167a /* @ECU_Address@KbDCSN_fcw_man_enbl@ */ Scalar_BOOLEAN 0 DCSN_subsystem_integrated_CM_boolean 0 1 /end CHARACTERISTIC
/begin CHARACTERISTIC KbDCSN_gear_ctrl_man_enbl "0 = manual override disabled
      1 = manual override enabled" VALUE 0x70101679 /* @ECU_Address@KbDCSN_gear_ctrl_man_enbl@ */ Scalar_BOOLEAN 0 DCSN_subsystem_integrated_CM_boolean 0 1 /end CHARACTERISTIC
/begin CHARACTERISTIC KbDCSN_gear_ctrl_man_value "manual gear control switch, valid only when KbDCSN_gear_ctrl_man_enbl = true
      0 = gear control off
      1 = gear control on" VALUE 0x70101678 /* @ECU_Address@KbDCSN_gear_ctrl_man_value@ */ Scalar_BOOLEAN 0 DCSN_subsystem_integrated_CM_boolean 0 1 /end CHARACTERISTIC
/begin CHARACTERISTIC KbDCSN_inlane_nudge_man_enbl "traffic decider
      0 = manual inlane nudge off
      1 = manual inlane nudge on" VALUE 0x70101677 /* @ECU_Address@KbDCSN_inlane_nudge_man_enbl@ */ Scalar_BOOLEAN 0 DCSN_subsystem_integrated_CM_boolean 0 1 /end CHARACTERISTIC
/begin CHARACTERISTIC KbDCSN_inlane_nudge_request_man_value "manual inlane nudge switch, valid only when KbDCSN_inlane_nudge_request_man_enbl = true
      0 = no inlane nudge request
      1 = inlane nudge request" VALUE 0x70101676 /* @ECU_Address@KbDCSN_inlane_nudge_request_man_value@ */ Scalar_BOOLEAN 0 DCSN_subsystem_integrated_CM_boolean 0 1 /end CHARACTERISTIC
/begin CHARACTERISTIC KbDCSN_lcc_man_enbl "0 = manual LCC off
      1 = manual LCC on" VALUE 0x70101675 /* @ECU_Address@KbDCSN_lcc_man_enbl@ */ Scalar_BOOLEAN 0 DCSN_subsystem_integrated_CM_boolean 0 1 /end CHARACTERISTIC
/begin CHARACTERISTIC KbDCSN_lcw_man_enbl "0 = manual LCW off
      1 = manual LCW on" VALUE 0x70101674 /* @ECU_Address@KbDCSN_lcw_man_enbl@ */ Scalar_BOOLEAN 0 DCSN_subsystem_integrated_CM_boolean 0 1 /end CHARACTERISTIC
/begin CHARACTERISTIC KbDCSN_ldw_man_enbl "0 = manual LDW off
      1 = manual LDW on" VALUE 0x70101673 /* @ECU_Address@KbDCSN_ldw_man_enbl@ */ Scalar_BOOLEAN 0 DCSN_subsystem_integrated_CM_boolean 0 1 /end CHARACTERISTIC
/begin CHARACTERISTIC KbDCSN_overspeed_warning_enable "0 = disable overspeed warning
      1 = enable overspeed warning" VALUE 0x70101672 /* @ECU_Address@KbDCSN_overspeed_warning_enable@ */ Scalar_BOOLEAN 0 DCSN_subsystem_integrated_CM_boolean 0 1 /end CHARACTERISTIC
/begin CHARACTERISTIC KbDCSN_passive_feature_man_ctrl "For all passive features (AEB, FCW, LDW, LCW):
      0 = manual override disabled
      1 = manual override enabled" VALUE 0x70101671 /* @ECU_Address@KbDCSN_passive_feature_man_ctrl@ */ Scalar_BOOLEAN 0 DCSN_subsystem_integrated_CM_boolean 0 1 /end CHARACTERISTIC
/begin CHARACTERISTIC KbDCSN_power_ctrl_man_enbl "0 = manual override disabled
      1 = manual override enabled" VALUE 0x70101670 /* @ECU_Address@KbDCSN_power_ctrl_man_enbl@ */ Scalar_BOOLEAN 0 DCSN_subsystem_integrated_CM_boolean 0 1 /end CHARACTERISTIC
/begin CHARACTERISTIC KbDCSN_power_ctrl_man_value "manual power control switch, valid only when KbDCSN_power_ctrl_man_enbl = true
      0 = power control off
      1 = power control on" VALUE 0x7010166f /* @ECU_Address@KbDCSN_power_ctrl_man_value@ */ Scalar_BOOLEAN 0 DCSN_subsystem_integrated_CM_boolean 0 1 /end CHARACTERISTIC
/begin CHARACTERISTIC KbDCSN_pull_over_man_enbl "traffic decider
      0 = manual pull over off
      1 = manual pull over on" VALUE 0x7010166e /* @ECU_Address@KbDCSN_pull_over_man_enbl@ */ Scalar_BOOLEAN 0 DCSN_subsystem_integrated_CM_boolean 0 1 /end CHARACTERISTIC
/begin CHARACTERISTIC KbDCSN_pull_over_request_man_value "manual pull over switch, valid only when KbDCSN_pull_over_request_man_enbl = true
      0 = no pull over request
      1 = pull over request" VALUE 0x7010166d /* @ECU_Address@KbDCSN_pull_over_request_man_value@ */ Scalar_BOOLEAN 0 DCSN_subsystem_integrated_CM_boolean 0 1 /end CHARACTERISTIC
/begin CHARACTERISTIC KbDCSN_speed_limit_enable "0 = disable speed limit output
      1 = enable speed limit output" VALUE 0x7010166c /* @ECU_Address@KbDCSN_speed_limit_enable@ */ Scalar_BOOLEAN 0 DCSN_subsystem_integrated_CM_boolean 0 1 /end CHARACTERISTIC
/begin CHARACTERISTIC KbDCSN_steer_ctrl_man_enbl "0 = manual override disabled
      1 = manual override enabled" VALUE 0x7010166b /* @ECU_Address@KbDCSN_steer_ctrl_man_enbl@ */ Scalar_BOOLEAN 0 DCSN_subsystem_integrated_CM_boolean 0 1 /end CHARACTERISTIC
/begin CHARACTERISTIC KbDCSN_steer_ctrl_man_value "manual steer control switch, valid only when KbDCSN_steer_ctrl_man_enbl = true
      0 = steer control off
      1 = steer control on" VALUE 0x7010166a /* @ECU_Address@KbDCSN_steer_ctrl_man_value@ */ Scalar_BOOLEAN 0 DCSN_subsystem_integrated_CM_boolean 0 1 /end CHARACTERISTIC
/begin CHARACTERISTIC KbDCSN_stop_man_enbl "traffic decider
      0 = manual stop off
      1 = manual stop on" VALUE 0x70101669 /* @ECU_Address@KbDCSN_stop_man_enbl@ */ Scalar_BOOLEAN 0 DCSN_subsystem_integrated_CM_boolean 0 1 /end CHARACTERISTIC
/begin CHARACTERISTIC KbDCSN_stop_request_enable "0 = disable stop request output
      1 = enable stop request output" VALUE 0x70101668 /* @ECU_Address@KbDCSN_stop_request_enable@ */ Scalar_BOOLEAN 0 DCSN_subsystem_integrated_CM_boolean 0 1 /end CHARACTERISTIC
/begin CHARACTERISTIC KbDCSN_stop_request_man_value "manual stop control switch, valid only when KbDCSN_stop_man_enbl = true
      0 = no stop request
      1 = stop request" VALUE 0x70101667 /* @ECU_Address@KbDCSN_stop_request_man_value@ */ Scalar_BOOLEAN 0 DCSN_subsystem_integrated_CM_boolean 0 1 /end CHARACTERISTIC
/begin CHARACTERISTIC KbDCSN_traffic_speed_limit_man_enbl "traffic decider
      0 = manual speed limit off
      1 = manual speed limit on" VALUE 0x70101666 /* @ECU_Address@KbDCSN_traffic_speed_limit_man_enbl@ */ Scalar_BOOLEAN 0 DCSN_subsystem_integrated_CM_boolean 0 1 /end CHARACTERISTIC
/begin CHARACTERISTIC KbDCSN_use_EgmoLinearSpeed "0 = Use vehicle CAN velocity
      1 = Use egmo linear velocity" VALUE 0x70101665 /* @ECU_Address@KbDCSN_use_EgmoLinearSpeed@ */ Scalar_BOOLEAN 0 DCSN_subsystem_integrated_CM_boolean 0 1 /end CHARACTERISTIC
/begin CHARACTERISTIC KbDCSN_use_EgmoReadyFlag "0 = use calibration to output EGMO ready flag
      1 = use EGMO ready flag" VALUE 0x70101664 /* @ECU_Address@KbDCSN_use_EgmoReadyFlag@ */ Scalar_BOOLEAN 0 DCSN_subsystem_integrated_CM_boolean 0 1 /end CHARACTERISTIC
/begin CHARACTERISTIC KbDCSN_use_SLEW_override_logic "0 = disable override logic in SLEW
      1 = enable override logic in SLEW
      " VALUE 0x70101663 /* @ECU_Address@KbDCSN_use_SLEW_override_logic@ */ Scalar_BOOLEAN 0 DCSN_subsystem_integrated_CM_boolean 0 1 /end CHARACTERISTIC
/begin CHARACTERISTIC KbDCSN_use_SLEW_switch_control_mode "0 = Use normal control mode logic
      1 = Use driver switch as control mode activated" VALUE 0x70101662 /* @ECU_Address@KbDCSN_use_SLEW_switch_control_mode@ */ Scalar_BOOLEAN 0 DCSN_subsystem_integrated_CM_boolean 0 1 /end CHARACTERISTIC
/begin CHARACTERISTIC KbDCSN_use_faw_handoff_as_ovrd "0 = use HandOn flag as override flag
      1 = use HandOff flag as override flag" VALUE 0x70101661 /* @ECU_Address@KbDCSN_use_faw_handoff_as_ovrd@ */ Scalar_BOOLEAN 0 DCSN_subsystem_integrated_CM_boolean 0 1 /end CHARACTERISTIC
/begin CHARACTERISTIC KbDCSN_use_faw_handoff_as_resume "0 = use HandOn flag as resume flag
      1 = use HandOff flag as resume flag" VALUE 0x70101660 /* @ECU_Address@KbDCSN_use_faw_handoff_as_resume@ */ Scalar_BOOLEAN 0 DCSN_subsystem_integrated_CM_boolean 0 1 /end CHARACTERISTIC
/begin CHARACTERISTIC KbDCSN_use_faw_l4_logic "0 = use jac l3 logic
      1 = use faw l4 logic" VALUE 0x7010165f /* @ECU_Address@KbDCSN_use_faw_l4_logic@ */ Scalar_BOOLEAN 0 DCSN_subsystem_integrated_CM_boolean 0 1 /end CHARACTERISTIC
/begin CHARACTERISTIC KbDCSN_use_vehicle_activate_switch "0 = use calibration activate switch
      1 = use vehicle activate switch" VALUE 0x7010165e /* @ECU_Address@KbDCSN_use_vehicle_activate_switch@ */ Scalar_BOOLEAN 0 DCSN_subsystem_integrated_CM_boolean 0 1 /end CHARACTERISTIC
/begin CHARACTERISTIC KbDCSN_use_vehicle_control_mode_fedbak "0 = use vehicle control mode feedback
      1 = use calibration control mode" VALUE 0x7010165d /* @ECU_Address@KbDCSN_use_vehicle_control_mode_fedbak@ */ Scalar_BOOLEAN 0 DCSN_subsystem_integrated_CM_boolean 0 1 /end CHARACTERISTIC
/begin CHARACTERISTIC KbDCSN_vehicle_control_mode_man_value "When using slew mode for vehicle control mode feedback, the vehicle mode value" VALUE 0x7010165c /* @ECU_Address@KbDCSN_vehicle_control_mode_man_value@ */ Scalar_BOOLEAN 0 DCSN_subsystem_integrated_CM_boolean 0 1 /end CHARACTERISTIC
/begin CHARACTERISTIC KtLCCS_heading_err_rate_gain_scheduler "Gain for heading error rate scheduler." CURVE 0x7010182c /* @ECU_Address@KtLCCS_heading_err_rate_gain_scheduler@ */ Lookup1D_FLOAT32_IEEE 0 LCCS_subsystem_integrated_CM_single -3.4E+38 3.4E+38
 /begin AXIS_DESCR COM_AXIS VfLCCS_linear_velocity LCCS_subsystem_integrated_CM_single 21 -3.4E+38 3.4E+38 AXIS_PTS_REF KtLCCS_AXIS_vehicle_speed /end AXIS_DESCR
/end CHARACTERISTIC
/begin CHARACTERISTIC KtLCCS_lat_err_gain_scheduler "Gain for lateral error scheduler." CURVE 0x701017ac /* @ECU_Address@KtLCCS_lat_err_gain_scheduler@ */ Lookup1D_FLOAT32_IEEE 0 LCCS_subsystem_integrated_CM_single -3.4E+38 3.4E+38
 /begin AXIS_DESCR COM_AXIS NO_INPUT_QUANTITY LCCS_subsystem_integrated_CM_single 21 -3.4E+38 3.4E+38 AXIS_PTS_REF KtLCCS_AXIS_vehicle_speed /end AXIS_DESCR
/end CHARACTERISTIC
/begin CHARACTERISTIC KtLCCS_heading_err_gain_scheduler "Gain for heading error scheduler." CURVE 0x70101880 /* @ECU_Address@KtLCCS_heading_err_gain_scheduler@ */ Lookup1D_FLOAT32_IEEE 0 LCCS_subsystem_integrated_CM_single -3.4E+38 3.4E+38
 /begin AXIS_DESCR COM_AXIS NO_INPUT_QUANTITY LCCS_subsystem_integrated_CM_single 21 -3.4E+38 3.4E+38 AXIS_PTS_REF KtLCCS_AXIS_vehicle_speed /end AXIS_DESCR
/end CHARACTERISTIC
/begin CHARACTERISTIC KtLCCS_slowpath_steer_P_gain "Gain for slowpath steer P part." CURVE 0x70101704 /* @ECU_Address@KtLCCS_slowpath_steer_P_gain@ */ Lookup1D_FLOAT32_IEEE 0 LCCS_subsystem_integrated_CM_single -3.4E+38 3.4E+38
 /begin AXIS_DESCR COM_AXIS NO_INPUT_QUANTITY LCCS_subsystem_integrated_CM_single 21 -3.4E+38 3.4E+38 AXIS_PTS_REF KtLCCS_AXIS_vehicle_speed /end AXIS_DESCR
/end CHARACTERISTIC
/begin CHARACTERISTIC KtLCCS_slowpath_steer_I_gain "Gain for slowpath steer I part." CURVE 0x70101758 /* @ECU_Address@KtLCCS_slowpath_steer_I_gain@ */ Lookup1D_FLOAT32_IEEE 0 LCCS_subsystem_integrated_CM_single -3.4E+38 3.4E+38
 /begin AXIS_DESCR COM_AXIS NO_INPUT_QUANTITY LCCS_subsystem_integrated_CM_single 21 -3.4E+38 3.4E+38 AXIS_PTS_REF KtLCCS_AXIS_vehicle_speed /end AXIS_DESCR
/end CHARACTERISTIC
/begin CHARACTERISTIC KtLCCS_Ang_steering_angle_step_engaging "Desired steering wheel angle moving step per second, when engaging steering control. Unit: degree/s." CURVE 0x70101ab8 /* @ECU_Address@KtLCCS_Ang_steering_angle_step_engaging@ */ Lookup1D_FLOAT32_IEEE 0 LCCS_subsystem_integrated_CM_single -3.4E+38 3.4E+38
 /begin AXIS_DESCR COM_AXIS VfLCCS_linear_velocity LCCS_subsystem_integrated_CM_single 21 -3.4E+38 3.4E+38 AXIS_PTS_REF KtLCCS_AXIS_vehicle_speed /end AXIS_DESCR
/end CHARACTERISTIC
/begin CHARACTERISTIC KtLCCS_Ang_steering_angle_step "Desired steering wheel angle moving step per second. Unit: degree/s." CURVE 0x70101b0c /* @ECU_Address@KtLCCS_Ang_steering_angle_step@ */ Lookup1D_FLOAT32_IEEE 0 LCCS_subsystem_integrated_CM_single -3.4E+38 3.4E+38
 /begin AXIS_DESCR COM_AXIS VfLCCS_linear_velocity LCCS_subsystem_integrated_CM_single 21 -3.4E+38 3.4E+38 AXIS_PTS_REF KtLCCS_AXIS_vehicle_speed /end AXIS_DESCR
/end CHARACTERISTIC
/begin CHARACTERISTIC KtLCCS_Ang_steering_angle_max "Absolute maximum steering wheel angle. Unit: degree." CURVE 0x70101bb4 /* @ECU_Address@KtLCCS_Ang_steering_angle_max@ */ Lookup1D_FLOAT32_IEEE 0 LCCS_subsystem_integrated_CM_single -3.4E+38 3.4E+38
 /begin AXIS_DESCR COM_AXIS VfLCCS_linear_velocity LCCS_subsystem_integrated_CM_single 21 -3.4E+38 3.4E+38 AXIS_PTS_REF KtLCCS_AXIS_vehicle_speed /end AXIS_DESCR
/end CHARACTERISTIC
/begin CHARACTERISTIC KtLCCS_Ang_steering_angle_reentry_zone "Steering angle delta limit for re-engage control. Unit: degree." CURVE 0x70101b60 /* @ECU_Address@KtLCCS_Ang_steering_angle_reentry_zone@ */ Lookup1D_FLOAT32_IEEE 0 LCCS_subsystem_integrated_CM_single -3.4E+38 3.4E+38
 /begin AXIS_DESCR COM_AXIS VfLCCS_linear_velocity LCCS_subsystem_integrated_CM_single 21 -3.4E+38 3.4E+38 AXIS_PTS_REF KtLCCS_AXIS_vehicle_speed /end AXIS_DESCR
/end CHARACTERISTIC
/begin CHARACTERISTIC KtLCCS_k_LanemarkMergeCoef "Lane marker merging filter coef." CURVE 0x70101800 /* @ECU_Address@KtLCCS_k_LanemarkMergeCoef@ */ Lookup1D_FLOAT32_IEEE 0 LCCS_subsystem_integrated_CM_single -3.4E+38 3.4E+38
 /begin AXIS_DESCR COM_AXIS VfLCCS_left_lanemark_switch_time LCCS_subsystem_integrated_CM_single 11 -3.4E+38 3.4E+38 AXIS_PTS_REF KtLCCS_AXIS_lanemark_switch_time /end AXIS_DESCR
/end CHARACTERISTIC
/begin CHARACTERISTIC KtLCCS_d_lookahead_distance "Vehicle lookahead distance." MAP 0x701018d4 /* @ECU_Address@KtLCCS_d_lookahead_distance@ */ Lookup2D_FLOAT32_IEEE 0 LCCS_subsystem_integrated_CM_single_m -3.4E+38 3.4E+38
 /begin AXIS_DESCR COM_AXIS VfLCCS_linear_velocity LCCS_subsystem_integrated_CM_single 21 -3.4E+38 3.4E+38 AXIS_PTS_REF KtLCCS_AXIS_vehicle_speed /end AXIS_DESCR
 /begin AXIS_DESCR COM_AXIS NO_INPUT_QUANTITY LCCS_subsystem_integrated_CM_single 5 -3.4E+38 3.4E+38 AXIS_PTS_REF KtLCCS_AXIS_route_curvature /end AXIS_DESCR
/end CHARACTERISTIC
/begin CHARACTERISTIC KfLCCS_Ang_slowpath_steer_limit "Slowpath adjuct limit for front wheel angle. Unit: rad." VALUE 0x70101d04 /* @ECU_Address@KfLCCS_Ang_slowpath_steer_limit@ */ Scalar_FLOAT32_IEEE 0 LCCS_subsystem_integrated_CM_single -3.4E+38 3.4E+38 /end CHARACTERISTIC
/begin CHARACTERISTIC KfLCCS_Ang_steering_center_position "Steering wheel center position. Unit: degree." VALUE 0x70101d00 /* @ECU_Address@KfLCCS_Ang_steering_center_position@ */ Scalar_FLOAT32_IEEE 0 LCCS_subsystem_integrated_CM_single -3.4E+38 3.4E+38 /end CHARACTERISTIC
/begin CHARACTERISTIC KfLCCS_LanemarkerQualityThrsh "Lane marker quality thresh, below which that lane marker is not utilized.
      " VALUE 0x70101cfc /* @ECU_Address@KfLCCS_LanemarkerQualityThrsh@ */ Scalar_FLOAT32_IEEE 0 LCCS_subsystem_integrated_CM_single -3.4E+38 3.4E+38 /end CHARACTERISTIC
/begin CHARACTERISTIC KfLCCS_WeightMatrixStates_R "Regulator matrix for LQR solver.
      " VALUE 0x70101cf8 /* @ECU_Address@KfLCCS_WeightMatrixStates_R@ */ Scalar_FLOAT32_IEEE 0 LCCS_subsystem_integrated_CM_single -3.4E+38 3.4E+38 /end CHARACTERISTIC
/begin CHARACTERISTIC KfLCCS_a_max_lat_acc "Max acceptable lateral acceleration. Unit: m/s^2." VALUE 0x70101cf4 /* @ECU_Address@KfLCCS_a_max_lat_acc@ */ Scalar_FLOAT32_IEEE 0 LCCS_subsystem_integrated_CM_single -3.4E+38 3.4E+38 /end CHARACTERISTIC
/begin CHARACTERISTIC KfLCCS_cf "Corning stiffness for front wheel.
      " VALUE 0x70101cf0 /* @ECU_Address@KfLCCS_cf@ */ Scalar_FLOAT32_IEEE 0 LCCS_subsystem_integrated_CM_single -3.4E+38 3.4E+38 /end CHARACTERISTIC
/begin CHARACTERISTIC KfLCCS_cr "Corning stiffness for rear wheel.
      " VALUE 0x70101cec /* @ECU_Address@KfLCCS_cr@ */ Scalar_FLOAT32_IEEE 0 LCCS_subsystem_integrated_CM_single -3.4E+38 3.4E+38 /end CHARACTERISTIC
/begin CHARACTERISTIC KfLCCS_d_NudgeSafetyZone "Inlane nudge safety margin between vehicle body and lane marker.
      " VALUE 0x70101ce8 /* @ECU_Address@KfLCCS_d_NudgeSafetyZone@ */ Scalar_FLOAT32_IEEE 0 LCCS_subsystem_integrated_CM_single_m 0.1 1.0 /end CHARACTERISTIC
/begin CHARACTERISTIC KfLCCS_d_ValidLaneWidthLimit "" VALUE 0x70101ce4 /* @ECU_Address@KfLCCS_d_ValidLaneWidthLimit@ */ Scalar_FLOAT32_IEEE 0 LCCS_subsystem_integrated_CM_single_m -3.4E+38 3.4E+38 /end CHARACTERISTIC
/begin CHARACTERISTIC KfLCCS_d_VehicleWidth "Vehicle width." VALUE 0x70101ce0 /* @ECU_Address@KfLCCS_d_VehicleWidth@ */ Scalar_FLOAT32_IEEE 0 LCCS_subsystem_integrated_CM_single_m 1.0 3.0 /end CHARACTERISTIC
/begin CHARACTERISTIC KfLCCS_d_lf "Distance between center of mass and front axle.
      " VALUE 0x70101cdc /* @ECU_Address@KfLCCS_d_lf@ */ Scalar_FLOAT32_IEEE 0 LCCS_subsystem_integrated_CM_single_m -3.4E+38 3.4E+38 /end CHARACTERISTIC
/begin CHARACTERISTIC KfLCCS_d_lr "Distance between center of mass and rear axle.
      " VALUE 0x70101cd8 /* @ECU_Address@KfLCCS_d_lr@ */ Scalar_FLOAT32_IEEE 0 LCCS_subsystem_integrated_CM_single_m -3.4E+38 3.4E+38 /end CHARACTERISTIC
/begin CHARACTERISTIC KfLCCS_d_min_turn_radius "Minimum turn radius at lowest speed.
      " VALUE 0x70101cd4 /* @ECU_Address@KfLCCS_d_min_turn_radius@ */ Scalar_FLOAT32_IEEE 0 LCCS_subsystem_integrated_CM_single_m -3.4E+38 3.4E+38 /end CHARACTERISTIC
/begin CHARACTERISTIC KfLCCS_d_wheel_base "Wheel base." VALUE 0x70101cd0 /* @ECU_Address@KfLCCS_d_wheel_base@ */ Scalar_FLOAT32_IEEE 0 LCCS_subsystem_integrated_CM_single_m -3.4E+38 3.4E+38 /end CHARACTERISTIC
/begin CHARACTERISTIC KfLCCS_eps "Tolerance for LQR solver.
      " VALUE 0x70101ccc /* @ECU_Address@KfLCCS_eps@ */ Scalar_FLOAT32_IEEE 0 LCCS_subsystem_integrated_CM_single -3.4E+38 3.4E+38 /end CHARACTERISTIC
/begin CHARACTERISTIC KfLCCS_heading_error_rate_limit "High limit for calculated heading error rate.
      " VALUE 0x70101cc8 /* @ECU_Address@KfLCCS_heading_error_rate_limit@ */ Scalar_FLOAT32_IEEE 0 LCCS_subsystem_integrated_CM_single -3.4E+38 3.4E+38 /end CHARACTERISTIC
/begin CHARACTERISTIC KfLCCS_iz "Vehicle yaw inertia around -Z- axis.
      " VALUE 0x70101cc4 /* @ECU_Address@KfLCCS_iz@ */ Scalar_FLOAT32_IEEE 0 LCCS_subsystem_integrated_CM_single -3.4E+38 3.4E+38 /end CHARACTERISTIC
/begin CHARACTERISTIC KfLCCS_mass "Vehicle mass.
      " VALUE 0x70101cc0 /* @ECU_Address@KfLCCS_mass@ */ Scalar_FLOAT32_IEEE 0 LCCS_subsystem_integrated_CM_single_kg -3.4E+38 3.4E+38 /end CHARACTERISTIC
/begin CHARACTERISTIC KfLCCS_r_LateralSpeedRatio "The maximum ratio of lateral speed over vehicle speed." VALUE 0x70101cbc /* @ECU_Address@KfLCCS_r_LateralSpeedRatio@ */ Scalar_FLOAT32_IEEE 0 LCCS_subsystem_integrated_CM_single -3.4E+38 3.4E+38 /end CHARACTERISTIC
/begin CHARACTERISTIC KfLCCS_r_UpdateStanleyK "Correction factor for LQR sover result when using stanley mode." VALUE 0x70101cb8 /* @ECU_Address@KfLCCS_r_UpdateStanleyK@ */ Scalar_FLOAT32_IEEE 0 LCCS_subsystem_integrated_CM_single -3.4E+38 3.4E+38 /end CHARACTERISTIC
/begin CHARACTERISTIC KfLCCS_r_shift_speed_gain "Lateral distance to go multiply by thisgain to calculate lateral shift speed." VALUE 0x70101cb4 /* @ECU_Address@KfLCCS_r_shift_speed_gain@ */ Scalar_FLOAT32_IEEE 0 LCCS_subsystem_integrated_CM_single -3.4E+38 3.4E+38 /end CHARACTERISTIC
/begin CHARACTERISTIC KfLCCS_r_steering_rate_forward_gain "Steering wheel turning speed gain when moving to forward direction." VALUE 0x70101cb0 /* @ECU_Address@KfLCCS_r_steering_rate_forward_gain@ */ Scalar_FLOAT32_IEEE 0 LCCS_subsystem_integrated_CM_single -3.4E+38 3.4E+38 /end CHARACTERISTIC
/begin CHARACTERISTIC KfLCCS_r_veh_strwhl_2_frtwhl_ratio "The gear ratio between steering wheel angle and front wheel angle." VALUE 0x70101cac /* @ECU_Address@KfLCCS_r_veh_strwhl_2_frtwhl_ratio@ */ Scalar_FLOAT32_IEEE 0 LCCS_subsystem_integrated_CM_single -3.4E+38 3.4E+38 /end CHARACTERISTIC
/begin CHARACTERISTIC KfLCCS_t_SampleTime "Base control loop time.
      " VALUE 0x70101ca8 /* @ECU_Address@KfLCCS_t_SampleTime@ */ Scalar_FLOAT32_IEEE 0 LCCS_subsystem_integrated_CM_single_s 0.01 0.1 /end CHARACTERISTIC
/begin CHARACTERISTIC KfLCCS_t_lateral_movement_delay "When vehicle is moving, and steering control is active, lateral movement will be enabled after this time delay." VALUE 0x70101ca4 /* @ECU_Address@KfLCCS_t_lateral_movement_delay@ */ Scalar_FLOAT32_IEEE 0 LCCS_subsystem_integrated_CM_single_s -3.4E+38 3.4E+38 /end CHARACTERISTIC
/begin CHARACTERISTIC KfLCCS_v_shift_speed_high_limit "Lateral shift speed high limit." VALUE 0x70101ca0 /* @ECU_Address@KfLCCS_v_shift_speed_high_limit@ */ Scalar_FLOAT32_IEEE 0 LCCS_subsystem_integrated_CM_single_m_s -3.4E+38 3.4E+38 /end CHARACTERISTIC
/begin CHARACTERISTIC KfLCCS_v_shift_speed_low_limit "Lateral shift speed low limit." VALUE 0x70101c9c /* @ECU_Address@KfLCCS_v_shift_speed_low_limit@ */ Scalar_FLOAT32_IEEE 0 LCCS_subsystem_integrated_CM_single_m_s -3.4E+38 3.4E+38 /end CHARACTERISTIC
/begin CHARACTERISTIC KtLCCS_WeightMatrixInputs_Q "Q matrix for LQR solver." VAL_BLK 0x70101a78 /* @ECU_Address@KtLCCS_WeightMatrixInputs_Q@ */ Scalar_FLOAT32_IEEE 0 LCCS_subsystem_integrated_CM_single -3.4E+38 3.4E+38 NUMBER 16 /end CHARACTERISTIC
/begin CHARACTERISTIC KcLCCS_HeadingErrorRateSmooth "This number of heading error samples are used to calculate heading error rate.
      " VALUE 0x70101700 /* @ECU_Address@KcLCCS_HeadingErrorRateSmooth@ */ Scalar_LONG 0 LCCS_subsystem_integrated_CM_int32 1.0 100.0 /end CHARACTERISTIC
/begin CHARACTERISTIC KcLCCS_shifting_direction_value "Shifting direction value in SLEW mode." VALUE 0x701016fe /* @ECU_Address@KcLCCS_shifting_direction_value@ */ Scalar_UBYTE 0 LCCS_subsystem_integrated_CM_uint8 0.0 2.0 /end CHARACTERISTIC
/begin CHARACTERISTIC KbLCCS_UsePurePursuit "True: Use lookahead point to calculate target driving direction." VALUE 0x701016fd /* @ECU_Address@KbLCCS_UsePurePursuit@ */ Scalar_BOOLEAN 0 LCCS_subsystem_integrated_CM_boolean 0 1 /end CHARACTERISTIC
/begin CHARACTERISTIC KbLCCS_inlane_nudge_request_SLEW "Calibration switch to SLEW inlane nudge request." VALUE 0x701016fc /* @ECU_Address@KbLCCS_inlane_nudge_request_SLEW@ */ Scalar_BOOLEAN 0 LCCS_subsystem_integrated_CM_boolean 0 1 /end CHARACTERISTIC
/begin CHARACTERISTIC KbLCCS_inlane_nudge_request_value "Inlane nudge request value in SLEW mode." VALUE 0x701016fb /* @ECU_Address@KbLCCS_inlane_nudge_request_value@ */ Scalar_BOOLEAN 0 LCCS_subsystem_integrated_CM_boolean 0 1 /end CHARACTERISTIC
/begin CHARACTERISTIC KbLCCS_lane_change_request_SLEW "Calibration switch to SLEW lane change request." VALUE 0x701016fa /* @ECU_Address@KbLCCS_lane_change_request_SLEW@ */ Scalar_BOOLEAN 0 LCCS_subsystem_integrated_CM_boolean 0 1 /end CHARACTERISTIC
/begin CHARACTERISTIC KbLCCS_lane_change_request_value "Lane change request value in SLEW mode." VALUE 0x701016f9 /* @ECU_Address@KbLCCS_lane_change_request_value@ */ Scalar_BOOLEAN 0 LCCS_subsystem_integrated_CM_boolean 0 1 /end CHARACTERISTIC
/begin CHARACTERISTIC KbLCCS_shifting_direction_SLEW "Calibration switch to SLEW shifting direction." VALUE 0x701016f8 /* @ECU_Address@KbLCCS_shifting_direction_SLEW@ */ Scalar_BOOLEAN 0 LCCS_subsystem_integrated_CM_boolean 0 1 /end CHARACTERISTIC
/begin CHARACTERISTIC KfLCWS_c_DisbleCurveThrshMax "" VALUE 0x70101d70 /* @ECU_Address@KfLCWS_c_DisbleCurveThrshMax@ */ Scalar_FLOAT32_IEEE 0 LCWS_subsystem_integrated_CM_single 0.001 0.1 /end CHARACTERISTIC
/begin CHARACTERISTIC KfLCWS_c_EnbleCurveThrshMax "" VALUE 0x70101d6c /* @ECU_Address@KfLCWS_c_EnbleCurveThrshMax@ */ Scalar_FLOAT32_IEEE 0 LCWS_subsystem_integrated_CM_single 0.001 0.1 /end CHARACTERISTIC
/begin CHARACTERISTIC KfLCWS_d_BSDLargerZone_BackDis "" VALUE 0x70101d68 /* @ECU_Address@KfLCWS_d_BSDLargerZone_BackDis@ */ Scalar_FLOAT32_IEEE 0 LCWS_subsystem_integrated_CM_single 3.0 30.0 /end CHARACTERISTIC
/begin CHARACTERISTIC KfLCWS_d_BSDLargerZone_FrontDis "" VALUE 0x70101d64 /* @ECU_Address@KfLCWS_d_BSDLargerZone_FrontDis@ */ Scalar_FLOAT32_IEEE 0 LCWS_subsystem_integrated_CM_single -1.0 2.0 /end CHARACTERISTIC
/begin CHARACTERISTIC KfLCWS_d_BSDLargerZone_NearDis "" VALUE 0x70101d60 /* @ECU_Address@KfLCWS_d_BSDLargerZone_NearDis@ */ Scalar_FLOAT32_IEEE 0 LCWS_subsystem_integrated_CM_single -0.5 0.5 /end CHARACTERISTIC
/begin CHARACTERISTIC KfLCWS_d_BSDZone_BackDis "" VALUE 0x70101d5c /* @ECU_Address@KfLCWS_d_BSDZone_BackDis@ */ Scalar_FLOAT32_IEEE 0 LCWS_subsystem_integrated_CM_single 3.0 30.0 /end CHARACTERISTIC
/begin CHARACTERISTIC KfLCWS_d_BSDZone_Eye95Dis "" VALUE 0x70101d58 /* @ECU_Address@KfLCWS_d_BSDZone_Eye95Dis@ */ Scalar_FLOAT32_IEEE 0 LCWS_subsystem_integrated_CM_single 0.0 5.0 /end CHARACTERISTIC
/begin CHARACTERISTIC KfLCWS_d_BSDZone_FarDis "" VALUE 0x70101d54 /* @ECU_Address@KfLCWS_d_BSDZone_FarDis@ */ Scalar_FLOAT32_IEEE 0 LCWS_subsystem_integrated_CM_single 3.0 6.0 /end CHARACTERISTIC
/begin CHARACTERISTIC KfLCWS_d_BSDZone_FrontDis "" VALUE 0x70101d50 /* @ECU_Address@KfLCWS_d_BSDZone_FrontDis@ */ Scalar_FLOAT32_IEEE 0 LCWS_subsystem_integrated_CM_single -1.0 2.0 /end CHARACTERISTIC
/begin CHARACTERISTIC KfLCWS_d_BSDZone_NearDis "" VALUE 0x70101d4c /* @ECU_Address@KfLCWS_d_BSDZone_NearDis@ */ Scalar_FLOAT32_IEEE 0 LCWS_subsystem_integrated_CM_single -0.5 0.5 /end CHARACTERISTIC
/begin CHARACTERISTIC KfLCWS_d_CVLargerZone_FrontDis "" VALUE 0x70101d48 /* @ECU_Address@KfLCWS_d_CVLargerZone_FrontDis@ */ Scalar_FLOAT32_IEEE 0 LCWS_subsystem_integrated_CM_single 0.0 3.0 /end CHARACTERISTIC
/begin CHARACTERISTIC KfLCWS_d_CVZone_FrontDis "" VALUE 0x70101d44 /* @ECU_Address@KfLCWS_d_CVZone_FrontDis@ */ Scalar_FLOAT32_IEEE 0 LCWS_subsystem_integrated_CM_single 0.0 3.0 /end CHARACTERISTIC
/begin CHARACTERISTIC KfLCWS_d_NearDisHiLevel "" VALUE 0x70101d40 /* @ECU_Address@KfLCWS_d_NearDisHiLevel@ */ Scalar_FLOAT32_IEEE 0 LCWS_subsystem_integrated_CM_single 0.0 1.0 /end CHARACTERISTIC
/begin CHARACTERISTIC KfLCWS_d_VehLenth "" VALUE 0x70101d3c /* @ECU_Address@KfLCWS_d_VehLenth@ */ Scalar_FLOAT32_IEEE 0 LCWS_subsystem_integrated_CM_single 0.0 20.0 /end CHARACTERISTIC
/begin CHARACTERISTIC KfLCWS_d_VehWidth "" VALUE 0x70101d38 /* @ECU_Address@KfLCWS_d_VehWidth@ */ Scalar_FLOAT32_IEEE 0 LCWS_subsystem_integrated_CM_single 0.0 10.0 /end CHARACTERISTIC
/begin CHARACTERISTIC KfLCWS_r_ObtWidthProportion "" VALUE 0x70101d34 /* @ECU_Address@KfLCWS_r_ObtWidthProportion@ */ Scalar_FLOAT32_IEEE 0 LCWS_subsystem_integrated_CM_single 0.0 1.0 /end CHARACTERISTIC
/begin CHARACTERISTIC KfLCWS_t_TTCLargerThrsh_LowLevel "" VALUE 0x70101d30 /* @ECU_Address@KfLCWS_t_TTCLargerThrsh_LowLevel@ */ Scalar_FLOAT32_IEEE 0 LCWS_subsystem_integrated_CM_single 3.0 7.5 /end CHARACTERISTIC
/begin CHARACTERISTIC KfLCWS_t_TTCThrshHiLevel "" VALUE 0x70101d2c /* @ECU_Address@KfLCWS_t_TTCThrshHiLevel@ */ Scalar_FLOAT32_IEEE 0 LCWS_subsystem_integrated_CM_single 0.0 3.5 /end CHARACTERISTIC
/begin CHARACTERISTIC KfLCWS_t_TTCThrshLowLevel "" VALUE 0x70101d28 /* @ECU_Address@KfLCWS_t_TTCThrshLowLevel@ */ Scalar_FLOAT32_IEEE 0 LCWS_subsystem_integrated_CM_single 3.0 7.5 /end CHARACTERISTIC
/begin CHARACTERISTIC KfLCWS_v_DisbleVehSpdThrshHi "" VALUE 0x70101d24 /* @ECU_Address@KfLCWS_v_DisbleVehSpdThrshHi@ */ Scalar_FLOAT32_IEEE 0 LCWS_subsystem_integrated_CM_single 0.0 100.0 /end CHARACTERISTIC
/begin CHARACTERISTIC KfLCWS_v_DisbleVehSpdThrshLo "" VALUE 0x70101d20 /* @ECU_Address@KfLCWS_v_DisbleVehSpdThrshLo@ */ Scalar_FLOAT32_IEEE 0 LCWS_subsystem_integrated_CM_single -5.0 20.0 /end CHARACTERISTIC
/begin CHARACTERISTIC KfLCWS_v_EnbleVehSpdThrshHi "" VALUE 0x70101d1c /* @ECU_Address@KfLCWS_v_EnbleVehSpdThrshHi@ */ Scalar_FLOAT32_IEEE 0 LCWS_subsystem_integrated_CM_single 0.0 100.0 /end CHARACTERISTIC
/begin CHARACTERISTIC KfLCWS_v_EnbleVehSpdThrshLo "" VALUE 0x70101d18 /* @ECU_Address@KfLCWS_v_EnbleVehSpdThrshLo@ */ Scalar_FLOAT32_IEEE 0 LCWS_subsystem_integrated_CM_single -5.0 20.0 /end CHARACTERISTIC
/begin CHARACTERISTIC KfLCWS_v_LatSpdThr "" VALUE 0x70101d14 /* @ECU_Address@KfLCWS_v_LatSpdThr@ */ Scalar_FLOAT32_IEEE 0 LCWS_subsystem_integrated_CM_single_m_s 0.0 20.0 /end CHARACTERISTIC
/begin CHARACTERISTIC KfLCWS_v_OncomRelSpdThrshHi_in "" VALUE 0x70101d10 /* @ECU_Address@KfLCWS_v_OncomRelSpdThrshHi_in@ */ Scalar_FLOAT32_IEEE 0 LCWS_subsystem_integrated_CM_single 0.0 30.0 /end CHARACTERISTIC
/begin CHARACTERISTIC KfLCWS_v_OncomRelSpdThrshHi_out "" VALUE 0x70101d0c /* @ECU_Address@KfLCWS_v_OncomRelSpdThrshHi_out@ */ Scalar_FLOAT32_IEEE 0 LCWS_subsystem_integrated_CM_single 0.0 30.0 /end CHARACTERISTIC
/begin CHARACTERISTIC KfLCWS_d_BSDLargerZone_FarDis "" VALUE 0x70101d0a /* @ECU_Address@KfLCWS_d_BSDLargerZone_FarDis@ */ Scalar_BYTE 0 LCWS_subsystem_integrated_CM_int8 3.0 6.0 /end CHARACTERISTIC
/begin CHARACTERISTIC KbLCWS_ObtStaticIn "" VALUE 0x70101d09 /* @ECU_Address@KbLCWS_ObtStaticIn@ */ Scalar_BOOLEAN 0 LCWS_subsystem_integrated_CM_boolean 0.0 1.0 /end CHARACTERISTIC
/begin CHARACTERISTIC KbLCWS_Switch "" VALUE 0x70101d08 /* @ECU_Address@KbLCWS_Switch@ */ Scalar_BOOLEAN 0 LCWS_subsystem_integrated_CM_boolean 0.0 1.0 /end CHARACTERISTIC
/begin CHARACTERISTIC KfLDWS_Ang_BkToCnrAng "The angle X axis and the line connecting center of rear axle and front tire." VALUE 0x70101ddc /* @ECU_Address@KfLDWS_Ang_BkToCnrAng@ */ Scalar_FLOAT32_IEEE 0 LDWS_subsystem_integrated_CM_single_rad 0.0 1.5707963267948966 /end CHARACTERISTIC
/begin CHARACTERISTIC KfLDWS_Ang_SuppSteerAngThrsh "The suppression threshold for Steer Angle" VALUE 0x70101dd8 /* @ECU_Address@KfLDWS_Ang_SuppSteerAngThrsh@ */ Scalar_FLOAT32_IEEE 0 LDWS_subsystem_integrated_CM_single__ 0.0 360.0 /end CHARACTERISTIC
/begin CHARACTERISTIC KfLDWS_M_SuppTorque "The torque limit that could be treated as suppression" VALUE 0x70101dd4 /* @ECU_Address@KfLDWS_M_SuppTorque@ */ Scalar_FLOAT32_IEEE 0 LDWS_subsystem_integrated_CM_single_NM 0.0 10.0 /end CHARACTERISTIC
/begin CHARACTERISTIC KfLDWS_c_CurvLwrBnd "The curvature upper bound for ODD" VALUE 0x70101dd0 /* @ECU_Address@KfLDWS_c_CurvLwrBnd@ */ Scalar_FLOAT32_IEEE 0 LDWS_subsystem_integrated_CM_single_1_m 0.0 0.01 /end CHARACTERISTIC
/begin CHARACTERISTIC KfLDWS_c_CurvUprBnd "The curvature lower bound for ODD" VALUE 0x70101dcc /* @ECU_Address@KfLDWS_c_CurvUprBnd@ */ Scalar_FLOAT32_IEEE 0 LDWS_subsystem_integrated_CM_single_1_m 0.0 0.01 /end CHARACTERISTIC
/begin CHARACTERISTIC KfLDWS_d_BkToFrtCnrDist "The distance between one fo the front tires to the center of rear axle." VALUE 0x70101dc8 /* @ECU_Address@KfLDWS_d_BkToFrtCnrDist@ */ Scalar_FLOAT32_IEEE 0 LDWS_subsystem_integrated_CM_single_m 0.0 20.0 /end CHARACTERISTIC
/begin CHARACTERISTIC KfLDWS_d_EdgBuff "The edge buffer that added to the calcualted distance to lane markers" VALUE 0x70101dc4 /* @ECU_Address@KfLDWS_d_EdgBuff@ */ Scalar_FLOAT32_IEEE 0 LDWS_subsystem_integrated_CM_single_m -2.0 2.0 /end CHARACTERISTIC
/begin CHARACTERISTIC KfLDWS_d_LnWidthLwrBnd "The lane width lower bound for ODD" VALUE 0x70101dc0 /* @ECU_Address@KfLDWS_d_LnWidthLwrBnd@ */ Scalar_FLOAT32_IEEE 0 LDWS_subsystem_integrated_CM_single_m 0.0 10.0 /end CHARACTERISTIC
/begin CHARACTERISTIC KfLDWS_d_LnWidthUprBnd "The lane width upper bound for ODD" VALUE 0x70101dbc /* @ECU_Address@KfLDWS_d_LnWidthUprBnd@ */ Scalar_FLOAT32_IEEE 0 LDWS_subsystem_integrated_CM_single_m 0.0 10.0 /end CHARACTERISTIC
/begin CHARACTERISTIC KfLDWS_d_WarnLineLvlOne "When vehicle speed is higher than 1.0m/s, the earliest warning line shall be placed no more than 1.5m inside the lane boundary." VALUE 0x70101db8 /* @ECU_Address@KfLDWS_d_WarnLineLvlOne@ */ Scalar_FLOAT32_IEEE 0 LDWS_subsystem_integrated_CM_single_m 0.0 1.5 /end CHARACTERISTIC
/begin CHARACTERISTIC KfLDWS_d_WarnLineLvlThree "When vehicle speed is not higher than 0.5 m/s, the earliest warning line shall be placed no more than 0.75m inside the lane boundary." VALUE 0x70101db4 /* @ECU_Address@KfLDWS_d_WarnLineLvlThree@ */ Scalar_FLOAT32_IEEE 0 LDWS_subsystem_integrated_CM_single_m 0.0 0.75 /end CHARACTERISTIC
/begin CHARACTERISTIC KfLDWS_k_CurvBuffCoe "The coefficient that multiples the distance to lanemarker when the vehicle is driving under large curavture." VALUE 0x70101db0 /* @ECU_Address@KfLDWS_k_CurvBuffCoe@ */ Scalar_FLOAT32_IEEE 0 LDWS_subsystem_integrated_CM_single 0.0 2.0 /end CHARACTERISTIC
/begin CHARACTERISTIC KfLDWS_k_WarnLineLvlTwo "When vehicle speed is higher than 0.5m/s but not  higher than 1.0m/s, the earliest warning line shall be placed no more than 1.5*Va m inside the lane boundary" VALUE 0x70101dac /* @ECU_Address@KfLDWS_k_WarnLineLvlTwo@ */ Scalar_FLOAT32_IEEE 0 LDWS_subsystem_integrated_CM_single 0.0 1.5 /end CHARACTERISTIC
/begin CHARACTERISTIC KfLDWS_t_TLCThrsh "Time to lane crossing threshold" VALUE 0x70101da8 /* @ECU_Address@KfLDWS_t_TLCThrsh@ */ Scalar_FLOAT32_IEEE 0 LDWS_subsystem_integrated_CM_single_s 0.0 2.0 /end CHARACTERISTIC
/begin CHARACTERISTIC KfLDWS_v_SpdLwrBnd "The speed lower bound for ODD" VALUE 0x70101da4 /* @ECU_Address@KfLDWS_v_SpdLwrBnd@ */ Scalar_FLOAT32_IEEE 0 LDWS_subsystem_integrated_CM_single_m_s 0.0 55.0 /end CHARACTERISTIC
/begin CHARACTERISTIC KfLDWS_v_SpdUprBnd "The speed upper bound for ODD" VALUE 0x70101da0 /* @ECU_Address@KfLDWS_v_SpdUprBnd@ */ Scalar_FLOAT32_IEEE 0 LDWS_subsystem_integrated_CM_single_m_s 0.0 55.0 /end CHARACTERISTIC
/begin CHARACTERISTIC KfLDWS_v_SuppSteerRateThrsh "The suppression threshold for Steer Rate" VALUE 0x70101d9c /* @ECU_Address@KfLDWS_v_SuppSteerRateThrsh@ */ Scalar_FLOAT32_IEEE 0 LDWS_subsystem_integrated_CM_single___s 0.0 360.0 /end CHARACTERISTIC
/begin CHARACTERISTIC KcLDWS_CntSample "The sample time that state machine uses in a loop." VALUE 0x70101d9a /* @ECU_Address@KcLDWS_CntSample@ */ Scalar_UWORD 0 LDWS_subsystem_integrated_CM_uint16 1.0 10.0 /end CHARACTERISTIC
/begin CHARACTERISTIC KfLDWS_t_CntMaxWarnHold "The maximum time that a warning satte is allowed to last" VALUE 0x70101d98 /* @ECU_Address@KfLDWS_t_CntMaxWarnHold@ */ Scalar_UWORD 0 LDWS_subsystem_integrated_CM_uint16 0.0 1000.0 /end CHARACTERISTIC
/begin CHARACTERISTIC KfLDWS_t_CntMinWarnHold "The minimum time that a warning state shall last." VALUE 0x70101d96 /* @ECU_Address@KfLDWS_t_CntMinWarnHold@ */ Scalar_UWORD 0 LDWS_subsystem_integrated_CM_uint16 0.0 1000.0 /end CHARACTERISTIC
/begin CHARACTERISTIC KfLDWS_t_CntOnHold "The bouncing time that avoids wrong trigger." VALUE 0x70101d94 /* @ECU_Address@KfLDWS_t_CntOnHold@ */ Scalar_UWORD 0 LDWS_subsystem_integrated_CM_uint16 0.0 1000.0 /end CHARACTERISTIC
/begin CHARACTERISTIC KfLDWS_t_CurvNotValidTime "The time that Enabling Manager uses to reset condition for curvature" VALUE 0x70101d92 /* @ECU_Address@KfLDWS_t_CurvNotValidTime@ */ Scalar_UWORD 0 LDWS_subsystem_integrated_CM_uint16 0.0 1000.0 /end CHARACTERISTIC
/begin CHARACTERISTIC KfLDWS_t_CurvValidTime "The time that Enabling Manager uses to set condition for curvature" VALUE 0x70101d90 /* @ECU_Address@KfLDWS_t_CurvValidTime@ */ Scalar_UWORD 0 LDWS_subsystem_integrated_CM_uint16 0.0 1000.0 /end CHARACTERISTIC
/begin CHARACTERISTIC KfLDWS_t_LnMkrMissThrsh "The maximum time that a lane marker could termporarily go missing" VALUE 0x70101d8e /* @ECU_Address@KfLDWS_t_LnMkrMissThrsh@ */ Scalar_UWORD 0 LDWS_subsystem_integrated_CM_uint16 0.0 1000.0 /end CHARACTERISTIC
/begin CHARACTERISTIC KfLDWS_t_LnMkrNotValidTime "The time that Enabling Manager uses set condion for lane marker" VALUE 0x70101d8c /* @ECU_Address@KfLDWS_t_LnMkrNotValidTime@ */ Scalar_UWORD 0 LDWS_subsystem_integrated_CM_uint16 0.0 1000.0 /end CHARACTERISTIC
/begin CHARACTERISTIC KfLDWS_t_LnMkrValidTime "The time that Enabling Manager uses reset condition for lane marker" VALUE 0x70101d8a /* @ECU_Address@KfLDWS_t_LnMkrValidTime@ */ Scalar_UWORD 0 LDWS_subsystem_integrated_CM_uint16 0.0 1000.0 /end CHARACTERISTIC
/begin CHARACTERISTIC KfLDWS_t_LnWidthNotValidTime "The time that Enabling Manager uses to reset condition for lane width" VALUE 0x70101d88 /* @ECU_Address@KfLDWS_t_LnWidthNotValidTime@ */ Scalar_UWORD 0 LDWS_subsystem_integrated_CM_uint16 0.0 1000.0 /end CHARACTERISTIC
/begin CHARACTERISTIC KfLDWS_t_LnWidthValidTime "The time that enabling manager uses to set condition for lane width" VALUE 0x70101d86 /* @ECU_Address@KfLDWS_t_LnWidthValidTime@ */ Scalar_UWORD 0 LDWS_subsystem_integrated_CM_uint16 0.0 1000.0 /end CHARACTERISTIC
/begin CHARACTERISTIC KfLDWS_t_SpdRngNotValidTime "The time that enabling manager uses to reset condition for speed range" VALUE 0x70101d84 /* @ECU_Address@KfLDWS_t_SpdRngNotValidTime@ */ Scalar_UWORD 0 LDWS_subsystem_integrated_CM_uint16 0.0 1000.0 /end CHARACTERISTIC
/begin CHARACTERISTIC KfLDWS_t_SpdRngValidTime "The time that enabling manager uses to set condtion for speed range" VALUE 0x70101d82 /* @ECU_Address@KfLDWS_t_SpdRngValidTime@ */ Scalar_UWORD 0 LDWS_subsystem_integrated_CM_uint16 0.0 1000.0 /end CHARACTERISTIC
/begin CHARACTERISTIC KfLDWS_t_SuppIndiTime "The time that indicator could be treated as suppression" VALUE 0x70101d80 /* @ECU_Address@KfLDWS_t_SuppIndiTime@ */ Scalar_UWORD 0 LDWS_subsystem_integrated_CM_uint16 0.0 1000.0 /end CHARACTERISTIC
/begin CHARACTERISTIC KfLDWS_t_SuppSteerAngTime "The time that steer angle could be treated as suppression" VALUE 0x70101d7e /* @ECU_Address@KfLDWS_t_SuppSteerAngTime@ */ Scalar_UWORD 0 LDWS_subsystem_integrated_CM_uint16 0.0 1000.0 /end CHARACTERISTIC
/begin CHARACTERISTIC KfLDWS_t_SuppSteerRateTime "The time that steer rate could be treated as suppression" VALUE 0x70101d7c /* @ECU_Address@KfLDWS_t_SuppSteerRateTime@ */ Scalar_UWORD 0 LDWS_subsystem_integrated_CM_uint16 0.0 1000.0 /end CHARACTERISTIC
/begin CHARACTERISTIC KfLDWS_t_SuppTorqueTime "The time that steer toque could be treated as suppression" VALUE 0x70101d7a /* @ECU_Address@KfLDWS_t_SuppTorqueTime@ */ Scalar_UWORD 0 LDWS_subsystem_integrated_CM_uint16 0.0 1000.0 /end CHARACTERISTIC
/begin CHARACTERISTIC KfLDWS_r_LaMkrQlt "Lane marker quality threshold" VALUE 0x70101d79 /* @ECU_Address@KfLDWS_r_LaMkrQlt@ */ Scalar_UBYTE 0 LDWS_subsystem_integrated_CM_uint8 0.0 100.0 /end CHARACTERISTIC
/begin CHARACTERISTIC KbLDWS_EnableSwitch "" VALUE 0x70101d78 /* @ECU_Address@KbLDWS_EnableSwitch@ */ Scalar_BOOLEAN 0 LDWS_subsystem_integrated_CM_boolean 0.0 1.0 /end CHARACTERISTIC
/begin CHARACTERISTIC KbLDWS_SuppLeSwitch "" VALUE 0x70101d77 /* @ECU_Address@KbLDWS_SuppLeSwitch@ */ Scalar_BOOLEAN 0 LDWS_subsystem_integrated_CM_boolean 0.0 1.0 /end CHARACTERISTIC
/begin CHARACTERISTIC KbLDWS_SuppRiSwitch "" VALUE 0x70101d76 /* @ECU_Address@KbLDWS_SuppRiSwitch@ */ Scalar_BOOLEAN 0 LDWS_subsystem_integrated_CM_boolean 0.0 1.0 /end CHARACTERISTIC
/begin CHARACTERISTIC KbLDWS_ThetaSwitch "" VALUE 0x70101d75 /* @ECU_Address@KbLDWS_ThetaSwitch@ */ Scalar_BOOLEAN 0 LDWS_subsystem_integrated_CM_boolean 0.0 1.0 /end CHARACTERISTIC
/begin CHARACTERISTIC KbLDWS_WarnAllowed "A swicth that enable the state machine" VALUE 0x70101d74 /* @ECU_Address@KbLDWS_WarnAllowed@ */ Scalar_BOOLEAN 0 LDWS_subsystem_integrated_CM_boolean 0.0 1.0 /end CHARACTERISTIC
/begin AXIS_PTS KtACCS_AXIS_OpenAccelStop_StopDis "The axis for the calibration KtACCS_t_CalOpenAccelForStopFrmDCSN" 0x70100e88 /* @ECU_Address@KtACCS_AXIS_OpenAccelStop_StopDis@ */ NO_INPUT_QUANTITY Lookup1D_X_FLOAT32_IEEE 0 ACCS_subsystem_integrated_CM_single_m 6 0.0 200.0 /end AXIS_PTS
/begin AXIS_PTS KtACCS_AXIS_OpenAccelSpedCtrl_SpedErr "This is speed error axis for KtACCS_OpenAccel_SpeedCtrl" 0x70100ea0 /* @ECU_Address@KtACCS_AXIS_OpenAccelSpedCtrl_SpedErr@ */ NO_INPUT_QUANTITY Lookup1D_X_FLOAT32_IEEE 0 ACCS_subsystem_integrated_CM_single_m_s 7 -30.0 30.0 /end AXIS_PTS
/begin AXIS_PTS KtACCS_AXIS_OpenAccelLowSpedCtrl_SpedErr "This is speed error axis for KtACCS_a_OpenAccel_LowSpeedCtrl" 0x70100ebc /* @ECU_Address@KtACCS_AXIS_OpenAccelLowSpedCtrl_SpedErr@ */ NO_INPUT_QUANTITY Lookup1D_X_FLOAT32_IEEE 0 ACCS_subsystem_integrated_CM_single_m_s 7 -45.0 45.0 /end AXIS_PTS
/begin AXIS_PTS KtACCS_AXIS_OpenAccelLaunch_CurSpd "This is vehcile speed axis for KtACCS_OpenAccel_Launch" 0x70100ed8 /* @ECU_Address@KtACCS_AXIS_OpenAccelLaunch_CurSpd@ */ NO_INPUT_QUANTITY Lookup1D_X_FLOAT32_IEEE 0 ACCS_subsystem_integrated_CM_single_m_s 6 0.0 50.0 /end AXIS_PTS
/begin AXIS_PTS KtACCS_AXIS_StopStatus_Accel_Pitch "This is Pitch axis for KtACCS_StopStatus_Accel" 0x70100df0 /* @ECU_Address@KtACCS_AXIS_StopStatus_Accel_Pitch@ */ NO_INPUT_QUANTITY Lookup1D_X_FLOAT32_IEEE 0 ACCS_subsystem_integrated_CM_single_deg 10 0.0 90.0 /end AXIS_PTS
/begin AXIS_PTS KtLCCS_AXIS_vehicle_speed "Vehicle speed axis for tables except lateral control." 0x70101c08 /* @ECU_Address@KtLCCS_AXIS_vehicle_speed@ */ VfLCCS_linear_velocity Lookup1D_X_FLOAT32_IEEE 0 LCCS_subsystem_integrated_CM_single 21 -3.4E+38 3.4E+38 /end AXIS_PTS
/begin AXIS_PTS KtLCCS_AXIS_lanemark_switch_time "Axis for lanemarker filtering coefficient KtLCCS_LanemarkMergeCoef. Time elapsed after switching between actual and virtual lanemarker. Unit: s." 0x70101c70 /* @ECU_Address@KtLCCS_AXIS_lanemark_switch_time@ */ VfLCCS_left_lanemark_switch_time Lookup1D_X_FLOAT32_IEEE 0 LCCS_subsystem_integrated_CM_single 11 -3.4E+38 3.4E+38 /end AXIS_PTS
/begin AXIS_PTS KtLCCS_AXIS_route_curvature "Curvature axis." 0x70101c5c /* @ECU_Address@KtLCCS_AXIS_route_curvature@ */ NO_INPUT_QUANTITY Lookup2D_X_FLOAT32_IEEE 0 LCCS_subsystem_integrated_CM_single 5 -3.4E+38 3.4E+38 /end AXIS_PTS
/begin MEASUREMENT VbHWIO_DriverModeComd "" UBYTE COMM_subsystem_integrated_CM_boolean 0 0 0 1 ECU_ADDRESS 0xb00037c8 /* @ECU_Address@VbHWIO_DriverModeComd@ */ /end MEASUREMENT
/begin MEASUREMENT VfCOMM_Decs_Breake_Value "" FLOAT32_IEEE COMM_subsystem_integrated_CM_single 0 0 -3.4E+38 3.4E+38 ECU_ADDRESS 0xb000354c /* @ECU_Address@VfCOMM_Decs_Breake_Value@ */ /end MEASUREMENT
/begin MEASUREMENT VfCOMM_Decs_Acc_Value "" FLOAT32_IEEE COMM_subsystem_integrated_CM_single 0 0 -3.4E+38 3.4E+38 ECU_ADDRESS 0xb0003548 /* @ECU_Address@VfCOMM_Decs_Acc_Value@ */ /end MEASUREMENT
/begin MEASUREMENT VfCOMM_Decs_SteeringAngle "" FLOAT32_IEEE COMM_subsystem_integrated_CM_single 0 0 -3.4E+38 3.4E+38 ECU_ADDRESS 0xb0003544 /* @ECU_Address@VfCOMM_Decs_SteeringAngle@ */ /end MEASUREMENT
/begin MEASUREMENT VcCOMM_EPB_control_enable "EPB control enable flag." FLOAT32_IEEE COMM_subsystem_integrated_CM_single 0 0 -3.4E+38 3.4E+38 ECU_ADDRESS 0xb0003540 /* @ECU_Address@VcCOMM_EPB_control_enable@ */ /end MEASUREMENT
/begin MEASUREMENT VcCOMM_EPB_switch_request "EPB Switch request. 0 = Release, 1 = Clamp." FLOAT32_IEEE COMM_subsystem_integrated_CM_single 0 0 -3.4E+38 3.4E+38 ECU_ADDRESS 0xb000353c /* @ECU_Address@VcCOMM_EPB_switch_request@ */ /end MEASUREMENT
/begin MEASUREMENT VfCOMM_req_pct_torque_raw "Power requested torque in percentage." FLOAT32_IEEE COMM_subsystem_integrated_CM_single 0 0 -3.4E+38 3.4E+38 ECU_ADDRESS 0xb0003538 /* @ECU_Address@VfCOMM_req_pct_torque_raw@ */ /end MEASUREMENT
/begin MEASUREMENT VcCOMM_max_gas_pedal_EPB "" FLOAT32_IEEE COMM_subsystem_integrated_CM_single 0 0 -3.4E+38 3.4E+38 ECU_ADDRESS 0xb0003534 /* @ECU_Address@VcCOMM_max_gas_pedal_EPB@ */ /end MEASUREMENT
/begin MEASUREMENT VfCOMM_EPS_SteeringTorqueAct "" FLOAT32_IEEE COMM_subsystem_integrated_CM_single 0 0 -3.4E+38 3.4E+38 ECU_ADDRESS 0xb0003530 /* @ECU_Address@VfCOMM_EPS_SteeringTorqueAct@ */ /end MEASUREMENT
/begin MEASUREMENT VfCOMM_VCU_LongitudinalAcc "" FLOAT32_IEEE COMM_subsystem_integrated_CM_single 0 0 -3.4E+38 3.4E+38 ECU_ADDRESS 0xb000352c /* @ECU_Address@VfCOMM_VCU_LongitudinalAcc@ */ /end MEASUREMENT
/begin MEASUREMENT VfCOMM_VCU_BrkPedPos "Brake pedal position." FLOAT32_IEEE COMM_subsystem_integrated_CM_single 0 0 -3.4E+38 3.4E+38 ECU_ADDRESS 0xb0003528 /* @ECU_Address@VfCOMM_VCU_BrkPedPos@ */ /end MEASUREMENT
/begin MEASUREMENT VfCOMM_VCU_YawRate "Yaw Rate." FLOAT32_IEEE COMM_subsystem_integrated_CM_single 0 0 -3.4E+38 3.4E+38 ECU_ADDRESS 0xb0003524 /* @ECU_Address@VfCOMM_VCU_YawRate@ */ /end MEASUREMENT
/begin MEASUREMENT VfCOMM_VCU_LateralAcc "Lateral acceleration (m/s~2)." FLOAT32_IEEE COMM_subsystem_integrated_CM_single 0 0 -3.4E+38 3.4E+38 ECU_ADDRESS 0xb0003520 /* @ECU_Address@VfCOMM_VCU_LateralAcc@ */ /end MEASUREMENT
/begin MEASUREMENT VfCOMM_VCU_ESCWhlRRSpd "Rear right wheel speed (kph)." FLOAT32_IEEE COMM_subsystem_integrated_CM_single 0 0 -3.4E+38 3.4E+38 ECU_ADDRESS 0xb000351c /* @ECU_Address@VfCOMM_VCU_ESCWhlRRSpd@ */ /end MEASUREMENT
/begin MEASUREMENT VfCOMM_VCU_ESCWhlRLSpd "Rear left wheel speed (kph)." FLOAT32_IEEE COMM_subsystem_integrated_CM_single 0 0 -3.4E+38 3.4E+38 ECU_ADDRESS 0xb0003518 /* @ECU_Address@VfCOMM_VCU_ESCWhlRLSpd@ */ /end MEASUREMENT
/begin MEASUREMENT VfCOMM_VCU_ESCWhlFRSpd "Front right wheel speed (kph)." FLOAT32_IEEE COMM_subsystem_integrated_CM_single 0 0 -3.4E+38 3.4E+38 ECU_ADDRESS 0xb0003514 /* @ECU_Address@VfCOMM_VCU_ESCWhlFRSpd@ */ /end MEASUREMENT
/begin MEASUREMENT VfCOMM_VCU_ESCWhlFLSpd "Front left wheel speed (kph)." FLOAT32_IEEE COMM_subsystem_integrated_CM_single 0 0 -3.4E+38 3.4E+38 ECU_ADDRESS 0xb0003510 /* @ECU_Address@VfCOMM_VCU_ESCWhlFLSpd@ */ /end MEASUREMENT
/begin MEASUREMENT VfCOMM_Decs_FedBck_StrAngle "" FLOAT32_IEEE COMM_subsystem_integrated_CM_single 0 0 -3.4E+38 3.4E+38 ECU_ADDRESS 0xb000350c /* @ECU_Address@VfCOMM_Decs_FedBck_StrAngle@ */ /end MEASUREMENT
/begin MEASUREMENT VfCOMM_Decs_FedBck_VehSpd "" FLOAT32_IEEE COMM_subsystem_integrated_CM_single 0 0 -3.4E+38 3.4E+38 ECU_ADDRESS 0xb0003508 /* @ECU_Address@VfCOMM_Decs_FedBck_VehSpd@ */ /end MEASUREMENT
/begin MEASUREMENT VfCOMM_AccPedl "" FLOAT32_IEEE COMM_subsystem_integrated_CM_single 0 0 -3.4E+38 3.4E+38 ECU_ADDRESS 0xb0003504 /* @ECU_Address@VfCOMM_AccPedl@ */ /end MEASUREMENT
/begin MEASUREMENT VfCOMM_Actual_Gear_Ratio "" FLOAT32_IEEE COMM_subsystem_integrated_CM_single 0 0 -3.4E+38 3.4E+38 ECU_ADDRESS 0xb0003500 /* @ECU_Address@VfCOMM_Actual_Gear_Ratio@ */ /end MEASUREMENT
/begin MEASUREMENT VfCOMM_req_pct_torque_final "" SWORD COMM_subsystem_integrated_CM_int16 0 0 -32768 32767 ECU_ADDRESS 0xb00034fc /* @ECU_Address@VfCOMM_req_pct_torque_final@ */ /end MEASUREMENT
/begin MEASUREMENT VcCOMM_Auto_To_Manual_Tips "" UWORD COMM_subsystem_integrated_CM_uint16 0 0 0 65535 ECU_ADDRESS 0xb00034fa /* @ECU_Address@VcCOMM_Auto_To_Manual_Tips@ */ /end MEASUREMENT
/begin MEASUREMENT VcCOMM_Decs_WarnLight_Req "" UBYTE COMM_subsystem_integrated_CM_uint8 0 0 0 255 ECU_ADDRESS 0xb00034f8 /* @ECU_Address@VcCOMM_Decs_WarnLight_Req@ */ /end MEASUREMENT
/begin MEASUREMENT VcCOMM_Decs_RihtLmp_Req "" UBYTE COMM_subsystem_integrated_CM_uint8 0 0 0 255 ECU_ADDRESS 0xb00034f7 /* @ECU_Address@VcCOMM_Decs_RihtLmp_Req@ */ /end MEASUREMENT
/begin MEASUREMENT VcCOMM_Decs_Light_Req "" UBYTE COMM_subsystem_integrated_CM_uint8 0 0 0 255 ECU_ADDRESS 0xb00034f6 /* @ECU_Address@VcCOMM_Decs_Light_Req@ */ /end MEASUREMENT
/begin MEASUREMENT VcCOMM_Decs_LftLmp_Req "" UBYTE COMM_subsystem_integrated_CM_uint8 0 0 0 255 ECU_ADDRESS 0xb00034f5 /* @ECU_Address@VcCOMM_Decs_LftLmp_Req@ */ /end MEASUREMENT
/begin MEASUREMENT VcCOMM_Decs_Horn_Req "" UBYTE COMM_subsystem_integrated_CM_uint8 0 0 0 255 ECU_ADDRESS 0xb00034f4 /* @ECU_Address@VcCOMM_Decs_Horn_Req@ */ /end MEASUREMENT
/begin MEASUREMENT VcCOMM_Decs_HighBeam_Req "" UBYTE COMM_subsystem_integrated_CM_uint8 0 0 0 255 ECU_ADDRESS 0xb00034f3 /* @ECU_Address@VcCOMM_Decs_HighBeam_Req@ */ /end MEASUREMENT
/begin MEASUREMENT VcCOMM_Decs_FrontFogLamp_Req "" UBYTE COMM_subsystem_integrated_CM_uint8 0 0 0 255 ECU_ADDRESS 0xb00034f2 /* @ECU_Address@VcCOMM_Decs_FrontFogLamp_Req@ */ /end MEASUREMENT
/begin MEASUREMENT VcCOMM_Decs_DippedBeam_Req "" UBYTE COMM_subsystem_integrated_CM_uint8 0 0 0 255 ECU_ADDRESS 0xb00034f1 /* @ECU_Address@VcCOMM_Decs_DippedBeam_Req@ */ /end MEASUREMENT
/begin MEASUREMENT VcCOMM_Decs_BrkLight_Req "" UBYTE COMM_subsystem_integrated_CM_uint8 0 0 0 255 ECU_ADDRESS 0xb00034f0 /* @ECU_Address@VcCOMM_Decs_BrkLight_Req@ */ /end MEASUREMENT
/begin MEASUREMENT VcCOMM_Decs_BckfogLmp_Req "" UBYTE COMM_subsystem_integrated_CM_uint8 0 0 0 255 ECU_ADDRESS 0xb00034ef /* @ECU_Address@VcCOMM_Decs_BckfogLmp_Req@ */ /end MEASUREMENT
/begin MEASUREMENT VcCOMM_Decs_Control_mod "" UBYTE COMM_subsystem_integrated_CM_uint8 0 0 0 255 ECU_ADDRESS 0xb00034ee /* @ECU_Address@VcCOMM_Decs_Control_mod@ */ /end MEASUREMENT
/begin MEASUREMENT VcCOMM_Decs_iBCM_Req "" UBYTE COMM_subsystem_integrated_CM_uint8 0 0 0 255 ECU_ADDRESS 0xb00034ed /* @ECU_Address@VcCOMM_Decs_iBCM_Req@ */ /end MEASUREMENT
/begin MEASUREMENT VcCOMM_Decs_Gear_Value "" UBYTE COMM_subsystem_integrated_CM_uint8 0 0 0 255 ECU_ADDRESS 0xb00034ec /* @ECU_Address@VcCOMM_Decs_Gear_Value@ */ /end MEASUREMENT
/begin MEASUREMENT VcCOMM_Decs_Gear_Req "" UBYTE COMM_subsystem_integrated_CM_uint8 0 0 0 255 ECU_ADDRESS 0xb00034eb /* @ECU_Address@VcCOMM_Decs_Gear_Req@ */ /end MEASUREMENT
/begin MEASUREMENT VcCOMM_Decs_Breake_Req "" UBYTE COMM_subsystem_integrated_CM_uint8 0 0 0 255 ECU_ADDRESS 0xb00034ea /* @ECU_Address@VcCOMM_Decs_Breake_Req@ */ /end MEASUREMENT
/begin MEASUREMENT VcCOMM_Decs_Acc_Req "" UBYTE COMM_subsystem_integrated_CM_uint8 0 0 0 255 ECU_ADDRESS 0xb00034e9 /* @ECU_Address@VcCOMM_Decs_Acc_Req@ */ /end MEASUREMENT
/begin MEASUREMENT VcCOMM_Decs_Steering_Req "" UBYTE COMM_subsystem_integrated_CM_uint8 0 0 0 255 ECU_ADDRESS 0xb00034e8 /* @ECU_Address@VcCOMM_Decs_Steering_Req@ */ /end MEASUREMENT
/begin MEASUREMENT VcCOMM_Decs_FedBck_EPBstate "" UBYTE COMM_subsystem_integrated_CM_uint8 0 0 0 255 ECU_ADDRESS 0xb00034e7 /* @ECU_Address@VcCOMM_Decs_FedBck_EPBstate@ */ /end MEASUREMENT
/begin MEASUREMENT VcCOMM_DriverModeComd "" UBYTE COMM_subsystem_integrated_CM_uint8 0 0 0 255 ECU_ADDRESS 0xb00034e6 /* @ECU_Address@VcCOMM_DriverModeComd@ */ /end MEASUREMENT
/begin MEASUREMENT VcCOMM_Decs_FedBck_KeyState "Ignition Key State." UBYTE COMM_subsystem_integrated_CM_uint8 0 0 0 255 ECU_ADDRESS 0xb00034e5 /* @ECU_Address@VcCOMM_Decs_FedBck_KeyState@ */ /end MEASUREMENT
/begin MEASUREMENT VcCOMM_VCU_DirIndicationLH "Left turning lamp status." UBYTE COMM_subsystem_integrated_CM_uint8 0 0 0 255 ECU_ADDRESS 0xb00034e4 /* @ECU_Address@VcCOMM_VCU_DirIndicationLH@ */ /end MEASUREMENT
/begin MEASUREMENT VcCOMM_VCU_DirIndicationRH "Right turning lamp status." UBYTE COMM_subsystem_integrated_CM_uint8 0 0 0 255 ECU_ADDRESS 0xb00034e3 /* @ECU_Address@VcCOMM_VCU_DirIndicationRH@ */ /end MEASUREMENT
/begin MEASUREMENT VcCOMM_Decs_FedBck_BrkPedSts "" UBYTE COMM_subsystem_integrated_CM_uint8 0 0 0 255 ECU_ADDRESS 0xb00034e2 /* @ECU_Address@VcCOMM_Decs_FedBck_BrkPedSts@ */ /end MEASUREMENT
/begin MEASUREMENT VcCOMM_VCU_HeadLampLowBeam "" UBYTE COMM_subsystem_integrated_CM_uint8 0 0 0 255 ECU_ADDRESS 0xb00034e1 /* @ECU_Address@VcCOMM_VCU_HeadLampLowBeam@ */ /end MEASUREMENT
/begin MEASUREMENT VcCOMM_VCU_HeadLampHighBeam "" UBYTE COMM_subsystem_integrated_CM_uint8 0 0 0 255 ECU_ADDRESS 0xb00034e0 /* @ECU_Address@VcCOMM_VCU_HeadLampHighBeam@ */ /end MEASUREMENT
/begin MEASUREMENT VcCOMM_Decs_FedBck_EPSmod "" UBYTE COMM_subsystem_integrated_CM_uint8 0 0 0 255 ECU_ADDRESS 0xb00034df /* @ECU_Address@VcCOMM_Decs_FedBck_EPSmod@ */ /end MEASUREMENT
/begin MEASUREMENT VcCOMM_Decs_FedBck_ESCmod "" UBYTE COMM_subsystem_integrated_CM_uint8 0 0 0 255 ECU_ADDRESS 0xb00034de /* @ECU_Address@VcCOMM_Decs_FedBck_ESCmod@ */ /end MEASUREMENT
/begin MEASUREMENT VcCOMM_Decs_FedBck_Drivemod "" UBYTE COMM_subsystem_integrated_CM_uint8 0 0 0 255 ECU_ADDRESS 0xb00034dd /* @ECU_Address@VcCOMM_Decs_FedBck_Drivemod@ */ /end MEASUREMENT
/begin MEASUREMENT VcCOMM_Decs_FedBck_GearValue "" UBYTE COMM_subsystem_integrated_CM_uint8 0 0 0 255 ECU_ADDRESS 0xb00034dc /* @ECU_Address@VcCOMM_Decs_FedBck_GearValue@ */ /end MEASUREMENT
/begin MEASUREMENT VfDCSN_vehicle_speed_egmo "The linear velocity of ego vehicle from egmo" FLOAT32_IEEE DCSN_subsystem_integrated_CM_single_m_s 0 0 -3.4E+38 3.4E+38 ECU_ADDRESS 0x70010a28 /* @ECU_Address@VfDCSN_vehicle_speed_egmo@ */ /end MEASUREMENT
/begin MEASUREMENT VfDCSN_traffic_speed_limit "speed limit" FLOAT32_IEEE DCSN_subsystem_integrated_CM_single_m_s 0 0 -3.4E+38 3.4E+38 ECU_ADDRESS 0x70010a24 /* @ECU_Address@VfDCSN_traffic_speed_limit@ */ /end MEASUREMENT
/begin MEASUREMENT VfDCSN_raw_stop_line_distance "The raw stop line distance from mpfu" FLOAT32_IEEE DCSN_subsystem_integrated_CM_single_m 0 0 -3.4E+38 3.4E+38 ECU_ADDRESS 0x70010a20 /* @ECU_Address@VfDCSN_raw_stop_line_distance@ */ /end MEASUREMENT
/begin MEASUREMENT VfDCSN_stop_s_distance "stop distance" FLOAT32_IEEE DCSN_subsystem_integrated_CM_single_m 0 0 -3.4E+38 3.4E+38 ECU_ADDRESS 0x70010a1c /* @ECU_Address@VfDCSN_stop_s_distance@ */ /end MEASUREMENT
/begin MEASUREMENT VfDCSN_change_lane_target_speed "target speed when change lane" FLOAT32_IEEE DCSN_subsystem_integrated_CM_single_m_s 0 0 -3.4E+38 3.4E+38 ECU_ADDRESS 0x70010a18 /* @ECU_Address@VfDCSN_change_lane_target_speed@ */ /end MEASUREMENT
/begin MEASUREMENT VfDCSN_mpfu_num_stop_lines "The number of input numbers of stop lines from mpfu" UBYTE DCSN_subsystem_integrated_CM_uint8 0 0 0 255 ECU_ADDRESS 0x70010a17 /* @ECU_Address@VfDCSN_mpfu_num_stop_lines@ */ /end MEASUREMENT
/begin MEASUREMENT VfDCSN_inlane_nudge_side "inlane nudge side
      0 = NA
      1 = LEFT
      2 = RIGHT" UBYTE DCSN_subsystem_integrated_CM_uint8 0 0 0 255 ECU_ADDRESS 0x70010a16 /* @ECU_Address@VfDCSN_inlane_nudge_side@ */ /end MEASUREMENT
/begin MEASUREMENT VeDCSN_stop_request_mode "0 = NotEnabled
      1 = WaitForValidStopLine
      2 = CheckStopCond
      3 = SendStopReqEgmoDis
      4 = UpdateStopDis
      5 = HoldForStopLineUpdate" UBYTE DCSN_subsystem_integrated_CM_uint8 0 0 0 255 ECU_ADDRESS 0x70010a15 /* @ECU_Address@VeDCSN_stop_request_mode@ */ /end MEASUREMENT
/begin MEASUREMENT VeDCSN_usr_cmd_autodrive_activate "usr activate cmd
      0 = deactivate
      1 = activate
      2 = hold" UBYTE DCSN_subsystem_integrated_CM_uint8 0 0 0 255 ECU_ADDRESS 0x70010a14 /* @ECU_Address@VeDCSN_usr_cmd_autodrive_activate@ */ /end MEASUREMENT
/begin MEASUREMENT VbDCSN_num_lanes_isNaN "Whether lanes number from mpfu is NaN" UBYTE DCSN_subsystem_integrated_CM_boolean 0 0 0 1 ECU_ADDRESS 0x70010a13 /* @ECU_Address@VbDCSN_num_lanes_isNaN@ */ /end MEASUREMENT
/begin MEASUREMENT VbDCSN_speed_limit_enabled "Whether the speed limit output is enabled" UBYTE DCSN_subsystem_integrated_CM_boolean 0 0 0 1 ECU_ADDRESS 0x70010a12 /* @ECU_Address@VbDCSN_speed_limit_enabled@ */ /end MEASUREMENT
/begin MEASUREMENT VbDCSN_overspeed_warning "0 = speed in range
      1 = overspeed warning" UBYTE DCSN_subsystem_integrated_CM_boolean 0 0 0 1 ECU_ADDRESS 0x70010a11 /* @ECU_Address@VbDCSN_overspeed_warning@ */ /end MEASUREMENT
/begin MEASUREMENT VbDCSN_num_stop_lines_isNaN "The output stop lines number from mpfu" UBYTE DCSN_subsystem_integrated_CM_boolean 0 0 0 1 ECU_ADDRESS 0x70010a10 /* @ECU_Address@VbDCSN_num_stop_lines_isNaN@ */ /end MEASUREMENT
/begin MEASUREMENT VbDCSN_has_valid_stop_line "0 = no valid stop line
      1 = has valid stop line" UBYTE DCSN_subsystem_integrated_CM_boolean 0 0 0 1 ECU_ADDRESS 0x70010a0f /* @ECU_Address@VbDCSN_has_valid_stop_line@ */ /end MEASUREMENT
/begin MEASUREMENT VbDCSN_stop_line_distance_isNaN "0 = distance from stop line is valid
      1 = distance from stop line is NaN" UBYTE DCSN_subsystem_integrated_CM_boolean 0 0 0 1 ECU_ADDRESS 0x70010a0e /* @ECU_Address@VbDCSN_stop_line_distance_isNaN@ */ /end MEASUREMENT
/begin MEASUREMENT VbDCSN_accs_stop_finished "If ACCS finished the stop request from DCSN" UBYTE DCSN_subsystem_integrated_CM_boolean 0 0 0 1 ECU_ADDRESS 0x70010a0d /* @ECU_Address@VbDCSN_accs_stop_finished@ */ /end MEASUREMENT
/begin MEASUREMENT VbDCSN_raw_stop_finished "The raw signal:
      Whether ACCS has finished stop request before the stop line." UBYTE DCSN_subsystem_integrated_CM_boolean 0 0 0 1 ECU_ADDRESS 0x70010a0c /* @ECU_Address@VbDCSN_raw_stop_finished@ */ /end MEASUREMENT
/begin MEASUREMENT VbDCSN_hold_stop_finished "The time hold signal:
      Whether ACCS has finished stop request before the stop line." UBYTE DCSN_subsystem_integrated_CM_boolean 0 0 0 1 ECU_ADDRESS 0x70010a0b /* @ECU_Address@VbDCSN_hold_stop_finished@ */ /end MEASUREMENT
/begin MEASUREMENT VbDCSN_raw_stop_finished_late "The raw signal:
      Whether ACCS has finished stop request after the stop line." UBYTE DCSN_subsystem_integrated_CM_boolean 0 0 0 1 ECU_ADDRESS 0x70010a0a /* @ECU_Address@VbDCSN_raw_stop_finished_late@ */ /end MEASUREMENT
/begin MEASUREMENT VbDCSN_hold_stop_finished_late "The time hold signal:
      Whether ACCS has finished stop request after the stop line." UBYTE DCSN_subsystem_integrated_CM_boolean 0 0 0 1 ECU_ADDRESS 0x70010a09 /* @ECU_Address@VbDCSN_hold_stop_finished_late@ */ /end MEASUREMENT
/begin MEASUREMENT VbDCSN_stop_request_enabled "0 = Sending stop request is disabled
      1 = Sending stop request is ensabled" UBYTE DCSN_subsystem_integrated_CM_boolean 0 0 0 1 ECU_ADDRESS 0x70010a08 /* @ECU_Address@VbDCSN_stop_request_enabled@ */ /end MEASUREMENT
/begin MEASUREMENT VbDCSN_should_send_stop_req "0 = should not send stop req
      1 = should send stop req" UBYTE DCSN_subsystem_integrated_CM_boolean 0 0 0 1 ECU_ADDRESS 0x70010a07 /* @ECU_Address@VbDCSN_should_send_stop_req@ */ /end MEASUREMENT
/begin MEASUREMENT VbDCSN_stop_line_is_close "0 = stop line is far
      1 = stop line is close and will be updated by vehicle speed" UBYTE DCSN_subsystem_integrated_CM_boolean 0 0 0 1 ECU_ADDRESS 0x70010a06 /* @ECU_Address@VbDCSN_stop_line_is_close@ */ /end MEASUREMENT
/begin MEASUREMENT VbDCSN_stop_unsuccess "Whether the ego vehicle failed to stop for this stop request" UBYTE DCSN_subsystem_integrated_CM_boolean 0 0 0 1 ECU_ADDRESS 0x70010a05 /* @ECU_Address@VbDCSN_stop_unsuccess@ */ /end MEASUREMENT
/begin MEASUREMENT VbDCSN_stop_request "0 = no stop request
      1 = stop request" UBYTE DCSN_subsystem_integrated_CM_boolean 0 0 0 1 ECU_ADDRESS 0x70010a04 /* @ECU_Address@VbDCSN_stop_request@ */ /end MEASUREMENT
/begin MEASUREMENT VbDCSN_change_lane_request "0 = no change lane request
      1 = change lane request" UBYTE DCSN_subsystem_integrated_CM_boolean 0 0 0 1 ECU_ADDRESS 0x70010a03 /* @ECU_Address@VbDCSN_change_lane_request@ */ /end MEASUREMENT
/begin MEASUREMENT VbDCSN_inlane_nudge_request "0 = no inlane nudge request
      1 = request inlane nudge" UBYTE DCSN_subsystem_integrated_CM_boolean 0 0 0 1 ECU_ADDRESS 0x70010a02 /* @ECU_Address@VbDCSN_inlane_nudge_request@ */ /end MEASUREMENT
/begin MEASUREMENT VbDCSN_pull_over_request "0 = no pull over request
      1 = pull over" UBYTE DCSN_subsystem_integrated_CM_boolean 0 0 0 1 ECU_ADDRESS 0x70010a01 /* @ECU_Address@VbDCSN_pull_over_request@ */ /end MEASUREMENT
/begin MEASUREMENT VbDCSN_stop_line_input_isNaN "0 = input is valid
      1 = input is NaN" UBYTE DCSN_subsystem_integrated_CM_boolean 0 0 0 1 ECU_ADDRESS 0x70010a00 /* @ECU_Address@VbDCSN_stop_line_input_isNaN@ */ /end MEASUREMENT
/begin MEASUREMENT VbDCSN_spd_limt_max_isNaN "0 = input speed limit is valid
      1 = input speed limit is NaN" UBYTE DCSN_subsystem_integrated_CM_boolean 0 0 0 1 ECU_ADDRESS 0x700109ff /* @ECU_Address@VbDCSN_spd_limt_max_isNaN@ */ /end MEASUREMENT
/begin MEASUREMENT VbDCSN_speed_limit_input_isNaN "0 = input is valid
      1 = input is NaN" UBYTE DCSN_subsystem_integrated_CM_boolean 0 0 0 1 ECU_ADDRESS 0x700109fe /* @ECU_Address@VbDCSN_speed_limit_input_isNaN@ */ /end MEASUREMENT
/begin MEASUREMENT VbDCSN_egmo_is_ready "0 = egmo not ready
      1 = egmo ready" UBYTE DCSN_subsystem_integrated_CM_boolean 0 0 0 1 ECU_ADDRESS 0x700109fd /* @ECU_Address@VbDCSN_egmo_is_ready@ */ /end MEASUREMENT
/begin MEASUREMENT VbDCSN_mpfu_is_ready "0 = mpfu not ready
      1 = mpfu ready" UBYTE DCSN_subsystem_integrated_CM_boolean 0 0 0 1 ECU_ADDRESS 0x700109fc /* @ECU_Address@VbDCSN_mpfu_is_ready@ */ /end MEASUREMENT
/begin MEASUREMENT VbDCSN_input_is_ready "0 = input data is not ready
      1 = input data is ready" UBYTE DCSN_subsystem_integrated_CM_boolean 0 0 0 1 ECU_ADDRESS 0x700109fb /* @ECU_Address@VbDCSN_input_is_ready@ */ /end MEASUREMENT
/begin MEASUREMENT VbDCSN_acc_feature_enable "0 = acc not enabled
      1 = acc enabled" UBYTE DCSN_subsystem_integrated_CM_boolean 0 0 0 1 ECU_ADDRESS 0x700109fa /* @ECU_Address@VbDCSN_acc_feature_enable@ */ /end MEASUREMENT
/begin MEASUREMENT VbDCSN_power_ctrl_enable "0 = power not enabled
      1 = power enabled" UBYTE DCSN_subsystem_integrated_CM_boolean 0 0 0 1 ECU_ADDRESS 0x700109f9 /* @ECU_Address@VbDCSN_power_ctrl_enable@ */ /end MEASUREMENT
/begin MEASUREMENT VbDCSN_brake_ctrl_enable "0 = brake not enabled
      1 = brake enabled
      " UBYTE DCSN_subsystem_integrated_CM_boolean 0 0 0 1 ECU_ADDRESS 0x700109f8 /* @ECU_Address@VbDCSN_brake_ctrl_enable@ */ /end MEASUREMENT
/begin MEASUREMENT VbDCSN_steer_ctrl_enable "0 = steer not enabled
      1 = steer enabled" UBYTE DCSN_subsystem_integrated_CM_boolean 0 0 0 1 ECU_ADDRESS 0x700109f7 /* @ECU_Address@VbDCSN_steer_ctrl_enable@ */ /end MEASUREMENT
/begin MEASUREMENT VbDCSN_gear_ctrl_enable "0 = gear not enabled
      1 = gear enabled" UBYTE DCSN_subsystem_integrated_CM_boolean 0 0 0 1 ECU_ADDRESS 0x700109f6 /* @ECU_Address@VbDCSN_gear_ctrl_enable@ */ /end MEASUREMENT
/begin MEASUREMENT VbDCSN_epb_ctrl_enable "0 = epb not enabled
      1 = epb enabled" UBYTE DCSN_subsystem_integrated_CM_boolean 0 0 0 1 ECU_ADDRESS 0x700109f5 /* @ECU_Address@VbDCSN_epb_ctrl_enable@ */ /end MEASUREMENT
/begin MEASUREMENT VbDCSN_lcc_feature_enable "0 = lcc not enabled
      1 = lcc enabled
      " UBYTE DCSN_subsystem_integrated_CM_boolean 0 0 0 1 ECU_ADDRESS 0x700109f4 /* @ECU_Address@VbDCSN_lcc_feature_enable@ */ /end MEASUREMENT
/begin MEASUREMENT VbDCSN_alca_feature_enable "0 = alca not enabled
      1 = alca enabled" UBYTE DCSN_subsystem_integrated_CM_boolean 0 0 0 1 ECU_ADDRESS 0x700109f3 /* @ECU_Address@VbDCSN_alca_feature_enable@ */ /end MEASUREMENT
/begin MEASUREMENT VbDCSN_aeb_feature_enable "0 = aeb not enabled
      1 = aeb enabled
      " UBYTE DCSN_subsystem_integrated_CM_boolean 0 0 0 1 ECU_ADDRESS 0x700109f2 /* @ECU_Address@VbDCSN_aeb_feature_enable@ */ /end MEASUREMENT
/begin MEASUREMENT VbDCSN_fcw_feature_enable "0 = fcw not enabled
      1 = fcw enabled" UBYTE DCSN_subsystem_integrated_CM_boolean 0 0 0 1 ECU_ADDRESS 0x700109f1 /* @ECU_Address@VbDCSN_fcw_feature_enable@ */ /end MEASUREMENT
/begin MEASUREMENT VbDCSN_lcw_feature_enable "0 = lcw not enabled
      1 = lcw enabled
      " UBYTE DCSN_subsystem_integrated_CM_boolean 0 0 0 1 ECU_ADDRESS 0x700109f0 /* @ECU_Address@VbDCSN_lcw_feature_enable@ */ /end MEASUREMENT
/begin MEASUREMENT VbDCSN_ldw_feature_enable "0 = ldw not enabled
      1 = ldw enabled
      " UBYTE DCSN_subsystem_integrated_CM_boolean 0 0 0 1 ECU_ADDRESS 0x700109ef /* @ECU_Address@VbDCSN_ldw_feature_enable@ */ /end MEASUREMENT
/begin MEASUREMENT VbDCSN_fault_detected "Whether system fault is level 3,4,5." UBYTE DCSN_subsystem_integrated_CM_boolean 0 0 0 1 ECU_ADDRESS 0x700109ee /* @ECU_Address@VbDCSN_fault_detected@ */ /end MEASUREMENT
/begin MEASUREMENT VbDCSN_ACC_ready_to_engage "ACCS subsystem ready" UBYTE DCSN_subsystem_integrated_CM_boolean 0 0 0 1 ECU_ADDRESS 0x700109ed /* @ECU_Address@VbDCSN_ACC_ready_to_engage@ */ /end MEASUREMENT
/begin MEASUREMENT VbDCSN_vehicle_ready_to_engage "Whether vehicle speed, EPB, Brk, gear are all ready." UBYTE DCSN_subsystem_integrated_CM_boolean 0 0 0 1 ECU_ADDRESS 0x700109ec /* @ECU_Address@VbDCSN_vehicle_ready_to_engage@ */ /end MEASUREMENT
/begin MEASUREMENT VbDCSN_adm_steering_override "0 = not override
      1 = override" UBYTE DCSN_subsystem_integrated_CM_boolean 0 0 0 1 ECU_ADDRESS 0x700109eb /* @ECU_Address@VbDCSN_adm_steering_override@ */ /end MEASUREMENT
/begin MEASUREMENT VbDCSN_adm_steering_resume "0 = not resume
      1 = resume" UBYTE DCSN_subsystem_integrated_CM_boolean 0 0 0 1 ECU_ADDRESS 0x700109ea /* @ECU_Address@VbDCSN_adm_steering_resume@ */ /end MEASUREMENT
/begin MEASUREMENT VeDCSN_adm_main_mode "0 = ADM_OFF
      1 = ADM_STANDBY
      2 = ADM_READY
      3 = ADM_ACTIVE
      4 = ADM_STEER_OVRD
      5 = ADM_TAKEOVER_WARNING
      6 = ADM_FAULT_WARNING
      7 = ADM_FAULT_REACTION
      8 = ADM_FAULT_DETECTED" UBYTE DCSN_subsystem_integrated_CM_EnumDCSN_adm_main_mode 0 0 0 8 ECU_ADDRESS 0x700109e9 /* @ECU_Address@VeDCSN_adm_main_mode@ */ /end MEASUREMENT
/begin MEASUREMENT VeDCSN_hmi_msg_display "0 = NO_MSG
      1 = ACTIVE
      2 = OVRD
      3 = TAKOVER_REQ
      4 = FAULT" UBYTE DCSN_subsystem_integrated_CM_EnumDCSN_adm_hmi_msg_display 0 0 0 4 ECU_ADDRESS 0x700109e8 /* @ECU_Address@VeDCSN_hmi_msg_display@ */ /end MEASUREMENT
/begin MEASUREMENT VeDCSN_hmi_icon_display "0 = NO_ICON
      1 = GREY_SOLID
      2 = GREEN_SOLID
      3 = BLUE_SOLID
      4 = RED_FLASH_SLOW
      5 = RED_FLASH_FAST
      6 = RED_SOLID" UBYTE DCSN_subsystem_integrated_CM_EnumDCSN_adm_hmi_icon_display 0 0 0 6 ECU_ADDRESS 0x700109e7 /* @ECU_Address@VeDCSN_hmi_icon_display@ */ /end MEASUREMENT
/begin MEASUREMENT VeDCSN_autodrive_control_mode "0 = AUTODRIVE_PASSIVE
      1 = AUTODRIVE_ACTIVATING
      2 = AUTODRIVE_ACTIVATED
      " UBYTE DCSN_subsystem_integrated_CM_EnumDCSN_autodrive_control_mode 0 0 0 2 ECU_ADDRESS 0x700109e6 /* @ECU_Address@VeDCSN_autodrive_control_mode@ */ /end MEASUREMENT
/begin MEASUREMENT VeDCSN_stop_reason "0 = NO_STOP_REQUEST
      1 = STOP_FOR_DESTINATION
      2 = STOP_FOR_TRAFFIC_LIGHT
      3 = STOP_FOR_STOP_SIGN
      4 = STOP_FOR_STOP_LINE
      5 = STOP_FOR_CROSSWALK
      6 = STOP_FOR_KEEP_CLEAR" UBYTE DCSN_subsystem_integrated_CM_EnumDCSN_stop_reason 0 0 0 5 ECU_ADDRESS 0x700109e5 /* @ECU_Address@VeDCSN_stop_reason@ */ /end MEASUREMENT
/begin MEASUREMENT VeDCSN_speed_limit_reason "0 = NO_LIMIT
      1 = LIMIT_FOR_EGO_LANE
      2 = LIMIT_FOR_DRIVER_REQ
      3 = LIMIT_FOR_CROSSWALK
      4 = LIMIT_FOR_NUDGE" UBYTE DCSN_subsystem_integrated_CM_EnumDCSN_speed_limit_reason 0 0 0 2 ECU_ADDRESS 0x700109e4 /* @ECU_Address@VeDCSN_speed_limit_reason@ */ /end MEASUREMENT
/begin MEASUREMENT VeDCSN_change_lane_req_side "0 = FORWARD
      1 = LEFT
      2 = RIGHT" UBYTE DCSN_subsystem_integrated_CM_EnumDCSN_driving_direction 0 0 0 2 ECU_ADDRESS 0x700109e3 /* @ECU_Address@VeDCSN_change_lane_req_side@ */ /end MEASUREMENT
/begin MEASUREMENT VeDCSN_change_lane_reason "0 = LC_NO_REQUEST
      1 = LC_USER_CMD
      2 = LC_NAVIGATION_CMD
      3 = LC_FRONT_OBSTACLE" UBYTE DCSN_subsystem_integrated_CM_EnumDCSN_change_lane_reason 0 0 0 3 ECU_ADDRESS 0x700109e2 /* @ECU_Address@VeDCSN_change_lane_reason@ */ /end MEASUREMENT
/begin MEASUREMENT VeDCSN_inlane_nudge_reason "0 = NUDGE_NO_REQUEST
      1 = NUDGE_FRONT_OBSTACLE
      2 = NUDGE_SIDE_OBSTACLE" UBYTE DCSN_subsystem_integrated_CM_EnumDCSN_inlane_nudge_reason 0 0 0 2 ECU_ADDRESS 0x700109e1 /* @ECU_Address@VeDCSN_inlane_nudge_reason@ */ /end MEASUREMENT
/begin MEASUREMENT VeDCSN_pull_over_reason "0 = PULLOVER_NO_REQUEST
      1 = PULLOVER_USER_CMD
      2 = PULLOVER_POLICE
      3 = PULLOVER_SYSTEM_FAULT" UBYTE DCSN_subsystem_integrated_CM_EnumDCSN_pull_over_reason 0 0 0 3 ECU_ADDRESS 0x700109e0 /* @ECU_Address@VeDCSN_pull_over_reason@ */ /end MEASUREMENT
/begin MEASUREMENT VfLCCS_steering_angle_diff_abs "Steering angle delta absolute value." FLOAT32_IEEE LCCS_subsystem_integrated_CM_single 0 0 -3.4E+38 3.4E+38 ECU_ADDRESS 0xb0004e7c /* @ECU_Address@VfLCCS_steering_angle_diff_abs@ */ /end MEASUREMENT
/begin MEASUREMENT VfLCCS_linear_velocity "Linear velocity." FLOAT32_IEEE LCCS_subsystem_integrated_CM_single 0 0 -3.4E+38 3.4E+38 ECU_ADDRESS 0xb0004e78 /* @ECU_Address@VfLCCS_linear_velocity@ */ /end MEASUREMENT
/begin MEASUREMENT VfLCCS_velocity_rel_x "Lateral speed Vx." FLOAT32_IEEE LCCS_subsystem_integrated_CM_single 0 0 -3.4E+38 3.4E+38 ECU_ADDRESS 0xb0004e74 /* @ECU_Address@VfLCCS_velocity_rel_x@ */ /end MEASUREMENT
/begin MEASUREMENT VfLCCS_velocity_rel_y "Longitudinal speed Vy." FLOAT32_IEEE LCCS_subsystem_integrated_CM_single 0 0 -3.4E+38 3.4E+38 ECU_ADDRESS 0xb0004e70 /* @ECU_Address@VfLCCS_velocity_rel_y@ */ /end MEASUREMENT
/begin MEASUREMENT VfLCCS_veh_heading_rel "Slip angle of center of mass." FLOAT32_IEEE LCCS_subsystem_integrated_CM_single 0 0 -3.4E+38 3.4E+38 ECU_ADDRESS 0xb0004e6c /* @ECU_Address@VfLCCS_veh_heading_rel@ */ /end MEASUREMENT
/begin MEASUREMENT VfLCCS_VCU1_ICPV_StrAngle "Steering wheel angle from CAN." FLOAT32_IEEE LCCS_subsystem_integrated_CM_single 0 0 -3.4E+38 3.4E+38 ECU_ADDRESS 0xb0004e68 /* @ECU_Address@VfLCCS_VCU1_ICPV_StrAngle@ */ /end MEASUREMENT
/begin MEASUREMENT VfLCCS_lookahead_distance "Lookahead distance." FLOAT32_IEEE LCCS_subsystem_integrated_CM_single 0 0 -3.4E+38 3.4E+38 ECU_ADDRESS 0xb0004e64 /* @ECU_Address@VfLCCS_lookahead_distance@ */ /end MEASUREMENT
/begin MEASUREMENT VfLCCS_veh_frtwhl_angle_act "Vehicle front wheel angle actual value." FLOAT32_IEEE LCCS_subsystem_integrated_CM_single 0 0 -3.4E+38 3.4E+38 ECU_ADDRESS 0xb0004e60 /* @ECU_Address@VfLCCS_veh_frtwhl_angle_act@ */ /end MEASUREMENT
/begin MEASUREMENT VfLCCS_raw_lane_width "Raw lane width." FLOAT32_IEEE LCCS_subsystem_integrated_CM_single 0 0 -3.4E+38 3.4E+38 ECU_ADDRESS 0xb0004e5c /* @ECU_Address@VfLCCS_raw_lane_width@ */ /end MEASUREMENT
/begin MEASUREMENT VaLCCS_raw_left_lanemark "Raw left lanemark." FLOAT32_IEEE LCCS_subsystem_integrated_CM_single 0 0 -3.4E+38 3.4E+38 ARRAY_SIZE 6 ECU_ADDRESS 0xb0004e44 /* @ECU_Address@VaLCCS_raw_left_lanemark@ */ /end MEASUREMENT
/begin MEASUREMENT VaLCCS_raw_right_lanemark "Raw right lanemark." FLOAT32_IEEE LCCS_subsystem_integrated_CM_single 0 0 -3.4E+38 3.4E+38 ARRAY_SIZE 6 ECU_ADDRESS 0xb0004e2c /* @ECU_Address@VaLCCS_raw_right_lanemark@ */ /end MEASUREMENT
/begin MEASUREMENT VfLCCS_smoothed_lane_width "Smoothed lane width." FLOAT32_IEEE LCCS_subsystem_integrated_CM_single 0 0 -3.4E+38 3.4E+38 ECU_ADDRESS 0xb0004e28 /* @ECU_Address@VfLCCS_smoothed_lane_width@ */ /end MEASUREMENT
/begin MEASUREMENT VfLCCS_left_lanemark_confidence "" FLOAT32_IEEE LCCS_subsystem_integrated_CM_single 0 0 -3.4E+38 3.4E+38 ECU_ADDRESS 0xb0004e24 /* @ECU_Address@VfLCCS_left_lanemark_confidence@ */ /end MEASUREMENT
/begin MEASUREMENT VfLCCS_right_lanemark_confidence "" FLOAT32_IEEE LCCS_subsystem_integrated_CM_single 0 0 -3.4E+38 3.4E+38 ECU_ADDRESS 0xb0004e20 /* @ECU_Address@VfLCCS_right_lanemark_confidence@ */ /end MEASUREMENT
/begin MEASUREMENT VaLCCS_virtual_left_lanemark "Virtual left lanemark." FLOAT32_IEEE LCCS_subsystem_integrated_CM_single 0 0 -3.4E+38 3.4E+38 ARRAY_SIZE 4 ECU_ADDRESS 0xb0004e10 /* @ECU_Address@VaLCCS_virtual_left_lanemark@ */ /end MEASUREMENT
/begin MEASUREMENT VaLCCS_virtual_right_lanemark "Virtual right lanemark." FLOAT32_IEEE LCCS_subsystem_integrated_CM_single 0 0 -3.4E+38 3.4E+38 ARRAY_SIZE 4 ECU_ADDRESS 0xb0004e00 /* @ECU_Address@VaLCCS_virtual_right_lanemark@ */ /end MEASUREMENT
/begin MEASUREMENT VfLCCS_c0_scaling "c0 scaling factor against lane width." FLOAT32_IEEE LCCS_subsystem_integrated_CM_single 0 0 -3.4E+38 3.4E+38 ECU_ADDRESS 0xb0004dfc /* @ECU_Address@VfLCCS_c0_scaling@ */ /end MEASUREMENT
/begin MEASUREMENT VfLCCS_target_lateral_shift_width "Target shift width for lane change or inlane nudge." FLOAT32_IEEE LCCS_subsystem_integrated_CM_single 0 0 -3.4E+38 3.4E+38 ECU_ADDRESS 0xb0004df8 /* @ECU_Address@VfLCCS_target_lateral_shift_width@ */ /end MEASUREMENT
/begin MEASUREMENT VfLCCS_lateral_shift_step "Lane change or nudge shift lateral distance step." FLOAT32_IEEE LCCS_subsystem_integrated_CM_single 0 0 -3.4E+38 3.4E+38 ECU_ADDRESS 0xb0004df4 /* @ECU_Address@VfLCCS_lateral_shift_step@ */ /end MEASUREMENT
/begin MEASUREMENT VfLCCS_lateral_dist_to_go "Lateral distance from tracked lane center to target lane center." FLOAT32_IEEE LCCS_subsystem_integrated_CM_single_m 0 0 -3.4E+38 3.4E+38 ECU_ADDRESS 0xb0004df0 /* @ECU_Address@VfLCCS_lateral_dist_to_go@ */ /end MEASUREMENT
/begin MEASUREMENT VfLCCS_lateral_shift_width "Lane change or inlane nudge lateral shift width, which is an offset to raw lane center." FLOAT32_IEEE LCCS_subsystem_integrated_CM_single 0 0 -3.4E+38 3.4E+38 ECU_ADDRESS 0xb0004dec /* @ECU_Address@VfLCCS_lateral_shift_width@ */ /end MEASUREMENT
/begin MEASUREMENT VaLCCS_shifted_lane_center_line "Shifted lane center line." FLOAT32_IEEE LCCS_subsystem_integrated_CM_single 0 0 -3.4E+38 3.4E+38 ARRAY_SIZE 4 ECU_ADDRESS 0xb0004ddc /* @ECU_Address@VaLCCS_shifted_lane_center_line@ */ /end MEASUREMENT
/begin MEASUREMENT VfLCCS_frtwhl_angle_step_limit "Front wheel angle step limit." FLOAT32_IEEE LCCS_subsystem_integrated_CM_single 0 0 -3.4E+38 3.4E+38 ECU_ADDRESS 0xb0004dd8 /* @ECU_Address@VfLCCS_frtwhl_angle_step_limit@ */ /end MEASUREMENT
/begin MEASUREMENT VfLCCS_frtwhl_angle_limit_manual "Front wheel angle limit manual." FLOAT32_IEEE LCCS_subsystem_integrated_CM_single 0 0 -3.4E+38 3.4E+38 ECU_ADDRESS 0xb0004dd4 /* @ECU_Address@VfLCCS_frtwhl_angle_limit_manual@ */ /end MEASUREMENT
/begin MEASUREMENT VfLCCS_veh_frtwhl_angle_des_ramped "Vehicle front wheel angle desired value ramped." FLOAT32_IEEE LCCS_subsystem_integrated_CM_single 0 0 -3.4E+38 3.4E+38 ECU_ADDRESS 0xb0004dd0 /* @ECU_Address@VfLCCS_veh_frtwhl_angle_des_ramped@ */ /end MEASUREMENT
/begin MEASUREMENT VfLCCS_veh_strwhl_angle_des "Desired steering wheel angle." FLOAT32_IEEE LCCS_subsystem_integrated_CM_single 0 0 -3.4E+38 3.4E+38 ECU_ADDRESS 0xb0004dcc /* @ECU_Address@VfLCCS_veh_strwhl_angle_des@ */ /end MEASUREMENT
/begin MEASUREMENT VfLCCS_steer_angle_feedback "Steer angle feedback." FLOAT32_IEEE LCCS_subsystem_integrated_CM_single 0 0 -3.4E+38 3.4E+38 ECU_ADDRESS 0xb0004dc8 /* @ECU_Address@VfLCCS_steer_angle_feedback@ */ /end MEASUREMENT
/begin MEASUREMENT VfLCCS_slowpath_steer_P "Slowpath steer P part." FLOAT32_IEEE LCCS_subsystem_integrated_CM_single 0 0 -3.4E+38 3.4E+38 ECU_ADDRESS 0xb0004dc4 /* @ECU_Address@VfLCCS_slowpath_steer_P@ */ /end MEASUREMENT
/begin MEASUREMENT VfLCCS_slowpath_steer_I "Slowpath steer I part." FLOAT32_IEEE LCCS_subsystem_integrated_CM_single 0 0 -3.4E+38 3.4E+38 ECU_ADDRESS 0xb0004dc0 /* @ECU_Address@VfLCCS_slowpath_steer_I@ */ /end MEASUREMENT
/begin MEASUREMENT VfLCCS_slowpath_steer_PI "Slowpath steer PI part." FLOAT32_IEEE LCCS_subsystem_integrated_CM_single 0 0 -3.4E+38 3.4E+38 ECU_ADDRESS 0xb0004dbc /* @ECU_Address@VfLCCS_slowpath_steer_PI@ */ /end MEASUREMENT
/begin MEASUREMENT VfLCCS_frtwhl_angle_limit_lat_acc "Front wheel angle limit lat acc." FLOAT32_IEEE LCCS_subsystem_integrated_CM_single 0 0 -3.4E+38 3.4E+38 ECU_ADDRESS 0xb0004db8 /* @ECU_Address@VfLCCS_frtwhl_angle_limit_lat_acc@ */ /end MEASUREMENT
/begin MEASUREMENT VfLCCS_veh_frtwhl_angle_des "Vehicle front wheel angle desired value raw." FLOAT32_IEEE LCCS_subsystem_integrated_CM_single 0 0 -3.4E+38 3.4E+38 ECU_ADDRESS 0xb0004db4 /* @ECU_Address@VfLCCS_veh_frtwhl_angle_des@ */ /end MEASUREMENT
/begin MEASUREMENT VfLCCS_lateral_error_contribution "Lateral error contribution." FLOAT32_IEEE LCCS_subsystem_integrated_CM_single 0 0 -3.4E+38 3.4E+38 ECU_ADDRESS 0xb0004db0 /* @ECU_Address@VfLCCS_lateral_error_contribution@ */ /end MEASUREMENT
/begin MEASUREMENT VfLCCS_lateral_error_rate_contribution "Lateral error rate contribution." FLOAT32_IEEE LCCS_subsystem_integrated_CM_single 0 0 -3.4E+38 3.4E+38 ECU_ADDRESS 0xb0004dac /* @ECU_Address@VfLCCS_lateral_error_rate_contribution@ */ /end MEASUREMENT
/begin MEASUREMENT VfLCCS_heading_error_contribution "Heading error contribution." FLOAT32_IEEE LCCS_subsystem_integrated_CM_single 0 0 -3.4E+38 3.4E+38 ECU_ADDRESS 0xb0004da8 /* @ECU_Address@VfLCCS_heading_error_contribution@ */ /end MEASUREMENT
/begin MEASUREMENT VfLCCS_heading_error_rate_contribution "Heading error rate contribution." FLOAT32_IEEE LCCS_subsystem_integrated_CM_single 0 0 -3.4E+38 3.4E+38 ECU_ADDRESS 0xb0004da4 /* @ECU_Address@VfLCCS_heading_error_rate_contribution@ */ /end MEASUREMENT
/begin MEASUREMENT VfLCCS_left_lanemark_switch_time "Left lanemark switch time." FLOAT32_IEEE LCCS_subsystem_integrated_CM_single 0 0 -3.4E+38 3.4E+38 ECU_ADDRESS 0xb0004da0 /* @ECU_Address@VfLCCS_left_lanemark_switch_time@ */ /end MEASUREMENT
/begin MEASUREMENT VaLCCS_final_left_lanemark "Final left lanemarker." FLOAT32_IEEE LCCS_subsystem_integrated_CM_single 0 0 -3.4E+38 3.4E+38 ARRAY_SIZE 4 ECU_ADDRESS 0xb0004d90 /* @ECU_Address@VaLCCS_final_left_lanemark@ */ /end MEASUREMENT
/begin MEASUREMENT VfLCCS_right_lanemark_switch_time "Right lanemark switch time." FLOAT32_IEEE LCCS_subsystem_integrated_CM_single 0 0 -3.4E+38 3.4E+38 ECU_ADDRESS 0xb0004d8c /* @ECU_Address@VfLCCS_right_lanemark_switch_time@ */ /end MEASUREMENT
/begin MEASUREMENT VaLCCS_final_right_lanemark "Final right lanemarker." FLOAT32_IEEE LCCS_subsystem_integrated_CM_single 0 0 -3.4E+38 3.4E+38 ARRAY_SIZE 4 ECU_ADDRESS 0xb0004d7c /* @ECU_Address@VaLCCS_final_right_lanemark@ */ /end MEASUREMENT
/begin MEASUREMENT VaLCCS_raw_lane_center_line "Raw lane center line." FLOAT32_IEEE LCCS_subsystem_integrated_CM_single 0 0 -3.4E+38 3.4E+38 ARRAY_SIZE 4 ECU_ADDRESS 0xb0004d6c /* @ECU_Address@VaLCCS_raw_lane_center_line@ */ /end MEASUREMENT
/begin MEASUREMENT VaLCCS_com_point "Center of mass position." FLOAT32_IEEE LCCS_subsystem_integrated_CM_single 0 0 -3.4E+38 3.4E+38 ARRAY_SIZE 3 ECU_ADDRESS 0xb0004d60 /* @ECU_Address@VaLCCS_com_point@ */ /end MEASUREMENT
/begin MEASUREMENT VaLCCS_preview_proj_point "Lookahead point projection position." FLOAT32_IEEE LCCS_subsystem_integrated_CM_single 0 0 -3.4E+38 3.4E+38 ARRAY_SIZE 3 ECU_ADDRESS 0xb0004d54 /* @ECU_Address@VaLCCS_preview_proj_point@ */ /end MEASUREMENT
/begin MEASUREMENT VfLCCS_lookahead_angle "Lookahead angle." FLOAT32_IEEE LCCS_subsystem_integrated_CM_single 0 0 -3.4E+38 3.4E+38 ECU_ADDRESS 0xb0004d50 /* @ECU_Address@VfLCCS_lookahead_angle@ */ /end MEASUREMENT
/begin MEASUREMENT VaLCCS_com_proj_point "Center of mass projection point position." FLOAT32_IEEE LCCS_subsystem_integrated_CM_single 0 0 -3.4E+38 3.4E+38 ARRAY_SIZE 3 ECU_ADDRESS 0xb0004d44 /* @ECU_Address@VaLCCS_com_proj_point@ */ /end MEASUREMENT
/begin MEASUREMENT VfLCCS_lateral_error "Lateral error." FLOAT32_IEEE LCCS_subsystem_integrated_CM_single 0 0 -3.4E+38 3.4E+38 ECU_ADDRESS 0xb0004d40 /* @ECU_Address@VfLCCS_lateral_error@ */ /end MEASUREMENT
/begin MEASUREMENT VfLCCS_lateral_error_rate "Lateral error rate." FLOAT32_IEEE LCCS_subsystem_integrated_CM_single 0 0 -3.4E+38 3.4E+38 ECU_ADDRESS 0xb0004d3c /* @ECU_Address@VfLCCS_lateral_error_rate@ */ /end MEASUREMENT
/begin MEASUREMENT VfLCCS_heading_error_rate "Heading error rate." FLOAT32_IEEE LCCS_subsystem_integrated_CM_single 0 0 -3.4E+38 3.4E+38 ECU_ADDRESS 0xb0004d38 /* @ECU_Address@VfLCCS_heading_error_rate@ */ /end MEASUREMENT
/begin MEASUREMENT VfLCCS_heading_error "Heading error." FLOAT32_IEEE LCCS_subsystem_integrated_CM_single 0 0 -3.4E+38 3.4E+38 ECU_ADDRESS 0xb0004d34 /* @ECU_Address@VfLCCS_heading_error@ */ /end MEASUREMENT
/begin MEASUREMENT VfLCCS_preview_curvature "The lane center curvature of preview projection point." FLOAT32_IEEE LCCS_subsystem_integrated_CM_single 0 0 -3.4E+38 3.4E+38 ECU_ADDRESS 0xb0004d30 /* @ECU_Address@VfLCCS_preview_curvature@ */ /end MEASUREMENT
/begin MEASUREMENT VcLCCS_shifting_direction_raw "Inlane nudge or lane change shifting_direction. 1 = left. 2 = right." UBYTE LCCS_subsystem_integrated_CM_uint8 0 0 0 255 ECU_ADDRESS 0xb0004d2f /* @ECU_Address@VcLCCS_shifting_direction_raw@ */ /end MEASUREMENT
/begin MEASUREMENT VcLCCS_VCU1_ICPV_EPSMODE "EPS control mode feedback." UBYTE LCCS_subsystem_integrated_CM_uint8 0 0 0 255 ECU_ADDRESS 0xb0004d2e /* @ECU_Address@VcLCCS_VCU1_ICPV_EPSMODE@ */ /end MEASUREMENT
/begin MEASUREMENT VfLCCS_num_lane_markers "" UBYTE LCCS_subsystem_integrated_CM_uint8 0 0 0 255 ECU_ADDRESS 0xb0004d2d /* @ECU_Address@VfLCCS_num_lane_markers@ */ /end MEASUREMENT
/begin MEASUREMENT VcLCCS_shifting_direction_final "Inlane nudge or lane change shifting_direction." UBYTE LCCS_subsystem_integrated_CM_uint8 0 0 0 255 ECU_ADDRESS 0xb0004d2c /* @ECU_Address@VcLCCS_shifting_direction_final@ */ /end MEASUREMENT
/begin MEASUREMENT VcLCCS_num_iteration "" UBYTE LCCS_subsystem_integrated_CM_uint8 0 0 0 255 ECU_ADDRESS 0xb0004d2b /* @ECU_Address@VcLCCS_num_iteration@ */ /end MEASUREMENT
/begin MEASUREMENT VbLCCS_steering_control_active "Steering control active." UBYTE LCCS_subsystem_integrated_CM_boolean 0 0 0 1 ECU_ADDRESS 0xb0004d2a /* @ECU_Address@VbLCCS_steering_control_active@ */ /end MEASUREMENT
/begin MEASUREMENT VbLCCS_LCC_ReadyToEngage "LCC ReadyToEngage." UBYTE LCCS_subsystem_integrated_CM_boolean 0 0 0 1 ECU_ADDRESS 0xb0004d29 /* @ECU_Address@VbLCCS_LCC_ReadyToEngage@ */ /end MEASUREMENT
/begin MEASUREMENT VbLCCS_steering_control_stable "Steering control stable." UBYTE LCCS_subsystem_integrated_CM_boolean 0 0 0 1 ECU_ADDRESS 0xb0004d28 /* @ECU_Address@VbLCCS_steering_control_stable@ */ /end MEASUREMENT
/begin MEASUREMENT VbLCCS_steering_control_engaged "Steering control engaged." UBYTE LCCS_subsystem_integrated_CM_boolean 0 0 0 1 ECU_ADDRESS 0xb0004d27 /* @ECU_Address@VbLCCS_steering_control_engaged@ */ /end MEASUREMENT
/begin MEASUREMENT VbLCCS_lateral_movement_enabled "Flag to indicate lateral movement is allowed." UBYTE LCCS_subsystem_integrated_CM_boolean 0 0 0 1 ECU_ADDRESS 0xb0004d26 /* @ECU_Address@VbLCCS_lateral_movement_enabled@ */ /end MEASUREMENT
/begin MEASUREMENT VbLCCS_lane_change_request "" UBYTE LCCS_subsystem_integrated_CM_boolean 0 0 0 1 ECU_ADDRESS 0xb0004d25 /* @ECU_Address@VbLCCS_lane_change_request@ */ /end MEASUREMENT
/begin MEASUREMENT VbLCCS_inlane_nudge_request "Inlane nudge request." UBYTE LCCS_subsystem_integrated_CM_boolean 0 0 0 1 ECU_ADDRESS 0xb0004d24 /* @ECU_Address@VbLCCS_inlane_nudge_request@ */ /end MEASUREMENT
/begin MEASUREMENT VbLCCS_input_isNaN_DCSN "" UBYTE LCCS_subsystem_integrated_CM_boolean 0 0 0 1 ECU_ADDRESS 0xb0004d23 /* @ECU_Address@VbLCCS_input_isNaN_DCSN@ */ /end MEASUREMENT
/begin MEASUREMENT VbLCCS_lcc_feature_enable "" UBYTE LCCS_subsystem_integrated_CM_boolean 0 0 0 1 ECU_ADDRESS 0xb0004d22 /* @ECU_Address@VbLCCS_lcc_feature_enable@ */ /end MEASUREMENT
/begin MEASUREMENT VbLCCS_steer_control_enable "LCC is allowed by decision module." UBYTE LCCS_subsystem_integrated_CM_boolean 0 0 0 1 ECU_ADDRESS 0xb0004d21 /* @ECU_Address@VbLCCS_steer_control_enable@ */ /end MEASUREMENT
/begin MEASUREMENT VbLCCS_input_isNaN_EGMO "" UBYTE LCCS_subsystem_integrated_CM_boolean 0 0 0 1 ECU_ADDRESS 0xb0004d20 /* @ECU_Address@VbLCCS_input_isNaN_EGMO@ */ /end MEASUREMENT
/begin MEASUREMENT VbLCCS_input_isNaN_COMM "" UBYTE LCCS_subsystem_integrated_CM_boolean 0 0 0 1 ECU_ADDRESS 0xb0004d1f /* @ECU_Address@VbLCCS_input_isNaN_COMM@ */ /end MEASUREMENT
/begin MEASUREMENT VbLCCS_input_isNaN_MPFU "" UBYTE LCCS_subsystem_integrated_CM_boolean 0 0 0 1 ECU_ADDRESS 0xb0004d1e /* @ECU_Address@VbLCCS_input_isNaN_MPFU@ */ /end MEASUREMENT
/begin MEASUREMENT VbLCCS_left_lanemark_valid "Left lanemark valid." UBYTE LCCS_subsystem_integrated_CM_boolean 0 0 0 1 ECU_ADDRESS 0xb0004d1d /* @ECU_Address@VbLCCS_left_lanemark_valid@ */ /end MEASUREMENT
/begin MEASUREMENT VbLCCS_right_lanemark_valid "Right lanemark valid." UBYTE LCCS_subsystem_integrated_CM_boolean 0 0 0 1 ECU_ADDRESS 0xb0004d1c /* @ECU_Address@VbLCCS_right_lanemark_valid@ */ /end MEASUREMENT
/begin MEASUREMENT VbLCCS_both_lanemark_available "" UBYTE LCCS_subsystem_integrated_CM_boolean 0 0 0 1 ECU_ADDRESS 0xb0004d1b /* @ECU_Address@VbLCCS_both_lanemark_available@ */ /end MEASUREMENT
/begin MEASUREMENT VbLCCS_shifting_in_progress "Flag to indicate lateral shifting is in progress." UBYTE LCCS_subsystem_integrated_CM_boolean 0 0 0 1 ECU_ADDRESS 0xb0004d1a /* @ECU_Address@VbLCCS_shifting_in_progress@ */ /end MEASUREMENT
/begin MEASUREMENT VbLCCS_touched_new_lane "Flag to to indicate that ego car has crossed lane marker." UBYTE LCCS_subsystem_integrated_CM_boolean 0 0 0 1 ECU_ADDRESS 0xb0004d19 /* @ECU_Address@VbLCCS_touched_new_lane@ */ /end MEASUREMENT
/begin MEASUREMENT VeLCCS_valid_lane_marker "Valid lane marker. 0 = LCCS_NoLane; 1 = LCCS_LeftLane; 2 = LCCS_RightLane; 3 = BothLane." UBYTE LCCS_subsystem_integrated_CM_EnumLCCS_ValidLane 0 0 0 3 ECU_ADDRESS 0xb0004d18 /* @ECU_Address@VeLCCS_valid_lane_marker@ */ /end MEASUREMENT
/begin MEASUREMENT VfLCWS_speed_in "" FLOAT32_IEEE LCWS_subsystem_integrated_CM_single 0 0 -3.4E+38 3.4E+38 ECU_ADDRESS 0xb0005a30 /* @ECU_Address@VfLCWS_speed_in@ */ /end MEASUREMENT
/begin MEASUREMENT VfLCWS_curvature "" FLOAT32_IEEE LCWS_subsystem_integrated_CM_single 0 0 -3.4E+38 3.4E+38 ECU_ADDRESS 0xb0005a2c /* @ECU_Address@VfLCWS_curvature@ */ /end MEASUREMENT
/begin MEASUREMENT VaLCWS_ObtR "" FLOAT32_IEEE LCWS_subsystem_integrated_CM_single 0 0 -3.4E+38 3.4E+38 ARRAY_SIZE 55 ECU_ADDRESS 0xb0005950 /* @ECU_Address@VaLCWS_ObtR@ */ /end MEASUREMENT
/begin MEASUREMENT VaLCWS_x_in "" FLOAT32_IEEE LCWS_subsystem_integrated_CM_single 0 0 -3.4E+38 3.4E+38 ARRAY_SIZE 20 ECU_ADDRESS 0xb0005900 /* @ECU_Address@VaLCWS_x_in@ */ /end MEASUREMENT
/begin MEASUREMENT VaLCWS_y_in "" FLOAT32_IEEE LCWS_subsystem_integrated_CM_single 0 0 -3.4E+38 3.4E+38 ARRAY_SIZE 20 ECU_ADDRESS 0xb00058b0 /* @ECU_Address@VaLCWS_y_in@ */ /end MEASUREMENT
/begin MEASUREMENT VaLCWS_heading_in "" FLOAT32_IEEE LCWS_subsystem_integrated_CM_single 0 0 -3.4E+38 3.4E+38 ARRAY_SIZE 20 ECU_ADDRESS 0xb0005860 /* @ECU_Address@VaLCWS_heading_in@ */ /end MEASUREMENT
/begin MEASUREMENT VaLCWS_Vx_in "" FLOAT32_IEEE LCWS_subsystem_integrated_CM_single 0 0 -3.4E+38 3.4E+38 ARRAY_SIZE 20 ECU_ADDRESS 0xb0005810 /* @ECU_Address@VaLCWS_Vx_in@ */ /end MEASUREMENT
/begin MEASUREMENT VaLCWS_Vy_in "" FLOAT32_IEEE LCWS_subsystem_integrated_CM_single 0 0 -3.4E+38 3.4E+38 ARRAY_SIZE 20 ECU_ADDRESS 0xb00057c0 /* @ECU_Address@VaLCWS_Vy_in@ */ /end MEASUREMENT
/begin MEASUREMENT VaLCWS_obt_lenth_in "" FLOAT32_IEEE LCWS_subsystem_integrated_CM_single 0 0 -3.4E+38 3.4E+38 ARRAY_SIZE 20 ECU_ADDRESS 0xb0005770 /* @ECU_Address@VaLCWS_obt_lenth_in@ */ /end MEASUREMENT
/begin MEASUREMENT VaLCWS_obt_width_in "" FLOAT32_IEEE LCWS_subsystem_integrated_CM_single 0 0 -3.4E+38 3.4E+38 ARRAY_SIZE 20 ECU_ADDRESS 0xb0005720 /* @ECU_Address@VaLCWS_obt_width_in@ */ /end MEASUREMENT
/begin MEASUREMENT VaLCWS_nearest_point_rel_x_in "" FLOAT32_IEEE LCWS_subsystem_integrated_CM_single 0 0 -3.4E+38 3.4E+38 ARRAY_SIZE 20 ECU_ADDRESS 0xb00056d0 /* @ECU_Address@VaLCWS_nearest_point_rel_x_in@ */ /end MEASUREMENT
/begin MEASUREMENT VaLCWS_nearest_point_rel_y_in "" FLOAT32_IEEE LCWS_subsystem_integrated_CM_single 0 0 -3.4E+38 3.4E+38 ARRAY_SIZE 20 ECU_ADDRESS 0xb0005680 /* @ECU_Address@VaLCWS_nearest_point_rel_y_in@ */ /end MEASUREMENT
/begin MEASUREMENT VaLCWS_id_in "" SLONG LCWS_subsystem_integrated_CM_int32 0 0 -2147483648 2147483647 ARRAY_SIZE 20 ECU_ADDRESS 0xb0005630 /* @ECU_Address@VaLCWS_id_in@ */ /end MEASUREMENT
/begin MEASUREMENT ViLCWS_bswR_ID "" SLONG LCWS_subsystem_integrated_CM_int32 0 0 -2147483648 2147483647 ECU_ADDRESS 0xb000562c /* @ECU_Address@ViLCWS_bswR_ID@ */ /end MEASUREMENT
/begin MEASUREMENT ViLCWS_cvwR_ID "" SLONG LCWS_subsystem_integrated_CM_int32 0 0 -2147483648 2147483647 ECU_ADDRESS 0xb0005628 /* @ECU_Address@ViLCWS_cvwR_ID@ */ /end MEASUREMENT
/begin MEASUREMENT ViLCWS_bswL_ID "" SLONG LCWS_subsystem_integrated_CM_int32 0 0 -2147483648 2147483647 ECU_ADDRESS 0xb0005624 /* @ECU_Address@ViLCWS_bswL_ID@ */ /end MEASUREMENT
/begin MEASUREMENT ViLCWS_cvwL_ID "" SLONG LCWS_subsystem_integrated_CM_int32 0 0 -2147483648 2147483647 ECU_ADDRESS 0xb0005620 /* @ECU_Address@ViLCWS_cvwL_ID@ */ /end MEASUREMENT
/begin MEASUREMENT VnLCWS_num_R "" UWORD LCWS_subsystem_integrated_CM_uint16 0 0 0 65535 ECU_ADDRESS 0xb000561c /* @ECU_Address@VnLCWS_num_R@ */ /end MEASUREMENT
/begin MEASUREMENT VnLCWS_num_L "" UWORD LCWS_subsystem_integrated_CM_uint16 0 0 0 65535 ECU_ADDRESS 0xb000561a /* @ECU_Address@VnLCWS_num_L@ */ /end MEASUREMENT
/begin MEASUREMENT VnLCWS_num_in "" UWORD LCWS_subsystem_integrated_CM_uint16 0 0 0 65535 ECU_ADDRESS 0xb0005618 /* @ECU_Address@VnLCWS_num_in@ */ /end MEASUREMENT
/begin MEASUREMENT VeLCWS_active_status "" SWORD LCWS_subsystem_integrated_CM_EnumLCWS_Active_Status 0 0 0 3 ECU_ADDRESS 0xb0005616 /* @ECU_Address@VeLCWS_active_status@ */ /end MEASUREMENT
/begin MEASUREMENT VeLCWS_right_warning_status "" SWORD LCWS_subsystem_integrated_CM_EnumLCWS_Warning_Status 0 0 0 2 ECU_ADDRESS 0xb0005614 /* @ECU_Address@VeLCWS_right_warning_status@ */ /end MEASUREMENT
/begin MEASUREMENT VeLCWS_left_warning_status "" SWORD LCWS_subsystem_integrated_CM_EnumLCWS_Warning_Status 0 0 0 2 ECU_ADDRESS 0xb0005612 /* @ECU_Address@VeLCWS_left_warning_status@ */ /end MEASUREMENT
/begin MEASUREMENT VaLCWS_position_zone_in "" SBYTE LCWS_subsystem_integrated_CM_int8 0 0 -128 127 ARRAY_SIZE 20 ECU_ADDRESS 0xb00055fd /* @ECU_Address@VaLCWS_position_zone_in@ */ /end MEASUREMENT
/begin MEASUREMENT VaLCWS_orientation_in "" SBYTE LCWS_subsystem_integrated_CM_int8 0 0 -128 127 ARRAY_SIZE 20 ECU_ADDRESS 0xb00055e9 /* @ECU_Address@VaLCWS_orientation_in@ */ /end MEASUREMENT
/begin MEASUREMENT VaLCWS_motion_status_in "" SBYTE LCWS_subsystem_integrated_CM_int8 0 0 -128 127 ARRAY_SIZE 20 ECU_ADDRESS 0xb00055d5 /* @ECU_Address@VaLCWS_motion_status_in@ */ /end MEASUREMENT
/begin MEASUREMENT VfLCWS_gear_in "" UBYTE LCWS_subsystem_integrated_CM_uint8 0 0 0 255 ECU_ADDRESS 0xb00055d4 /* @ECU_Address@VfLCWS_gear_in@ */ /end MEASUREMENT
/begin MEASUREMENT VaLCWS_type "" UBYTE LCWS_subsystem_integrated_CM_uint8 0 0 0 255 ARRAY_SIZE 20 ECU_ADDRESS 0xb00055c0 /* @ECU_Address@VaLCWS_type@ */ /end MEASUREMENT
/begin MEASUREMENT ViLCWS_bswR "" UBYTE LCWS_subsystem_integrated_CM_uint8 0 0 0 255 ECU_ADDRESS 0xb00055bf /* @ECU_Address@ViLCWS_bswR@ */ /end MEASUREMENT
/begin MEASUREMENT ViLCWS_cvwR "" UBYTE LCWS_subsystem_integrated_CM_uint8 0 0 0 255 ECU_ADDRESS 0xb00055be /* @ECU_Address@ViLCWS_cvwR@ */ /end MEASUREMENT
/begin MEASUREMENT ViLCWS_bswL "" UBYTE LCWS_subsystem_integrated_CM_uint8 0 0 0 255 ECU_ADDRESS 0xb00055bd /* @ECU_Address@ViLCWS_bswL@ */ /end MEASUREMENT
/begin MEASUREMENT ViLCWS_cvwL "" UBYTE LCWS_subsystem_integrated_CM_uint8 0 0 0 255 ECU_ADDRESS 0xb00055bc /* @ECU_Address@ViLCWS_cvwL@ */ /end MEASUREMENT
/begin MEASUREMENT VfLDWS_SteerAngleRate "" FLOAT32_IEEE LDWS_subsystem_integrated_CM_single 0 0 -3.4E+38 3.4E+38 ECU_ADDRESS 0xb0005b44 /* @ECU_Address@VfLDWS_SteerAngleRate@ */ /end MEASUREMENT
/begin MEASUREMENT VfLDWS_BackToRiDist "The distacne bewteen center of rear axle and right lane marker" FLOAT32_IEEE LDWS_subsystem_integrated_CM_single 0 0 -3.4E+38 3.4E+38 ECU_ADDRESS 0xb0005b40 /* @ECU_Address@VfLDWS_BackToRiDist@ */ /end MEASUREMENT
/begin MEASUREMENT VfLDWS_Theta "The angle between linear velocity and heading" FLOAT32_IEEE LDWS_subsystem_integrated_CM_single 0 0 -3.4E+38 3.4E+38 ECU_ADDRESS 0xb0005b3c /* @ECU_Address@VfLDWS_Theta@ */ /end MEASUREMENT
/begin MEASUREMENT VfLDWS_Vx "The value of Vx" FLOAT32_IEEE LDWS_subsystem_integrated_CM_single 0 0 -3.4E+38 3.4E+38 ECU_ADDRESS 0xb0005b38 /* @ECU_Address@VfLDWS_Vx@ */ /end MEASUREMENT
/begin MEASUREMENT VfLDWS_Vy "The value of Vy" FLOAT32_IEEE LDWS_subsystem_integrated_CM_single 0 0 -3.4E+38 3.4E+38 ECU_ADDRESS 0xb0005b34 /* @ECU_Address@VfLDWS_Vy@ */ /end MEASUREMENT
/begin MEASUREMENT VfLDWS_VLatLe "" FLOAT32_IEEE LDWS_subsystem_integrated_CM_single 0 0 -3.4E+38 3.4E+38 ECU_ADDRESS 0xb0005b30 /* @ECU_Address@VfLDWS_VLatLe@ */ /end MEASUREMENT
/begin MEASUREMENT VfLDWS_EdgeLaneLe "The vertical distacne between left front wheel and left lane marker" FLOAT32_IEEE LDWS_subsystem_integrated_CM_single 0 0 -3.4E+38 3.4E+38 ECU_ADDRESS 0xb0005b2c /* @ECU_Address@VfLDWS_EdgeLaneLe@ */ /end MEASUREMENT
/begin MEASUREMENT VfLDWS_TLCLe "The time to collision of left side" FLOAT32_IEEE LDWS_subsystem_integrated_CM_single 0 0 -3.4E+38 3.4E+38 ECU_ADDRESS 0xb0005b28 /* @ECU_Address@VfLDWS_TLCLe@ */ /end MEASUREMENT
/begin MEASUREMENT VfLDWS_EdgeLaneRi "The vertical distacne between right front wheel and right lane marker" FLOAT32_IEEE LDWS_subsystem_integrated_CM_single 0 0 -3.4E+38 3.4E+38 ECU_ADDRESS 0xb0005b24 /* @ECU_Address@VfLDWS_EdgeLaneRi@ */ /end MEASUREMENT
/begin MEASUREMENT VfLDWS_VLatRi "" FLOAT32_IEEE LDWS_subsystem_integrated_CM_single 0 0 -3.4E+38 3.4E+38 ECU_ADDRESS 0xb0005b20 /* @ECU_Address@VfLDWS_VLatRi@ */ /end MEASUREMENT
/begin MEASUREMENT VfLDWS_TLCRi "The time to collision of right side" FLOAT32_IEEE LDWS_subsystem_integrated_CM_single 0 0 -3.4E+38 3.4E+38 ECU_ADDRESS 0xb0005b1c /* @ECU_Address@VfLDWS_TLCRi@ */ /end MEASUREMENT
/begin MEASUREMENT VfLDWS_SteerAngle "The vehicle's steering angle" FLOAT32_IEEE LDWS_subsystem_integrated_CM_single 0 0 -3.4E+38 3.4E+38 ECU_ADDRESS 0xb0005b18 /* @ECU_Address@VfLDWS_SteerAngle@ */ /end MEASUREMENT
/begin MEASUREMENT VfLDWS_SteerTorque "" FLOAT32_IEEE LDWS_subsystem_integrated_CM_single 0 0 -3.4E+38 3.4E+38 ECU_ADDRESS 0xb0005b14 /* @ECU_Address@VfLDWS_SteerTorque@ */ /end MEASUREMENT
/begin MEASUREMENT VfLDWS_Curvature "" FLOAT32_IEEE LDWS_subsystem_integrated_CM_single 0 0 -3.4E+38 3.4E+38 ECU_ADDRESS 0xb0005b10 /* @ECU_Address@VfLDWS_Curvature@ */ /end MEASUREMENT
/begin MEASUREMENT VfLDWS_LeC0Filtd "The C0 coefficient of left lane marker after filtering" FLOAT32_IEEE LDWS_subsystem_integrated_CM_single 0 0 -3.4E+38 3.4E+38 ECU_ADDRESS 0xb0005b0c /* @ECU_Address@VfLDWS_LeC0Filtd@ */ /end MEASUREMENT
/begin MEASUREMENT VfLDWS_RiC0Filtd "The C0 coefficient of right lane marker after filtering" FLOAT32_IEEE LDWS_subsystem_integrated_CM_single 0 0 -3.4E+38 3.4E+38 ECU_ADDRESS 0xb0005b08 /* @ECU_Address@VfLDWS_RiC0Filtd@ */ /end MEASUREMENT
/begin MEASUREMENT VfLDWS_LeC1Filtd "The C1 coefficient of left lane marker after filtering" FLOAT32_IEEE LDWS_subsystem_integrated_CM_single 0 0 -3.4E+38 3.4E+38 ECU_ADDRESS 0xb0005b04 /* @ECU_Address@VfLDWS_LeC1Filtd@ */ /end MEASUREMENT
/begin MEASUREMENT VfLDWS_RiC1Filtd "The C1 coefficient of right lane marker after filtering" FLOAT32_IEEE LDWS_subsystem_integrated_CM_single 0 0 -3.4E+38 3.4E+38 ECU_ADDRESS 0xb0005b00 /* @ECU_Address@VfLDWS_RiC1Filtd@ */ /end MEASUREMENT
/begin MEASUREMENT VfLDWS_BackToLeDist "The distacne bewteen center of rear axle and left lane marker" FLOAT32_IEEE LDWS_subsystem_integrated_CM_single 0 0 -3.4E+38 3.4E+38 ECU_ADDRESS 0xb0005afc /* @ECU_Address@VfLDWS_BackToLeDist@ */ /end MEASUREMENT
/begin MEASUREMENT VfLDWS_LeIndicatorSt "The status of right indicator" UBYTE LDWS_subsystem_integrated_CM_uint8 0 0 0 255 ECU_ADDRESS 0xb0005af8 /* @ECU_Address@VfLDWS_LeIndicatorSt@ */ /end MEASUREMENT
/begin MEASUREMENT VfLDWS_RiIndicatorSt "The status of right indicator" UBYTE LDWS_subsystem_integrated_CM_uint8 0 0 0 255 ECU_ADDRESS 0xb0005af7 /* @ECU_Address@VfLDWS_RiIndicatorSt@ */ /end MEASUREMENT
/begin MEASUREMENT VbLDWS_IsOnLeLine "The vehicle is on left lane marker or not" UBYTE LDWS_subsystem_integrated_CM_boolean 0 0 0 1 ECU_ADDRESS 0xb0005af6 /* @ECU_Address@VbLDWS_IsOnLeLine@ */ /end MEASUREMENT
/begin MEASUREMENT VbLDWS_LeadDrctn "The heading of vehicle is left or right. True is on left, fale is on right." UBYTE LDWS_subsystem_integrated_CM_boolean 0 0 0 1 ECU_ADDRESS 0xb0005af5 /* @ECU_Address@VbLDWS_LeadDrctn@ */ /end MEASUREMENT
/begin MEASUREMENT VbLDWS_ActLeLDW "The left LDW is whether trggered or not" UBYTE LDWS_subsystem_integrated_CM_boolean 0 0 0 1 ECU_ADDRESS 0xb0005af4 /* @ECU_Address@VbLDWS_ActLeLDW@ */ /end MEASUREMENT
/begin MEASUREMENT VbLDWS_IsOnRiLine "The vehicle is on right lane marker or not" UBYTE LDWS_subsystem_integrated_CM_boolean 0 0 0 1 ECU_ADDRESS 0xb0005af3 /* @ECU_Address@VbLDWS_IsOnRiLine@ */ /end MEASUREMENT
/begin MEASUREMENT VbLDWS_ActRiLDW "The right LDW is whether triggered or not" UBYTE LDWS_subsystem_integrated_CM_boolean 0 0 0 1 ECU_ADDRESS 0xb0005af2 /* @ECU_Address@VbLDWS_ActRiLDW@ */ /end MEASUREMENT
/begin MEASUREMENT VbLDWS_SuppLe "The left LDW is whether suppressed or not" UBYTE LDWS_subsystem_integrated_CM_boolean 0 0 0 1 ECU_ADDRESS 0xb0005af1 /* @ECU_Address@VbLDWS_SuppLe@ */ /end MEASUREMENT
/begin MEASUREMENT VbLDWS_SuppRi "The right LDW is whether suppressed or not" UBYTE LDWS_subsystem_integrated_CM_boolean 0 0 0 1 ECU_ADDRESS 0xb0005af0 /* @ECU_Address@VbLDWS_SuppRi@ */ /end MEASUREMENT
/begin MEASUREMENT VbLDWS_RdEnblLe "The left Lane Marker is whether enabled or not" UBYTE LDWS_subsystem_integrated_CM_boolean 0 0 0 1 ECU_ADDRESS 0xb0005aef /* @ECU_Address@VbLDWS_RdEnblLe@ */ /end MEASUREMENT
/begin MEASUREMENT VbLDWS_RdEnblRi "The right Lane Marker is whether enabled or not" UBYTE LDWS_subsystem_integrated_CM_boolean 0 0 0 1 ECU_ADDRESS 0xb0005aee /* @ECU_Address@VbLDWS_RdEnblRi@ */ /end MEASUREMENT
/begin MEASUREMENT VbLDWS_WrnSt "The warning is whether issued or not" UBYTE LDWS_subsystem_integrated_CM_boolean 0 0 0 1 ECU_ADDRESS 0xb0005aed /* @ECU_Address@VbLDWS_WrnSt@ */ /end MEASUREMENT
/begin MEASUREMENT VbLDWS_EnabledLDW "The system is whether enabled or not" UBYTE LDWS_subsystem_integrated_CM_boolean 0 0 0 1 ECU_ADDRESS 0xb0005aec /* @ECU_Address@VbLDWS_EnabledLDW@ */ /end MEASUREMENT
/begin MEASUREMENT VbLDWS_SpdRngValid "The ODD of speed range is whether fullfiled" UBYTE LDWS_subsystem_integrated_CM_boolean 0 0 0 1 ECU_ADDRESS 0xb0005aeb /* @ECU_Address@VbLDWS_SpdRngValid@ */ /end MEASUREMENT
/begin MEASUREMENT VbLDWS_CurvValid "The ODD of lane curvature is whether fullfiled" UBYTE LDWS_subsystem_integrated_CM_boolean 0 0 0 1 ECU_ADDRESS 0xb0005aea /* @ECU_Address@VbLDWS_CurvValid@ */ /end MEASUREMENT
/begin MEASUREMENT VbLDWS_WidthValid "The ODD of lane width is whether fullfiled" UBYTE LDWS_subsystem_integrated_CM_boolean 0 0 0 1 ECU_ADDRESS 0xb0005ae9 /* @ECU_Address@VbLDWS_WidthValid@ */ /end MEASUREMENT
/begin MEASUREMENT VbLDWS_LnMkrValid "The ODD of lane marker is whether fullfiled" UBYTE LDWS_subsystem_integrated_CM_boolean 0 0 0 1 ECU_ADDRESS 0xb0005ae8 /* @ECU_Address@VbLDWS_LnMkrValid@ */ /end MEASUREMENT
/begin MEASUREMENT VeLDWS_LaDetecSt "" UBYTE LDWS_subsystem_integrated_CM_EnumLDWS_la_detec_st 0 0 0 3 ECU_ADDRESS 0xb0005ae7 /* @ECU_Address@VeLDWS_LaDetecSt@ */ /end MEASUREMENT
/begin MEASUREMENT VeLDWS_WrnSd "" UBYTE LDWS_subsystem_integrated_CM_EnumLDWS_warn_side 0 0 0 2 ECU_ADDRESS 0xb0005ae6 /* @ECU_Address@VeLDWS_WrnSd@ */ /end MEASUREMENT
/begin MEASUREMENT VeLDWS_SysSt "" UBYTE LDWS_subsystem_integrated_CM_EnumLDWS_system_st 0 0 0 2 ECU_ADDRESS 0xb0005ae5 /* @ECU_Address@VeLDWS_SysSt@ */ /end MEASUREMENT
/begin MEASUREMENT VeLDWS_OnStateSt "" UBYTE LDWS_subsystem_integrated_CM_EnumLDWS_on_state_st 0 0 0 3 ECU_ADDRESS 0xb0005ae4 /* @ECU_Address@VeLDWS_OnStateSt@ */ /end MEASUREMENT
/begin MEASUREMENT ADCtrl_Thruput_MS "" FLOAT32_IEEE ad_ctrl_thruput_measurement_CM_ms 0 0 -3.4E+38 3.4E+38 ECU_ADDRESS 0xb0005bf4 /* @ECU_Address@ADCtrl_Thruput_MS@ */ /end MEASUREMENT
/begin MEASUREMENT COMM_Subsystem_Intergreted_Receive_Period "" ULONG ad_ctrl_subfunction_measurement_CM_us 0 0 0 4E+9 ECU_ADDRESS 0xb0005b70 /* @ECU_Address@COMM_Subsystem_Intergreted_Receive_Period@ */ /end MEASUREMENT
/begin MEASUREMENT DCSN_Subsystem_Integrated_Period "" ULONG ad_ctrl_subfunction_measurement_CM_us 0 0 0 4E+9 ECU_ADDRESS 0xb0005b6c /* @ECU_Address@DCSN_Subsystem_Integrated_Period@ */ /end MEASUREMENT
/begin MEASUREMENT AEBS_Subsystem_Integrated_Period "" ULONG ad_ctrl_subfunction_measurement_CM_us 0 0 0 4E+9 ECU_ADDRESS 0xb0005b68 /* @ECU_Address@AEBS_Subsystem_Integrated_Period@ */ /end MEASUREMENT
/begin MEASUREMENT ACCS_Subsystem_Integrated_Period "" ULONG ad_ctrl_subfunction_measurement_CM_us 0 0 0 4E+9 ECU_ADDRESS 0xb0005b64 /* @ECU_Address@ACCS_Subsystem_Integrated_Period@ */ /end MEASUREMENT
/begin MEASUREMENT LCCS_Subsystem_Integrated_Period "" ULONG ad_ctrl_subfunction_measurement_CM_us 0 0 0 4E+9 ECU_ADDRESS 0xb0005b60 /* @ECU_Address@LCCS_Subsystem_Integrated_Period@ */ /end MEASUREMENT
/begin MEASUREMENT LCWS_Subsystem_Integrated_Period "" ULONG ad_ctrl_subfunction_measurement_CM_us 0 0 0 4E+9 ECU_ADDRESS 0xb0005b5c /* @ECU_Address@LCWS_Subsystem_Integrated_Period@ */ /end MEASUREMENT
/begin MEASUREMENT LDWS_Subsystem_Integrated_Period "" ULONG ad_ctrl_subfunction_measurement_CM_us 0 0 0 4E+9 ECU_ADDRESS 0xb0005b58 /* @ECU_Address@LDWS_Subsystem_Integrated_Period@ */ /end MEASUREMENT
/begin MEASUREMENT arbt_Subsystem_Integrated_Period "" ULONG ad_ctrl_subfunction_measurement_CM_us 0 0 0 4E+9 ECU_ADDRESS 0xb0005b54 /* @ECU_Address@arbt_Subsystem_Integrated_Period@ */ /end MEASUREMENT
/begin MEASUREMENT COMM_Subsystem_Integrated_Transmit_Period "" ULONG ad_ctrl_subfunction_measurement_CM_us 0 0 0 4E+9 ECU_ADDRESS 0xb0005b50 /* @ECU_Address@COMM_Subsystem_Integrated_Transmit_Period@ */ /end MEASUREMENT
/begin MEASUREMENT os_core0_tick_cnt "" ULONG ad_ctrl_thruput_measurement_CM_ms 0 0 0 3.4E+38 ECU_ADDRESS 0x70017a60 /* @ECU_Address@os_core0_tick_cnt@ */ /end MEASUREMENT
/begin MEASUREMENT Entry_ADCtrl_STM_Cnt "ADCtrl entry STM_0_3 counter. 1us = Entry_ADCtrl_STM_Cnt*4096.0/100" ULONG ad_ctrl_thruput_measurement_CM_ms 0 0 0 3.4E+38 ECU_ADDRESS 0xb0005c00 /* @ECU_Address@Entry_ADCtrl_STM_Cnt@ */ /end MEASUREMENT
/begin COMPU_METHOD ACCS_subsystem_integrated_CM_single_s "Q = V" RAT_FUNC "%8.6" "s" COEFFS 0 1 0 0 0 1 /end COMPU_METHOD
/begin COMPU_METHOD ACCS_subsystem_integrated_CM_single_m "Q = V" RAT_FUNC "%8.6" "m" COEFFS 0 1 0 0 0 1 /end COMPU_METHOD
/begin COMPU_METHOD ACCS_subsystem_integrated_CM_single_m_s2 "Q = V" RAT_FUNC "%8.6" "m/s2" COEFFS 0 1 0 0 0 1 /end COMPU_METHOD
/begin COMPU_METHOD ACCS_subsystem_integrated_CM_single_m_s "Q = V" RAT_FUNC "%8.6" "m/s" COEFFS 0 1 0 0 0 1 /end COMPU_METHOD
/begin COMPU_METHOD ACCS_subsystem_integrated_CM_single_deg "Q = V" RAT_FUNC "%8.6" "deg" COEFFS 0 1 0 0 0 1 /end COMPU_METHOD
/begin COMPU_METHOD COMM_subsystem_integrated_CM_single "Q = V" RAT_FUNC "%8.6" "" COEFFS 0 1 0 0 0 1 /end COMPU_METHOD
/begin COMPU_METHOD COMM_subsystem_integrated_CM_uint8 "Q = V" RAT_FUNC "%3.0" "" COEFFS 0 1 0 0 0 1 /end COMPU_METHOD
/begin COMPU_METHOD COMM_subsystem_integrated_CM_boolean "Q = V" RAT_FUNC "%1.0" "" COEFFS 0 1 0 0 0 1 /end COMPU_METHOD
/begin COMPU_METHOD COMM_subsystem_integrated_CM_int16 "Q = V" RAT_FUNC "%5.0" "" COEFFS 0 1 0 0 0 1 /end COMPU_METHOD
/begin COMPU_METHOD COMM_subsystem_integrated_CM_uint16 "Q = V" RAT_FUNC "%5.0" "" COEFFS 0 1 0 0 0 1 /end COMPU_METHOD
/begin COMPU_METHOD DCSN_subsystem_integrated_CM_single_nm "Q = V" RAT_FUNC "%8.6" "nm" COEFFS 0 1 0 0 0 1 /end COMPU_METHOD
/begin COMPU_METHOD DCSN_subsystem_integrated_CM_single_m "Q = V" RAT_FUNC "%8.6" "m" COEFFS 0 1 0 0 0 1 /end COMPU_METHOD
/begin COMPU_METHOD DCSN_subsystem_integrated_CM_single_s "Q = V" RAT_FUNC "%8.6" "s" COEFFS 0 1 0 0 0 1 /end COMPU_METHOD
/begin COMPU_METHOD DCSN_subsystem_integrated_CM_single_m_s "Q = V" RAT_FUNC "%8.6" "m/s" COEFFS 0 1 0 0 0 1 /end COMPU_METHOD
/begin COMPU_METHOD DCSN_subsystem_integrated_CM_uint8 "Q = V" RAT_FUNC "%3.0" "" COEFFS 0 1 0 0 0 1 /end COMPU_METHOD
/begin COMPU_METHOD DCSN_subsystem_integrated_CM_uint8_s "Q = V" RAT_FUNC "%3.0" "s" COEFFS 0 1 0 0 0 1 /end COMPU_METHOD
/begin COMPU_METHOD DCSN_subsystem_integrated_CM_boolean "Q = V" RAT_FUNC "%1.0" "" COEFFS 0 1 0 0 0 1 /end COMPU_METHOD
/begin COMPU_METHOD DCSN_subsystem_integrated_CM_EnumDCSN_adm_main_mode "Enumerated data type: EnumDCSN_adm_main_mode" TAB_VERB "%0.6" "" COMPU_TAB_REF VTAB_FOR_DCSN_subsystem_integrated_CM_EnumDCSN_adm_main_mode /end COMPU_METHOD
/begin COMPU_METHOD DCSN_subsystem_integrated_CM_EnumDCSN_adm_hmi_msg_display "Enumerated data type: EnumDCSN_adm_hmi_msg_display" TAB_VERB "%0.6" "" COMPU_TAB_REF VTAB_FOR_DCSN_subsystem_integrated_CM_EnumDCSN_adm_hmi_msg_display /end COMPU_METHOD
/begin COMPU_METHOD DCSN_subsystem_integrated_CM_EnumDCSN_adm_hmi_icon_display "Enumerated data type: EnumDCSN_adm_hmi_icon_display" TAB_VERB "%0.6" "" COMPU_TAB_REF VTAB_FOR_DCSN_subsystem_integrated_CM_EnumDCSN_adm_hmi_icon_display /end COMPU_METHOD
/begin COMPU_METHOD DCSN_subsystem_integrated_CM_EnumDCSN_autodrive_control_mode "Enumerated data type: EnumDCSN_autodrive_control_mode" TAB_VERB "%0.6" "" COMPU_TAB_REF VTAB_FOR_DCSN_subsystem_integrated_CM_EnumDCSN_autodrive_control_mode /end COMPU_METHOD
/begin COMPU_METHOD DCSN_subsystem_integrated_CM_EnumDCSN_stop_reason "Enumerated data type: EnumDCSN_stop_reason" TAB_VERB "%0.6" "" COMPU_TAB_REF VTAB_FOR_DCSN_subsystem_integrated_CM_EnumDCSN_stop_reason /end COMPU_METHOD
/begin COMPU_METHOD DCSN_subsystem_integrated_CM_EnumDCSN_speed_limit_reason "Enumerated data type: EnumDCSN_speed_limit_reason" TAB_VERB "%0.6" "" COMPU_TAB_REF VTAB_FOR_DCSN_subsystem_integrated_CM_EnumDCSN_speed_limit_reason /end COMPU_METHOD
/begin COMPU_METHOD DCSN_subsystem_integrated_CM_EnumDCSN_driving_direction "Enumerated data type: EnumDCSN_driving_direction" TAB_VERB "%0.6" "" COMPU_TAB_REF VTAB_FOR_DCSN_subsystem_integrated_CM_EnumDCSN_driving_direction /end COMPU_METHOD
/begin COMPU_METHOD DCSN_subsystem_integrated_CM_EnumDCSN_change_lane_reason "Enumerated data type: EnumDCSN_change_lane_reason" TAB_VERB "%0.6" "" COMPU_TAB_REF VTAB_FOR_DCSN_subsystem_integrated_CM_EnumDCSN_change_lane_reason /end COMPU_METHOD
/begin COMPU_METHOD DCSN_subsystem_integrated_CM_EnumDCSN_inlane_nudge_reason "Enumerated data type: EnumDCSN_inlane_nudge_reason" TAB_VERB "%0.6" "" COMPU_TAB_REF VTAB_FOR_DCSN_subsystem_integrated_CM_EnumDCSN_inlane_nudge_reason /end COMPU_METHOD
/begin COMPU_METHOD DCSN_subsystem_integrated_CM_EnumDCSN_pull_over_reason "Enumerated data type: EnumDCSN_pull_over_reason" TAB_VERB "%0.6" "" COMPU_TAB_REF VTAB_FOR_DCSN_subsystem_integrated_CM_EnumDCSN_pull_over_reason /end COMPU_METHOD
/begin COMPU_METHOD LCCS_subsystem_integrated_CM_single "Q = V" RAT_FUNC "%8.6" "" COEFFS 0 1 0 0 0 1 /end COMPU_METHOD
/begin COMPU_METHOD LCCS_subsystem_integrated_CM_single_m "Q = V" RAT_FUNC "%8.6" "m" COEFFS 0 1 0 0 0 1 /end COMPU_METHOD
/begin COMPU_METHOD LCCS_subsystem_integrated_CM_single_kg "Q = V" RAT_FUNC "%8.6" "kg" COEFFS 0 1 0 0 0 1 /end COMPU_METHOD
/begin COMPU_METHOD LCCS_subsystem_integrated_CM_single_s "Q = V" RAT_FUNC "%8.6" "s" COEFFS 0 1 0 0 0 1 /end COMPU_METHOD
/begin COMPU_METHOD LCCS_subsystem_integrated_CM_single_m_s "Q = V" RAT_FUNC "%8.6" "m/s" COEFFS 0 1 0 0 0 1 /end COMPU_METHOD
/begin COMPU_METHOD LCCS_subsystem_integrated_CM_int32 "Q = V" RAT_FUNC "%10.0" "" COEFFS 0 1 0 0 0 1 /end COMPU_METHOD
/begin COMPU_METHOD LCCS_subsystem_integrated_CM_uint8 "Q = V" RAT_FUNC "%3.0" "" COEFFS 0 1 0 0 0 1 /end COMPU_METHOD
/begin COMPU_METHOD LCCS_subsystem_integrated_CM_boolean "Q = V" RAT_FUNC "%1.0" "" COEFFS 0 1 0 0 0 1 /end COMPU_METHOD
/begin COMPU_METHOD LCCS_subsystem_integrated_CM_EnumLCCS_ValidLane "Enumerated data type: EnumLCCS_ValidLane" TAB_VERB "%0.6" "" COMPU_TAB_REF VTAB_FOR_LCCS_subsystem_integrated_CM_EnumLCCS_ValidLane /end COMPU_METHOD
/begin COMPU_METHOD LCWS_subsystem_integrated_CM_single "Q = V" RAT_FUNC "%8.6" "" COEFFS 0 1 0 0 0 1 /end COMPU_METHOD
/begin COMPU_METHOD LCWS_subsystem_integrated_CM_single_m_s "Q = V" RAT_FUNC "%8.6" "m/s" COEFFS 0 1 0 0 0 1 /end COMPU_METHOD
/begin COMPU_METHOD LCWS_subsystem_integrated_CM_int8 "Q = V" RAT_FUNC "%3.0" "" COEFFS 0 1 0 0 0 1 /end COMPU_METHOD
/begin COMPU_METHOD LCWS_subsystem_integrated_CM_boolean "Q = V" RAT_FUNC "%1.0" "" COEFFS 0 1 0 0 0 1 /end COMPU_METHOD
/begin COMPU_METHOD LCWS_subsystem_integrated_CM_int32 "Q = V" RAT_FUNC "%10.0" "" COEFFS 0 1 0 0 0 1 /end COMPU_METHOD
/begin COMPU_METHOD LCWS_subsystem_integrated_CM_uint16 "Q = V" RAT_FUNC "%5.0" "" COEFFS 0 1 0 0 0 1 /end COMPU_METHOD
/begin COMPU_METHOD LCWS_subsystem_integrated_CM_EnumLCWS_Active_Status "Enumerated data type: EnumLCWS_Active_Status" TAB_VERB "%0.6" "" COMPU_TAB_REF VTAB_FOR_LCWS_subsystem_integrated_CM_EnumLCWS_Active_Status /end COMPU_METHOD
/begin COMPU_METHOD LCWS_subsystem_integrated_CM_EnumLCWS_Warning_Status "Enumerated data type: EnumLCWS_Warning_Status" TAB_VERB "%0.6" "" COMPU_TAB_REF VTAB_FOR_LCWS_subsystem_integrated_CM_EnumLCWS_Warning_Status /end COMPU_METHOD
/begin COMPU_METHOD LCWS_subsystem_integrated_CM_uint8 "Q = V" RAT_FUNC "%3.0" "" COEFFS 0 1 0 0 0 1 /end COMPU_METHOD
/begin COMPU_METHOD LDWS_subsystem_integrated_CM_single_rad "Q = V" RAT_FUNC "%8.6" "rad" COEFFS 0 1 0 0 0 1 /end COMPU_METHOD
/begin COMPU_METHOD LDWS_subsystem_integrated_CM_single__ "Q = V" RAT_FUNC "%8.6" "��" COEFFS 0 1 0 0 0 1 /end COMPU_METHOD
/begin COMPU_METHOD LDWS_subsystem_integrated_CM_single_NM "Q = V" RAT_FUNC "%8.6" "NM" COEFFS 0 1 0 0 0 1 /end COMPU_METHOD
/begin COMPU_METHOD LDWS_subsystem_integrated_CM_single_1_m "Q = V" RAT_FUNC "%8.6" "1/m" COEFFS 0 1 0 0 0 1 /end COMPU_METHOD
/begin COMPU_METHOD LDWS_subsystem_integrated_CM_single_m "Q = V" RAT_FUNC "%8.6" "m" COEFFS 0 1 0 0 0 1 /end COMPU_METHOD
/begin COMPU_METHOD LDWS_subsystem_integrated_CM_single "Q = V" RAT_FUNC "%8.6" "" COEFFS 0 1 0 0 0 1 /end COMPU_METHOD
/begin COMPU_METHOD LDWS_subsystem_integrated_CM_single_s "Q = V" RAT_FUNC "%8.6" "s" COEFFS 0 1 0 0 0 1 /end COMPU_METHOD
/begin COMPU_METHOD LDWS_subsystem_integrated_CM_single_m_s "Q = V" RAT_FUNC "%8.6" "m/s" COEFFS 0 1 0 0 0 1 /end COMPU_METHOD
/begin COMPU_METHOD LDWS_subsystem_integrated_CM_single___s "Q = V" RAT_FUNC "%8.6" "��/s" COEFFS 0 1 0 0 0 1 /end COMPU_METHOD
/begin COMPU_METHOD LDWS_subsystem_integrated_CM_uint16 "Q = V" RAT_FUNC "%5.0" "" COEFFS 0 1 0 0 0 1 /end COMPU_METHOD
/begin COMPU_METHOD LDWS_subsystem_integrated_CM_uint8 "Q = V" RAT_FUNC "%3.0" "" COEFFS 0 1 0 0 0 1 /end COMPU_METHOD
/begin COMPU_METHOD LDWS_subsystem_integrated_CM_boolean "Q = V" RAT_FUNC "%1.0" "" COEFFS 0 1 0 0 0 1 /end COMPU_METHOD
/begin COMPU_METHOD LDWS_subsystem_integrated_CM_EnumLDWS_la_detec_st "Enumerated data type: EnumLDWS_la_detec_st" TAB_VERB "%0.6" "" COMPU_TAB_REF VTAB_FOR_LDWS_subsystem_integrated_CM_EnumLDWS_la_detec_st /end COMPU_METHOD
/begin COMPU_METHOD LDWS_subsystem_integrated_CM_EnumLDWS_warn_side "Enumerated data type: EnumLDWS_warn_side" TAB_VERB "%0.6" "" COMPU_TAB_REF VTAB_FOR_LDWS_subsystem_integrated_CM_EnumLDWS_warn_side /end COMPU_METHOD
/begin COMPU_METHOD LDWS_subsystem_integrated_CM_EnumLDWS_system_st "Enumerated data type: EnumLDWS_system_st" TAB_VERB "%0.6" "" COMPU_TAB_REF VTAB_FOR_LDWS_subsystem_integrated_CM_EnumLDWS_system_st /end COMPU_METHOD
/begin COMPU_METHOD LDWS_subsystem_integrated_CM_EnumLDWS_on_state_st "Enumerated data type: EnumLDWS_on_state_st" TAB_VERB "%0.6" "" COMPU_TAB_REF VTAB_FOR_LDWS_subsystem_integrated_CM_EnumLDWS_on_state_st /end COMPU_METHOD
/begin COMPU_METHOD ad_ctrl_thruput_measurement_CM_ms "Q = V" RAT_FUNC "%8.6" "ms" COEFFS 0 1 0 0 0 1 /end COMPU_METHOD
/begin COMPU_METHOD ad_ctrl_subfunction_measurement_CM_us "Q = V" RAT_FUNC "%8.0" "us" COEFFS 0 1 0 0 0 1 /end COMPU_METHOD
/begin COMPU_VTAB VTAB_FOR_DCSN_subsystem_integrated_CM_EnumDCSN_adm_main_mode "Enumerated data type: EnumDCSN_adm_main_mode" TAB_VERB 9 0 "ADM_OFF" 1 "ADM_STANDBY" 2 "ADM_READY" 3 "ADM_ACTIVE" 4 "ADM_STEER_OVRD" 5 "ADM_TAKEOVER_WARNING" 6 "ADM_FAULT_WARNING" 7 "ADM_FAULT_REACTION" 8 "ADM_FAULT_DETECTED" /end COMPU_VTAB
/begin COMPU_VTAB VTAB_FOR_DCSN_subsystem_integrated_CM_EnumDCSN_adm_hmi_msg_display "Enumerated data type: EnumDCSN_adm_hmi_msg_display" TAB_VERB 5 0 "NO_MSG" 1 "ACTIVE" 2 "OVRD" 3 "TAKEOVER_REQ" 4 "FAULT" /end COMPU_VTAB
/begin COMPU_VTAB VTAB_FOR_DCSN_subsystem_integrated_CM_EnumDCSN_adm_hmi_icon_display "Enumerated data type: EnumDCSN_adm_hmi_icon_display" TAB_VERB 7 0 "NO_ICON" 1 "GREY_SOLID" 2 "GREEN_SOLID" 3 "BLUE_SOLID" 4 "RED_FLASH_SLOW" 5 "RED_FLASH_FAST" 6 "RED_SOLID" /end COMPU_VTAB
/begin COMPU_VTAB VTAB_FOR_DCSN_subsystem_integrated_CM_EnumDCSN_autodrive_control_mode "Enumerated data type: EnumDCSN_autodrive_control_mode" TAB_VERB 3 0 "AUTODRIVE_PASIV" 1 "AUTODRIVE_ACTIVATING" 2 "AUTODRIVE_ACTIVATED" /end COMPU_VTAB
/begin COMPU_VTAB VTAB_FOR_DCSN_subsystem_integrated_CM_EnumDCSN_stop_reason "Enumerated data type: EnumDCSN_stop_reason" TAB_VERB 6 0 "NO_STOP_REQUEST" 1 "STOP_FOR_DESTINATION" 2 "STOP_FOR_TRAFFIC_LIGHT" 3 "STOP_FOR_STOP_SIGN" 4 "STOP_FOR_CROSSWALK" 5 "STOP_FOR_KEEP_CLEAR" /end COMPU_VTAB
/begin COMPU_VTAB VTAB_FOR_DCSN_subsystem_integrated_CM_EnumDCSN_speed_limit_reason "Enumerated data type: EnumDCSN_speed_limit_reason" TAB_VERB 3 0 "NO_LIMIT" 1 "LIMIT_FOR_CROSSWALK" 2 "LIMIT_FOR_NUDGE" /end COMPU_VTAB
/begin COMPU_VTAB VTAB_FOR_DCSN_subsystem_integrated_CM_EnumDCSN_driving_direction "Enumerated data type: EnumDCSN_driving_direction" TAB_VERB 3 0 "FORWARD" 1 "LEFT" 2 "RIGHT" /end COMPU_VTAB
/begin COMPU_VTAB VTAB_FOR_DCSN_subsystem_integrated_CM_EnumDCSN_change_lane_reason "Enumerated data type: EnumDCSN_change_lane_reason" TAB_VERB 4 0 "LC_NO_REQUEST" 1 "LC_USER_CMD" 2 "LC_NAVIGATION_CMD" 3 "LC_FRONT_OBSTACLE" /end COMPU_VTAB
/begin COMPU_VTAB VTAB_FOR_DCSN_subsystem_integrated_CM_EnumDCSN_inlane_nudge_reason "Enumerated data type: EnumDCSN_inlane_nudge_reason" TAB_VERB 3 0 "NUDGE_NO_REQUEST" 1 "NUDGE_FRONT_OBSTACLE" 2 "NUDGE_SIDE_OBSTACLE" /end COMPU_VTAB
/begin COMPU_VTAB VTAB_FOR_DCSN_subsystem_integrated_CM_EnumDCSN_pull_over_reason "Enumerated data type: EnumDCSN_pull_over_reason" TAB_VERB 4 0 "PULLOVER_NO_REQUEST" 1 "PULLOVER_USER_CMD" 2 "PULLOVER_POLICE" 3 "PULLOVER_SYSTEM_FAULT" /end COMPU_VTAB
/begin COMPU_VTAB VTAB_FOR_LCCS_subsystem_integrated_CM_EnumLCCS_ValidLane "Enumerated data type: EnumLCCS_ValidLane" TAB_VERB 4 0 "LCCS_NoLane" 1 "LCCS_LeftLane" 2 "LCCS_RightLane" 3 "LCCS_BothLane" /end COMPU_VTAB
/begin COMPU_VTAB VTAB_FOR_LCWS_subsystem_integrated_CM_EnumLCWS_Active_Status "Enumerated data type: EnumLCWS_Active_Status" TAB_VERB 4 0 "LCWS_OFF" 1 "LCWS_PASSIVE" 2 "LCWS_INACTIVE" 3 "LCWS_ACTIVE" /end COMPU_VTAB
/begin COMPU_VTAB VTAB_FOR_LCWS_subsystem_integrated_CM_EnumLCWS_Warning_Status "Enumerated data type: EnumLCWS_Warning_Status" TAB_VERB 3 0 "LCWS_NO_WARNING" 1 "LCWS_WARNING_LOW_LEVEL" 2 "LCWS_WARNING_HIGH_LEVEL" /end COMPU_VTAB
/begin COMPU_VTAB VTAB_FOR_LDWS_subsystem_integrated_CM_EnumLDWS_la_detec_st "Enumerated data type: EnumLDWS_la_detec_st" TAB_VERB 4 3 "LDWS_BothAvl" 1 "LDWS_LeAvl" 2 "LDWS_RiAvl" 0 "LDWS_NotAvl" /end COMPU_VTAB
/begin COMPU_VTAB VTAB_FOR_LDWS_subsystem_integrated_CM_EnumLDWS_warn_side "Enumerated data type: EnumLDWS_warn_side" TAB_VERB 3 1 "LDWS_WarnLe" 2 "LDWS_WarnRi" 0 "LDWS_NoWarn" /end COMPU_VTAB
/begin COMPU_VTAB VTAB_FOR_LDWS_subsystem_integrated_CM_EnumLDWS_system_st "Enumerated data type: EnumLDWS_system_st" TAB_VERB 3 0 "LDWS_Off" 1 "LDWS_On" 2 "LDWS_Error" /end COMPU_VTAB
/begin COMPU_VTAB VTAB_FOR_LDWS_subsystem_integrated_CM_EnumLDWS_on_state_st "Enumerated data type: EnumLDWS_on_state_st" TAB_VERB 4 0 "LDWS_Enabling" 1 "LDWS_Standby" 2 "LDWS_Active" 3 "LDWS_Passive" /end COMPU_VTAB
/begin GROUP COMM_subsystem_integrated "COMM_subsystem_integrated" ROOT /begin SUB_GROUP Root_Receive Root_Transmit /end SUB_GROUP /begin REF_MEASUREMENT VbHWIO_DriverModeComd /end REF_MEASUREMENT /end GROUP
/begin GROUP Root_Receive "COMM_subsystem_integrated/Receive" /begin SUB_GROUP S1_iEV7S S1_iVISTA /end SUB_GROUP /begin REF_CHARACTERISTIC KcCOMM_VehicleCANbusConfig /end REF_CHARACTERISTIC
 /begin REF_MEASUREMENT VcCOMM_Auto_To_Manual_Tips VcCOMM_Decs_FedBck_BrkPedSts VcCOMM_Decs_FedBck_Drivemod VcCOMM_Decs_FedBck_EPBstate VcCOMM_Decs_FedBck_EPSmod VcCOMM_Decs_FedBck_ESCmod VcCOMM_Decs_FedBck_GearValue VcCOMM_Decs_FedBck_KeyState VcCOMM_DriverModeComd VcCOMM_VCU_DirIndicationLH VcCOMM_VCU_DirIndicationRH VcCOMM_VCU_HeadLampHighBeam VcCOMM_VCU_HeadLampLowBeam VfCOMM_AccPedl VfCOMM_Actual_Gear_Ratio VfCOMM_Decs_FedBck_StrAngle VfCOMM_Decs_FedBck_VehSpd VfCOMM_EPS_SteeringTorqueAct VfCOMM_VCU_BrkPedPos VfCOMM_VCU_ESCWhlFLSpd VfCOMM_VCU_ESCWhlFRSpd VfCOMM_VCU_ESCWhlRLSpd VfCOMM_VCU_ESCWhlRRSpd VfCOMM_VCU_LateralAcc VfCOMM_VCU_LongitudinalAcc VfCOMM_VCU_YawRate /end REF_MEASUREMENT
/end GROUP
/begin GROUP Root_Transmit "COMM_subsystem_integrated/Transmit" /begin SUB_GROUP S2_FAW S2_ICPV S2_Test_Mode /end SUB_GROUP
 /begin REF_CHARACTERISTIC KcCOMM_Test_Cmd_EPSXBW_En KcCOMM_Test_Cmd_EPSXBW_En_ovr KcCOMM_Test_Cmd_StrAngle KcCOMM_Test_Cmd_StrAngle_ovr KcCOMM_Test_Decs_Acc_Req KcCOMM_Test_Decs_Acc_Req_ovr KcCOMM_Test_Decs_Acc_Value KcCOMM_Test_Decs_Acc_Value_ovr KcCOMM_Test_Decs_Breake_Req KcCOMM_Test_Decs_Breake_Req_ovr KcCOMM_Test_Decs_Breake_Value KcCOMM_Test_Decs_Breake_Value_ovr KcCOMM_Test_mode KcCOMM_VehicleCANbusConfig /end REF_CHARACTERISTIC
 /begin REF_MEASUREMENT VcCOMM_Decs_Acc_Req VcCOMM_Decs_BckfogLmp_Req VcCOMM_Decs_Breake_Req VcCOMM_Decs_BrkLight_Req VcCOMM_Decs_Control_mod VcCOMM_Decs_DippedBeam_Req VcCOMM_Decs_FrontFogLamp_Req VcCOMM_Decs_Gear_Req VcCOMM_Decs_Gear_Value VcCOMM_Decs_HighBeam_Req VcCOMM_Decs_Horn_Req VcCOMM_Decs_LftLmp_Req VcCOMM_Decs_Light_Req VcCOMM_Decs_RihtLmp_Req VcCOMM_Decs_Steering_Req VcCOMM_Decs_WarnLight_Req VcCOMM_Decs_iBCM_Req VcCOMM_EPB_control_enable VcCOMM_EPB_switch_request VfCOMM_Decs_Acc_Value VfCOMM_Decs_Breake_Value VfCOMM_Decs_SteeringAngle VfCOMM_req_pct_torque_raw /end REF_MEASUREMENT
/end GROUP
/begin GROUP S1_iEV7S "COMM_subsystem_integrated/Receive/iEV7S" /begin REF_CHARACTERISTIC KfCOMM_a_VCULongAccOffset KfCOMM_r_VCULongAccSlope /end REF_CHARACTERISTIC /end GROUP
/begin GROUP S1_iVISTA "COMM_subsystem_integrated/Receive/iVISTA" /begin REF_CHARACTERISTIC KfCOMM_a_VCULongAccOffset KfCOMM_r_VCULongAccSlope /end REF_CHARACTERISTIC /end GROUP
/begin GROUP S2_FAW "COMM_subsystem_integrated/Transmit/FAW" /begin SUB_GROUP S29_Command_Mapping /end SUB_GROUP /begin REF_CHARACTERISTIC KcCOMM_FirstGearRatio /end REF_CHARACTERISTIC /begin REF_MEASUREMENT VfCOMM_req_pct_torque_final /end REF_MEASUREMENT /end GROUP
/begin GROUP S2_ICPV "COMM_subsystem_integrated/Transmit/ICPV" /begin SUB_GROUP S31_EPB_clamped S31_EPB_released S31_EPB_releasing /end SUB_GROUP
 /begin REF_CHARACTERISTIC KcCOMM_BrakePedalMax KcCOMM_BrakePedalMin KcCOMM_GasPedalMax KcCOMM_GasPedalMin /end REF_CHARACTERISTIC
 /begin REF_MEASUREMENT VcCOMM_max_gas_pedal_EPB /end REF_MEASUREMENT
/end GROUP
/begin GROUP S2_Test_Mode "COMM_subsystem_integrated/Transmit/Test_Mode"
 /begin REF_CHARACTERISTIC KcCOMM_Test_BckFogLamp_Req KcCOMM_Test_Checksum_0x150 KcCOMM_Test_Checksum_0x151 KcCOMM_Test_Cmd_ATOModEnable KcCOMM_Test_Cmd_AccPelEnable KcCOMM_Test_Cmd_AccPelPosAct KcCOMM_Test_Cmd_AccPelPosActInv KcCOMM_Test_Cmd_BrakeLightReq KcCOMM_Test_Cmd_BrkPelEnable KcCOMM_Test_Cmd_BrkPelPosAct KcCOMM_Test_Cmd_BrkPelPosActInv KcCOMM_Test_Cmd_Checksum KcCOMM_Test_Cmd_EPSDir KcCOMM_Test_Cmd_EPSXBW_En KcCOMM_Test_Cmd_ICPDTC KcCOMM_Test_Cmd_RCnt KcCOMM_Test_Cmd_StrAngle KcCOMM_Test_Cmd_StrAngleLimit KcCOMM_Test_Cmd_StrAngleSpd KcCOMM_Test_Cmd_TgtSft KcCOMM_Test_Cmd_TgtSftEnable KcCOMM_Test_Cmd_VCUCnt KcCOMM_Test_Decs_Acc_Mod KcCOMM_Test_Decs_Acc_Req KcCOMM_Test_Decs_Acc_Value KcCOMM_Test_Decs_Breake_Req KcCOMM_Test_Decs_Breake_Value KcCOMM_Test_Decs_DippedBeam_Req KcCOMM_Test_Decs_HighBeam_Req KcCOMM_Test_Decs_LftLmp_Req KcCOMM_Test_Decs_Light_Req KcCOMM_Test_Decs_RihtLmp_Req KcCOMM_Test_Decs_iBCM_Req KcCOMM_Test_FrontFogLamp_Req KcCOMM_Test_Horn_Req KcCOMM_Test_HummerSts KcCOMM_Test_Over_Speed KcCOMM_Test_RCnt_0x150 KcCOMM_Test_RCnt_0x151 KcCOMM_Test_SlowDown_Indication KcCOMM_Test_SpeedUp_Indication KcCOMM_Test_Stop_Request KcCOMM_Test_Tar_Torq KcCOMM_Test_Tar_vehiclespd KcCOMM_Test_WarnLight_Req KcCOMM_Test_XBR_EBI_Mode KcCOMM_Test_XBR_Priority KcCOMM_Test_acceleration_fb KcCOMM_Test_cmd_VCUChecksum KcCOMM_Test_driveoff_Req KcCOMM_Test_yaw_rate_fb /end REF_CHARACTERISTIC
/end GROUP
/begin GROUP S29_Command_Mapping "COMM_subsystem_integrated/Transmit/FAW/Command_Mapping" /begin SUB_GROUP S36_T03 /end SUB_GROUP /end GROUP
/begin GROUP S31_EPB_clamped "COMM_subsystem_integrated/Transmit/ICPV/EPB_clamped" /begin REF_CHARACTERISTIC KcCOMM_GasPedalMinEPB /end REF_CHARACTERISTIC /end GROUP
/begin GROUP S31_EPB_released "COMM_subsystem_integrated/Transmit/ICPV/EPB_released" /begin REF_CHARACTERISTIC KcCOMM_GasPedalMax KcCOMM_GasPedalRampEPB /end REF_CHARACTERISTIC /end GROUP
/begin GROUP S31_EPB_releasing "COMM_subsystem_integrated/Transmit/ICPV/EPB_releasing" /begin REF_CHARACTERISTIC KcCOMM_GasPedalMaxEPB KcCOMM_GasPedalRampEPB /end REF_CHARACTERISTIC /end GROUP
/begin GROUP S36_T03 "COMM_subsystem_integrated/Transmit/FAW/Command_Mapping/T03" /begin REF_CHARACTERISTIC KcCOMM_TorqueControlPriority /end REF_CHARACTERISTIC /end GROUP
/begin GROUP DCSN_subsystem_integrated "DCSN_subsystem_integrated" ROOT /begin SUB_GROUP Root_DtrmnDCSN_Integrated /end SUB_GROUP /end GROUP
/begin GROUP Root_DtrmnDCSN_Integrated "DCSN_subsystem_integrated/DtrmnDCSN_Integrated"
 /begin SUB_GROUP S1_DtrmnDCSN_ADM S1_DtrmnDCSN_EnablingManager S1_DtrmnDCSN_TrafficDecider /end SUB_GROUP
/end GROUP
/begin GROUP S1_DtrmnDCSN_ADM "DCSN_subsystem_integrated/DtrmnDCSN_Integrated/DtrmnDCSN_ADM"
 /begin SUB_GROUP S3_CheckDCSN_ACCS_mode S3_CheckDCSN_UsrSwitchStatus S3_DtrmnDCSN_ADMMainManager S3_DtrmnDCSN_DRIVIintentionSimu /end SUB_GROUP
 /begin REF_CHARACTERISTIC KbDCSN_adm_temp_stop_finished KbDCSN_adm_temp_usr_cmd_autodrive_enabled KbDCSN_use_EgmoLinearSpeed KbDCSN_use_EgmoReadyFlag KeDCSN_adm_temp_diag_system_fault KfDCSN_t_max_time_fault_warning KfDCSN_t_max_time_to_takeover KfDCSN_v_adm_temp_veh_setspeed KfDCSN_v_setspeed_thrsh_hi /end REF_CHARACTERISTIC
/end GROUP
/begin GROUP S1_DtrmnDCSN_EnablingManager "DCSN_subsystem_integrated/DtrmnDCSN_Integrated/DtrmnDCSN_EnablingManager"
 /begin SUB_GROUP S4_DtrmnDCSN_EpbCtrlSwitch S4_DtrmnDCSN_GearCtrlSwitch S4_Dtrmn_DCSN_AutoDriveModeManager S4_Dtrmn_EnablingFlagsOSP /end SUB_GROUP
 /begin REF_CHARACTERISTIC KbDCSN_use_EgmoReadyFlag /end REF_CHARACTERISTIC
/end GROUP
/begin GROUP S1_DtrmnDCSN_TrafficDecider "DCSN_subsystem_integrated/DtrmnDCSN_Integrated/DtrmnDCSN_TrafficDecider"
 /begin SUB_GROUP S5_CalcDCSN_OverSpeedWarning S5_CalcDCSN_SpeedLimit S5_CalcDCSN_StopRequest S5_CheckDCSN_InputDataValidity S5_CvrtDCSN_DataSelector S5_MngDCSN_TrafficDeciderManager S5_MngDCSN_TrafficDeciderOutputM /end SUB_GROUP
/end GROUP
/begin GROUP S3_CheckDCSN_ACCS_mode "DCSN_subsystem_integrated/DtrmnDCSN_Integrated/DtrmnDCSN_ADM/CheckDCSN_ACCS_mode" /begin REF_MEASUREMENT VbDCSN_ACC_ready_to_engage /end REF_MEASUREMENT /end GROUP
/begin GROUP S3_CheckDCSN_UsrSwitchStatus "DCSN_subsystem_integrated/DtrmnDCSN_Integrated/DtrmnDCSN_ADM/CheckDCSN_UsrSwitchStatus"
 /begin REF_CHARACTERISTIC KbDCSN_use_vehicle_activate_switch KcDCSN_t_usr_activate_cmd_send_count KeDCSN_usr_cmd_autodrive_activate_man /end REF_CHARACTERISTIC
 /begin REF_MEASUREMENT VeDCSN_usr_cmd_autodrive_activate /end REF_MEASUREMENT
/end GROUP
/begin GROUP S3_DtrmnDCSN_ADMMainManager "DCSN_subsystem_integrated/DtrmnDCSN_Integrated/DtrmnDCSN_ADM/DtrmnDCSN_ADMMainManager"
 /begin SUB_GROUP S9_CheckDCSN_SystemFaultCheck S9_CheckDCSN_VehicleStateCheck /end SUB_GROUP
 /begin REF_CHARACTERISTIC KbDCSN_adm_main_mode_man_ctrl KeDCSN_adm_main_mode_man_value /end REF_CHARACTERISTIC
 /begin REF_MEASUREMENT VeDCSN_adm_main_mode VeDCSN_hmi_icon_display VeDCSN_hmi_msg_display /end REF_MEASUREMENT
/end GROUP
/begin GROUP S3_DtrmnDCSN_DRIVIintentionSimu "DCSN_subsystem_integrated/DtrmnDCSN_Integrated/DtrmnDCSN_ADM/DtrmnDCSN_DRIVIintentionSimu"
 /begin SUB_GROUP S10_DtrmnDCSN_FAWTorqueOverride S10_DtrmnDCSN_TakeOverLogicFAW /end SUB_GROUP
 /begin REF_CHARACTERISTIC KeDCSN_adm_temp_steering_controlmode KfDCSN_M_adm_temp_steering_ovrd_torque KfDCSN_M_adm_temp_steering_resume_torque KfDCSN_t_adm_temp_steering_ovrd_delay KfDCSN_t_adm_temp_steering_resume_delay /end REF_CHARACTERISTIC
 /begin REF_MEASUREMENT VbDCSN_adm_steering_override VbDCSN_adm_steering_resume /end REF_MEASUREMENT
/end GROUP
/begin GROUP S4_DtrmnDCSN_EpbCtrlSwitch "DCSN_subsystem_integrated/DtrmnDCSN_Integrated/DtrmnDCSN_EnablingManager/DtrmnDCSN_EpbCtrlSwitch" /begin REF_CHARACTERISTIC KbDCSN_use_faw_l4_logic /end REF_CHARACTERISTIC /end GROUP
/begin GROUP S4_DtrmnDCSN_GearCtrlSwitch "DCSN_subsystem_integrated/DtrmnDCSN_Integrated/DtrmnDCSN_EnablingManager/DtrmnDCSN_GearCtrlSwitch" /begin REF_CHARACTERISTIC KbDCSN_use_faw_l4_logic /end REF_CHARACTERISTIC /end GROUP
/begin GROUP S4_Dtrmn_DCSN_AutoDriveModeManager "DCSN_subsystem_integrated/DtrmnDCSN_Integrated/DtrmnDCSN_EnablingManager/Dtrmn_DCSN_AutoDriveModeManager"
 /begin SUB_GROUP S28_DtrmnDCSN_AutodriveActDelay S28_DtrmnDCSN_ReActivateLogicFAW /end SUB_GROUP
 /begin REF_CHARACTERISTIC KbDCSN_use_SLEW_switch_control_mode KbDCSN_use_vehicle_control_mode_fedbak KbDCSN_vehicle_control_mode_man_value KfDCSN_t_autodrive_max_wait_time /end REF_CHARACTERISTIC
/end GROUP
/begin GROUP S4_Dtrmn_EnablingFlagsOSP "DCSN_subsystem_integrated/DtrmnDCSN_Integrated/DtrmnDCSN_EnablingManager/Dtrmn_EnablingFlagsOSP"
 /begin REF_CHARACTERISTIC KbDCSN_SLEW_DriveModeComd_enbl KbDCSN_SLEW_DriveModeComd_value KbDCSN_acc_man_enbl KbDCSN_active_feature_man_ctrl KbDCSN_adm_main_mode_man_ctrl KbDCSN_aeb_man_enbl KbDCSN_alca_man_enbl KbDCSN_autodrive_mode_man_enbl KbDCSN_brake_ctrl_man_enbl KbDCSN_brake_ctrl_man_value KbDCSN_epb_ctrl_man_enbl KbDCSN_epb_ctrl_man_value KbDCSN_fcw_man_enbl KbDCSN_gear_ctrl_man_enbl KbDCSN_gear_ctrl_man_value KbDCSN_lcc_man_enbl KbDCSN_lcw_man_enbl KbDCSN_ldw_man_enbl KbDCSN_passive_feature_man_ctrl KbDCSN_power_ctrl_man_enbl KbDCSN_power_ctrl_man_value KbDCSN_steer_ctrl_man_enbl KbDCSN_steer_ctrl_man_value KbDCSN_use_SLEW_override_logic KeDCSN_autodrive_mode_man_value /end REF_CHARACTERISTIC
 /begin REF_MEASUREMENT VbDCSN_acc_feature_enable VbDCSN_aeb_feature_enable VbDCSN_alca_feature_enable VbDCSN_brake_ctrl_enable VbDCSN_epb_ctrl_enable VbDCSN_fcw_feature_enable VbDCSN_gear_ctrl_enable VbDCSN_lcc_feature_enable VbDCSN_lcw_feature_enable VbDCSN_ldw_feature_enable VbDCSN_power_ctrl_enable VbDCSN_steer_ctrl_enable VeDCSN_autodrive_control_mode /end REF_MEASUREMENT
/end GROUP
/begin GROUP S5_CalcDCSN_OverSpeedWarning "DCSN_subsystem_integrated/DtrmnDCSN_Integrated/DtrmnDCSN_TrafficDecider/CalcDCSN_OverSpeedWarning"
 /begin REF_CHARACTERISTIC KbDCSN_enable_warning_no_input KfDCSN_v_default_warning_speed KfDCSN_v_overspeed_warning_extra /end REF_CHARACTERISTIC
 /begin REF_MEASUREMENT VbDCSN_overspeed_warning /end REF_MEASUREMENT
/end GROUP
/begin GROUP S5_CalcDCSN_SpeedLimit "DCSN_subsystem_integrated/DtrmnDCSN_Integrated/DtrmnDCSN_TrafficDecider/CalcDCSN_SpeedLimit" /begin REF_MEASUREMENT VbDCSN_spd_limt_max_isNaN VbDCSN_speed_limit_input_isNaN /end REF_MEASUREMENT /end GROUP
/begin GROUP S5_CalcDCSN_StopRequest "DCSN_subsystem_integrated/DtrmnDCSN_Integrated/DtrmnDCSN_TrafficDecider/CalcDCSN_StopRequest"
 /begin SUB_GROUP S35_CalcDCSN_RawStopDistance S35_CalcDCSN_SLEWStopDistance S35_CalcDCSN_StopReasonDistance /end SUB_GROUP
/end GROUP
/begin GROUP S5_CheckDCSN_InputDataValidity "DCSN_subsystem_integrated/DtrmnDCSN_Integrated/DtrmnDCSN_TrafficDecider/CheckDCSN_InputDataValidity"
 /begin REF_MEASUREMENT VbDCSN_egmo_is_ready VbDCSN_input_is_ready VbDCSN_mpfu_is_ready /end REF_MEASUREMENT
/end GROUP
/begin GROUP S5_CvrtDCSN_DataSelector "DCSN_subsystem_integrated/DtrmnDCSN_Integrated/DtrmnDCSN_TrafficDecider/CvrtDCSN_DataSelector"
 /begin SUB_GROUP S37_CheckDCSN_num_lanes_isNaN S37_CheckDCSN_num_stop_lines_isNaN /end SUB_GROUP
 /begin REF_MEASUREMENT VbDCSN_accs_stop_finished VfDCSN_vehicle_speed_egmo /end REF_MEASUREMENT
/end GROUP
/begin GROUP S5_MngDCSN_TrafficDeciderManager "DCSN_subsystem_integrated/DtrmnDCSN_Integrated/DtrmnDCSN_TrafficDecider/MngDCSN_TrafficDeciderManager"
 /begin REF_CHARACTERISTIC KbDCSN_overspeed_warning_enable KbDCSN_speed_limit_enable KbDCSN_stop_request_enable /end REF_CHARACTERISTIC
 /begin REF_MEASUREMENT VbDCSN_speed_limit_enabled VbDCSN_stop_request_enabled /end REF_MEASUREMENT
/end GROUP
/begin GROUP S5_MngDCSN_TrafficDeciderOutputM "DCSN_subsystem_integrated/DtrmnDCSN_Integrated/DtrmnDCSN_TrafficDecider/MngDCSN_TrafficDeciderOutputM"
 /begin REF_CHARACTERISTIC KbDCSN_change_lane_man_enbl KbDCSN_change_lane_request_man_value KbDCSN_inlane_nudge_man_enbl KbDCSN_inlane_nudge_request_man_value KbDCSN_pull_over_man_enbl KbDCSN_pull_over_request_man_value KbDCSN_stop_man_enbl KbDCSN_stop_request_man_value KbDCSN_traffic_speed_limit_man_enbl KeDCSN_change_lane_reason_man_value KeDCSN_change_lane_req_side_man_value KeDCSN_inlane_nudge_reason_man_value KeDCSN_pull_over_reason_man_value KeDCSN_stop_reason_man_value KeDCSN_traffic_speed_reason_man_value KfDCSN_d_inlane_nudge_side_man_value KfDCSN_v_change_lane_target_speed_man_value KfDCSN_v_traffic_speed_limit_man_value /end REF_CHARACTERISTIC
 /begin REF_MEASUREMENT VbDCSN_change_lane_request VbDCSN_inlane_nudge_request VbDCSN_pull_over_request VbDCSN_stop_request VeDCSN_change_lane_reason VeDCSN_change_lane_req_side VeDCSN_inlane_nudge_reason VeDCSN_pull_over_reason VeDCSN_speed_limit_reason VeDCSN_stop_reason VfDCSN_change_lane_target_speed VfDCSN_inlane_nudge_side VfDCSN_stop_s_distance VfDCSN_traffic_speed_limit /end REF_MEASUREMENT
/end GROUP
/begin GROUP S9_CheckDCSN_SystemFaultCheck "DCSN_subsystem_integrated/DtrmnDCSN_Integrated/DtrmnDCSN_ADM/DtrmnDCSN_ADMMainManager/CheckDCSN_SystemFaultCheck" /begin REF_MEASUREMENT VbDCSN_fault_detected /end REF_MEASUREMENT /end GROUP
/begin GROUP S9_CheckDCSN_VehicleStateCheck "DCSN_subsystem_integrated/DtrmnDCSN_Integrated/DtrmnDCSN_ADM/DtrmnDCSN_ADMMainManager/CheckDCSN_VehicleStateCheck" /begin SUB_GROUP S12_DtrmnDCSN_BrakePressed S12_DtrmnDCSN_FawAutodriveMode /end SUB_GROUP /begin REF_CHARACTERISTIC KbDCSN_use_faw_l4_logic KfDCSN_v_adm_active_extraspeed /end REF_CHARACTERISTIC /begin REF_MEASUREMENT VbDCSN_vehicle_ready_to_engage /end REF_MEASUREMENT /end GROUP
/begin GROUP S10_DtrmnDCSN_FAWTorqueOverride "DCSN_subsystem_integrated/DtrmnDCSN_Integrated/DtrmnDCSN_ADM/DtrmnDCSN_DRIVIintentionSimu/DtrmnDCSN_FAWTorqueOverride" /begin REF_CHARACTERISTIC KbDCSN_use_faw_l4_logic /end REF_CHARACTERISTIC /end GROUP
/begin GROUP S10_DtrmnDCSN_TakeOverLogicFAW "DCSN_subsystem_integrated/DtrmnDCSN_Integrated/DtrmnDCSN_ADM/DtrmnDCSN_DRIVIintentionSimu/DtrmnDCSN_TakeOverLogicFAW"
 /begin REF_CHARACTERISTIC KbDCSN_use_faw_handoff_as_ovrd KbDCSN_use_faw_handoff_as_resume KbDCSN_use_faw_l4_logic /end REF_CHARACTERISTIC
/end GROUP
/begin GROUP S28_DtrmnDCSN_AutodriveActDelay "DCSN_subsystem_integrated/DtrmnDCSN_Integrated/DtrmnDCSN_EnablingManager/Dtrmn_DCSN_AutoDriveModeManager/DtrmnDCSN_AutodriveActDelay"
 /begin REF_CHARACTERISTIC KbDCSN_use_faw_l4_logic KfDCSN_t_autodrive_control_mode_delay /end REF_CHARACTERISTIC
/end GROUP
/begin GROUP S28_DtrmnDCSN_ReActivateLogicFAW "DCSN_subsystem_integrated/DtrmnDCSN_Integrated/DtrmnDCSN_EnablingManager/Dtrmn_DCSN_AutoDriveModeManager/DtrmnDCSN_ReActivateLogicFAW" /begin REF_CHARACTERISTIC KbDCSN_use_faw_l4_logic /end REF_CHARACTERISTIC /end GROUP
/begin GROUP S35_CalcDCSN_RawStopDistance "DCSN_subsystem_integrated/DtrmnDCSN_Integrated/DtrmnDCSN_TrafficDecider/CalcDCSN_StopRequest/CalcDCSN_RawStopDistance"
 /begin REF_MEASUREMENT VbDCSN_has_valid_stop_line VbDCSN_stop_line_distance_isNaN VbDCSN_stop_line_input_isNaN VfDCSN_raw_stop_line_distance /end REF_MEASUREMENT
/end GROUP
/begin GROUP S35_CalcDCSN_SLEWStopDistance "DCSN_subsystem_integrated/DtrmnDCSN_Integrated/DtrmnDCSN_TrafficDecider/CalcDCSN_StopRequest/CalcDCSN_SLEWStopDistance" /begin SUB_GROUP S49_Subsystem /end SUB_GROUP /begin REF_CHARACTERISTIC KbDCSN_stop_request_man_value /end REF_CHARACTERISTIC /end GROUP
/begin GROUP S35_CalcDCSN_StopReasonDistance "DCSN_subsystem_integrated/DtrmnDCSN_Integrated/DtrmnDCSN_TrafficDecider/CalcDCSN_StopRequest/CalcDCSN_StopReasonDistance"
 /begin SUB_GROUP S50_CheckDCSN_VariableTimeHold S50_CheckDCSN_VariableTimeHold1 /end SUB_GROUP
 /begin REF_CHARACTERISTIC KfDCSN_d_Thrsh_request_stop KfDCSN_d_stop_cleared_Thrsh KfDCSN_d_stop_close_Thrsh KfDCSN_d_stop_finished_dis KfDCSN_d_stop_unsuccess_Thrsh KfDCSN_t_sample_time /end REF_CHARACTERISTIC
 /begin REF_MEASUREMENT VbDCSN_raw_stop_finished VbDCSN_raw_stop_finished_late VbDCSN_should_send_stop_req VbDCSN_stop_line_is_close VbDCSN_stop_unsuccess VeDCSN_stop_request_mode /end REF_MEASUREMENT
/end GROUP
/begin GROUP S37_CheckDCSN_num_lanes_isNaN "DCSN_subsystem_integrated/DtrmnDCSN_Integrated/DtrmnDCSN_TrafficDecider/CvrtDCSN_DataSelector/CheckDCSN_num_lanes_isNaN" /begin REF_MEASUREMENT VbDCSN_num_lanes_isNaN /end REF_MEASUREMENT /end GROUP
/begin GROUP S37_CheckDCSN_num_stop_lines_isNaN "DCSN_subsystem_integrated/DtrmnDCSN_Integrated/DtrmnDCSN_TrafficDecider/CvrtDCSN_DataSelector/CheckDCSN_num_stop_lines_isNaN" /begin REF_MEASUREMENT VbDCSN_num_stop_lines_isNaN VfDCSN_mpfu_num_stop_lines /end REF_MEASUREMENT /end GROUP
/begin GROUP S12_DtrmnDCSN_BrakePressed "DCSN_subsystem_integrated/DtrmnDCSN_Integrated/DtrmnDCSN_ADM/DtrmnDCSN_ADMMainManager/CheckDCSN_VehicleStateCheck/DtrmnDCSN_BrakePressed" /begin REF_CHARACTERISTIC KbDCSN_adm_BrkPressDeactivateEnabled /end REF_CHARACTERISTIC /end GROUP
/begin GROUP S12_DtrmnDCSN_FawAutodriveMode "DCSN_subsystem_integrated/DtrmnDCSN_Integrated/DtrmnDCSN_ADM/DtrmnDCSN_ADMMainManager/CheckDCSN_VehicleStateCheck/DtrmnDCSN_FawAutodriveMode"
 /begin REF_CHARACTERISTIC KbDCSN_adm_BrkPressDeactivateEnabled KbDCSN_use_faw_l4_logic /end REF_CHARACTERISTIC
/end GROUP
/begin GROUP S49_Subsystem "DCSN_subsystem_integrated/DtrmnDCSN_Integrated/DtrmnDCSN_TrafficDecider/CalcDCSN_StopRequest/CalcDCSN_SLEWStopDistance/Subsystem" /begin REF_CHARACTERISTIC KfDCSN_d_stop_s_distance_man_value KfDCSN_t_sample_time /end REF_CHARACTERISTIC /end GROUP
/begin GROUP S50_CheckDCSN_VariableTimeHold "DCSN_subsystem_integrated/DtrmnDCSN_Integrated/DtrmnDCSN_TrafficDecider/CalcDCSN_StopRequest/CalcDCSN_StopReasonDistance/CheckDCSN_VariableTimeHold" /begin REF_CHARACTERISTIC KfDCSN_t_stop_req_hold /end REF_CHARACTERISTIC /begin REF_MEASUREMENT VbDCSN_hold_stop_finished /end REF_MEASUREMENT /end GROUP
/begin GROUP S50_CheckDCSN_VariableTimeHold1 "DCSN_subsystem_integrated/DtrmnDCSN_Integrated/DtrmnDCSN_TrafficDecider/CalcDCSN_StopRequest/CalcDCSN_StopReasonDistance/CheckDCSN_VariableTimeHold1" /begin REF_CHARACTERISTIC KfDCSN_t_stop_req_hold /end REF_CHARACTERISTIC /begin REF_MEASUREMENT VbDCSN_hold_stop_finished_late /end REF_MEASUREMENT /end GROUP
/begin GROUP LCCS_subsystem_integrated "LCCS_subsystem_integrated" ROOT /begin SUB_GROUP Root_LCCS /end SUB_GROUP /end GROUP
/begin GROUP Root_LCCS "LCCS_subsystem_integrated/LCCS"
 /begin SUB_GROUP S1_CalcLCCS_compute_lateral_errors S1_CalcLCCS_lane_center_discretize S1_CalcLCCS_lane_center_line S1_CalcLCCS_lateral_control_main S1_CalcLCCS_lateral_shift_width S1_CalcLCCS_virtual_lane_marker S1_DtrmnLCCS_sensor_signal_processing S1_DtrmnLCCS_sensor_signal_rationality S1_DtrmnLCCS_steering_control_output /end SUB_GROUP
/end GROUP
/begin GROUP S1_CalcLCCS_compute_lateral_errors "LCCS_subsystem_integrated/LCCS/CalcLCCS_compute_lateral_errors"
 /begin SUB_GROUP S2_center_of_mass_projection S2_compute_lateral_errors S2_preview_point_projection /end SUB_GROUP
/end GROUP
/begin GROUP S1_CalcLCCS_lane_center_discretize "LCCS_subsystem_integrated/LCCS/CalcLCCS_lane_center_discretize" /begin REF_CHARACTERISTIC KfLCCS_d_lr /end REF_CHARACTERISTIC /end GROUP
/begin GROUP S1_CalcLCCS_lane_center_line "LCCS_subsystem_integrated/LCCS/CalcLCCS_lane_center_line" /begin REF_CHARACTERISTIC KfLCCS_t_SampleTime KtLCCS_k_LanemarkMergeCoef /end REF_CHARACTERISTIC
 /begin REF_MEASUREMENT VaLCCS_final_left_lanemark VaLCCS_final_right_lanemark VaLCCS_raw_lane_center_line VbLCCS_touched_new_lane VfLCCS_left_lanemark_switch_time VfLCCS_right_lanemark_switch_time /end REF_MEASUREMENT
/end GROUP
/begin GROUP S1_CalcLCCS_lateral_control_main "LCCS_subsystem_integrated/LCCS/CalcLCCS_lateral_control_main" /begin SUB_GROUP S5_lateral_control S5_steering_wheel_angle /end SUB_GROUP /end GROUP
/begin GROUP S1_CalcLCCS_lateral_shift_width "LCCS_subsystem_integrated/LCCS/CalcLCCS_lateral_shift_width" /begin SUB_GROUP S6_CalcLCCS_target_shift_width /end SUB_GROUP
 /begin REF_CHARACTERISTIC KfLCCS_r_LateralSpeedRatio KfLCCS_r_shift_speed_gain KfLCCS_t_SampleTime KfLCCS_v_shift_speed_high_limit KfLCCS_v_shift_speed_low_limit /end REF_CHARACTERISTIC
 /begin REF_MEASUREMENT VaLCCS_shifted_lane_center_line VbLCCS_shifting_in_progress VcLCCS_shifting_direction_final VfLCCS_lateral_dist_to_go VfLCCS_lateral_shift_step VfLCCS_lateral_shift_width /end REF_MEASUREMENT
/end GROUP
/begin GROUP S1_CalcLCCS_virtual_lane_marker "LCCS_subsystem_integrated/LCCS/CalcLCCS_virtual_lane_marker" /begin REF_CHARACTERISTIC KfLCCS_LanemarkerQualityThrsh KfLCCS_d_ValidLaneWidthLimit /end REF_CHARACTERISTIC
 /begin REF_MEASUREMENT VaLCCS_virtual_left_lanemark VaLCCS_virtual_right_lanemark VbLCCS_both_lanemark_available VbLCCS_left_lanemark_valid VbLCCS_right_lanemark_valid VeLCCS_valid_lane_marker VfLCCS_c0_scaling VfLCCS_left_lanemark_confidence VfLCCS_right_lanemark_confidence VfLCCS_smoothed_lane_width /end REF_MEASUREMENT
/end GROUP
/begin GROUP S1_DtrmnLCCS_sensor_signal_processing "LCCS_subsystem_integrated/LCCS/DtrmnLCCS_sensor_signal_processing"
 /begin REF_CHARACTERISTIC KfLCCS_Ang_steering_center_position KfLCCS_r_veh_strwhl_2_frtwhl_ratio KtLCCS_d_lookahead_distance /end REF_CHARACTERISTIC
 /begin REF_MEASUREMENT VaLCCS_raw_left_lanemark VaLCCS_raw_right_lanemark VbLCCS_input_isNaN_MPFU VfLCCS_lookahead_distance VfLCCS_raw_lane_width VfLCCS_veh_frtwhl_angle_act /end REF_MEASUREMENT
/end GROUP
/begin GROUP S1_DtrmnLCCS_sensor_signal_rationality "LCCS_subsystem_integrated/LCCS/DtrmnLCCS_sensor_signal_rationality"
 /begin SUB_GROUP S9_check_signal_isNan S9_check_signal_isNan1 S9_check_signal_isNan10 S9_check_signal_isNan12 S9_check_signal_isNan2 S9_check_signal_isNan3 S9_check_signal_isNan6 S9_check_signal_isNan8 S9_check_signal_isNan9 /end SUB_GROUP
 /begin REF_CHARACTERISTIC KbLCCS_inlane_nudge_request_SLEW KbLCCS_inlane_nudge_request_value KbLCCS_lane_change_request_SLEW KbLCCS_lane_change_request_value KbLCCS_shifting_direction_SLEW KcLCCS_shifting_direction_value /end REF_CHARACTERISTIC
 /begin REF_MEASUREMENT VbLCCS_inlane_nudge_request VbLCCS_input_isNaN_COMM VbLCCS_input_isNaN_DCSN VbLCCS_input_isNaN_EGMO VbLCCS_lane_change_request VcLCCS_shifting_direction_raw /end REF_MEASUREMENT
/end GROUP
/begin GROUP S1_DtrmnLCCS_steering_control_output "LCCS_subsystem_integrated/LCCS/DtrmnLCCS_steering_control_output" /begin SUB_GROUP S10_steering_control_machine /end SUB_GROUP /begin REF_MEASUREMENT VbLCCS_LCC_ReadyToEngage VfLCCS_steering_angle_diff_abs /end REF_MEASUREMENT /end GROUP
/begin GROUP S2_center_of_mass_projection "LCCS_subsystem_integrated/LCCS/CalcLCCS_compute_lateral_errors/center_of_mass_projection" /begin REF_CHARACTERISTIC KfLCCS_d_lr /end REF_CHARACTERISTIC /begin REF_MEASUREMENT VaLCCS_com_point VaLCCS_com_proj_point /end REF_MEASUREMENT /end GROUP
/begin GROUP S2_compute_lateral_errors "LCCS_subsystem_integrated/LCCS/CalcLCCS_compute_lateral_errors/compute_lateral_errors"
 /begin REF_CHARACTERISTIC KcLCCS_HeadingErrorRateSmooth KfLCCS_heading_error_rate_limit /end REF_CHARACTERISTIC
 /begin REF_MEASUREMENT VfLCCS_heading_error VfLCCS_heading_error_rate VfLCCS_lateral_error VfLCCS_lateral_error_rate VfLCCS_lookahead_angle VfLCCS_preview_curvature /end REF_MEASUREMENT
/end GROUP
/begin GROUP S2_preview_point_projection "LCCS_subsystem_integrated/LCCS/CalcLCCS_compute_lateral_errors/preview_point_projection" /begin REF_CHARACTERISTIC KfLCCS_d_lr /end REF_CHARACTERISTIC /begin REF_MEASUREMENT VaLCCS_preview_proj_point /end REF_MEASUREMENT /end GROUP
/begin GROUP S5_lateral_control "LCCS_subsystem_integrated/LCCS/CalcLCCS_lateral_control_main/lateral_control" /begin SUB_GROUP S53_slowpath_steer_PI /end SUB_GROUP
 /begin REF_CHARACTERISTIC KbLCCS_UsePurePursuit KfLCCS_Ang_slowpath_steer_limit KfLCCS_WeightMatrixStates_R KfLCCS_a_max_lat_acc KfLCCS_cf KfLCCS_cr KfLCCS_d_lf KfLCCS_d_lr KfLCCS_d_min_turn_radius KfLCCS_d_wheel_base KfLCCS_eps KfLCCS_iz KfLCCS_mass KfLCCS_r_UpdateStanleyK KtLCCS_WeightMatrixInputs_Q /end REF_CHARACTERISTIC
 /begin REF_MEASUREMENT VcLCCS_num_iteration VfLCCS_frtwhl_angle_limit_lat_acc VfLCCS_heading_error_contribution VfLCCS_heading_error_rate_contribution VfLCCS_lateral_error_contribution VfLCCS_lateral_error_rate_contribution VfLCCS_steer_angle_feedback VfLCCS_veh_frtwhl_angle_des /end REF_MEASUREMENT
/end GROUP
/begin GROUP S5_steering_wheel_angle "LCCS_subsystem_integrated/LCCS/CalcLCCS_lateral_control_main/steering_wheel_angle" /begin SUB_GROUP S54_angular_vel_limit /end SUB_GROUP /end GROUP
/begin GROUP S6_CalcLCCS_target_shift_width "LCCS_subsystem_integrated/LCCS/CalcLCCS_lateral_shift_width/CalcLCCS_target_shift_width" /begin REF_CHARACTERISTIC KfLCCS_d_NudgeSafetyZone KfLCCS_d_VehicleWidth /end REF_CHARACTERISTIC /begin REF_MEASUREMENT VfLCCS_target_lateral_shift_width /end REF_MEASUREMENT /end GROUP
/begin GROUP S9_check_signal_isNan "LCCS_subsystem_integrated/LCCS/DtrmnLCCS_sensor_signal_rationality/check_signal_isNan" /begin REF_MEASUREMENT VfLCCS_linear_velocity /end REF_MEASUREMENT /end GROUP
/begin GROUP S9_check_signal_isNan1 "LCCS_subsystem_integrated/LCCS/DtrmnLCCS_sensor_signal_rationality/check_signal_isNan1" /begin REF_MEASUREMENT VfLCCS_veh_heading_rel /end REF_MEASUREMENT /end GROUP
/begin GROUP S9_check_signal_isNan10 "LCCS_subsystem_integrated/LCCS/DtrmnLCCS_sensor_signal_rationality/check_signal_isNan10" /begin REF_MEASUREMENT VfLCCS_num_lane_markers /end REF_MEASUREMENT /end GROUP
/begin GROUP S9_check_signal_isNan12 "LCCS_subsystem_integrated/LCCS/DtrmnLCCS_sensor_signal_rationality/check_signal_isNan12" /begin REF_MEASUREMENT VbLCCS_lcc_feature_enable /end REF_MEASUREMENT /end GROUP
/begin GROUP S9_check_signal_isNan2 "LCCS_subsystem_integrated/LCCS/DtrmnLCCS_sensor_signal_rationality/check_signal_isNan2" /begin REF_MEASUREMENT VfLCCS_velocity_rel_x /end REF_MEASUREMENT /end GROUP
/begin GROUP S9_check_signal_isNan3 "LCCS_subsystem_integrated/LCCS/DtrmnLCCS_sensor_signal_rationality/check_signal_isNan3" /begin REF_MEASUREMENT VfLCCS_velocity_rel_y /end REF_MEASUREMENT /end GROUP
/begin GROUP S9_check_signal_isNan6 "LCCS_subsystem_integrated/LCCS/DtrmnLCCS_sensor_signal_rationality/check_signal_isNan6" /begin REF_MEASUREMENT VbLCCS_steer_control_enable /end REF_MEASUREMENT /end GROUP
/begin GROUP S9_check_signal_isNan8 "LCCS_subsystem_integrated/LCCS/DtrmnLCCS_sensor_signal_rationality/check_signal_isNan8" /begin REF_MEASUREMENT VcLCCS_VCU1_ICPV_EPSMODE /end REF_MEASUREMENT /end GROUP
/begin GROUP S9_check_signal_isNan9 "LCCS_subsystem_integrated/LCCS/DtrmnLCCS_sensor_signal_rationality/check_signal_isNan9" /begin REF_MEASUREMENT VfLCCS_VCU1_ICPV_StrAngle /end REF_MEASUREMENT /end GROUP
/begin GROUP S10_steering_control_machine "LCCS_subsystem_integrated/LCCS/DtrmnLCCS_steering_control_output/steering_control_machine" /begin REF_CHARACTERISTIC KfLCCS_t_SampleTime KfLCCS_t_lateral_movement_delay /end REF_CHARACTERISTIC
 /begin REF_MEASUREMENT VbLCCS_lateral_movement_enabled VbLCCS_steering_control_active VbLCCS_steering_control_engaged VbLCCS_steering_control_stable /end REF_MEASUREMENT
/end GROUP
/begin GROUP S53_slowpath_steer_PI "LCCS_subsystem_integrated/LCCS/CalcLCCS_lateral_control_main/lateral_control/slowpath_steer_PI" /begin REF_CHARACTERISTIC KfLCCS_t_SampleTime /end REF_CHARACTERISTIC
 /begin REF_MEASUREMENT VfLCCS_slowpath_steer_I VfLCCS_slowpath_steer_P VfLCCS_slowpath_steer_PI /end REF_MEASUREMENT
/end GROUP
/begin GROUP S54_angular_vel_limit "LCCS_subsystem_integrated/LCCS/CalcLCCS_lateral_control_main/steering_wheel_angle/angular_vel_limit"
 /begin SUB_GROUP S67_frontwheel_2_steeringwheel S67_rate_limit S67_steering_angle_limit /end SUB_GROUP
/end GROUP
/begin GROUP S67_frontwheel_2_steeringwheel "LCCS_subsystem_integrated/LCCS/CalcLCCS_lateral_control_main/steering_wheel_angle/angular_vel_limit/frontwheel_2_steeringwheel"
 /begin REF_CHARACTERISTIC KfLCCS_Ang_steering_center_position KfLCCS_r_veh_strwhl_2_frtwhl_ratio /end REF_CHARACTERISTIC
 /begin REF_MEASUREMENT VfLCCS_veh_strwhl_angle_des /end REF_MEASUREMENT
/end GROUP
/begin GROUP S67_rate_limit "LCCS_subsystem_integrated/LCCS/CalcLCCS_lateral_control_main/steering_wheel_angle/angular_vel_limit/rate_limit" /begin REF_CHARACTERISTIC KfLCCS_r_steering_rate_forward_gain /end REF_CHARACTERISTIC
 /begin REF_MEASUREMENT VfLCCS_frtwhl_angle_step_limit VfLCCS_veh_frtwhl_angle_des_ramped /end REF_MEASUREMENT
/end GROUP
/begin GROUP S67_steering_angle_limit "LCCS_subsystem_integrated/LCCS/CalcLCCS_lateral_control_main/steering_wheel_angle/angular_vel_limit/steering_angle_limit" /begin REF_CHARACTERISTIC KfLCCS_r_veh_strwhl_2_frtwhl_ratio KfLCCS_t_SampleTime /end REF_CHARACTERISTIC /begin REF_MEASUREMENT VfLCCS_frtwhl_angle_limit_manual /end REF_MEASUREMENT /end GROUP
/begin GROUP LCWS_subsystem_integrated "LCWS_subsystem_integrated" ROOT /begin SUB_GROUP Root_LCWS_Subsystem /end SUB_GROUP /end GROUP
/begin GROUP Root_LCWS_Subsystem "LCWS_subsystem_integrated/LCWS_Subsystem"
 /begin SUB_GROUP S1_CalcLLCWEnabledSubsystem S1_CalcRLCWEnabledSubsystem S1_Dtmn_Subsystem S1_input_Subsystem /end SUB_GROUP
/end GROUP
/begin GROUP S1_CalcLLCWEnabledSubsystem "LCWS_subsystem_integrated/LCWS_Subsystem/CalcLLCWEnabledSubsystem"
 /begin REF_MEASUREMENT VeLCWS_left_warning_status ViLCWS_bswL ViLCWS_bswL_ID ViLCWS_cvwL ViLCWS_cvwL_ID /end REF_MEASUREMENT
/end GROUP
/begin GROUP S1_CalcRLCWEnabledSubsystem "LCWS_subsystem_integrated/LCWS_Subsystem/CalcRLCWEnabledSubsystem"
 /begin REF_MEASUREMENT VeLCWS_right_warning_status ViLCWS_bswR ViLCWS_bswR_ID ViLCWS_cvwR ViLCWS_cvwR_ID /end REF_MEASUREMENT
/end GROUP
/begin GROUP S1_Dtmn_Subsystem "LCWS_subsystem_integrated/LCWS_Subsystem/Dtmn_Subsystem" /begin REF_MEASUREMENT VeLCWS_active_status /end REF_MEASUREMENT /end GROUP
/begin GROUP S1_input_Subsystem "LCWS_subsystem_integrated/LCWS_Subsystem/input_Subsystem"
 /begin SUB_GROUP S5_Calibration_Subsystem S5_CvrtInput_Subsystem S5_CvrtObtVecFunctionEnabled /end SUB_GROUP
/end GROUP
/begin GROUP S5_Calibration_Subsystem "LCWS_subsystem_integrated/LCWS_Subsystem/input_Subsystem/Calibration_Subsystem"
 /begin REF_CHARACTERISTIC KbLCWS_Switch KfLCWS_c_DisbleCurveThrshMax KfLCWS_c_EnbleCurveThrshMax KfLCWS_d_BSDLargerZone_BackDis KfLCWS_d_BSDLargerZone_FarDis KfLCWS_d_BSDLargerZone_FrontDis KfLCWS_d_BSDLargerZone_NearDis KfLCWS_d_BSDZone_BackDis KfLCWS_d_BSDZone_Eye95Dis KfLCWS_d_BSDZone_FarDis KfLCWS_d_BSDZone_FrontDis KfLCWS_d_BSDZone_NearDis KfLCWS_d_CVLargerZone_FrontDis KfLCWS_d_CVZone_FrontDis KfLCWS_d_NearDisHiLevel KfLCWS_d_VehLenth KfLCWS_d_VehWidth KfLCWS_r_ObtWidthProportion KfLCWS_t_TTCLargerThrsh_LowLevel KfLCWS_t_TTCThrshHiLevel KfLCWS_t_TTCThrshLowLevel KfLCWS_v_DisbleVehSpdThrshHi KfLCWS_v_DisbleVehSpdThrshLo KfLCWS_v_EnbleVehSpdThrshHi KfLCWS_v_EnbleVehSpdThrshLo KfLCWS_v_LatSpdThr KfLCWS_v_OncomRelSpdThrshHi_in KfLCWS_v_OncomRelSpdThrshHi_out /end REF_CHARACTERISTIC
/end GROUP
/begin GROUP S5_CvrtInput_Subsystem "LCWS_subsystem_integrated/LCWS_Subsystem/input_Subsystem/CvrtInput_Subsystem" /begin REF_MEASUREMENT VfLCWS_curvature VfLCWS_gear_in VfLCWS_speed_in /end REF_MEASUREMENT /end GROUP
/begin GROUP S5_CvrtObtVecFunctionEnabled "LCWS_subsystem_integrated/LCWS_Subsystem/input_Subsystem/CvrtObtVecFunctionEnabled" /begin REF_CHARACTERISTIC KbLCWS_ObtStaticIn /end REF_CHARACTERISTIC
 /begin REF_MEASUREMENT VaLCWS_ObtR VaLCWS_Vx_in VaLCWS_Vy_in VaLCWS_heading_in VaLCWS_id_in VaLCWS_motion_status_in VaLCWS_nearest_point_rel_x_in VaLCWS_nearest_point_rel_y_in VaLCWS_obt_lenth_in VaLCWS_obt_width_in VaLCWS_orientation_in VaLCWS_position_zone_in VaLCWS_type VaLCWS_x_in VaLCWS_y_in VnLCWS_num_L VnLCWS_num_R VnLCWS_num_in /end REF_MEASUREMENT
/end GROUP
/begin GROUP LDWS_subsystem_integrated "LDWS_subsystem_integrated" ROOT /begin SUB_GROUP Root_LDWS_subsystem_integrated /end SUB_GROUP /end GROUP
/begin GROUP Root_LDWS_subsystem_integrated "LDWS_subsystem_integrated/LDWS_subsystem_integrated"
 /begin SUB_GROUP S1_Derivation S1_EnablingManager S1_LnMkrFilter S1_OutputManager S1_Road_Enable_Estimator S1_SuppressionManager S1_TriggerManager S1_WarningManager /end SUB_GROUP
 /begin REF_CHARACTERISTIC KbLDWS_WarnAllowed /end REF_CHARACTERISTIC
/end GROUP
/begin GROUP S1_Derivation "LDWS_subsystem_integrated/LDWS_subsystem_integrated/Derivation" /begin REF_MEASUREMENT VfLDWS_SteerAngleRate /end REF_MEASUREMENT /end GROUP
/begin GROUP S1_EnablingManager "LDWS_subsystem_integrated/LDWS_subsystem_integrated/EnablingManager" /begin SUB_GROUP S3_ResetCondition S3_SR_FF S3_SetCondition /end SUB_GROUP
 /begin REF_CHARACTERISTIC KfLDWS_c_CurvLwrBnd KfLDWS_c_CurvUprBnd KfLDWS_d_LnWidthLwrBnd KfLDWS_d_LnWidthUprBnd KfLDWS_v_SpdLwrBnd KfLDWS_v_SpdUprBnd /end REF_CHARACTERISTIC
 /begin REF_MEASUREMENT VbLDWS_CurvValid VbLDWS_LnMkrValid VbLDWS_SpdRngValid VbLDWS_WidthValid /end REF_MEASUREMENT
/end GROUP
/begin GROUP S1_LnMkrFilter "LDWS_subsystem_integrated/LDWS_subsystem_integrated/LnMkrFilter" /begin SUB_GROUP S4_Filter_Left S4_Filter_Right /end SUB_GROUP
 /begin REF_MEASUREMENT VfLDWS_BackToLeDist VfLDWS_Curvature VfLDWS_LeC1Filtd VfLDWS_RiC1Filtd /end REF_MEASUREMENT
/end GROUP
/begin GROUP S1_OutputManager "LDWS_subsystem_integrated/LDWS_subsystem_integrated/OutputManager" /begin REF_MEASUREMENT VbLDWS_WrnSt VeLDWS_LaDetecSt VeLDWS_WrnSd /end REF_MEASUREMENT /end GROUP
/begin GROUP S1_Road_Enable_Estimator "LDWS_subsystem_integrated/LDWS_subsystem_integrated/Road_Enable_Estimator" /begin SUB_GROUP S6_Subsystem S6_Subsystem1 /end SUB_GROUP /end GROUP
/begin GROUP S1_SuppressionManager "LDWS_subsystem_integrated/LDWS_subsystem_integrated/SuppressionManager" /begin SUB_GROUP S7_DtrmnSuppLe S7_DtrmnSuppRi /end SUB_GROUP /begin REF_CHARACTERISTIC KbLDWS_SuppLeSwitch KbLDWS_SuppRiSwitch /end REF_CHARACTERISTIC
 /begin REF_MEASUREMENT VfLDWS_LeIndicatorSt VfLDWS_RiIndicatorSt VfLDWS_SteerTorque /end REF_MEASUREMENT
/end GROUP
/begin GROUP S1_TriggerManager "LDWS_subsystem_integrated/LDWS_subsystem_integrated/TriggerManager"
 /begin SUB_GROUP S8_DtrmnActLe S8_DtrmnActRi S8_LanePositionConstraint S8_LeadDirectionCondition S8_TTLCondition S8_ThetaCalc S8_VehicleToBdlnCalc /end SUB_GROUP
 /begin REF_MEASUREMENT VbLDWS_ActLeLDW VbLDWS_ActRiLDW VfLDWS_BackToRiDist VfLDWS_SteerAngle VfLDWS_Vx VfLDWS_Vy /end REF_MEASUREMENT
/end GROUP
/begin GROUP S1_WarningManager "LDWS_subsystem_integrated/LDWS_subsystem_integrated/WarningManager"
 /begin REF_CHARACTERISTIC KbLDWS_EnableSwitch KcLDWS_CntSample KfLDWS_t_CntMaxWarnHold KfLDWS_t_CntMinWarnHold KfLDWS_t_CntOnHold /end REF_CHARACTERISTIC
 /begin REF_MEASUREMENT VeLDWS_OnStateSt VeLDWS_SysSt /end REF_MEASUREMENT
/end GROUP
/begin GROUP S3_ResetCondition "LDWS_subsystem_integrated/LDWS_subsystem_integrated/EnablingManager/ResetCondition"
 /begin REF_CHARACTERISTIC KcLDWS_CntSample KfLDWS_t_CurvNotValidTime KfLDWS_t_LnMkrNotValidTime KfLDWS_t_LnWidthNotValidTime KfLDWS_t_SpdRngNotValidTime /end REF_CHARACTERISTIC
/end GROUP
/begin GROUP S3_SR_FF "LDWS_subsystem_integrated/LDWS_subsystem_integrated/EnablingManager/SR_FF" /begin REF_MEASUREMENT VbLDWS_EnabledLDW /end REF_MEASUREMENT /end GROUP
/begin GROUP S3_SetCondition "LDWS_subsystem_integrated/LDWS_subsystem_integrated/EnablingManager/SetCondition"
 /begin REF_CHARACTERISTIC KcLDWS_CntSample KfLDWS_t_CurvValidTime KfLDWS_t_LnMkrValidTime KfLDWS_t_LnWidthValidTime KfLDWS_t_SpdRngValidTime /end REF_CHARACTERISTIC
/end GROUP
/begin GROUP S4_Filter_Left "LDWS_subsystem_integrated/LDWS_subsystem_integrated/LnMkrFilter/Filter_Left" /begin REF_MEASUREMENT VfLDWS_LeC0Filtd /end REF_MEASUREMENT /end GROUP
/begin GROUP S4_Filter_Right "LDWS_subsystem_integrated/LDWS_subsystem_integrated/LnMkrFilter/Filter_Right" /begin REF_MEASUREMENT VfLDWS_RiC0Filtd /end REF_MEASUREMENT /end GROUP
/begin GROUP S6_Subsystem "LDWS_subsystem_integrated/LDWS_subsystem_integrated/Road_Enable_Estimator/Subsystem" /begin REF_CHARACTERISTIC KcLDWS_CntSample KfLDWS_r_LaMkrQlt KfLDWS_t_LnMkrMissThrsh /end REF_CHARACTERISTIC /begin REF_MEASUREMENT VbLDWS_RdEnblLe /end REF_MEASUREMENT /end GROUP
/begin GROUP S6_Subsystem1 "LDWS_subsystem_integrated/LDWS_subsystem_integrated/Road_Enable_Estimator/Subsystem1" /begin REF_CHARACTERISTIC KcLDWS_CntSample KfLDWS_r_LaMkrQlt KfLDWS_t_LnMkrMissThrsh /end REF_CHARACTERISTIC /begin REF_MEASUREMENT VbLDWS_RdEnblRi /end REF_MEASUREMENT /end GROUP
/begin GROUP S7_DtrmnSuppLe "LDWS_subsystem_integrated/LDWS_subsystem_integrated/SuppressionManager/DtrmnSuppLe"
 /begin REF_CHARACTERISTIC KcLDWS_CntSample KfLDWS_Ang_SuppSteerAngThrsh KfLDWS_M_SuppTorque KfLDWS_t_SuppIndiTime KfLDWS_t_SuppSteerAngTime KfLDWS_t_SuppSteerRateTime KfLDWS_t_SuppTorqueTime KfLDWS_v_SuppSteerRateThrsh /end REF_CHARACTERISTIC
 /begin REF_MEASUREMENT VbLDWS_SuppLe /end REF_MEASUREMENT
/end GROUP
/begin GROUP S7_DtrmnSuppRi "LDWS_subsystem_integrated/LDWS_subsystem_integrated/SuppressionManager/DtrmnSuppRi"
 /begin REF_CHARACTERISTIC KcLDWS_CntSample KfLDWS_Ang_SuppSteerAngThrsh KfLDWS_M_SuppTorque KfLDWS_t_SuppIndiTime KfLDWS_t_SuppSteerAngTime KfLDWS_t_SuppSteerRateTime KfLDWS_t_SuppTorqueTime KfLDWS_v_SuppSteerRateThrsh /end REF_CHARACTERISTIC
 /begin REF_MEASUREMENT VbLDWS_SuppRi /end REF_MEASUREMENT
/end GROUP
/begin GROUP S8_DtrmnActLe "LDWS_subsystem_integrated/LDWS_subsystem_integrated/TriggerManager/DtrmnActLe" /begin REF_CHARACTERISTIC KfLDWS_t_TLCThrsh /end REF_CHARACTERISTIC /end GROUP
/begin GROUP S8_DtrmnActRi "LDWS_subsystem_integrated/LDWS_subsystem_integrated/TriggerManager/DtrmnActRi" /begin REF_CHARACTERISTIC KfLDWS_t_TLCThrsh /end REF_CHARACTERISTIC /end GROUP
/begin GROUP S8_LanePositionConstraint "LDWS_subsystem_integrated/LDWS_subsystem_integrated/TriggerManager/LanePositionConstraint" /begin SUB_GROUP S46_DtrmnIsOnLeLine S46_DtrmnIsOnRiLine /end SUB_GROUP /end GROUP
/begin GROUP S8_LeadDirectionCondition "LDWS_subsystem_integrated/LDWS_subsystem_integrated/TriggerManager/LeadDirectionCondition" /begin REF_MEASUREMENT VbLDWS_LeadDrctn /end REF_MEASUREMENT /end GROUP
/begin GROUP S8_TTLCondition "LDWS_subsystem_integrated/LDWS_subsystem_integrated/TriggerManager/TTLCondition" /begin SUB_GROUP S48_TLC_calculation S48_v_lat_calculation /end SUB_GROUP /end GROUP
/begin GROUP S8_ThetaCalc "LDWS_subsystem_integrated/LDWS_subsystem_integrated/TriggerManager/ThetaCalc" /begin REF_CHARACTERISTIC KbLDWS_ThetaSwitch /end REF_CHARACTERISTIC /begin REF_MEASUREMENT VfLDWS_Theta /end REF_MEASUREMENT /end GROUP
/begin GROUP S8_VehicleToBdlnCalc "LDWS_subsystem_integrated/LDWS_subsystem_integrated/TriggerManager/VehicleToBdlnCalc"
 /begin REF_CHARACTERISTIC KfLDWS_Ang_BkToCnrAng KfLDWS_c_CurvUprBnd KfLDWS_d_BkToFrtCnrDist KfLDWS_d_EdgBuff KfLDWS_k_CurvBuffCoe /end REF_CHARACTERISTIC
 /begin REF_MEASUREMENT VfLDWS_EdgeLaneLe VfLDWS_EdgeLaneRi /end REF_MEASUREMENT
/end GROUP
/begin GROUP S46_DtrmnIsOnLeLine "LDWS_subsystem_integrated/LDWS_subsystem_integrated/TriggerManager/LanePositionConstraint/DtrmnIsOnLeLine"
 /begin REF_CHARACTERISTIC KfLDWS_d_WarnLineLvlOne KfLDWS_d_WarnLineLvlThree KfLDWS_k_WarnLineLvlTwo /end REF_CHARACTERISTIC
 /begin REF_MEASUREMENT VbLDWS_IsOnLeLine /end REF_MEASUREMENT
/end GROUP
/begin GROUP S46_DtrmnIsOnRiLine "LDWS_subsystem_integrated/LDWS_subsystem_integrated/TriggerManager/LanePositionConstraint/DtrmnIsOnRiLine"
 /begin REF_CHARACTERISTIC KfLDWS_d_WarnLineLvlOne KfLDWS_d_WarnLineLvlThree KfLDWS_k_WarnLineLvlTwo /end REF_CHARACTERISTIC
 /begin REF_MEASUREMENT VbLDWS_IsOnRiLine /end REF_MEASUREMENT
/end GROUP
/begin GROUP S48_TLC_calculation "LDWS_subsystem_integrated/LDWS_subsystem_integrated/TriggerManager/TTLCondition/TLC_calculation" /begin REF_MEASUREMENT VfLDWS_TLCLe VfLDWS_TLCRi /end REF_MEASUREMENT /end GROUP
/begin GROUP S48_v_lat_calculation "LDWS_subsystem_integrated/LDWS_subsystem_integrated/TriggerManager/TTLCondition/v_lat_calculation" /begin REF_MEASUREMENT VfLDWS_VLatLe VfLDWS_VLatRi /end REF_MEASUREMENT /end GROUP
/begin GROUP bsw_critical_variable "bsw_critical_variable" ROOT /begin SUB_GROUP BSW_Thruput_Measure /end SUB_GROUP /end GROUP
/begin GROUP BSW_Thruput_Measure "BSW_Thruput_Measure" /begin REF_MEASUREMENT ADCtrl_Thruput_MS os_core0_tick_cnt /end REF_MEASUREMENT /end GROUP
/end MODULE
/end PROJECT
