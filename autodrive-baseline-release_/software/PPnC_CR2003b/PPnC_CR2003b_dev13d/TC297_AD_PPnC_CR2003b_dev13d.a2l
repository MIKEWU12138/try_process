ASAP2_VERSION 1 60
/begin PROJECT hj_adcu "_default_ProjectLongIdentifier"
/begin HEADER "_default_HeaderComment" PROJECT_NO _default_ProjectNr /end HEADER
/begin MODULE _default_ModuleName "_default_ModuleLongIdentifier"
/begin MOD_COMMON "_default_ModCommonComment" DEPOSIT ABSOLUTE BYTE_ORDER MSB_LAST ALIGNMENT_BYTE 1 ALIGNMENT_WORD 2 ALIGNMENT_LONG 4 ALIGNMENT_FLOAT32_IEEE 4 ALIGNMENT_FLOAT64_IEEE 4 /end MOD_COMMON
/begin MOD_COMMON "Mod Common Comment Here" BYTE_ORDER MSB_LAST /end MOD_COMMON
/begin RECORD_LAYOUT Scalar_BOOLEAN FNC_VALUES 1 UBYTE COLUMN_DIR DIRECT /end RECORD_LAYOUT
/begin RECORD_LAYOUT Scalar_UBYTE FNC_VALUES 1 UBYTE COLUMN_DIR DIRECT /end RECORD_LAYOUT
/begin RECORD_LAYOUT Scalar_FLOAT32_IEEE FNC_VALUES 1 FLOAT32_IEEE COLUMN_DIR DIRECT /end RECORD_LAYOUT
/begin RECORD_LAYOUT Lookup1D_X_UBYTE AXIS_PTS_X 1 UBYTE INDEX_INCR DIRECT /end RECORD_LAYOUT
/begin RECORD_LAYOUT Lookup1D_UWORD FNC_VALUES 1 UWORD COLUMN_DIR DIRECT /end RECORD_LAYOUT
/begin RECORD_LAYOUT Lookup1D_X_UWORD AXIS_PTS_X 1 UWORD INDEX_INCR DIRECT /end RECORD_LAYOUT
/begin RECORD_LAYOUT Lookup1D_WORD FNC_VALUES 1 SWORD COLUMN_DIR DIRECT /end RECORD_LAYOUT
/begin RECORD_LAYOUT Lookup1D_X_WORD AXIS_PTS_X 1 SWORD INDEX_INCR DIRECT /end RECORD_LAYOUT
/begin RECORD_LAYOUT Lookup1D_ULONG FNC_VALUES 1 ULONG COLUMN_DIR DIRECT /end RECORD_LAYOUT
/begin RECORD_LAYOUT Lookup1D_X_ULONG AXIS_PTS_X 1 ULONG INDEX_INCR DIRECT /end RECORD_LAYOUT
/begin RECORD_LAYOUT Lookup1D_SLONG FNC_VALUES 1 SLONG COLUMN_DIR DIRECT /end RECORD_LAYOUT
/begin RECORD_LAYOUT Lookup1D_X_LONG AXIS_PTS_X 1 SLONG INDEX_INCR DIRECT /end RECORD_LAYOUT
/begin RECORD_LAYOUT Lookup1D_FLOAT32_IEEE FNC_VALUES 1 FLOAT32_IEEE COLUMN_DIR DIRECT /end RECORD_LAYOUT
/begin RECORD_LAYOUT Lookup1D_X_FLOAT32_IEEE AXIS_PTS_X 1 FLOAT32_IEEE INDEX_INCR DIRECT /end RECORD_LAYOUT
/begin RECORD_LAYOUT Lookup1D_FLOAT64_IEEE FNC_VALUES 1 FLOAT64_IEEE COLUMN_DIR DIRECT /end RECORD_LAYOUT
/begin CHARACTERISTIC KtAEBS_a_BrakeValueLimit "" CURVE 0x701011fc /* @ECU_Address@KtAEBS_a_BrakeValueLimit@ */ Lookup1D_FLOAT32_IEEE 0 AEBS_subsystem_integrated_CM_single -3.4E+38 3.4E+38
 /begin AXIS_DESCR COM_AXIS NO_INPUT_QUANTITY AEBS_subsystem_integrated_CM_single 10 -3.4E+38 3.4E+38 AXIS_PTS_REF KaAEBS_AXIS_Veh_Curvature_vec /end AXIS_DESCR
/end CHARACTERISTIC
/begin CHARACTERISTIC KfAEBS_Change_LateralPosThrsh "Object change lateral position threshold" VALUE 0x70101544 /* @ECU_Address@KfAEBS_Change_LateralPosThrsh@ */ Scalar_FLOAT32_IEEE 0 AEBS_subsystem_integrated_CM_single -3.4E+38 3.4E+38 /end CHARACTERISTIC
/begin CHARACTERISTIC KfAEBS_Change_LonglPosThrsh "Object change longitudinal position threshold" VALUE 0x70101540 /* @ECU_Address@KfAEBS_Change_LonglPosThrsh@ */ Scalar_FLOAT32_IEEE 0 AEBS_subsystem_integrated_CM_single -3.4E+38 3.4E+38 /end CHARACTERISTIC
/begin CHARACTERISTIC KfAEBS_SpdMinOvrdAccrResetInCllsnRednByBrkg "" VALUE 0x701014f0 /* @ECU_Address@KfAEBS_SpdMinOvrdAccrResetInCllsnRednByBrkg@ */ Scalar_FLOAT32_IEEE 0 AEBS_subsystem_integrated_CM_single -3.4E+38 3.4E+38 /end CHARACTERISTIC
/begin CHARACTERISTIC KfAEBS_SteerRate_Limit_hi "" VALUE 0x701014ec /* @ECU_Address@KfAEBS_SteerRate_Limit_hi@ */ Scalar_FLOAT32_IEEE 0 AEBS_subsystem_integrated_CM_single -3.4E+38 3.4E+38 /end CHARACTERISTIC
/begin CHARACTERISTIC KfAEBS_SteerRate_Limit_lo "" VALUE 0x701014e8 /* @ECU_Address@KfAEBS_SteerRate_Limit_lo@ */ Scalar_FLOAT32_IEEE 0 AEBS_subsystem_integrated_CM_single -3.4E+38 3.4E+38 /end CHARACTERISTIC
/begin CHARACTERISTIC KfAEBS_Test_CeterYVIP "" VALUE 0x701014e4 /* @ECU_Address@KfAEBS_Test_CeterYVIP@ */ Scalar_FLOAT32_IEEE 0 AEBS_subsystem_integrated_CM_single -3.4E+38 3.4E+38 /end CHARACTERISTIC
/begin CHARACTERISTIC KfAEBS_Test_DeltaDisVIP "" VALUE 0x701014e0 /* @ECU_Address@KfAEBS_Test_DeltaDisVIP@ */ Scalar_FLOAT32_IEEE 0 AEBS_subsystem_integrated_CM_single -3.4E+38 3.4E+38 /end CHARACTERISTIC
/begin CHARACTERISTIC KfAEBS_Test_DeltaSpeedVIP "" VALUE 0x701014dc /* @ECU_Address@KfAEBS_Test_DeltaSpeedVIP@ */ Scalar_FLOAT32_IEEE 0 AEBS_subsystem_integrated_CM_single -3.4E+38 3.4E+38 /end CHARACTERISTIC
/begin CHARACTERISTIC KfAEBS_Test_IDVIP "" VALUE 0x701014d8 /* @ECU_Address@KfAEBS_Test_IDVIP@ */ Scalar_FLOAT32_IEEE 0 AEBS_subsystem_integrated_CM_single -3.4E+38 3.4E+38 /end CHARACTERISTIC
/begin CHARACTERISTIC KfAEBS_Test_TTCVIP "" VALUE 0x701014d4 /* @ECU_Address@KfAEBS_Test_TTCVIP@ */ Scalar_FLOAT32_IEEE 0 AEBS_subsystem_integrated_CM_single -3.4E+38 3.4E+38 /end CHARACTERISTIC
/begin CHARACTERISTIC KfAEBS_VeloRectThrsdByBrkg "" VALUE 0x701014ac /* @ECU_Address@KfAEBS_VeloRectThrsdByBrkg@ */ Scalar_FLOAT32_IEEE 0 AEBS_subsystem_integrated_CM_single -3.4E+38 3.4E+38 /end CHARACTERISTIC
/begin CHARACTERISTIC KfAEBS_YawRate_Limit_hi "" VALUE 0x701014a8 /* @ECU_Address@KfAEBS_YawRate_Limit_hi@ */ Scalar_FLOAT32_IEEE 0 AEBS_subsystem_integrated_CM_single -3.4E+38 3.4E+38 /end CHARACTERISTIC
/begin CHARACTERISTIC KfAEBS_YawRate_Limit_lo "" VALUE 0x701014a4 /* @ECU_Address@KfAEBS_YawRate_Limit_lo@ */ Scalar_FLOAT32_IEEE 0 AEBS_subsystem_integrated_CM_single -3.4E+38 3.4E+38 /end CHARACTERISTIC
/begin CHARACTERISTIC KfAEBS_a_AreqRampRate "" VALUE 0x70101498 /* @ECU_Address@KfAEBS_a_AreqRampRate@ */ Scalar_FLOAT32_IEEE 0 AEBS_subsystem_integrated_CM_single -3.4E+38 3.4E+38 /end CHARACTERISTIC
/begin CHARACTERISTIC KfAEBS_a_Areq_FullBrkActThrsd "Acceleration request full brake active threshold" VALUE 0x70101494 /* @ECU_Address@KfAEBS_a_Areq_FullBrkActThrsd@ */ Scalar_FLOAT32_IEEE 0 AEBS_subsystem_integrated_CM_single -3.4E+38 3.4E+38 /end CHARACTERISTIC
/begin CHARACTERISTIC KfAEBS_a_Areq_FullBrkDeactThrsd "Acceleration request full brake dactive threshold(Full brake 
      can be deactived only in a short period)" VALUE 0x70101490 /* @ECU_Address@KfAEBS_a_Areq_FullBrkDeactThrsd@ */ Scalar_FLOAT32_IEEE 0 AEBS_subsystem_integrated_CM_single -3.4E+38 3.4E+38 /end CHARACTERISTIC
/begin CHARACTERISTIC KfAEBS_a_Areq_ObjChangThrsd "When the object is changed, only when the new object's acceleration request
      is samller than a threshold, then, the AEB/FCW can be deactived." VALUE 0x7010148c /* @ECU_Address@KfAEBS_a_Areq_ObjChangThrsd@ */ Scalar_FLOAT32_IEEE 0 AEBS_subsystem_integrated_CM_single -3.4E+38 3.4E+38 /end CHARACTERISTIC
/begin CHARACTERISTIC KfAEBS_a_Areq_PartialBrkActThrsd "Acceleration request partial brake active threshold" VALUE 0x70101488 /* @ECU_Address@KfAEBS_a_Areq_PartialBrkActThrsd@ */ Scalar_FLOAT32_IEEE 0 AEBS_subsystem_integrated_CM_single -3.4E+38 3.4E+38 /end CHARACTERISTIC
/begin CHARACTERISTIC KfAEBS_a_Areq_PartialBrkDeactThrsd "Acceleration request partial brake deactive threshold" VALUE 0x70101484 /* @ECU_Address@KfAEBS_a_Areq_PartialBrkDeactThrsd@ */ Scalar_FLOAT32_IEEE 0 AEBS_subsystem_integrated_CM_single -3.4E+38 3.4E+38 /end CHARACTERISTIC
/begin CHARACTERISTIC KfAEBS_a_BrakeInit "In passensor protected stage,acceleration send at initial step" VALUE 0x7010147c /* @ECU_Address@KfAEBS_a_BrakeInit@ */ Scalar_FLOAT32_IEEE 0 AEBS_subsystem_integrated_CM_single -3.4E+38 3.4E+38 /end CHARACTERISTIC
/begin CHARACTERISTIC KfAEBS_a_BrakeMax "In passensor protected stage,acceleration send maximum" VALUE 0x70101478 /* @ECU_Address@KfAEBS_a_BrakeMax@ */ Scalar_FLOAT32_IEEE 0 AEBS_subsystem_integrated_CM_single -3.4E+38 3.4E+38 /end CHARACTERISTIC
/begin CHARACTERISTIC KfAEBS_a_Buffer "Acceleration send buffer in distance safe" VALUE 0x70101474 /* @ECU_Address@KfAEBS_a_Buffer@ */ Scalar_FLOAT32_IEEE 0 AEBS_subsystem_integrated_CM_single -3.4E+38 3.4E+38 /end CHARACTERISTIC
/begin CHARACTERISTIC KfAEBS_a_FullBrakeHi "Maximum decceleration send in full brake(ex. -5)" VALUE 0x70101470 /* @ECU_Address@KfAEBS_a_FullBrakeHi@ */ Scalar_FLOAT32_IEEE 0 AEBS_subsystem_integrated_CM_single -3.4E+38 3.4E+38 /end CHARACTERISTIC
/begin CHARACTERISTIC KfAEBS_a_FullBrakeLo "Minimum decceleration send in full brake(ex. -2.5)" VALUE 0x7010146c /* @ECU_Address@KfAEBS_a_FullBrakeLo@ */ Scalar_FLOAT32_IEEE 0 AEBS_subsystem_integrated_CM_single -3.4E+38 3.4E+38 /end CHARACTERISTIC
/begin CHARACTERISTIC KfAEBS_a_ObjUrgentBrake_Thrsh "" VALUE 0x70101468 /* @ECU_Address@KfAEBS_a_ObjUrgentBrake_Thrsh@ */ Scalar_FLOAT32_IEEE 0 AEBS_subsystem_integrated_CM_single -3.4E+38 3.4E+38 /end CHARACTERISTIC
/begin CHARACTERISTIC KfAEBS_a_PartialBrakeHi "Maximum decceleration send in partial brake(ex. -4)" VALUE 0x70101464 /* @ECU_Address@KfAEBS_a_PartialBrakeHi@ */ Scalar_FLOAT32_IEEE 0 AEBS_subsystem_integrated_CM_single -3.4E+38 3.4E+38 /end CHARACTERISTIC
/begin CHARACTERISTIC KfAEBS_a_PartialBrakeLo "Minimum decceleration send in partial brake(ex. -2)" VALUE 0x70101460 /* @ECU_Address@KfAEBS_a_PartialBrakeLo@ */ Scalar_FLOAT32_IEEE 0 AEBS_subsystem_integrated_CM_single -3.4E+38 3.4E+38 /end CHARACTERISTIC
/begin CHARACTERISTIC KfAEBS_d_Dis_Safe "Distance safe, when vehicle is stopped, the distance to obj" VALUE 0x70101450 /* @ECU_Address@KfAEBS_d_Dis_Safe@ */ Scalar_FLOAT32_IEEE 0 AEBS_subsystem_integrated_CM_single -3.4E+38 3.4E+38 /end CHARACTERISTIC
/begin CHARACTERISTIC KfAEBS_t_Speed_DebounceTime "Speed debounce time, used to estimate whether the vheicle is standstill" VALUE 0x70101448 /* @ECU_Address@KfAEBS_t_Speed_DebounceTime@ */ Scalar_FLOAT32_IEEE 0 AEBS_subsystem_integrated_CM_single -3.4E+38 3.4E+38 /end CHARACTERISTIC
/begin CHARACTERISTIC KfAEBS_t_TTC_DeactiveThrsh "TTC Deactive Thrsh" VALUE 0x70101444 /* @ECU_Address@KfAEBS_t_TTC_DeactiveThrsh@ */ Scalar_FLOAT32_IEEE 0 AEBS_subsystem_integrated_CM_single -3.4E+38 3.4E+38 /end CHARACTERISTIC
/begin CHARACTERISTIC KfAEBS_t_TTC_FCWLevel1ActiveThrsd "TTC FCW Level1 Active Thrsd" VALUE 0x70101440 /* @ECU_Address@KfAEBS_t_TTC_FCWLevel1ActiveThrsd@ */ Scalar_FLOAT32_IEEE 0 AEBS_subsystem_integrated_CM_single -3.4E+38 3.4E+38 /end CHARACTERISTIC
/begin CHARACTERISTIC KfAEBS_t_TTC_FCWLevel1DeactThrsd "TTC_FCW Level1 Deact Thrsd" VALUE 0x7010143c /* @ECU_Address@KfAEBS_t_TTC_FCWLevel1DeactThrsd@ */ Scalar_FLOAT32_IEEE 0 AEBS_subsystem_integrated_CM_single -3.4E+38 3.4E+38 /end CHARACTERISTIC
/begin CHARACTERISTIC KfAEBS_t_TTC_FCWLevel2ActiveThrsd "TTC FCW Level2 Active Thrsd" VALUE 0x70101438 /* @ECU_Address@KfAEBS_t_TTC_FCWLevel2ActiveThrsd@ */ Scalar_FLOAT32_IEEE 0 AEBS_subsystem_integrated_CM_single -3.4E+38 3.4E+38 /end CHARACTERISTIC
/begin CHARACTERISTIC KfAEBS_t_TTC_FCWLevel2DeactThrsd "TTC FCW Level2 Deact Thrsd" VALUE 0x70101434 /* @ECU_Address@KfAEBS_t_TTC_FCWLevel2DeactThrsd@ */ Scalar_FLOAT32_IEEE 0 AEBS_subsystem_integrated_CM_single -3.4E+38 3.4E+38 /end CHARACTERISTIC
/begin CHARACTERISTIC KfAEBS_t_TTC_FCWLevel3ActiveThrsd "TTC FCW Level3 Active Thrsd" VALUE 0x70101430 /* @ECU_Address@KfAEBS_t_TTC_FCWLevel3ActiveThrsd@ */ Scalar_FLOAT32_IEEE 0 AEBS_subsystem_integrated_CM_single -3.4E+38 3.4E+38 /end CHARACTERISTIC
/begin CHARACTERISTIC KfAEBS_t_TTC_FCWLevel3DeactThrsd "TTC FCW Level3 Deact Thrsd" VALUE 0x7010142c /* @ECU_Address@KfAEBS_t_TTC_FCWLevel3DeactThrsd@ */ Scalar_FLOAT32_IEEE 0 AEBS_subsystem_integrated_CM_single -3.4E+38 3.4E+38 /end CHARACTERISTIC
/begin CHARACTERISTIC KfAEBS_t_TTC_ObjChangThrsd "" VALUE 0x70101428 /* @ECU_Address@KfAEBS_t_TTC_ObjChangThrsd@ */ Scalar_FLOAT32_IEEE 0 AEBS_subsystem_integrated_CM_single -3.4E+38 3.4E+38 /end CHARACTERISTIC
/begin CHARACTERISTIC KfAEBS_t_TTC_PartialBrkActiveThrsd "TTC Partial Brk Active Thrsd" VALUE 0x70101424 /* @ECU_Address@KfAEBS_t_TTC_PartialBrkActiveThrsd@ */ Scalar_FLOAT32_IEEE 0 AEBS_subsystem_integrated_CM_single -3.4E+38 3.4E+38 /end CHARACTERISTIC
/begin CHARACTERISTIC KfAEBS_t_TTC_PartialBrkDeactiveThrsd "TTC Partial Brk Deactive Thrsd" VALUE 0x70101420 /* @ECU_Address@KfAEBS_t_TTC_PartialBrkDeactiveThrsd@ */ Scalar_FLOAT32_IEEE 0 AEBS_subsystem_integrated_CM_single -3.4E+38 3.4E+38 /end CHARACTERISTIC
/begin CHARACTERISTIC KfAEBS_t_TTC_PreBrkActiveThrsd "TTC PreBrk Active Thrsd" VALUE 0x7010141c /* @ECU_Address@KfAEBS_t_TTC_PreBrkActiveThrsd@ */ Scalar_FLOAT32_IEEE 0 AEBS_subsystem_integrated_CM_single -3.4E+38 3.4E+38 /end CHARACTERISTIC
/begin CHARACTERISTIC KfAEBS_t_TTC_PreBrkDeactThrsd "KfAEBS TTC PreBrk Deact Thrsd" VALUE 0x70101418 /* @ECU_Address@KfAEBS_t_TTC_PreBrkDeactThrsd@ */ Scalar_FLOAT32_IEEE 0 AEBS_subsystem_integrated_CM_single -3.4E+38 3.4E+38 /end CHARACTERISTIC
/begin CHARACTERISTIC KfAEBS_t_TimeBrakeThrsd "" VALUE 0x70101410 /* @ECU_Address@KfAEBS_t_TimeBrakeThrsd@ */ Scalar_FLOAT32_IEEE 0 AEBS_subsystem_integrated_CM_single -3.4E+38 3.4E+38 /end CHARACTERISTIC
/begin CHARACTERISTIC KfAEBS_t_Time_BrakeDelay "Time Brake Delay" VALUE 0x70101404 /* @ECU_Address@KfAEBS_t_Time_BrakeDelay@ */ Scalar_FLOAT32_IEEE 0 AEBS_subsystem_integrated_CM_single -3.4E+38 3.4E+38 /end CHARACTERISTIC
/begin CHARACTERISTIC KfAEBS_t_Time_BrakeInit "Time Brake Init" VALUE 0x70101400 /* @ECU_Address@KfAEBS_t_Time_BrakeInit@ */ Scalar_FLOAT32_IEEE 0 AEBS_subsystem_integrated_CM_single -3.4E+38 3.4E+38 /end CHARACTERISTIC
/begin CHARACTERISTIC KfAEBS_t_Time_BrakeRamp "Time Brake Ramp" VALUE 0x701013fc /* @ECU_Address@KfAEBS_t_Time_BrakeRamp@ */ Scalar_FLOAT32_IEEE 0 AEBS_subsystem_integrated_CM_single -3.4E+38 3.4E+38 /end CHARACTERISTIC
/begin CHARACTERISTIC KfAEBS_t_Time_HasNoVIPDelay "Time Has No VIP Delay" VALUE 0x701013f8 /* @ECU_Address@KfAEBS_t_Time_HasNoVIPDelay@ */ Scalar_FLOAT32_IEEE 0 AEBS_subsystem_integrated_CM_single -3.4E+38 3.4E+38 /end CHARACTERISTIC
/begin CHARACTERISTIC KfAEBS_t_Time_ObjUrgentBrk "" VALUE 0x701013f0 /* @ECU_Address@KfAEBS_t_Time_ObjUrgentBrk@ */ Scalar_FLOAT32_IEEE 0 AEBS_subsystem_integrated_CM_single -3.4E+38 3.4E+38 /end CHARACTERISTIC
/begin CHARACTERISTIC KfAEBS_t_Time_ResetVeloRdctThrsd "" VALUE 0x701013ec /* @ECU_Address@KfAEBS_t_Time_ResetVeloRdctThrsd@ */ Scalar_FLOAT32_IEEE 0 AEBS_subsystem_integrated_CM_single -3.4E+38 3.4E+38 /end CHARACTERISTIC
/begin CHARACTERISTIC KfAEBS_t_Time_TTCHLInhibitAEB "" VALUE 0x701013e8 /* @ECU_Address@KfAEBS_t_Time_TTCHLInhibitAEB@ */ Scalar_FLOAT32_IEEE 0 AEBS_subsystem_integrated_CM_single -3.4E+38 3.4E+38 /end CHARACTERISTIC
/begin CHARACTERISTIC KfAEBS_t_Time_TwiceAEBActive "" VALUE 0x701013e4 /* @ECU_Address@KfAEBS_t_Time_TwiceAEBActive@ */ Scalar_FLOAT32_IEEE 0 AEBS_subsystem_integrated_CM_single -3.4E+38 3.4E+38 /end CHARACTERISTIC
/begin CHARACTERISTIC KfAEBS_t_fb_active_delay_turn "" VALUE 0x701013e0 /* @ECU_Address@KfAEBS_t_fb_active_delay_turn@ */ Scalar_FLOAT32_IEEE 0 AEBS_subsystem_integrated_CM_single -3.4E+38 3.4E+38 /end CHARACTERISTIC
/begin CHARACTERISTIC KfAEBS_t_pb_active_delay_turn "" VALUE 0x701013dc /* @ECU_Address@KfAEBS_t_pb_active_delay_turn@ */ Scalar_FLOAT32_IEEE 0 AEBS_subsystem_integrated_CM_single -3.4E+38 3.4E+38 /end CHARACTERISTIC
/begin CHARACTERISTIC KfAEBS_v_ObjUrgentBrk_speed_Thrsh "" VALUE 0x701013d4 /* @ECU_Address@KfAEBS_v_ObjUrgentBrk_speed_Thrsh@ */ Scalar_FLOAT32_IEEE 0 AEBS_subsystem_integrated_CM_single -3.4E+38 3.4E+38 /end CHARACTERISTIC
/begin CHARACTERISTIC KfAEBS_v_SpeedLLThrshOvrrd "" VALUE 0x701013d0 /* @ECU_Address@KfAEBS_v_SpeedLLThrshOvrrd@ */ Scalar_FLOAT32_IEEE 0 AEBS_subsystem_integrated_CM_single -3.4E+38 3.4E+38 /end CHARACTERISTIC
/begin CHARACTERISTIC KfAEBS_v_SpeedRelLThrshOvrrd "" VALUE 0x701013cc /* @ECU_Address@KfAEBS_v_SpeedRelLThrshOvrrd@ */ Scalar_FLOAT32_IEEE 0 AEBS_subsystem_integrated_CM_single -3.4E+38 3.4E+38 /end CHARACTERISTIC
/begin CHARACTERISTIC KfAEBS_v_Speed_DeltaStStThrsh "delta speed, used to estimate whether the vheicle is standstill" VALUE 0x701013c8 /* @ECU_Address@KfAEBS_v_Speed_DeltaStStThrsh@ */ Scalar_FLOAT32_IEEE 0 AEBS_subsystem_integrated_CM_single -3.4E+38 3.4E+38 /end CHARACTERISTIC
/begin CHARACTERISTIC KfAEBS_v_Speed_MaxInhibitAEB "The speed to active AEB" VALUE 0x701013c0 /* @ECU_Address@KfAEBS_v_Speed_MaxInhibitAEB@ */ Scalar_FLOAT32_IEEE 0 AEBS_subsystem_integrated_CM_single -3.4E+38 3.4E+38 /end CHARACTERISTIC
/begin CHARACTERISTIC KfAEBS_v_Speed_StandStillThrsh "Speed, used to estimate whether the vheicle is standstill" VALUE 0x701013b4 /* @ECU_Address@KfAEBS_v_Speed_StandStillThrsh@ */ Scalar_FLOAT32_IEEE 0 AEBS_subsystem_integrated_CM_single -3.4E+38 3.4E+38 /end CHARACTERISTIC
/begin CHARACTERISTIC KfAEBS_AccPedelThrshOvrrd "Acc Pedel threshold when override" VALUE 0x701011c6 /* @ECU_Address@KfAEBS_AccPedelThrshOvrrd@ */ Scalar_UBYTE 0 AEBS_subsystem_integrated_CM_uint8 0 255 /end CHARACTERISTIC
/begin CHARACTERISTIC KfAEBS_Gear_Value_R "Gear_Value_R" VALUE 0x701011c2 /* @ECU_Address@KfAEBS_Gear_Value_R@ */ Scalar_UBYTE 0 AEBS_subsystem_integrated_CM_uint8 0 255 /end CHARACTERISTIC
/begin CHARACTERISTIC KfAEBS_LoPosValInCllsnRednByBrkg "" VALUE 0x701011c1 /* @ECU_Address@KfAEBS_LoPosValInCllsnRednByBrkg@ */ Scalar_UBYTE 0 AEBS_subsystem_integrated_CM_uint8 0 255 /end CHARACTERISTIC
/begin CHARACTERISTIC KbAEBS_Active_LeftTurn "Left turn collision mitigation active" VALUE 0x701011c0 /* @ECU_Address@KbAEBS_Active_LeftTurn@ */ Scalar_BOOLEAN 0 AEBS_subsystem_integrated_CM_boolean 0 1 /end CHARACTERISTIC
/begin CHARACTERISTIC KbAEBS_Active_RightTurn "Right turn collision mitigation active" VALUE 0x701011bf /* @ECU_Address@KbAEBS_Active_RightTurn@ */ Scalar_BOOLEAN 0 AEBS_subsystem_integrated_CM_boolean 0 1 /end CHARACTERISTIC
/begin CHARACTERISTIC KbAEBS_Active_Straight "Ego go straight collision mitigation active" VALUE 0x701011be /* @ECU_Address@KbAEBS_Active_Straight@ */ Scalar_BOOLEAN 0 AEBS_subsystem_integrated_CM_boolean 0 1 /end CHARACTERISTIC
/begin CHARACTERISTIC KbAEBS_AllowOverride "Allow driver override" VALUE 0x701011bd /* @ECU_Address@KbAEBS_AllowOverride@ */ Scalar_BOOLEAN 0 AEBS_subsystem_integrated_CM_boolean 0 1 /end CHARACTERISTIC
/begin CHARACTERISTIC KbAEBS_Enable_OutputAEB "Enable output decceleration/ AEB request" VALUE 0x701011b3 /* @ECU_Address@KbAEBS_Enable_OutputAEB@ */ Scalar_BOOLEAN 0 AEBS_subsystem_integrated_CM_boolean 0 1 /end CHARACTERISTIC
/begin CHARACTERISTIC KbAEBS_Test_HasObsVIP "" VALUE 0x701011b2 /* @ECU_Address@KbAEBS_Test_HasObsVIP@ */ Scalar_BOOLEAN 0 AEBS_subsystem_integrated_CM_boolean 0 1 /end CHARACTERISTIC
/begin CHARACTERISTIC KbAEBS_use_steerAngle "" VALUE 0x701011ae /* @ECU_Address@KbAEBS_use_steerAngle@ */ Scalar_BOOLEAN 0 AEBS_subsystem_integrated_CM_boolean 0 1 /end CHARACTERISTIC
/begin CHARACTERISTIC KfAEBS_Test_CeterXVIP "" VALUE 0x701011ad /* @ECU_Address@KfAEBS_Test_CeterXVIP@ */ Scalar_BOOLEAN 0 AEBS_subsystem_integrated_CM_boolean 0 1 /end CHARACTERISTIC
/begin CHARACTERISTIC KfARBT_autohold_timeout "Unit in second" VALUE 0x701015d8 /* @ECU_Address@KfARBT_autohold_timeout@ */ Scalar_FLOAT32_IEEE 0 ARBT_subsystem_integrated_CM_single_s -3.4E+38 3.4E+38 /end CHARACTERISTIC
/begin CHARACTERISTIC KfARBT_brake_req_lon_a_lowerlimit "Lower limit for brake longitudinal acceleration request output (in m/s2)" VALUE 0x701015d4 /* @ECU_Address@KfARBT_brake_req_lon_a_lowerlimit@ */ Scalar_FLOAT32_IEEE 0 ARBT_subsystem_integrated_CM_single_m_s2 -3.4E+38 3.4E+38 /end CHARACTERISTIC
/begin CHARACTERISTIC KfARBT_brake_req_lon_a_upperlimit "Upper limit for brake longitudinal acceleration request output (in m/s2)" VALUE 0x701015d0 /* @ECU_Address@KfARBT_brake_req_lon_a_upperlimit@ */ Scalar_FLOAT32_IEEE 0 ARBT_subsystem_integrated_CM_single_m_s2 -3.4E+38 3.4E+38 /end CHARACTERISTIC
/begin CHARACTERISTIC KfARBT_brk_ped_pos_thrsh_rec_trig "Threshold of actual brake pedal position to determine if driver is taking a hard brake" VALUE 0x701015cc /* @ECU_Address@KfARBT_brk_ped_pos_thrsh_rec_trig@ */ Scalar_FLOAT32_IEEE 0 ARBT_subsystem_integrated_CM_single__ 0.0 100.0 /end CHARACTERISTIC
/begin CHARACTERISTIC KfARBT_lon_a_thrsh_rec_trig "Threshold of longitudinal acceleration to determine if the driver is taking a hard brake" VALUE 0x701015c8 /* @ECU_Address@KfARBT_lon_a_thrsh_rec_trig@ */ Scalar_FLOAT32_IEEE 0 ARBT_subsystem_integrated_CM_single_m_s2 -10.0 0.0 /end CHARACTERISTIC
/begin CHARACTERISTIC KfARBT_power_req_lon_a_lowerlimit "Lower limit for power longitudinal acceleration request output (in m/s2)" VALUE 0x701015c4 /* @ECU_Address@KfARBT_power_req_lon_a_lowerlimit@ */ Scalar_FLOAT32_IEEE 0 ARBT_subsystem_integrated_CM_single_m_s2 -3.4E+38 3.4E+38 /end CHARACTERISTIC
/begin CHARACTERISTIC KfARBT_power_req_lon_a_upperlimit "Lower limit for power longitudinal acceleration request output (in m/s2)" VALUE 0x701015c0 /* @ECU_Address@KfARBT_power_req_lon_a_upperlimit@ */ Scalar_FLOAT32_IEEE 0 ARBT_subsystem_integrated_CM_single_m_s2 -3.4E+38 3.4E+38 /end CHARACTERISTIC
/begin CHARACTERISTIC KfARBT_steer_req_strwhl_angle_lowerlimit "Lower limit for steer wheel angle output (in degrees)" VALUE 0x701015bc /* @ECU_Address@KfARBT_steer_req_strwhl_angle_lowerlimit@ */ Scalar_FLOAT32_IEEE 0 ARBT_subsystem_integrated_CM_single_deg -3.4E+38 3.4E+38 /end CHARACTERISTIC
/begin CHARACTERISTIC KfARBT_steer_req_strwhl_angle_upperlimit "Upper limit for steer wheel angle output (in degrees)" VALUE 0x701015b8 /* @ECU_Address@KfARBT_steer_req_strwhl_angle_upperlimit@ */ Scalar_FLOAT32_IEEE 0 ARBT_subsystem_integrated_CM_single_deg -3.4E+38 3.4E+38 /end CHARACTERISTIC
/begin CHARACTERISTIC KfARBT_t_false_aeb_time_gap_thrsh "Time difference allowed for AEB to be triggered earlier than the start of driver hard braking
      
      Unit in ms
      " VALUE 0x701015b4 /* @ECU_Address@KfARBT_t_false_aeb_time_gap_thrsh@ */ Scalar_FLOAT32_IEEE 0 ARBT_subsystem_integrated_CM_single_ms -3.4E+38 3.4E+38 /end CHARACTERISTIC
/begin CHARACTERISTIC KfARBT_t_hard_brake_debounce_time "Unit in ms. The debounce time to enter hard braking state" VALUE 0x701015b0 /* @ECU_Address@KfARBT_t_hard_brake_debounce_time@ */ Scalar_FLOAT32_IEEE 0 ARBT_subsystem_integrated_CM_single_ms 0.0 3.4E+38 /end CHARACTERISTIC
/begin CHARACTERISTIC KfARBT_t_hard_brake_time_out "Unit in second, time out for hard braking state" VALUE 0x701015ac /* @ECU_Address@KfARBT_t_hard_brake_time_out@ */ Scalar_FLOAT32_IEEE 0 ARBT_subsystem_integrated_CM_single_sec 0.0 3.4E+38 /end CHARACTERISTIC
/begin CHARACTERISTIC KfARBT_t_missed_aeb_time_gap_thrsh "Time difference allowed for AEB to be triggered later than the start of driver hard braking
      
      Unit in ms
      
      " VALUE 0x701015a8 /* @ECU_Address@KfARBT_t_missed_aeb_time_gap_thrsh@ */ Scalar_FLOAT32_IEEE 0 ARBT_subsystem_integrated_CM_single_ms -3.4E+38 3.4E+38 /end CHARACTERISTIC
/begin CHARACTERISTIC KfARBT_t_speed_debounce_time "" VALUE 0x701015a4 /* @ECU_Address@KfARBT_t_speed_debounce_time@ */ Scalar_FLOAT32_IEEE 0 ARBT_subsystem_integrated_CM_single -3.4E+38 3.4E+38 /end CHARACTERISTIC
/begin CHARACTERISTIC KfARBT_v_moving_speed_thrsh "" VALUE 0x701015a0 /* @ECU_Address@KfARBT_v_moving_speed_thrsh@ */ Scalar_FLOAT32_IEEE 0 ARBT_subsystem_integrated_CM_single_m_s 0.1 1.0 /end CHARACTERISTIC
/begin CHARACTERISTIC KfARBT_v_standstill_speed_thrsh "" VALUE 0x7010159c /* @ECU_Address@KfARBT_v_standstill_speed_thrsh@ */ Scalar_FLOAT32_IEEE 0 ARBT_subsystem_integrated_CM_single_m_s 0.1 1.0 /end CHARACTERISTIC
/begin CHARACTERISTIC KbARBT_power_req_mode_man_ctrl_temp "" VALUE 0x7010159b /* @ECU_Address@KbARBT_power_req_mode_man_ctrl_temp@ */ Scalar_UBYTE 0 ARBT_subsystem_integrated_CM_uint8 0 255 /end CHARACTERISTIC
/begin CHARACTERISTIC KbARBT_SLEW_autohold_active "" VALUE 0x7010159a /* @ECU_Address@KbARBT_SLEW_autohold_active@ */ Scalar_BOOLEAN 0 ARBT_subsystem_integrated_CM_boolean 0 1 /end CHARACTERISTIC
/begin CHARACTERISTIC KbARBT_SLEW_gear_ctrl_accel_req "" VALUE 0x70101599 /* @ECU_Address@KbARBT_SLEW_gear_ctrl_accel_req@ */ Scalar_BOOLEAN 0 ARBT_subsystem_integrated_CM_boolean 0 1 /end CHARACTERISTIC
/begin CHARACTERISTIC KbARBT_gear_pos_fedbck_valid "Validity flag of gear position feedback signal.
      
      For project vehicle without gear position feedback, this calibration shall be set to 0" VALUE 0x70101598 /* @ECU_Address@KbARBT_gear_pos_fedbck_valid@ */ Scalar_BOOLEAN 0 ARBT_subsystem_integrated_CM_boolean 0 1 /end CHARACTERISTIC
/begin CHARACTERISTIC KcCOMM_BrakePedalMax "" VALUE 0x7010167c /* @ECU_Address@KcCOMM_BrakePedalMax@ */ Scalar_FLOAT32_IEEE 0 COMM_subsystem_integrated_CM_single -3.4E+38 3.4E+38 /end CHARACTERISTIC
/begin CHARACTERISTIC KcCOMM_BrakePedalMin "" VALUE 0x70101678 /* @ECU_Address@KcCOMM_BrakePedalMin@ */ Scalar_FLOAT32_IEEE 0 COMM_subsystem_integrated_CM_single -3.4E+38 3.4E+38 /end CHARACTERISTIC
/begin CHARACTERISTIC KcCOMM_FirstGearRatio "Gear ratio in 1st gear." VALUE 0x70101674 /* @ECU_Address@KcCOMM_FirstGearRatio@ */ Scalar_FLOAT32_IEEE 0 COMM_subsystem_integrated_CM_single -3.4E+38 3.4E+38 /end CHARACTERISTIC
/begin CHARACTERISTIC KcCOMM_GasPedalMax "" VALUE 0x70101670 /* @ECU_Address@KcCOMM_GasPedalMax@ */ Scalar_FLOAT32_IEEE 0 COMM_subsystem_integrated_CM_single -3.4E+38 3.4E+38 /end CHARACTERISTIC
/begin CHARACTERISTIC KcCOMM_GasPedalMaxEPB "" VALUE 0x7010166c /* @ECU_Address@KcCOMM_GasPedalMaxEPB@ */ Scalar_FLOAT32_IEEE 0 COMM_subsystem_integrated_CM_single -3.4E+38 3.4E+38 /end CHARACTERISTIC
/begin CHARACTERISTIC KcCOMM_GasPedalMin "" VALUE 0x70101668 /* @ECU_Address@KcCOMM_GasPedalMin@ */ Scalar_FLOAT32_IEEE 0 COMM_subsystem_integrated_CM_single -3.4E+38 3.4E+38 /end CHARACTERISTIC
/begin CHARACTERISTIC KcCOMM_GasPedalMinEPB "" VALUE 0x70101664 /* @ECU_Address@KcCOMM_GasPedalMinEPB@ */ Scalar_FLOAT32_IEEE 0 COMM_subsystem_integrated_CM_single -3.4E+38 3.4E+38 /end CHARACTERISTIC
/begin CHARACTERISTIC KcCOMM_GasPedalRampEPB "" VALUE 0x70101660 /* @ECU_Address@KcCOMM_GasPedalRampEPB@ */ Scalar_FLOAT32_IEEE 0 COMM_subsystem_integrated_CM_single -3.4E+38 3.4E+38 /end CHARACTERISTIC
/begin CHARACTERISTIC KcCOMM_Test_Checksum_0x150 "" VALUE 0x7010165c /* @ECU_Address@KcCOMM_Test_Checksum_0x150@ */ Scalar_FLOAT32_IEEE 0 COMM_subsystem_integrated_CM_single -3.4E+38 3.4E+38 /end CHARACTERISTIC
/begin CHARACTERISTIC KcCOMM_Test_Checksum_0x151 "" VALUE 0x70101658 /* @ECU_Address@KcCOMM_Test_Checksum_0x151@ */ Scalar_FLOAT32_IEEE 0 COMM_subsystem_integrated_CM_single -3.4E+38 3.4E+38 /end CHARACTERISTIC
/begin CHARACTERISTIC KcCOMM_Test_Cmd_AccPelPosAct "" VALUE 0x70101654 /* @ECU_Address@KcCOMM_Test_Cmd_AccPelPosAct@ */ Scalar_FLOAT32_IEEE 0 COMM_subsystem_integrated_CM_single -3.4E+38 3.4E+38 /end CHARACTERISTIC
/begin CHARACTERISTIC KcCOMM_Test_Cmd_AccPelPosActInv "" VALUE 0x70101650 /* @ECU_Address@KcCOMM_Test_Cmd_AccPelPosActInv@ */ Scalar_FLOAT32_IEEE 0 COMM_subsystem_integrated_CM_single -3.4E+38 3.4E+38 /end CHARACTERISTIC
/begin CHARACTERISTIC KcCOMM_Test_Cmd_BrkPelPosAct "" VALUE 0x7010164c /* @ECU_Address@KcCOMM_Test_Cmd_BrkPelPosAct@ */ Scalar_FLOAT32_IEEE 0 COMM_subsystem_integrated_CM_single -3.4E+38 3.4E+38 /end CHARACTERISTIC
/begin CHARACTERISTIC KcCOMM_Test_Cmd_BrkPelPosActInv "" VALUE 0x70101648 /* @ECU_Address@KcCOMM_Test_Cmd_BrkPelPosActInv@ */ Scalar_FLOAT32_IEEE 0 COMM_subsystem_integrated_CM_single -3.4E+38 3.4E+38 /end CHARACTERISTIC
/begin CHARACTERISTIC KcCOMM_Test_Cmd_Checksum "" VALUE 0x70101644 /* @ECU_Address@KcCOMM_Test_Cmd_Checksum@ */ Scalar_FLOAT32_IEEE 0 COMM_subsystem_integrated_CM_single -3.4E+38 3.4E+38 /end CHARACTERISTIC
/begin CHARACTERISTIC KcCOMM_Test_Cmd_RCnt "" VALUE 0x70101640 /* @ECU_Address@KcCOMM_Test_Cmd_RCnt@ */ Scalar_FLOAT32_IEEE 0 COMM_subsystem_integrated_CM_single -3.4E+38 3.4E+38 /end CHARACTERISTIC
/begin CHARACTERISTIC KcCOMM_Test_Cmd_StrAngle "" VALUE 0x7010163c /* @ECU_Address@KcCOMM_Test_Cmd_StrAngle@ */ Scalar_FLOAT32_IEEE 0 COMM_subsystem_integrated_CM_single -3.4E+38 3.4E+38 /end CHARACTERISTIC
/begin CHARACTERISTIC KcCOMM_Test_Cmd_StrAngleLimit "" VALUE 0x70101638 /* @ECU_Address@KcCOMM_Test_Cmd_StrAngleLimit@ */ Scalar_FLOAT32_IEEE 0 COMM_subsystem_integrated_CM_single -3.4E+38 3.4E+38 /end CHARACTERISTIC
/begin CHARACTERISTIC KcCOMM_Test_Cmd_StrAngleSpd "" VALUE 0x70101634 /* @ECU_Address@KcCOMM_Test_Cmd_StrAngleSpd@ */ Scalar_FLOAT32_IEEE 0 COMM_subsystem_integrated_CM_single -3.4E+38 3.4E+38 /end CHARACTERISTIC
/begin CHARACTERISTIC KcCOMM_Test_Cmd_VCUCnt "" VALUE 0x70101630 /* @ECU_Address@KcCOMM_Test_Cmd_VCUCnt@ */ Scalar_FLOAT32_IEEE 0 COMM_subsystem_integrated_CM_single -3.4E+38 3.4E+38 /end CHARACTERISTIC
/begin CHARACTERISTIC KcCOMM_Test_Decs_Acc_Value "" VALUE 0x7010162c /* @ECU_Address@KcCOMM_Test_Decs_Acc_Value@ */ Scalar_FLOAT32_IEEE 0 COMM_subsystem_integrated_CM_single -3.4E+38 3.4E+38 /end CHARACTERISTIC
/begin CHARACTERISTIC KcCOMM_Test_Decs_Breake_Value "" VALUE 0x70101628 /* @ECU_Address@KcCOMM_Test_Decs_Breake_Value@ */ Scalar_FLOAT32_IEEE 0 COMM_subsystem_integrated_CM_single -3.4E+38 3.4E+38 /end CHARACTERISTIC
/begin CHARACTERISTIC KcCOMM_Test_RCnt_0x150 "" VALUE 0x70101624 /* @ECU_Address@KcCOMM_Test_RCnt_0x150@ */ Scalar_FLOAT32_IEEE 0 COMM_subsystem_integrated_CM_single -3.4E+38 3.4E+38 /end CHARACTERISTIC
/begin CHARACTERISTIC KcCOMM_Test_RCnt_0x151 "" VALUE 0x70101620 /* @ECU_Address@KcCOMM_Test_RCnt_0x151@ */ Scalar_FLOAT32_IEEE 0 COMM_subsystem_integrated_CM_single -3.4E+38 3.4E+38 /end CHARACTERISTIC
/begin CHARACTERISTIC KcCOMM_Test_Tar_Torq "" VALUE 0x7010161c /* @ECU_Address@KcCOMM_Test_Tar_Torq@ */ Scalar_FLOAT32_IEEE 0 COMM_subsystem_integrated_CM_single -3.4E+38 3.4E+38 /end CHARACTERISTIC
/begin CHARACTERISTIC KcCOMM_Test_Tar_vehiclespd "" VALUE 0x70101618 /* @ECU_Address@KcCOMM_Test_Tar_vehiclespd@ */ Scalar_FLOAT32_IEEE 0 COMM_subsystem_integrated_CM_single -3.4E+38 3.4E+38 /end CHARACTERISTIC
/begin CHARACTERISTIC KcCOMM_Test_acceleration_fb "" VALUE 0x70101614 /* @ECU_Address@KcCOMM_Test_acceleration_fb@ */ Scalar_FLOAT32_IEEE 0 COMM_subsystem_integrated_CM_single -3.4E+38 3.4E+38 /end CHARACTERISTIC
/begin CHARACTERISTIC KcCOMM_Test_cmd_VCUChecksum "" VALUE 0x70101610 /* @ECU_Address@KcCOMM_Test_cmd_VCUChecksum@ */ Scalar_FLOAT32_IEEE 0 COMM_subsystem_integrated_CM_single -3.4E+38 3.4E+38 /end CHARACTERISTIC
/begin CHARACTERISTIC KcCOMM_Test_yaw_rate_fb "" VALUE 0x7010160c /* @ECU_Address@KcCOMM_Test_yaw_rate_fb@ */ Scalar_FLOAT32_IEEE 0 COMM_subsystem_integrated_CM_single -3.4E+38 3.4E+38 /end CHARACTERISTIC
/begin CHARACTERISTIC KfCOMM_a_VCULongAccOffset "Offset to override Longitudinal Acceleration." VALUE 0x70101608 /* @ECU_Address@KfCOMM_a_VCULongAccOffset@ */ Scalar_FLOAT32_IEEE 0 COMM_subsystem_integrated_CM_single -3.4E+38 3.4E+38 /end CHARACTERISTIC
/begin CHARACTERISTIC KfCOMM_r_VCULongAccSlope "Slope to override Longitudinal Acceleration." VALUE 0x70101604 /* @ECU_Address@KfCOMM_r_VCULongAccSlope@ */ Scalar_FLOAT32_IEEE 0 COMM_subsystem_integrated_CM_single -3.4E+38 3.4E+38 /end CHARACTERISTIC
/begin CHARACTERISTIC KcCOMM_Test_BckFogLamp_Req "" VALUE 0x70101602 /* @ECU_Address@KcCOMM_Test_BckFogLamp_Req@ */ Scalar_UBYTE 0 COMM_subsystem_integrated_CM_uint8 0 255 /end CHARACTERISTIC
/begin CHARACTERISTIC KcCOMM_Test_Cmd_ATOModEnable "" VALUE 0x70101601 /* @ECU_Address@KcCOMM_Test_Cmd_ATOModEnable@ */ Scalar_UBYTE 0 COMM_subsystem_integrated_CM_uint8 0 255 /end CHARACTERISTIC
/begin CHARACTERISTIC KcCOMM_Test_Cmd_AccPelEnable "" VALUE 0x70101600 /* @ECU_Address@KcCOMM_Test_Cmd_AccPelEnable@ */ Scalar_UBYTE 0 COMM_subsystem_integrated_CM_uint8 0 255 /end CHARACTERISTIC
/begin CHARACTERISTIC KcCOMM_Test_Cmd_BrakeLightReq "" VALUE 0x701015ff /* @ECU_Address@KcCOMM_Test_Cmd_BrakeLightReq@ */ Scalar_UBYTE 0 COMM_subsystem_integrated_CM_uint8 0 255 /end CHARACTERISTIC
/begin CHARACTERISTIC KcCOMM_Test_Cmd_BrkPelEnable "" VALUE 0x701015fe /* @ECU_Address@KcCOMM_Test_Cmd_BrkPelEnable@ */ Scalar_UBYTE 0 COMM_subsystem_integrated_CM_uint8 0 255 /end CHARACTERISTIC
/begin CHARACTERISTIC KcCOMM_Test_Cmd_EPSDir "" VALUE 0x701015fd /* @ECU_Address@KcCOMM_Test_Cmd_EPSDir@ */ Scalar_UBYTE 0 COMM_subsystem_integrated_CM_uint8 0 255 /end CHARACTERISTIC
/begin CHARACTERISTIC KcCOMM_Test_Cmd_ICPDTC "" VALUE 0x701015fc /* @ECU_Address@KcCOMM_Test_Cmd_ICPDTC@ */ Scalar_UBYTE 0 COMM_subsystem_integrated_CM_uint8 0 255 /end CHARACTERISTIC
/begin CHARACTERISTIC KcCOMM_Test_Cmd_TgtSft "" VALUE 0x701015fb /* @ECU_Address@KcCOMM_Test_Cmd_TgtSft@ */ Scalar_UBYTE 0 COMM_subsystem_integrated_CM_uint8 0 255 /end CHARACTERISTIC
/begin CHARACTERISTIC KcCOMM_Test_Cmd_TgtSftEnable "" VALUE 0x701015fa /* @ECU_Address@KcCOMM_Test_Cmd_TgtSftEnable@ */ Scalar_UBYTE 0 COMM_subsystem_integrated_CM_uint8 0 255 /end CHARACTERISTIC
/begin CHARACTERISTIC KcCOMM_Test_Decs_Acc_Mod "" VALUE 0x701015f9 /* @ECU_Address@KcCOMM_Test_Decs_Acc_Mod@ */ Scalar_UBYTE 0 COMM_subsystem_integrated_CM_uint8 0 255 /end CHARACTERISTIC
/begin CHARACTERISTIC KcCOMM_Test_Decs_Acc_Req "" VALUE 0x701015f8 /* @ECU_Address@KcCOMM_Test_Decs_Acc_Req@ */ Scalar_UBYTE 0 COMM_subsystem_integrated_CM_uint8 0 255 /end CHARACTERISTIC
/begin CHARACTERISTIC KcCOMM_Test_Decs_DippedBeam_Req "" VALUE 0x701015f7 /* @ECU_Address@KcCOMM_Test_Decs_DippedBeam_Req@ */ Scalar_UBYTE 0 COMM_subsystem_integrated_CM_uint8 0 255 /end CHARACTERISTIC
/begin CHARACTERISTIC KcCOMM_Test_Decs_HighBeam_Req "" VALUE 0x701015f6 /* @ECU_Address@KcCOMM_Test_Decs_HighBeam_Req@ */ Scalar_UBYTE 0 COMM_subsystem_integrated_CM_uint8 0 255 /end CHARACTERISTIC
/begin CHARACTERISTIC KcCOMM_Test_Decs_LftLmp_Req "" VALUE 0x701015f5 /* @ECU_Address@KcCOMM_Test_Decs_LftLmp_Req@ */ Scalar_UBYTE 0 COMM_subsystem_integrated_CM_uint8 0 255 /end CHARACTERISTIC
/begin CHARACTERISTIC KcCOMM_Test_Decs_Light_Req "" VALUE 0x701015f4 /* @ECU_Address@KcCOMM_Test_Decs_Light_Req@ */ Scalar_UBYTE 0 COMM_subsystem_integrated_CM_uint8 0 255 /end CHARACTERISTIC
/begin CHARACTERISTIC KcCOMM_Test_Decs_RihtLmp_Req "" VALUE 0x701015f3 /* @ECU_Address@KcCOMM_Test_Decs_RihtLmp_Req@ */ Scalar_UBYTE 0 COMM_subsystem_integrated_CM_uint8 0 255 /end CHARACTERISTIC
/begin CHARACTERISTIC KcCOMM_Test_Decs_iBCM_Req "" VALUE 0x701015f2 /* @ECU_Address@KcCOMM_Test_Decs_iBCM_Req@ */ Scalar_UBYTE 0 COMM_subsystem_integrated_CM_uint8 0 255 /end CHARACTERISTIC
/begin CHARACTERISTIC KcCOMM_Test_FrontFogLamp_Req "" VALUE 0x701015f1 /* @ECU_Address@KcCOMM_Test_FrontFogLamp_Req@ */ Scalar_UBYTE 0 COMM_subsystem_integrated_CM_uint8 0 255 /end CHARACTERISTIC
/begin CHARACTERISTIC KcCOMM_Test_Horn_Req "" VALUE 0x701015f0 /* @ECU_Address@KcCOMM_Test_Horn_Req@ */ Scalar_UBYTE 0 COMM_subsystem_integrated_CM_uint8 0 255 /end CHARACTERISTIC
/begin CHARACTERISTIC KcCOMM_Test_HummerSts "" VALUE 0x701015ef /* @ECU_Address@KcCOMM_Test_HummerSts@ */ Scalar_UBYTE 0 COMM_subsystem_integrated_CM_uint8 0 255 /end CHARACTERISTIC
/begin CHARACTERISTIC KcCOMM_Test_Over_Speed "SLEW value for Over Speed." VALUE 0x701015ee /* @ECU_Address@KcCOMM_Test_Over_Speed@ */ Scalar_UBYTE 0 COMM_subsystem_integrated_CM_uint8 0 255 /end CHARACTERISTIC
/begin CHARACTERISTIC KcCOMM_Test_SlowDown_Indication "SLEW value for SpeedUp_Indication." VALUE 0x701015ed /* @ECU_Address@KcCOMM_Test_SlowDown_Indication@ */ Scalar_UBYTE 0 COMM_subsystem_integrated_CM_uint8 0 255 /end CHARACTERISTIC
/begin CHARACTERISTIC KcCOMM_Test_SpeedUp_Indication "SLEW value for SpeedUp_Indication." VALUE 0x701015ec /* @ECU_Address@KcCOMM_Test_SpeedUp_Indication@ */ Scalar_UBYTE 0 COMM_subsystem_integrated_CM_uint8 0 255 /end CHARACTERISTIC
/begin CHARACTERISTIC KcCOMM_Test_Stop_Request "" VALUE 0x701015eb /* @ECU_Address@KcCOMM_Test_Stop_Request@ */ Scalar_UBYTE 0 COMM_subsystem_integrated_CM_uint8 0 255 /end CHARACTERISTIC
/begin CHARACTERISTIC KcCOMM_Test_WarnLight_Req "" VALUE 0x701015ea /* @ECU_Address@KcCOMM_Test_WarnLight_Req@ */ Scalar_UBYTE 0 COMM_subsystem_integrated_CM_uint8 0 255 /end CHARACTERISTIC
/begin CHARACTERISTIC KcCOMM_Test_XBR_EBI_Mode "" VALUE 0x701015e9 /* @ECU_Address@KcCOMM_Test_XBR_EBI_Mode@ */ Scalar_UBYTE 0 COMM_subsystem_integrated_CM_uint8 0 255 /end CHARACTERISTIC
/begin CHARACTERISTIC KcCOMM_Test_XBR_Priority "" VALUE 0x701015e8 /* @ECU_Address@KcCOMM_Test_XBR_Priority@ */ Scalar_UBYTE 0 COMM_subsystem_integrated_CM_uint8 0 255 /end CHARACTERISTIC
/begin CHARACTERISTIC KcCOMM_Test_driveoff_Req "" VALUE 0x701015e7 /* @ECU_Address@KcCOMM_Test_driveoff_Req@ */ Scalar_UBYTE 0 COMM_subsystem_integrated_CM_uint8 0 255 /end CHARACTERISTIC
/begin CHARACTERISTIC KcCOMM_Test_mode "" VALUE 0x701015e6 /* @ECU_Address@KcCOMM_Test_mode@ */ Scalar_UBYTE 0 COMM_subsystem_integrated_CM_uint8 0 255 /end CHARACTERISTIC
/begin CHARACTERISTIC KcCOMM_TorqueControlPriority "The priority of the Torque Override Control Mode send to VCU.
      0 - Highest priority.
      1 - High priority.
      2 - Medium priority.
      3 - Low priority." VALUE 0x701015e5 /* @ECU_Address@KcCOMM_TorqueControlPriority@ */ Scalar_UBYTE 0 COMM_subsystem_integrated_CM_uint8 0 255 /end CHARACTERISTIC
/begin CHARACTERISTIC KcCOMM_VehicleCANbusConfig "Vehicle Platform and CAN Bus Configuration.
      1 - JAC#1;
      2 - JAC#2 or iVISTA;
      3 - ICPV;
      4 - GLB;
      5 - FAW;
      6 - HZBus;
      7 - USdemo." VALUE 0x701015e4 /* @ECU_Address@KcCOMM_VehicleCANbusConfig@ */ Scalar_UBYTE 0 COMM_subsystem_integrated_CM_uint8 0 255 /end CHARACTERISTIC
/begin CHARACTERISTIC KcCOMM_Test_Cmd_EPSXBW_En "" VALUE 0x701015e3 /* @ECU_Address@KcCOMM_Test_Cmd_EPSXBW_En@ */ Scalar_BOOLEAN 0 COMM_subsystem_integrated_CM_boolean 0 1 /end CHARACTERISTIC
/begin CHARACTERISTIC KcCOMM_Test_Cmd_EPSXBW_En_ovr "" VALUE 0x701015e2 /* @ECU_Address@KcCOMM_Test_Cmd_EPSXBW_En_ovr@ */ Scalar_BOOLEAN 0 COMM_subsystem_integrated_CM_boolean 0 1 /end CHARACTERISTIC
/begin CHARACTERISTIC KcCOMM_Test_Cmd_StrAngle_ovr "" VALUE 0x701015e1 /* @ECU_Address@KcCOMM_Test_Cmd_StrAngle_ovr@ */ Scalar_BOOLEAN 0 COMM_subsystem_integrated_CM_boolean 0 1 /end CHARACTERISTIC
/begin CHARACTERISTIC KcCOMM_Test_Decs_Acc_Req_ovr "" VALUE 0x701015e0 /* @ECU_Address@KcCOMM_Test_Decs_Acc_Req_ovr@ */ Scalar_BOOLEAN 0 COMM_subsystem_integrated_CM_boolean 0 1 /end CHARACTERISTIC
/begin CHARACTERISTIC KcCOMM_Test_Decs_Acc_Value_ovr "" VALUE 0x701015df /* @ECU_Address@KcCOMM_Test_Decs_Acc_Value_ovr@ */ Scalar_BOOLEAN 0 COMM_subsystem_integrated_CM_boolean 0 1 /end CHARACTERISTIC
/begin CHARACTERISTIC KcCOMM_Test_Decs_Breake_Req "" VALUE 0x701015de /* @ECU_Address@KcCOMM_Test_Decs_Breake_Req@ */ Scalar_BOOLEAN 0 COMM_subsystem_integrated_CM_boolean 0 1 /end CHARACTERISTIC
/begin CHARACTERISTIC KcCOMM_Test_Decs_Breake_Req_ovr "" VALUE 0x701015dd /* @ECU_Address@KcCOMM_Test_Decs_Breake_Req_ovr@ */ Scalar_BOOLEAN 0 COMM_subsystem_integrated_CM_boolean 0 1 /end CHARACTERISTIC
/begin CHARACTERISTIC KcCOMM_Test_Decs_Breake_Value_ovr "" VALUE 0x701015dc /* @ECU_Address@KcCOMM_Test_Decs_Breake_Value_ovr@ */ Scalar_BOOLEAN 0 COMM_subsystem_integrated_CM_boolean 0 1 /end CHARACTERISTIC
/begin CHARACTERISTIC KfDCSN_M_adm_temp_steering_ovrd_torque "The torque for driver to override." VALUE 0x70101720 /* @ECU_Address@KfDCSN_M_adm_temp_steering_ovrd_torque@ */ Scalar_FLOAT32_IEEE 0 DCSN_subsystem_integrated_CM_single_nm -3.4E+38 3.4E+38 /end CHARACTERISTIC
/begin CHARACTERISTIC KfDCSN_M_adm_temp_steering_resume_torque "The torque for driver to override." VALUE 0x7010171c /* @ECU_Address@KfDCSN_M_adm_temp_steering_resume_torque@ */ Scalar_FLOAT32_IEEE 0 DCSN_subsystem_integrated_CM_single_nm -3.4E+38 3.4E+38 /end CHARACTERISTIC
/begin CHARACTERISTIC KfDCSN_t_adm_temp_steering_ovrd_delay "when override conditions are met, the time to delay before exit." VALUE 0x701016f8 /* @ECU_Address@KfDCSN_t_adm_temp_steering_ovrd_delay@ */ Scalar_FLOAT32_IEEE 0 DCSN_subsystem_integrated_CM_single_s -3.4E+38 3.4E+38 /end CHARACTERISTIC
/begin CHARACTERISTIC KfDCSN_t_adm_temp_steering_resume_delay "When resume conditions are met, the time before re-engaged." VALUE 0x701016f4 /* @ECU_Address@KfDCSN_t_adm_temp_steering_resume_delay@ */ Scalar_FLOAT32_IEEE 0 DCSN_subsystem_integrated_CM_single_s -3.4E+38 3.4E+38 /end CHARACTERISTIC
/begin CHARACTERISTIC KfDCSN_t_autodrive_max_wait_time "the maximal wait time before the vehicle response to our activating request" VALUE 0x701016ec /* @ECU_Address@KfDCSN_t_autodrive_max_wait_time@ */ Scalar_FLOAT32_IEEE 0 DCSN_subsystem_integrated_CM_single_s -3.4E+38 3.4E+38 /end CHARACTERISTIC
/begin CHARACTERISTIC KfDCSN_t_max_time_fault_warning "allowed reaction time after fault warning and before triggering emergency stop" VALUE 0x701016e8 /* @ECU_Address@KfDCSN_t_max_time_fault_warning@ */ Scalar_FLOAT32_IEEE 0 DCSN_subsystem_integrated_CM_single_s -3.4E+38 3.4E+38 /end CHARACTERISTIC
/begin CHARACTERISTIC KfDCSN_t_max_time_to_takeover "allowed reaction time after both lane markers are missed but before autodrive exit" VALUE 0x701016e4 /* @ECU_Address@KfDCSN_t_max_time_to_takeover@ */ Scalar_FLOAT32_IEEE 0 DCSN_subsystem_integrated_CM_single_s -3.4E+38 3.4E+38 /end CHARACTERISTIC
/begin CHARACTERISTIC KfDCSN_v_adm_temp_veh_setspeed "Current vehicle acc set speed. 
      Not connect with ACCS yet" VALUE 0x701016d4 /* @ECU_Address@KfDCSN_v_adm_temp_veh_setspeed@ */ Scalar_FLOAT32_IEEE 0 DCSN_subsystem_integrated_CM_single_m_s -3.4E+38 3.4E+38 /end CHARACTERISTIC
/begin CHARACTERISTIC KfDCSN_v_default_warning_speed "The maximal speed allowed when input speed limit is missed before warning request." VALUE 0x701016cc /* @ECU_Address@KfDCSN_v_default_warning_speed@ */ Scalar_FLOAT32_IEEE 0 DCSN_subsystem_integrated_CM_single_m_s 0.0 100.0 /end CHARACTERISTIC
/begin CHARACTERISTIC KfDCSN_v_overspeed_warning_extra "The extra speed difference allowed when vehicle speed is higher than speed limit before warning request." VALUE 0x701016c8 /* @ECU_Address@KfDCSN_v_overspeed_warning_extra@ */ Scalar_FLOAT32_IEEE 0 DCSN_subsystem_integrated_CM_single_m_s 0.0 10.0 /end CHARACTERISTIC
/begin CHARACTERISTIC KfDCSN_v_setspeed_thrsh_hi "Max speed allowed by Autodrive system" VALUE 0x701016c4 /* @ECU_Address@KfDCSN_v_setspeed_thrsh_hi@ */ Scalar_FLOAT32_IEEE 0 DCSN_subsystem_integrated_CM_single_m_s -3.4E+38 3.4E+38 /end CHARACTERISTIC
/begin CHARACTERISTIC KbDCSN_SLEW_DriveModeComd_value "SLEW mode
      the DriveModeComd value" VALUE 0x701016be /* @ECU_Address@KbDCSN_SLEW_DriveModeComd_value@ */ Scalar_UBYTE 0 DCSN_subsystem_integrated_CM_uint8 0 255 /end CHARACTERISTIC
/begin CHARACTERISTIC KcDCSN_t_usr_activate_cmd_send_count "send count of usr_activate_action, valid when KbDCSN_use_vehicle_activate_switch = true
      unit: seconds" VALUE 0x701016bd /* @ECU_Address@KcDCSN_t_usr_activate_cmd_send_count@ */ Scalar_UBYTE 0 DCSN_subsystem_integrated_CM_uint8 0 255 /end CHARACTERISTIC
/begin CHARACTERISTIC KeDCSN_adm_main_mode_man_value "manual override of adm_main_mode output as uint8:
      
      0 = ADM_OFF
      1 = ADM_STANDBY
      2 = ADM_READY
      3 = ADM_ACTIVE
      4 = ADM_STEER_OVRD
      5 = ADM_TAKEOVER_WARNING
      6 = ADM_FAULT_WARNING76 = ADM_FAULT_REACTION
      8 = ADM_FAULT_DETECTED" VALUE 0x701016bc /* @ECU_Address@KeDCSN_adm_main_mode_man_value@ */ Scalar_UBYTE 0 DCSN_subsystem_integrated_CM_uint8 0 255 /end CHARACTERISTIC
/begin CHARACTERISTIC KeDCSN_adm_temp_diag_system_fault "System faults
      0 = no fault
      1,2 = warning faults
      3,4,5 = exit faults" VALUE 0x701016bb /* @ECU_Address@KeDCSN_adm_temp_diag_system_fault@ */ Scalar_UBYTE 0 DCSN_subsystem_integrated_CM_uint8 0 255 /end CHARACTERISTIC
/begin CHARACTERISTIC KeDCSN_adm_temp_steering_controlmode "steering control active mode
      usually 1" VALUE 0x701016ba /* @ECU_Address@KeDCSN_adm_temp_steering_controlmode@ */ Scalar_UBYTE 0 DCSN_subsystem_integrated_CM_uint8_s 0 255 /end CHARACTERISTIC
/begin CHARACTERISTIC KeDCSN_autodrive_mode_man_value "manual override of adm_main_mode output as uint8:
      
      0 = ADM_OFF
      1 = ADM_STANDBY
      2 = ADM_READY
      3 = ADM_ACTIVE
      4 = ADM_STEER_OVRD
      5 = ADM_TAKEOVER_WARNING
      6 = ADM_FAULT_WARNING
      7 = ADM_FAULT_REACTION
      8 = ADM_FAULT_DETECTED" VALUE 0x701016b9 /* @ECU_Address@KeDCSN_autodrive_mode_man_value@ */ Scalar_UBYTE 0 DCSN_subsystem_integrated_CM_uint8 0 255 /end CHARACTERISTIC
/begin CHARACTERISTIC KeDCSN_usr_cmd_autodrive_activate_man "0 = Deactivate
      1 = Activate
      2 = Hold" VALUE 0x701016b2 /* @ECU_Address@KeDCSN_usr_cmd_autodrive_activate_man@ */ Scalar_UBYTE 0 DCSN_subsystem_integrated_CM_uint8 0 255 /end CHARACTERISTIC
/begin CHARACTERISTIC KbDCSN_SLEW_DriveModeComd_enbl "0 = use COMM DriverModeComd
      1 = use SLEW DriverModeComd" VALUE 0x701016b0 /* @ECU_Address@KbDCSN_SLEW_DriveModeComd_enbl@ */ Scalar_BOOLEAN 0 DCSN_subsystem_integrated_CM_boolean 0 1 /end CHARACTERISTIC
/begin CHARACTERISTIC KbDCSN_acc_man_enbl "0 = manual override disabled
      1 = manual override enabled" VALUE 0x701016af /* @ECU_Address@KbDCSN_acc_man_enbl@ */ Scalar_BOOLEAN 0 DCSN_subsystem_integrated_CM_boolean 0 1 /end CHARACTERISTIC
/begin CHARACTERISTIC KbDCSN_active_feature_man_ctrl "For all active features (ACC, LCC, ALCA):
      0 = manual override disabled
      1 = manual override enabled" VALUE 0x701016ae /* @ECU_Address@KbDCSN_active_feature_man_ctrl@ */ Scalar_BOOLEAN 0 DCSN_subsystem_integrated_CM_boolean 0 1 /end CHARACTERISTIC
/begin CHARACTERISTIC KbDCSN_adm_main_mode_man_ctrl "0 = manual override disabled
      1 = manual override enabled" VALUE 0x701016ac /* @ECU_Address@KbDCSN_adm_main_mode_man_ctrl@ */ Scalar_BOOLEAN 0 DCSN_subsystem_integrated_CM_boolean 0 1 /end CHARACTERISTIC
/begin CHARACTERISTIC KbDCSN_adm_temp_stop_finished "0 = not finished
      1 = finished" VALUE 0x701016ab /* @ECU_Address@KbDCSN_adm_temp_stop_finished@ */ Scalar_BOOLEAN 0 DCSN_subsystem_integrated_CM_boolean 0 1 /end CHARACTERISTIC
/begin CHARACTERISTIC KbDCSN_adm_temp_usr_cmd_autodrive_enabled "0 = not enabled
      1 = enabled" VALUE 0x701016aa /* @ECU_Address@KbDCSN_adm_temp_usr_cmd_autodrive_enabled@ */ Scalar_BOOLEAN 0 DCSN_subsystem_integrated_CM_boolean 0 1 /end CHARACTERISTIC
/begin CHARACTERISTIC KbDCSN_aeb_man_enbl "0 = manual override disabled
      1 = manual override enabled" VALUE 0x701016a9 /* @ECU_Address@KbDCSN_aeb_man_enbl@ */ Scalar_BOOLEAN 0 DCSN_subsystem_integrated_CM_boolean 0 1 /end CHARACTERISTIC
/begin CHARACTERISTIC KbDCSN_alca_man_enbl "0 = manual override disabled
      1 = manual override enabled" VALUE 0x701016a8 /* @ECU_Address@KbDCSN_alca_man_enbl@ */ Scalar_BOOLEAN 0 DCSN_subsystem_integrated_CM_boolean 0 1 /end CHARACTERISTIC
/begin CHARACTERISTIC KbDCSN_autodrive_mode_man_enbl "For all active features (ACC, LCC, ALCA):
      0 = manual override disabled
      1 = manual override enabled" VALUE 0x701016a7 /* @ECU_Address@KbDCSN_autodrive_mode_man_enbl@ */ Scalar_BOOLEAN 0 DCSN_subsystem_integrated_CM_boolean 0 1 /end CHARACTERISTIC
/begin CHARACTERISTIC KbDCSN_brake_ctrl_man_enbl "0 = manual override disabled
      1 = manual override enabled" VALUE 0x701016a6 /* @ECU_Address@KbDCSN_brake_ctrl_man_enbl@ */ Scalar_BOOLEAN 0 DCSN_subsystem_integrated_CM_boolean 0 1 /end CHARACTERISTIC
/begin CHARACTERISTIC KbDCSN_brake_ctrl_man_value "manual brake control switch, valid only when KbDCSN_brake_ctrl_man_enbl = true
      0 = brake control off
      1 = brake control on" VALUE 0x701016a5 /* @ECU_Address@KbDCSN_brake_ctrl_man_value@ */ Scalar_BOOLEAN 0 DCSN_subsystem_integrated_CM_boolean 0 1 /end CHARACTERISTIC
/begin CHARACTERISTIC KbDCSN_enable_warning_no_input "0 = disable warning if no speed limit input
      1 = use default speed limit to warn if no speed limit input" VALUE 0x701016a2 /* @ECU_Address@KbDCSN_enable_warning_no_input@ */ Scalar_BOOLEAN 0 DCSN_subsystem_integrated_CM_boolean 0 1 /end CHARACTERISTIC
/begin CHARACTERISTIC KbDCSN_epb_ctrl_man_enbl "0 = manual override disabled
      1 = manual override enabled" VALUE 0x701016a1 /* @ECU_Address@KbDCSN_epb_ctrl_man_enbl@ */ Scalar_BOOLEAN 0 DCSN_subsystem_integrated_CM_boolean 0 1 /end CHARACTERISTIC
/begin CHARACTERISTIC KbDCSN_epb_ctrl_man_value "manual epb control switch, valid only when KbDCSN_epb_ctrl_man_enbl = true
      0 = epb release
      1 = epb engage" VALUE 0x701016a0 /* @ECU_Address@KbDCSN_epb_ctrl_man_value@ */ Scalar_BOOLEAN 0 DCSN_subsystem_integrated_CM_boolean 0 1 /end CHARACTERISTIC
/begin CHARACTERISTIC KbDCSN_fcw_man_enbl "0 = manual FCW off
      1 = manual FCW on" VALUE 0x7010169e /* @ECU_Address@KbDCSN_fcw_man_enbl@ */ Scalar_BOOLEAN 0 DCSN_subsystem_integrated_CM_boolean 0 1 /end CHARACTERISTIC
/begin CHARACTERISTIC KbDCSN_gear_ctrl_man_enbl "0 = manual override disabled
      1 = manual override enabled" VALUE 0x7010169d /* @ECU_Address@KbDCSN_gear_ctrl_man_enbl@ */ Scalar_BOOLEAN 0 DCSN_subsystem_integrated_CM_boolean 0 1 /end CHARACTERISTIC
/begin CHARACTERISTIC KbDCSN_gear_ctrl_man_value "manual gear control switch, valid only when KbDCSN_gear_ctrl_man_enbl = true
      0 = gear control off
      1 = gear control on" VALUE 0x7010169c /* @ECU_Address@KbDCSN_gear_ctrl_man_value@ */ Scalar_BOOLEAN 0 DCSN_subsystem_integrated_CM_boolean 0 1 /end CHARACTERISTIC
/begin CHARACTERISTIC KbDCSN_lcc_man_enbl "0 = manual LCC off
      1 = manual LCC on" VALUE 0x70101699 /* @ECU_Address@KbDCSN_lcc_man_enbl@ */ Scalar_BOOLEAN 0 DCSN_subsystem_integrated_CM_boolean 0 1 /end CHARACTERISTIC
/begin CHARACTERISTIC KbDCSN_lcw_man_enbl "0 = manual LCW off
      1 = manual LCW on" VALUE 0x70101698 /* @ECU_Address@KbDCSN_lcw_man_enbl@ */ Scalar_BOOLEAN 0 DCSN_subsystem_integrated_CM_boolean 0 1 /end CHARACTERISTIC
/begin CHARACTERISTIC KbDCSN_ldw_man_enbl "0 = manual LDW off
      1 = manual LDW on" VALUE 0x70101697 /* @ECU_Address@KbDCSN_ldw_man_enbl@ */ Scalar_BOOLEAN 0 DCSN_subsystem_integrated_CM_boolean 0 1 /end CHARACTERISTIC
/begin CHARACTERISTIC KbDCSN_overspeed_warning_enable "0 = disable overspeed warning
      1 = enable overspeed warning" VALUE 0x70101696 /* @ECU_Address@KbDCSN_overspeed_warning_enable@ */ Scalar_BOOLEAN 0 DCSN_subsystem_integrated_CM_boolean 0 1 /end CHARACTERISTIC
/begin CHARACTERISTIC KbDCSN_passive_feature_man_ctrl "For all passive features (AEB, FCW, LDW, LCW):
      0 = manual override disabled
      1 = manual override enabled" VALUE 0x70101695 /* @ECU_Address@KbDCSN_passive_feature_man_ctrl@ */ Scalar_BOOLEAN 0 DCSN_subsystem_integrated_CM_boolean 0 1 /end CHARACTERISTIC
/begin CHARACTERISTIC KbDCSN_power_ctrl_man_enbl "0 = manual override disabled
      1 = manual override enabled" VALUE 0x70101694 /* @ECU_Address@KbDCSN_power_ctrl_man_enbl@ */ Scalar_BOOLEAN 0 DCSN_subsystem_integrated_CM_boolean 0 1 /end CHARACTERISTIC
/begin CHARACTERISTIC KbDCSN_power_ctrl_man_value "manual power control switch, valid only when KbDCSN_power_ctrl_man_enbl = true
      0 = power control off
      1 = power control on" VALUE 0x70101693 /* @ECU_Address@KbDCSN_power_ctrl_man_value@ */ Scalar_BOOLEAN 0 DCSN_subsystem_integrated_CM_boolean 0 1 /end CHARACTERISTIC
/begin CHARACTERISTIC KbDCSN_speed_limit_enable "0 = disable speed limit output
      1 = enable speed limit output" VALUE 0x70101690 /* @ECU_Address@KbDCSN_speed_limit_enable@ */ Scalar_BOOLEAN 0 DCSN_subsystem_integrated_CM_boolean 0 1 /end CHARACTERISTIC
/begin CHARACTERISTIC KbDCSN_steer_ctrl_man_enbl "0 = manual override disabled
      1 = manual override enabled" VALUE 0x7010168f /* @ECU_Address@KbDCSN_steer_ctrl_man_enbl@ */ Scalar_BOOLEAN 0 DCSN_subsystem_integrated_CM_boolean 0 1 /end CHARACTERISTIC
/begin CHARACTERISTIC KbDCSN_steer_ctrl_man_value "manual steer control switch, valid only when KbDCSN_steer_ctrl_man_enbl = true
      0 = steer control off
      1 = steer control on" VALUE 0x7010168e /* @ECU_Address@KbDCSN_steer_ctrl_man_value@ */ Scalar_BOOLEAN 0 DCSN_subsystem_integrated_CM_boolean 0 1 /end CHARACTERISTIC
/begin CHARACTERISTIC KbDCSN_stop_request_enable "0 = disable stop request output
      1 = enable stop request output" VALUE 0x7010168c /* @ECU_Address@KbDCSN_stop_request_enable@ */ Scalar_BOOLEAN 0 DCSN_subsystem_integrated_CM_boolean 0 1 /end CHARACTERISTIC
/begin CHARACTERISTIC KbDCSN_use_EgmoLinearSpeed "0 = Use vehicle CAN velocity
      1 = Use egmo linear velocity" VALUE 0x70101689 /* @ECU_Address@KbDCSN_use_EgmoLinearSpeed@ */ Scalar_BOOLEAN 0 DCSN_subsystem_integrated_CM_boolean 0 1 /end CHARACTERISTIC
/begin CHARACTERISTIC KbDCSN_use_EgmoReadyFlag "0 = use calibration to output EGMO ready flag
      1 = use EGMO ready flag" VALUE 0x70101688 /* @ECU_Address@KbDCSN_use_EgmoReadyFlag@ */ Scalar_BOOLEAN 0 DCSN_subsystem_integrated_CM_boolean 0 1 /end CHARACTERISTIC
/begin CHARACTERISTIC KbDCSN_use_SLEW_override_logic "0 = disable override logic in SLEW
      1 = enable override logic in SLEW
      " VALUE 0x70101687 /* @ECU_Address@KbDCSN_use_SLEW_override_logic@ */ Scalar_BOOLEAN 0 DCSN_subsystem_integrated_CM_boolean 0 1 /end CHARACTERISTIC
/begin CHARACTERISTIC KbDCSN_use_SLEW_switch_control_mode "0 = Use normal control mode logic
      1 = Use driver switch as control mode activated" VALUE 0x70101686 /* @ECU_Address@KbDCSN_use_SLEW_switch_control_mode@ */ Scalar_BOOLEAN 0 DCSN_subsystem_integrated_CM_boolean 0 1 /end CHARACTERISTIC
/begin CHARACTERISTIC KbDCSN_use_faw_l4_logic "0 = use jac l3 logic
      1 = use faw l4 logic" VALUE 0x70101683 /* @ECU_Address@KbDCSN_use_faw_l4_logic@ */ Scalar_BOOLEAN 0 DCSN_subsystem_integrated_CM_boolean 0 1 /end CHARACTERISTIC
/begin CHARACTERISTIC KbDCSN_use_vehicle_activate_switch "0 = use calibration activate switch
      1 = use vehicle activate switch" VALUE 0x70101682 /* @ECU_Address@KbDCSN_use_vehicle_activate_switch@ */ Scalar_BOOLEAN 0 DCSN_subsystem_integrated_CM_boolean 0 1 /end CHARACTERISTIC
/begin CHARACTERISTIC KbDCSN_use_vehicle_control_mode_fedbak "0 = use vehicle control mode feedback
      1 = use calibration control mode" VALUE 0x70101681 /* @ECU_Address@KbDCSN_use_vehicle_control_mode_fedbak@ */ Scalar_BOOLEAN 0 DCSN_subsystem_integrated_CM_boolean 0 1 /end CHARACTERISTIC
/begin CHARACTERISTIC KbDCSN_vehicle_control_mode_man_value "When using slew mode for vehicle control mode feedback, the vehicle mode value" VALUE 0x70101680 /* @ECU_Address@KbDCSN_vehicle_control_mode_man_value@ */ Scalar_BOOLEAN 0 DCSN_subsystem_integrated_CM_boolean 0 1 /end CHARACTERISTIC
/begin AXIS_PTS KaAEBS_AXIS_Veh_Curvature_vec "" 0x70101570 /* @ECU_Address@KaAEBS_AXIS_Veh_Curvature_vec@ */ NO_INPUT_QUANTITY Lookup1D_X_FLOAT32_IEEE 0 AEBS_subsystem_integrated_CM_single 10 -3.4E+38 3.4E+38 /end AXIS_PTS
/begin MEASUREMENT VfAEBS_obs_v_long_vip "" FLOAT32_IEEE AEBS_subsystem_integrated_CM_single 0 0 -3.4E+38 3.4E+38 ECU_ADDRESS 0x7001053c /* @ECU_Address@VfAEBS_obs_v_long_vip@ */ /end MEASUREMENT
/begin MEASUREMENT VfAEBS_obs_acc_lateral_vip "" FLOAT32_IEEE AEBS_subsystem_integrated_CM_single 0 0 -3.4E+38 3.4E+38 ECU_ADDRESS 0x70010538 /* @ECU_Address@VfAEBS_obs_acc_lateral_vip@ */ /end MEASUREMENT
/begin MEASUREMENT VfAEBS_obs_acc_long_vip "" FLOAT32_IEEE AEBS_subsystem_integrated_CM_single 0 0 -3.4E+38 3.4E+38 ECU_ADDRESS 0x70010534 /* @ECU_Address@VfAEBS_obs_acc_long_vip@ */ /end MEASUREMENT
/begin MEASUREMENT VfAEBS_obs_center_x_vip "" FLOAT32_IEEE AEBS_subsystem_integrated_CM_single 0 0 -3.4E+38 3.4E+38 ECU_ADDRESS 0x70010530 /* @ECU_Address@VfAEBS_obs_center_x_vip@ */ /end MEASUREMENT
/begin MEASUREMENT VfAEBS_obs_center_y_vip "" FLOAT32_IEEE AEBS_subsystem_integrated_CM_single 0 0 -3.4E+38 3.4E+38 ECU_ADDRESS 0x7001052c /* @ECU_Address@VfAEBS_obs_center_y_vip@ */ /end MEASUREMENT
/begin MEASUREMENT VfAEBS_obs_heading_VIP "" FLOAT32_IEEE AEBS_subsystem_integrated_CM_single 0 0 -3.4E+38 3.4E+38 ECU_ADDRESS 0x70010528 /* @ECU_Address@VfAEBS_obs_heading_VIP@ */ /end MEASUREMENT
/begin MEASUREMENT VfAEBS_obs_length_VIP "" FLOAT32_IEEE AEBS_subsystem_integrated_CM_single 0 0 -3.4E+38 3.4E+38 ECU_ADDRESS 0x70010524 /* @ECU_Address@VfAEBS_obs_length_VIP@ */ /end MEASUREMENT
/begin MEASUREMENT VfAEBS_obs_width_VIP "" FLOAT32_IEEE AEBS_subsystem_integrated_CM_single 0 0 -3.4E+38 3.4E+38 ECU_ADDRESS 0x70010520 /* @ECU_Address@VfAEBS_obs_width_VIP@ */ /end MEASUREMENT
/begin MEASUREMENT VfAEBS_obs_dis_long_VIP "" FLOAT32_IEEE AEBS_subsystem_integrated_CM_single 0 0 -3.4E+38 3.4E+38 ECU_ADDRESS 0x7001051c /* @ECU_Address@VfAEBS_obs_dis_long_VIP@ */ /end MEASUREMENT
/begin MEASUREMENT VfAEBS_obs_dis_lateral_VIP "" FLOAT32_IEEE AEBS_subsystem_integrated_CM_single 0 0 -3.4E+38 3.4E+38 ECU_ADDRESS 0x70010518 /* @ECU_Address@VfAEBS_obs_dis_lateral_VIP@ */ /end MEASUREMENT
/begin MEASUREMENT VfAEBS_obs_rp_vip "" FLOAT32_IEEE AEBS_subsystem_integrated_CM_single 0 0 -3.4E+38 3.4E+38 ECU_ADDRESS 0x70010514 /* @ECU_Address@VfAEBS_obs_rp_vip@ */ /end MEASUREMENT
/begin MEASUREMENT VfAEBS_obs_ttc_vip "" FLOAT32_IEEE AEBS_subsystem_integrated_CM_single 0 0 -3.4E+38 3.4E+38 ECU_ADDRESS 0x70010510 /* @ECU_Address@VfAEBS_obs_ttc_vip@ */ /end MEASUREMENT
/begin MEASUREMENT VfAEBS_obs_delta_dis_vip "" FLOAT32_IEEE AEBS_subsystem_integrated_CM_single 0 0 -3.4E+38 3.4E+38 ECU_ADDRESS 0x7001050c /* @ECU_Address@VfAEBS_obs_delta_dis_vip@ */ /end MEASUREMENT
/begin MEASUREMENT VfAEBS_obs_delta_speed_vip "" FLOAT32_IEEE AEBS_subsystem_integrated_CM_single 0 0 -3.4E+38 3.4E+38 ECU_ADDRESS 0x70010508 /* @ECU_Address@VfAEBS_obs_delta_speed_vip@ */ /end MEASUREMENT
/begin MEASUREMENT VfAEBS_obs_v_lateral_vip "" FLOAT32_IEEE AEBS_subsystem_integrated_CM_single 0 0 -3.4E+38 3.4E+38 ECU_ADDRESS 0x70010504 /* @ECU_Address@VfAEBS_obs_v_lateral_vip@ */ /end MEASUREMENT
/begin MEASUREMENT VfAEBS_v_obj_absolute_speed "" FLOAT32_IEEE AEBS_subsystem_integrated_CM_single 0 0 -3.4E+38 3.4E+38 ECU_ADDRESS 0x70010500 /* @ECU_Address@VfAEBS_v_obj_absolute_speed@ */ /end MEASUREMENT
/begin MEASUREMENT VfAEBS_a_obj_absolute_acc "" FLOAT32_IEEE AEBS_subsystem_integrated_CM_single 0 0 -3.4E+38 3.4E+38 ECU_ADDRESS 0x700104fc /* @ECU_Address@VfAEBS_a_obj_absolute_acc@ */ /end MEASUREMENT
/begin MEASUREMENT VfAEBS_areq_withoutDelay_UrgentBrk "" FLOAT32_IEEE AEBS_subsystem_integrated_CM_single 0 0 -3.4E+38 3.4E+38 ECU_ADDRESS 0x700104f8 /* @ECU_Address@VfAEBS_areq_withoutDelay_UrgentBrk@ */ /end MEASUREMENT
/begin MEASUREMENT VfAEBS_areq_withoutDelay "" FLOAT32_IEEE AEBS_subsystem_integrated_CM_single 0 0 -3.4E+38 3.4E+38 ECU_ADDRESS 0x700104f4 /* @ECU_Address@VfAEBS_areq_withoutDelay@ */ /end MEASUREMENT
/begin MEASUREMENT VfAEBS_dis_delay "" FLOAT32_IEEE AEBS_subsystem_integrated_CM_single 0 0 -3.4E+38 3.4E+38 ECU_ADDRESS 0x700104f0 /* @ECU_Address@VfAEBS_dis_delay@ */ /end MEASUREMENT
/begin MEASUREMENT VfAEBS_areq "" FLOAT32_IEEE AEBS_subsystem_integrated_CM_single 0 0 -3.4E+38 3.4E+38 ECU_ADDRESS 0x700104ec /* @ECU_Address@VfAEBS_areq@ */ /end MEASUREMENT
/begin MEASUREMENT VfAEBS_AEB_acceleration_bf_limit "" FLOAT32_IEEE AEBS_subsystem_integrated_CM_single 0 0 -3.4E+38 3.4E+38 ECU_ADDRESS 0x700104e8 /* @ECU_Address@VfAEBS_AEB_acceleration_bf_limit@ */ /end MEASUREMENT
/begin MEASUREMENT VfAEBS_AEB_accReq_beforeSend "" FLOAT32_IEEE AEBS_subsystem_integrated_CM_single 0 0 -3.4E+38 3.4E+38 ECU_ADDRESS 0x700104e4 /* @ECU_Address@VfAEBS_AEB_accReq_beforeSend@ */ /end MEASUREMENT
/begin MEASUREMENT VfAEBS_FedBck_Vehspd "" FLOAT32_IEEE AEBS_subsystem_integrated_CM_single 0 0 -3.4E+38 3.4E+38 ECU_ADDRESS 0x700104dc /* @ECU_Address@VfAEBS_FedBck_Vehspd@ */ /end MEASUREMENT
/begin MEASUREMENT VfAEBS_FedBck_AccLong "" FLOAT32_IEEE AEBS_subsystem_integrated_CM_single 0 0 -3.4E+38 3.4E+38 ECU_ADDRESS 0x700104d8 /* @ECU_Address@VfAEBS_FedBck_AccLong@ */ /end MEASUREMENT
/begin MEASUREMENT VfAEBS_FedBck_StrAngle "" FLOAT32_IEEE AEBS_subsystem_integrated_CM_single 0 0 -3.4E+38 3.4E+38 ECU_ADDRESS 0x700104d4 /* @ECU_Address@VfAEBS_FedBck_StrAngle@ */ /end MEASUREMENT
/begin MEASUREMENT VfAEBS_FedBck_AccLateral "" FLOAT32_IEEE AEBS_subsystem_integrated_CM_single 0 0 -3.4E+38 3.4E+38 ECU_ADDRESS 0x700104d0 /* @ECU_Address@VfAEBS_FedBck_AccLateral@ */ /end MEASUREMENT
/begin MEASUREMENT VfAEBS_FedBck_yawRate "" FLOAT32_IEEE AEBS_subsystem_integrated_CM_single 0 0 -3.4E+38 3.4E+38 ECU_ADDRESS 0x700104cc /* @ECU_Address@VfAEBS_FedBck_yawRate@ */ /end MEASUREMENT
/begin MEASUREMENT VfAEBS_obs_id_vip "" SLONG AEBS_subsystem_integrated_CM_int32 0 0 -2147483648 2147483647 ECU_ADDRESS 0x700104bc /* @ECU_Address@VfAEBS_obs_id_vip@ */ /end MEASUREMENT
/begin MEASUREMENT VfAEBS_AEBS_obs_id "" SLONG AEBS_subsystem_integrated_CM_int32 0 0 -2147483648 2147483647 ECU_ADDRESS 0x700104b8 /* @ECU_Address@VfAEBS_AEBS_obs_id@ */ /end MEASUREMENT
/begin MEASUREMENT VfAEBS_obs_type_vip "" SBYTE AEBS_subsystem_integrated_CM_int8 0 0 -128 127 ECU_ADDRESS 0x7001049f /* @ECU_Address@VfAEBS_obs_type_vip@ */ /end MEASUREMENT
/begin MEASUREMENT VfAEBS_obs_index_vip "" UBYTE AEBS_subsystem_integrated_CM_uint8 0 0 0 255 ECU_ADDRESS 0x7001045e /* @ECU_Address@VfAEBS_obs_index_vip@ */ /end MEASUREMENT
/begin MEASUREMENT VfAEBS_obs_position_state_vip "" UBYTE AEBS_subsystem_integrated_CM_uint8 0 0 0 255 ECU_ADDRESS 0x7001045d /* @ECU_Address@VfAEBS_obs_position_state_vip@ */ /end MEASUREMENT
/begin MEASUREMENT VfAEBS_FCW_warn_level "" UBYTE AEBS_subsystem_integrated_CM_uint8 0 0 0 255 ECU_ADDRESS 0x7001045c /* @ECU_Address@VfAEBS_FCW_warn_level@ */ /end MEASUREMENT
/begin MEASUREMENT VfAEBS_FedBck_Drivemode "" UBYTE AEBS_subsystem_integrated_CM_uint8 0 0 0 255 ECU_ADDRESS 0x70010459 /* @ECU_Address@VfAEBS_FedBck_Drivemode@ */ /end MEASUREMENT
/begin MEASUREMENT VfAEBS_FedBck_BrkLightState "" UBYTE AEBS_subsystem_integrated_CM_uint8 0 0 0 255 ECU_ADDRESS 0x70010458 /* @ECU_Address@VfAEBS_FedBck_BrkLightState@ */ /end MEASUREMENT
/begin MEASUREMENT VfAEBS_FedBck_EPBstate "" UBYTE AEBS_subsystem_integrated_CM_uint8 0 0 0 255 ECU_ADDRESS 0x70010457 /* @ECU_Address@VfAEBS_FedBck_EPBstate@ */ /end MEASUREMENT
/begin MEASUREMENT VfAEBS_FedBck_GearValue "" UBYTE AEBS_subsystem_integrated_CM_uint8 0 0 0 255 ECU_ADDRESS 0x70010456 /* @ECU_Address@VfAEBS_FedBck_GearValue@ */ /end MEASUREMENT
/begin MEASUREMENT VfAEBS_FedBck_BrkPedPos "" UBYTE AEBS_subsystem_integrated_CM_uint8 0 0 0 255 ECU_ADDRESS 0x70010455 /* @ECU_Address@VfAEBS_FedBck_BrkPedPos@ */ /end MEASUREMENT
/begin MEASUREMENT VfAEBS_FedBck_AccPedPos "" UBYTE AEBS_subsystem_integrated_CM_uint8 0 0 0 255 ECU_ADDRESS 0x70010454 /* @ECU_Address@VfAEBS_FedBck_AccPedPos@ */ /end MEASUREMENT
/begin MEASUREMENT VfAEBS_FedBck_SmallLampState "" UBYTE AEBS_subsystem_integrated_CM_uint8 0 0 0 255 ECU_ADDRESS 0x70010453 /* @ECU_Address@VfAEBS_FedBck_SmallLampState@ */ /end MEASUREMENT
/begin MEASUREMENT VfAEBS_FedBck_LeftLampState "" UBYTE AEBS_subsystem_integrated_CM_uint8 0 0 0 255 ECU_ADDRESS 0x70010452 /* @ECU_Address@VfAEBS_FedBck_LeftLampState@ */ /end MEASUREMENT
/begin MEASUREMENT VfAEBS_FedBck_RightLampState "" UBYTE AEBS_subsystem_integrated_CM_uint8 0 0 0 255 ECU_ADDRESS 0x70010451 /* @ECU_Address@VfAEBS_FedBck_RightLampState@ */ /end MEASUREMENT
/begin MEASUREMENT VfAEBS_FCW_enabled "" UBYTE AEBS_subsystem_integrated_CM_boolean 0 0 0 1 ECU_ADDRESS 0x70010450 /* @ECU_Address@VfAEBS_FCW_enabled@ */ /end MEASUREMENT
/begin MEASUREMENT VfAEBS_FCWLev1_active "" UBYTE AEBS_subsystem_integrated_CM_boolean 0 0 0 1 ECU_ADDRESS 0x7001044f /* @ECU_Address@VfAEBS_FCWLev1_active@ */ /end MEASUREMENT
/begin MEASUREMENT VfAEBS_FCWLev1_dactive "" UBYTE AEBS_subsystem_integrated_CM_boolean 0 0 0 1 ECU_ADDRESS 0x7001044e /* @ECU_Address@VfAEBS_FCWLev1_dactive@ */ /end MEASUREMENT
/begin MEASUREMENT VfAEBS_FCWLev2_active "" UBYTE AEBS_subsystem_integrated_CM_boolean 0 0 0 1 ECU_ADDRESS 0x7001044d /* @ECU_Address@VfAEBS_FCWLev2_active@ */ /end MEASUREMENT
/begin MEASUREMENT VfAEBS_FCWLev2_dactive "" UBYTE AEBS_subsystem_integrated_CM_boolean 0 0 0 1 ECU_ADDRESS 0x7001044c /* @ECU_Address@VfAEBS_FCWLev2_dactive@ */ /end MEASUREMENT
/begin MEASUREMENT VfAEBS_FCWLev3_active "" UBYTE AEBS_subsystem_integrated_CM_boolean 0 0 0 1 ECU_ADDRESS 0x7001044b /* @ECU_Address@VfAEBS_FCWLev3_active@ */ /end MEASUREMENT
/begin MEASUREMENT VfAEBS_FCWLev3_dactive "" UBYTE AEBS_subsystem_integrated_CM_boolean 0 0 0 1 ECU_ADDRESS 0x7001044a /* @ECU_Address@VfAEBS_FCWLev3_dactive@ */ /end MEASUREMENT
/begin MEASUREMENT VfAEBS_FCW_disabled "" UBYTE AEBS_subsystem_integrated_CM_boolean 0 0 0 1 ECU_ADDRESS 0x70010449 /* @ECU_Address@VfAEBS_FCW_disabled@ */ /end MEASUREMENT
/begin MEASUREMENT VfAEBS_FCW_deacitve "" UBYTE AEBS_subsystem_integrated_CM_boolean 0 0 0 1 ECU_ADDRESS 0x70010448 /* @ECU_Address@VfAEBS_FCW_deacitve@ */ /end MEASUREMENT
/begin MEASUREMENT VbAEBS_has_obs_vip "" UBYTE AEBS_subsystem_integrated_CM_boolean 0 0 0 1 ECU_ADDRESS 0x70010447 /* @ECU_Address@VbAEBS_has_obs_vip@ */ /end MEASUREMENT
/begin MEASUREMENT VfAEBS_AEB_inhibit "" UBYTE AEBS_subsystem_integrated_CM_boolean 0 0 0 1 ECU_ADDRESS 0x70010446 /* @ECU_Address@VfAEBS_AEB_inhibit@ */ /end MEASUREMENT
/begin MEASUREMENT VfAEBS_preBrake_active "" UBYTE AEBS_subsystem_integrated_CM_boolean 0 0 0 1 ECU_ADDRESS 0x70010445 /* @ECU_Address@VfAEBS_preBrake_active@ */ /end MEASUREMENT
/begin MEASUREMENT VfAEBS_partialBrk_active "" UBYTE AEBS_subsystem_integrated_CM_boolean 0 0 0 1 ECU_ADDRESS 0x70010444 /* @ECU_Address@VfAEBS_partialBrk_active@ */ /end MEASUREMENT
/begin MEASUREMENT VfAEBS_fullBrk_active "" UBYTE AEBS_subsystem_integrated_CM_boolean 0 0 0 1 ECU_ADDRESS 0x70010443 /* @ECU_Address@VfAEBS_fullBrk_active@ */ /end MEASUREMENT
/begin MEASUREMENT VbAEBS_Deactive_R_NoVIP "" UBYTE AEBS_subsystem_integrated_CM_boolean 0 0 0 1 ECU_ADDRESS 0x70010442 /* @ECU_Address@VbAEBS_Deactive_R_NoVIP@ */ /end MEASUREMENT
/begin MEASUREMENT VbAEBS_Deactive_R_VIPChanged "" UBYTE AEBS_subsystem_integrated_CM_boolean 0 0 0 1 ECU_ADDRESS 0x70010441 /* @ECU_Address@VbAEBS_Deactive_R_VIPChanged@ */ /end MEASUREMENT
/begin MEASUREMENT VfAEBS_DeniedDueToSpdRed "" UBYTE AEBS_subsystem_integrated_CM_boolean 0 0 0 1 ECU_ADDRESS 0x70010440 /* @ECU_Address@VfAEBS_DeniedDueToSpdRed@ */ /end MEASUREMENT
/begin MEASUREMENT VfAEBS_DeniedDueToTimeBrake "" UBYTE AEBS_subsystem_integrated_CM_boolean 0 0 0 1 ECU_ADDRESS 0x7001043f /* @ECU_Address@VfAEBS_DeniedDueToTimeBrake@ */ /end MEASUREMENT
/begin MEASUREMENT VfAEBS_AEB_enabled "" UBYTE AEBS_subsystem_integrated_CM_boolean 0 0 0 1 ECU_ADDRESS 0x7001043e /* @ECU_Address@VfAEBS_AEB_enabled@ */ /end MEASUREMENT
/begin MEASUREMENT VfAEBS_preBrake_dactive "" UBYTE AEBS_subsystem_integrated_CM_boolean 0 0 0 1 ECU_ADDRESS 0x7001043d /* @ECU_Address@VfAEBS_preBrake_dactive@ */ /end MEASUREMENT
/begin MEASUREMENT VfAEBS_partialBrk_dactive "" UBYTE AEBS_subsystem_integrated_CM_boolean 0 0 0 1 ECU_ADDRESS 0x7001043c /* @ECU_Address@VfAEBS_partialBrk_dactive@ */ /end MEASUREMENT
/begin MEASUREMENT VfAEBS_fullBrk_dactive "" UBYTE AEBS_subsystem_integrated_CM_boolean 0 0 0 1 ECU_ADDRESS 0x7001043b /* @ECU_Address@VfAEBS_fullBrk_dactive@ */ /end MEASUREMENT
/begin MEASUREMENT VfAEBS_AEB_disabled "" UBYTE AEBS_subsystem_integrated_CM_boolean 0 0 0 1 ECU_ADDRESS 0x7001043a /* @ECU_Address@VfAEBS_AEB_disabled@ */ /end MEASUREMENT
/begin MEASUREMENT VfAEBS_veh_standstill "" UBYTE AEBS_subsystem_integrated_CM_boolean 0 0 0 1 ECU_ADDRESS 0x70010439 /* @ECU_Address@VfAEBS_veh_standstill@ */ /end MEASUREMENT
/begin MEASUREMENT VbAEBS_Deactive_R_HighTTC "" UBYTE AEBS_subsystem_integrated_CM_boolean 0 0 0 1 ECU_ADDRESS 0x70010438 /* @ECU_Address@VbAEBS_Deactive_R_HighTTC@ */ /end MEASUREMENT
/begin MEASUREMENT VfAEBS_AEB_deactive "" UBYTE AEBS_subsystem_integrated_CM_boolean 0 0 0 1 ECU_ADDRESS 0x70010437 /* @ECU_Address@VfAEBS_AEB_deactive@ */ /end MEASUREMENT
/begin MEASUREMENT VfAEBS_AEB_request_beforeSend "" UBYTE AEBS_subsystem_integrated_CM_boolean 0 0 0 1 ECU_ADDRESS 0x70010436 /* @ECU_Address@VfAEBS_AEB_request_beforeSend@ */ /end MEASUREMENT
/begin MEASUREMENT VfAEBS_FCW_active_state "" UBYTE AEBS_subsystem_integrated_CM_EnumAEBS_FCWState 0 0 0 5 ECU_ADDRESS 0x70010431 /* @ECU_Address@VfAEBS_FCW_active_state@ */ /end MEASUREMENT
/begin MEASUREMENT VeAEBS_TurnType "" UBYTE AEBS_subsystem_integrated_CM_EnumAEBS_TurnType 0 0 1 4 ECU_ADDRESS 0x70010430 /* @ECU_Address@VeAEBS_TurnType@ */ /end MEASUREMENT
/begin MEASUREMENT VfARBT_steer_req_strwhl_torque "" FLOAT32_IEEE ARBT_subsystem_integrated_CM_single_Nm 0 0 -3.4E+38 3.4E+38 ECU_ADDRESS 0xb0002e90 /* @ECU_Address@VfARBT_steer_req_strwhl_torque@ */ /end MEASUREMENT
/begin MEASUREMENT VfARBT_steer_req_strwhl_angle_raw "raw steer angle request after arbitration before saturation" FLOAT32_IEEE ARBT_subsystem_integrated_CM_single_deg 0 0 -3.4E+38 3.4E+38 ECU_ADDRESS 0xb0002e8c /* @ECU_Address@VfARBT_steer_req_strwhl_angle_raw@ */ /end MEASUREMENT
/begin MEASUREMENT VfARBT_steer_req_strwhl_angle "final steer angle req (as deg) after arbitration and saturation" FLOAT32_IEEE ARBT_subsystem_integrated_CM_single_deg 0 0 -3.4E+38 3.4E+38 ECU_ADDRESS 0xb0002e88 /* @ECU_Address@VfARBT_steer_req_strwhl_angle@ */ /end MEASUREMENT
/begin MEASUREMENT VfARBT_power_req_torque "" FLOAT32_IEEE ARBT_subsystem_integrated_CM_single 0 0 -3.4E+38 3.4E+38 ECU_ADDRESS 0xb0002e84 /* @ECU_Address@VfARBT_power_req_torque@ */ /end MEASUREMENT
/begin MEASUREMENT VfARBT_power_req_lon_a_raw "raw power request after arbitration before saturation" FLOAT32_IEEE ARBT_subsystem_integrated_CM_single_m_s2 0 0 -3.4E+38 3.4E+38 ECU_ADDRESS 0xb0002e80 /* @ECU_Address@VfARBT_power_req_lon_a_raw@ */ /end MEASUREMENT
/begin MEASUREMENT VfARBT_power_req_lon_a "final power req (as m/s2) after arbitration and saturation" FLOAT32_IEEE ARBT_subsystem_integrated_CM_single_m_s2 0 0 -3.4E+38 3.4E+38 ECU_ADDRESS 0xb0002e7c /* @ECU_Address@VfARBT_power_req_lon_a@ */ /end MEASUREMENT
/begin MEASUREMENT VfARBT_brake_req_lon_a_raw "raw brake request after arbitration before saturation" FLOAT32_IEEE ARBT_subsystem_integrated_CM_single_m_s2 0 0 -3.4E+38 3.4E+38 ECU_ADDRESS 0xb0002e78 /* @ECU_Address@VfARBT_brake_req_lon_a_raw@ */ /end MEASUREMENT
/begin MEASUREMENT VfARBT_brake_req_lon_a "final brake req (as m/s2) after arbitration and saturation" FLOAT32_IEEE ARBT_subsystem_integrated_CM_single_m_s2 0 0 -3.4E+38 3.4E+38 ECU_ADDRESS 0xb0002e74 /* @ECU_Address@VfARBT_brake_req_lon_a@ */ /end MEASUREMENT
/begin MEASUREMENT VfARBT_steer_req_mode "0 = acceleration mode
      1 = torque mode" UBYTE ARBT_subsystem_integrated_CM_uint8 0 0 0 255 ECU_ADDRESS 0xb0002e73 /* @ECU_Address@VfARBT_steer_req_mode@ */ /end MEASUREMENT
/begin MEASUREMENT VfARBT_power_req_mode "0 = steering wheel angle
      1 = steering wheel torque" UBYTE ARBT_subsystem_integrated_CM_uint8 0 0 0 255 ECU_ADDRESS 0xb0002e72 /* @ECU_Address@VfARBT_power_req_mode@ */ /end MEASUREMENT
/begin MEASUREMENT VfARBT_gear_pos_req "Gear Pos Definition
      0->N
      1->D
      13->R
      14->P
      15->Invalid" UBYTE ARBT_subsystem_integrated_CM_uint8 0 0 0 255 ECU_ADDRESS 0xb0002e71 /* @ECU_Address@VfARBT_gear_pos_req@ */ /end MEASUREMENT
/begin MEASUREMENT VfARBT_gear_ctrl_state "" UBYTE ARBT_subsystem_integrated_CM_uint8 0 0 0 255 ECU_ADDRESS 0xb0002e70 /* @ECU_Address@VfARBT_gear_ctrl_state@ */ /end MEASUREMENT
/begin MEASUREMENT VbARBT_EPB_ctrl_mode "" UBYTE ARBT_subsystem_integrated_CM_uint8 0 0 0 255 ECU_ADDRESS 0xb0002e6f /* @ECU_Address@VbARBT_EPB_ctrl_mode@ */ /end MEASUREMENT
/begin MEASUREMENT VbARBT_FCW_level_one "" UBYTE ARBT_subsystem_integrated_CM_boolean 0 0 0 1 ECU_ADDRESS 0xb0002e6e /* @ECU_Address@VbARBT_FCW_level_one@ */ /end MEASUREMENT
/begin MEASUREMENT VbARBT_FCW_level_two "" UBYTE ARBT_subsystem_integrated_CM_boolean 0 0 0 1 ECU_ADDRESS 0xb0002e6d /* @ECU_Address@VbARBT_FCW_level_two@ */ /end MEASUREMENT
/begin MEASUREMENT VbARBT_LDW_left "" UBYTE ARBT_subsystem_integrated_CM_boolean 0 0 0 1 ECU_ADDRESS 0xb0002e6c /* @ECU_Address@VbARBT_LDW_left@ */ /end MEASUREMENT
/begin MEASUREMENT VbARBT_LDW_right "" UBYTE ARBT_subsystem_integrated_CM_boolean 0 0 0 1 ECU_ADDRESS 0xb0002e6b /* @ECU_Address@VbARBT_LDW_right@ */ /end MEASUREMENT
/begin MEASUREMENT VbARBT_LCW_left_level_one "" UBYTE ARBT_subsystem_integrated_CM_boolean 0 0 0 1 ECU_ADDRESS 0xb0002e6a /* @ECU_Address@VbARBT_LCW_left_level_one@ */ /end MEASUREMENT
/begin MEASUREMENT VbARBT_LCW_left_level_two "" UBYTE ARBT_subsystem_integrated_CM_boolean 0 0 0 1 ECU_ADDRESS 0xb0002e69 /* @ECU_Address@VbARBT_LCW_left_level_two@ */ /end MEASUREMENT
/begin MEASUREMENT VbARBT_LCW_right_level_one "" UBYTE ARBT_subsystem_integrated_CM_boolean 0 0 0 1 ECU_ADDRESS 0xb0002e68 /* @ECU_Address@VbARBT_LCW_right_level_one@ */ /end MEASUREMENT
/begin MEASUREMENT VbARBT_LCW_right_level_two "" UBYTE ARBT_subsystem_integrated_CM_boolean 0 0 0 1 ECU_ADDRESS 0xb0002e67 /* @ECU_Address@VbARBT_LCW_right_level_two@ */ /end MEASUREMENT
/begin MEASUREMENT VbARBT_steer_ctrl_enbl_to_comm "" UBYTE ARBT_subsystem_integrated_CM_boolean 0 0 0 1 ECU_ADDRESS 0xb0002e66 /* @ECU_Address@VbARBT_steer_ctrl_enbl_to_comm@ */ /end MEASUREMENT
/begin MEASUREMENT VbARBT_aeb_triggered_flag "Flag of whether AEB is triggered" UBYTE ARBT_subsystem_integrated_CM_boolean 0 0 0 1 ECU_ADDRESS 0xb0002e65 /* @ECU_Address@VbARBT_aeb_triggered_flag@ */ /end MEASUREMENT
/begin MEASUREMENT VbARBT_missed_aeb_flag "Flag of whether a missed aeb event is detected" UBYTE ARBT_subsystem_integrated_CM_boolean 0 0 0 1 ECU_ADDRESS 0xb0002e64 /* @ECU_Address@VbARBT_missed_aeb_flag@ */ /end MEASUREMENT
/begin MEASUREMENT VbARBT_false_aeb_flag "Flag of whether a false AEB event is detected
      " UBYTE ARBT_subsystem_integrated_CM_boolean 0 0 0 1 ECU_ADDRESS 0xb0002e63 /* @ECU_Address@VbARBT_false_aeb_flag@ */ /end MEASUREMENT
/begin MEASUREMENT VbARBT_driver_hard_brake_flag "Flag of whether driver is taking a hard brake" UBYTE ARBT_subsystem_integrated_CM_boolean 0 0 0 1 ECU_ADDRESS 0xb0002e62 /* @ECU_Address@VbARBT_driver_hard_brake_flag@ */ /end MEASUREMENT
/begin MEASUREMENT VbARBT_power_ctrl_enbl_to_comm "" UBYTE ARBT_subsystem_integrated_CM_boolean 0 0 0 1 ECU_ADDRESS 0xb0002e61 /* @ECU_Address@VbARBT_power_ctrl_enbl_to_comm@ */ /end MEASUREMENT
/begin MEASUREMENT VbARBT_brake_ctrl_enbl_to_comm "" UBYTE ARBT_subsystem_integrated_CM_boolean 0 0 0 1 ECU_ADDRESS 0xb0002e60 /* @ECU_Address@VbARBT_brake_ctrl_enbl_to_comm@ */ /end MEASUREMENT
/begin MEASUREMENT VbARBT_EPB_ctrl_enbl_to_comm "" UBYTE ARBT_subsystem_integrated_CM_boolean 0 0 0 1 ECU_ADDRESS 0xb0002e5f /* @ECU_Address@VbARBT_EPB_ctrl_enbl_to_comm@ */ /end MEASUREMENT
/begin MEASUREMENT VbARBT_vehicle_standstill "" UBYTE ARBT_subsystem_integrated_CM_boolean 0 0 0 1 ECU_ADDRESS 0xb0002e5e /* @ECU_Address@VbARBT_vehicle_standstill@ */ /end MEASUREMENT
/begin MEASUREMENT VbARBT_EPB_switch_request "1 = clamping request
      0 = release request" UBYTE ARBT_subsystem_integrated_CM_boolean 0 0 0 1 ECU_ADDRESS 0xb0002e5d /* @ECU_Address@VbARBT_EPB_switch_request@ */ /end MEASUREMENT
/begin MEASUREMENT VbARBT_gear_ctrl_enbl_to_comm "" UBYTE ARBT_subsystem_integrated_CM_boolean 0 0 0 1 ECU_ADDRESS 0xb0002e5c /* @ECU_Address@VbARBT_gear_ctrl_enbl_to_comm@ */ /end MEASUREMENT
/begin MEASUREMENT VbARBT_auto_hold_req "" UBYTE ARBT_subsystem_integrated_CM_boolean 0 0 0 1 ECU_ADDRESS 0xb0002e5b /* @ECU_Address@VbARBT_auto_hold_req@ */ /end MEASUREMENT
/begin MEASUREMENT VeARBT_steer_arbt_winner "" UBYTE ARBT_subsystem_integrated_CM_EnumARBT_arbitration_winner 0 0 0 6 ECU_ADDRESS 0xb0002e5a /* @ECU_Address@VeARBT_steer_arbt_winner@ */ /end MEASUREMENT
/begin MEASUREMENT VeARBT_power_arbt_winner "" UBYTE ARBT_subsystem_integrated_CM_EnumARBT_arbitration_winner 0 0 0 6 ECU_ADDRESS 0xb0002e59 /* @ECU_Address@VeARBT_power_arbt_winner@ */ /end MEASUREMENT
/begin MEASUREMENT VeARBT_brake_arbt_winner "" UBYTE ARBT_subsystem_integrated_CM_EnumARBT_arbitration_winner 0 0 0 6 ECU_ADDRESS 0xb0002e58 /* @ECU_Address@VeARBT_brake_arbt_winner@ */ /end MEASUREMENT
/begin MEASUREMENT VbHWIO_DriverModeComd "" UBYTE COMM_subsystem_integrated_CM_boolean 0 0 0 1 ECU_ADDRESS 0xb0003870 /* @ECU_Address@VbHWIO_DriverModeComd@ */ /end MEASUREMENT
/begin MEASUREMENT VfCOMM_Decs_Breake_Value "" FLOAT32_IEEE COMM_subsystem_integrated_CM_single 0 0 -3.4E+38 3.4E+38 ECU_ADDRESS 0xb00035f4 /* @ECU_Address@VfCOMM_Decs_Breake_Value@ */ /end MEASUREMENT
/begin MEASUREMENT VfCOMM_Decs_Acc_Value "" FLOAT32_IEEE COMM_subsystem_integrated_CM_single 0 0 -3.4E+38 3.4E+38 ECU_ADDRESS 0xb00035f0 /* @ECU_Address@VfCOMM_Decs_Acc_Value@ */ /end MEASUREMENT
/begin MEASUREMENT VfCOMM_Decs_SteeringAngle "" FLOAT32_IEEE COMM_subsystem_integrated_CM_single 0 0 -3.4E+38 3.4E+38 ECU_ADDRESS 0xb00035ec /* @ECU_Address@VfCOMM_Decs_SteeringAngle@ */ /end MEASUREMENT
/begin MEASUREMENT VcCOMM_EPB_control_enable "EPB control enable flag." FLOAT32_IEEE COMM_subsystem_integrated_CM_single 0 0 -3.4E+38 3.4E+38 ECU_ADDRESS 0xb00035e8 /* @ECU_Address@VcCOMM_EPB_control_enable@ */ /end MEASUREMENT
/begin MEASUREMENT VcCOMM_EPB_switch_request "EPB Switch request. 0 = Release, 1 = Clamp." FLOAT32_IEEE COMM_subsystem_integrated_CM_single 0 0 -3.4E+38 3.4E+38 ECU_ADDRESS 0xb00035e4 /* @ECU_Address@VcCOMM_EPB_switch_request@ */ /end MEASUREMENT
/begin MEASUREMENT VfCOMM_req_pct_torque_raw "Power requested torque in percentage." FLOAT32_IEEE COMM_subsystem_integrated_CM_single 0 0 -3.4E+38 3.4E+38 ECU_ADDRESS 0xb00035e0 /* @ECU_Address@VfCOMM_req_pct_torque_raw@ */ /end MEASUREMENT
/begin MEASUREMENT VcCOMM_max_gas_pedal_EPB "" FLOAT32_IEEE COMM_subsystem_integrated_CM_single 0 0 -3.4E+38 3.4E+38 ECU_ADDRESS 0xb00035dc /* @ECU_Address@VcCOMM_max_gas_pedal_EPB@ */ /end MEASUREMENT
/begin MEASUREMENT VfCOMM_EPS_SteeringTorqueAct "" FLOAT32_IEEE COMM_subsystem_integrated_CM_single 0 0 -3.4E+38 3.4E+38 ECU_ADDRESS 0xb00035d8 /* @ECU_Address@VfCOMM_EPS_SteeringTorqueAct@ */ /end MEASUREMENT
/begin MEASUREMENT VfCOMM_VCU_LongitudinalAcc "" FLOAT32_IEEE COMM_subsystem_integrated_CM_single 0 0 -3.4E+38 3.4E+38 ECU_ADDRESS 0xb00035d4 /* @ECU_Address@VfCOMM_VCU_LongitudinalAcc@ */ /end MEASUREMENT
/begin MEASUREMENT VfCOMM_VCU_BrkPedPos "Brake pedal position." FLOAT32_IEEE COMM_subsystem_integrated_CM_single 0 0 -3.4E+38 3.4E+38 ECU_ADDRESS 0xb00035d0 /* @ECU_Address@VfCOMM_VCU_BrkPedPos@ */ /end MEASUREMENT
/begin MEASUREMENT VfCOMM_VCU_YawRate "Yaw Rate." FLOAT32_IEEE COMM_subsystem_integrated_CM_single 0 0 -3.4E+38 3.4E+38 ECU_ADDRESS 0xb00035cc /* @ECU_Address@VfCOMM_VCU_YawRate@ */ /end MEASUREMENT
/begin MEASUREMENT VfCOMM_VCU_LateralAcc "Lateral acceleration (m/s~2)." FLOAT32_IEEE COMM_subsystem_integrated_CM_single 0 0 -3.4E+38 3.4E+38 ECU_ADDRESS 0xb00035c8 /* @ECU_Address@VfCOMM_VCU_LateralAcc@ */ /end MEASUREMENT
/begin MEASUREMENT VfCOMM_VCU_ESCWhlRRSpd "Rear right wheel speed (kph)." FLOAT32_IEEE COMM_subsystem_integrated_CM_single 0 0 -3.4E+38 3.4E+38 ECU_ADDRESS 0xb00035c4 /* @ECU_Address@VfCOMM_VCU_ESCWhlRRSpd@ */ /end MEASUREMENT
/begin MEASUREMENT VfCOMM_VCU_ESCWhlRLSpd "Rear left wheel speed (kph)." FLOAT32_IEEE COMM_subsystem_integrated_CM_single 0 0 -3.4E+38 3.4E+38 ECU_ADDRESS 0xb00035c0 /* @ECU_Address@VfCOMM_VCU_ESCWhlRLSpd@ */ /end MEASUREMENT
/begin MEASUREMENT VfCOMM_VCU_ESCWhlFRSpd "Front right wheel speed (kph)." FLOAT32_IEEE COMM_subsystem_integrated_CM_single 0 0 -3.4E+38 3.4E+38 ECU_ADDRESS 0xb00035bc /* @ECU_Address@VfCOMM_VCU_ESCWhlFRSpd@ */ /end MEASUREMENT
/begin MEASUREMENT VfCOMM_VCU_ESCWhlFLSpd "Front left wheel speed (kph)." FLOAT32_IEEE COMM_subsystem_integrated_CM_single 0 0 -3.4E+38 3.4E+38 ECU_ADDRESS 0xb00035b8 /* @ECU_Address@VfCOMM_VCU_ESCWhlFLSpd@ */ /end MEASUREMENT
/begin MEASUREMENT VfCOMM_Decs_FedBck_StrAngle "" FLOAT32_IEEE COMM_subsystem_integrated_CM_single 0 0 -3.4E+38 3.4E+38 ECU_ADDRESS 0xb00035b4 /* @ECU_Address@VfCOMM_Decs_FedBck_StrAngle@ */ /end MEASUREMENT
/begin MEASUREMENT VfCOMM_Decs_FedBck_VehSpd "" FLOAT32_IEEE COMM_subsystem_integrated_CM_single 0 0 -3.4E+38 3.4E+38 ECU_ADDRESS 0xb00035b0 /* @ECU_Address@VfCOMM_Decs_FedBck_VehSpd@ */ /end MEASUREMENT
/begin MEASUREMENT VfCOMM_AccPedl "" FLOAT32_IEEE COMM_subsystem_integrated_CM_single 0 0 -3.4E+38 3.4E+38 ECU_ADDRESS 0xb00035ac /* @ECU_Address@VfCOMM_AccPedl@ */ /end MEASUREMENT
/begin MEASUREMENT VfCOMM_Actual_Gear_Ratio "" FLOAT32_IEEE COMM_subsystem_integrated_CM_single 0 0 -3.4E+38 3.4E+38 ECU_ADDRESS 0xb00035a8 /* @ECU_Address@VfCOMM_Actual_Gear_Ratio@ */ /end MEASUREMENT
/begin MEASUREMENT VfCOMM_req_pct_torque_final "" SWORD COMM_subsystem_integrated_CM_int16 0 0 -32768 32767 ECU_ADDRESS 0xb00035a4 /* @ECU_Address@VfCOMM_req_pct_torque_final@ */ /end MEASUREMENT
/begin MEASUREMENT VcCOMM_Auto_To_Manual_Tips "" UWORD COMM_subsystem_integrated_CM_uint16 0 0 0 65535 ECU_ADDRESS 0xb00035a2 /* @ECU_Address@VcCOMM_Auto_To_Manual_Tips@ */ /end MEASUREMENT
/begin MEASUREMENT VcCOMM_Decs_WarnLight_Req "" UBYTE COMM_subsystem_integrated_CM_uint8 0 0 0 255 ECU_ADDRESS 0xb00035a0 /* @ECU_Address@VcCOMM_Decs_WarnLight_Req@ */ /end MEASUREMENT
/begin MEASUREMENT VcCOMM_Decs_RihtLmp_Req "" UBYTE COMM_subsystem_integrated_CM_uint8 0 0 0 255 ECU_ADDRESS 0xb000359f /* @ECU_Address@VcCOMM_Decs_RihtLmp_Req@ */ /end MEASUREMENT
/begin MEASUREMENT VcCOMM_Decs_Light_Req "" UBYTE COMM_subsystem_integrated_CM_uint8 0 0 0 255 ECU_ADDRESS 0xb000359e /* @ECU_Address@VcCOMM_Decs_Light_Req@ */ /end MEASUREMENT
/begin MEASUREMENT VcCOMM_Decs_LftLmp_Req "" UBYTE COMM_subsystem_integrated_CM_uint8 0 0 0 255 ECU_ADDRESS 0xb000359d /* @ECU_Address@VcCOMM_Decs_LftLmp_Req@ */ /end MEASUREMENT
/begin MEASUREMENT VcCOMM_Decs_Horn_Req "" UBYTE COMM_subsystem_integrated_CM_uint8 0 0 0 255 ECU_ADDRESS 0xb000359c /* @ECU_Address@VcCOMM_Decs_Horn_Req@ */ /end MEASUREMENT
/begin MEASUREMENT VcCOMM_Decs_HighBeam_Req "" UBYTE COMM_subsystem_integrated_CM_uint8 0 0 0 255 ECU_ADDRESS 0xb000359b /* @ECU_Address@VcCOMM_Decs_HighBeam_Req@ */ /end MEASUREMENT
/begin MEASUREMENT VcCOMM_Decs_FrontFogLamp_Req "" UBYTE COMM_subsystem_integrated_CM_uint8 0 0 0 255 ECU_ADDRESS 0xb000359a /* @ECU_Address@VcCOMM_Decs_FrontFogLamp_Req@ */ /end MEASUREMENT
/begin MEASUREMENT VcCOMM_Decs_DippedBeam_Req "" UBYTE COMM_subsystem_integrated_CM_uint8 0 0 0 255 ECU_ADDRESS 0xb0003599 /* @ECU_Address@VcCOMM_Decs_DippedBeam_Req@ */ /end MEASUREMENT
/begin MEASUREMENT VcCOMM_Decs_BrkLight_Req "" UBYTE COMM_subsystem_integrated_CM_uint8 0 0 0 255 ECU_ADDRESS 0xb0003598 /* @ECU_Address@VcCOMM_Decs_BrkLight_Req@ */ /end MEASUREMENT
/begin MEASUREMENT VcCOMM_Decs_BckfogLmp_Req "" UBYTE COMM_subsystem_integrated_CM_uint8 0 0 0 255 ECU_ADDRESS 0xb0003597 /* @ECU_Address@VcCOMM_Decs_BckfogLmp_Req@ */ /end MEASUREMENT
/begin MEASUREMENT VcCOMM_Decs_Control_mod "" UBYTE COMM_subsystem_integrated_CM_uint8 0 0 0 255 ECU_ADDRESS 0xb0003596 /* @ECU_Address@VcCOMM_Decs_Control_mod@ */ /end MEASUREMENT
/begin MEASUREMENT VcCOMM_Decs_iBCM_Req "" UBYTE COMM_subsystem_integrated_CM_uint8 0 0 0 255 ECU_ADDRESS 0xb0003595 /* @ECU_Address@VcCOMM_Decs_iBCM_Req@ */ /end MEASUREMENT
/begin MEASUREMENT VcCOMM_Decs_Gear_Value "" UBYTE COMM_subsystem_integrated_CM_uint8 0 0 0 255 ECU_ADDRESS 0xb0003594 /* @ECU_Address@VcCOMM_Decs_Gear_Value@ */ /end MEASUREMENT
/begin MEASUREMENT VcCOMM_Decs_Gear_Req "" UBYTE COMM_subsystem_integrated_CM_uint8 0 0 0 255 ECU_ADDRESS 0xb0003593 /* @ECU_Address@VcCOMM_Decs_Gear_Req@ */ /end MEASUREMENT
/begin MEASUREMENT VcCOMM_Decs_Breake_Req "" UBYTE COMM_subsystem_integrated_CM_uint8 0 0 0 255 ECU_ADDRESS 0xb0003592 /* @ECU_Address@VcCOMM_Decs_Breake_Req@ */ /end MEASUREMENT
/begin MEASUREMENT VcCOMM_Decs_Acc_Req "" UBYTE COMM_subsystem_integrated_CM_uint8 0 0 0 255 ECU_ADDRESS 0xb0003591 /* @ECU_Address@VcCOMM_Decs_Acc_Req@ */ /end MEASUREMENT
/begin MEASUREMENT VcCOMM_Decs_Steering_Req "" UBYTE COMM_subsystem_integrated_CM_uint8 0 0 0 255 ECU_ADDRESS 0xb0003590 /* @ECU_Address@VcCOMM_Decs_Steering_Req@ */ /end MEASUREMENT
/begin MEASUREMENT VcCOMM_Decs_FedBck_EPBstate "" UBYTE COMM_subsystem_integrated_CM_uint8 0 0 0 255 ECU_ADDRESS 0xb000358f /* @ECU_Address@VcCOMM_Decs_FedBck_EPBstate@ */ /end MEASUREMENT
/begin MEASUREMENT VcCOMM_DriverModeComd "" UBYTE COMM_subsystem_integrated_CM_uint8 0 0 0 255 ECU_ADDRESS 0xb000358e /* @ECU_Address@VcCOMM_DriverModeComd@ */ /end MEASUREMENT
/begin MEASUREMENT VcCOMM_Decs_FedBck_KeyState "Ignition Key State." UBYTE COMM_subsystem_integrated_CM_uint8 0 0 0 255 ECU_ADDRESS 0xb000358d /* @ECU_Address@VcCOMM_Decs_FedBck_KeyState@ */ /end MEASUREMENT
/begin MEASUREMENT VcCOMM_VCU_DirIndicationLH "Left turning lamp status." UBYTE COMM_subsystem_integrated_CM_uint8 0 0 0 255 ECU_ADDRESS 0xb000358c /* @ECU_Address@VcCOMM_VCU_DirIndicationLH@ */ /end MEASUREMENT
/begin MEASUREMENT VcCOMM_VCU_DirIndicationRH "Right turning lamp status." UBYTE COMM_subsystem_integrated_CM_uint8 0 0 0 255 ECU_ADDRESS 0xb000358b /* @ECU_Address@VcCOMM_VCU_DirIndicationRH@ */ /end MEASUREMENT
/begin MEASUREMENT VcCOMM_Decs_FedBck_BrkPedSts "" UBYTE COMM_subsystem_integrated_CM_uint8 0 0 0 255 ECU_ADDRESS 0xb000358a /* @ECU_Address@VcCOMM_Decs_FedBck_BrkPedSts@ */ /end MEASUREMENT
/begin MEASUREMENT VcCOMM_VCU_HeadLampLowBeam "" UBYTE COMM_subsystem_integrated_CM_uint8 0 0 0 255 ECU_ADDRESS 0xb0003589 /* @ECU_Address@VcCOMM_VCU_HeadLampLowBeam@ */ /end MEASUREMENT
/begin MEASUREMENT VcCOMM_VCU_HeadLampHighBeam "" UBYTE COMM_subsystem_integrated_CM_uint8 0 0 0 255 ECU_ADDRESS 0xb0003588 /* @ECU_Address@VcCOMM_VCU_HeadLampHighBeam@ */ /end MEASUREMENT
/begin MEASUREMENT VcCOMM_Decs_FedBck_EPSmod "" UBYTE COMM_subsystem_integrated_CM_uint8 0 0 0 255 ECU_ADDRESS 0xb0003587 /* @ECU_Address@VcCOMM_Decs_FedBck_EPSmod@ */ /end MEASUREMENT
/begin MEASUREMENT VcCOMM_Decs_FedBck_ESCmod "" UBYTE COMM_subsystem_integrated_CM_uint8 0 0 0 255 ECU_ADDRESS 0xb0003586 /* @ECU_Address@VcCOMM_Decs_FedBck_ESCmod@ */ /end MEASUREMENT
/begin MEASUREMENT VcCOMM_Decs_FedBck_Drivemod "" UBYTE COMM_subsystem_integrated_CM_uint8 0 0 0 255 ECU_ADDRESS 0xb0003585 /* @ECU_Address@VcCOMM_Decs_FedBck_Drivemod@ */ /end MEASUREMENT
/begin MEASUREMENT VcCOMM_Decs_FedBck_GearValue "" UBYTE COMM_subsystem_integrated_CM_uint8 0 0 0 255 ECU_ADDRESS 0xb0003584 /* @ECU_Address@VcCOMM_Decs_FedBck_GearValue@ */ /end MEASUREMENT
/begin MEASUREMENT VfDCSN_vehicle_speed_egmo "The linear velocity of ego vehicle from egmo" FLOAT32_IEEE DCSN_subsystem_integrated_CM_single_m_s 0 0 -3.4E+38 3.4E+38 ECU_ADDRESS 0x70010a40 /* @ECU_Address@VfDCSN_vehicle_speed_egmo@ */ /end MEASUREMENT
/begin MEASUREMENT VeDCSN_usr_cmd_autodrive_activate "usr activate cmd
      0 = deactivate
      1 = activate
      2 = hold" UBYTE DCSN_subsystem_integrated_CM_uint8 0 0 0 255 ECU_ADDRESS 0x70010a2c /* @ECU_Address@VeDCSN_usr_cmd_autodrive_activate@ */ /end MEASUREMENT
/begin MEASUREMENT VbDCSN_speed_limit_enabled "Whether the speed limit output is enabled" UBYTE DCSN_subsystem_integrated_CM_boolean 0 0 0 1 ECU_ADDRESS 0x70010a2a /* @ECU_Address@VbDCSN_speed_limit_enabled@ */ /end MEASUREMENT
/begin MEASUREMENT VbDCSN_overspeed_warning "0 = speed in range
      1 = overspeed warning" UBYTE DCSN_subsystem_integrated_CM_boolean 0 0 0 1 ECU_ADDRESS 0x70010a29 /* @ECU_Address@VbDCSN_overspeed_warning@ */ /end MEASUREMENT
/begin MEASUREMENT VbDCSN_accs_stop_finished "If ACCS finished the stop request from DCSN" UBYTE DCSN_subsystem_integrated_CM_boolean 0 0 0 1 ECU_ADDRESS 0x70010a25 /* @ECU_Address@VbDCSN_accs_stop_finished@ */ /end MEASUREMENT
/begin MEASUREMENT VbDCSN_stop_request_enabled "0 = Sending stop request is disabled
      1 = Sending stop request is ensabled" UBYTE DCSN_subsystem_integrated_CM_boolean 0 0 0 1 ECU_ADDRESS 0x70010a20 /* @ECU_Address@VbDCSN_stop_request_enabled@ */ /end MEASUREMENT
/begin MEASUREMENT VbDCSN_spd_limt_max_isNaN "0 = input speed limit is valid
      1 = input speed limit is NaN" UBYTE DCSN_subsystem_integrated_CM_boolean 0 0 0 1 ECU_ADDRESS 0x70010a17 /* @ECU_Address@VbDCSN_spd_limt_max_isNaN@ */ /end MEASUREMENT
/begin MEASUREMENT VbDCSN_speed_limit_input_isNaN "0 = input is valid
      1 = input is NaN" UBYTE DCSN_subsystem_integrated_CM_boolean 0 0 0 1 ECU_ADDRESS 0x70010a16 /* @ECU_Address@VbDCSN_speed_limit_input_isNaN@ */ /end MEASUREMENT
/begin MEASUREMENT VbDCSN_egmo_is_ready "0 = egmo not ready
      1 = egmo ready" UBYTE DCSN_subsystem_integrated_CM_boolean 0 0 0 1 ECU_ADDRESS 0x70010a15 /* @ECU_Address@VbDCSN_egmo_is_ready@ */ /end MEASUREMENT
/begin MEASUREMENT VbDCSN_mpfu_is_ready "0 = mpfu not ready
      1 = mpfu ready" UBYTE DCSN_subsystem_integrated_CM_boolean 0 0 0 1 ECU_ADDRESS 0x70010a14 /* @ECU_Address@VbDCSN_mpfu_is_ready@ */ /end MEASUREMENT
/begin MEASUREMENT VbDCSN_input_is_ready "0 = input data is not ready
      1 = input data is ready" UBYTE DCSN_subsystem_integrated_CM_boolean 0 0 0 1 ECU_ADDRESS 0x70010a13 /* @ECU_Address@VbDCSN_input_is_ready@ */ /end MEASUREMENT
/begin MEASUREMENT VbDCSN_acc_feature_enable "0 = acc not enabled
      1 = acc enabled" UBYTE DCSN_subsystem_integrated_CM_boolean 0 0 0 1 ECU_ADDRESS 0x70010a12 /* @ECU_Address@VbDCSN_acc_feature_enable@ */ /end MEASUREMENT
/begin MEASUREMENT VbDCSN_power_ctrl_enable "0 = power not enabled
      1 = power enabled" UBYTE DCSN_subsystem_integrated_CM_boolean 0 0 0 1 ECU_ADDRESS 0x70010a11 /* @ECU_Address@VbDCSN_power_ctrl_enable@ */ /end MEASUREMENT
/begin MEASUREMENT VbDCSN_brake_ctrl_enable "0 = brake not enabled
      1 = brake enabled
      " UBYTE DCSN_subsystem_integrated_CM_boolean 0 0 0 1 ECU_ADDRESS 0x70010a10 /* @ECU_Address@VbDCSN_brake_ctrl_enable@ */ /end MEASUREMENT
/begin MEASUREMENT VbDCSN_steer_ctrl_enable "0 = steer not enabled
      1 = steer enabled" UBYTE DCSN_subsystem_integrated_CM_boolean 0 0 0 1 ECU_ADDRESS 0x70010a0f /* @ECU_Address@VbDCSN_steer_ctrl_enable@ */ /end MEASUREMENT
/begin MEASUREMENT VbDCSN_gear_ctrl_enable "0 = gear not enabled
      1 = gear enabled" UBYTE DCSN_subsystem_integrated_CM_boolean 0 0 0 1 ECU_ADDRESS 0x70010a0e /* @ECU_Address@VbDCSN_gear_ctrl_enable@ */ /end MEASUREMENT
/begin MEASUREMENT VbDCSN_epb_ctrl_enable "0 = epb not enabled
      1 = epb enabled" UBYTE DCSN_subsystem_integrated_CM_boolean 0 0 0 1 ECU_ADDRESS 0x70010a0d /* @ECU_Address@VbDCSN_epb_ctrl_enable@ */ /end MEASUREMENT
/begin MEASUREMENT VbDCSN_lcc_feature_enable "0 = lcc not enabled
      1 = lcc enabled
      " UBYTE DCSN_subsystem_integrated_CM_boolean 0 0 0 1 ECU_ADDRESS 0x70010a0c /* @ECU_Address@VbDCSN_lcc_feature_enable@ */ /end MEASUREMENT
/begin MEASUREMENT VbDCSN_alca_feature_enable "0 = alca not enabled
      1 = alca enabled" UBYTE DCSN_subsystem_integrated_CM_boolean 0 0 0 1 ECU_ADDRESS 0x70010a0b /* @ECU_Address@VbDCSN_alca_feature_enable@ */ /end MEASUREMENT
/begin MEASUREMENT VbDCSN_aeb_feature_enable "0 = aeb not enabled
      1 = aeb enabled
      " UBYTE DCSN_subsystem_integrated_CM_boolean 0 0 0 1 ECU_ADDRESS 0x70010a0a /* @ECU_Address@VbDCSN_aeb_feature_enable@ */ /end MEASUREMENT
/begin MEASUREMENT VbDCSN_fcw_feature_enable "0 = fcw not enabled
      1 = fcw enabled" UBYTE DCSN_subsystem_integrated_CM_boolean 0 0 0 1 ECU_ADDRESS 0x70010a09 /* @ECU_Address@VbDCSN_fcw_feature_enable@ */ /end MEASUREMENT
/begin MEASUREMENT VbDCSN_lcw_feature_enable "0 = lcw not enabled
      1 = lcw enabled
      " UBYTE DCSN_subsystem_integrated_CM_boolean 0 0 0 1 ECU_ADDRESS 0x70010a08 /* @ECU_Address@VbDCSN_lcw_feature_enable@ */ /end MEASUREMENT
/begin MEASUREMENT VbDCSN_ldw_feature_enable "0 = ldw not enabled
      1 = ldw enabled
      " UBYTE DCSN_subsystem_integrated_CM_boolean 0 0 0 1 ECU_ADDRESS 0x70010a07 /* @ECU_Address@VbDCSN_ldw_feature_enable@ */ /end MEASUREMENT
/begin MEASUREMENT VbDCSN_ACC_ready_to_engage "ACCS subsystem ready" UBYTE DCSN_subsystem_integrated_CM_boolean 0 0 0 1 ECU_ADDRESS 0x70010a05 /* @ECU_Address@VbDCSN_ACC_ready_to_engage@ */ /end MEASUREMENT
/begin MEASUREMENT VbDCSN_adm_steering_override "0 = not override
      1 = override" UBYTE DCSN_subsystem_integrated_CM_boolean 0 0 0 1 ECU_ADDRESS 0x70010a03 /* @ECU_Address@VbDCSN_adm_steering_override@ */ /end MEASUREMENT
/begin MEASUREMENT VbDCSN_adm_steering_resume "0 = not resume
      1 = resume" UBYTE DCSN_subsystem_integrated_CM_boolean 0 0 0 1 ECU_ADDRESS 0x70010a02 /* @ECU_Address@VbDCSN_adm_steering_resume@ */ /end MEASUREMENT
/begin MEASUREMENT VeDCSN_adm_main_mode "0 = ADM_OFF
      1 = ADM_STANDBY
      2 = ADM_READY
      3 = ADM_ACTIVE
      4 = ADM_STEER_OVRD
      5 = ADM_TAKEOVER_WARNING
      6 = ADM_FAULT_WARNING
      7 = ADM_FAULT_REACTION
      8 = ADM_FAULT_DETECTED" UBYTE DCSN_subsystem_integrated_CM_EnumDCSN_adm_main_mode 0 0 0 8 ECU_ADDRESS 0x70010a01 /* @ECU_Address@VeDCSN_adm_main_mode@ */ /end MEASUREMENT
/begin MEASUREMENT VeDCSN_hmi_msg_display "0 = NO_MSG
      1 = ACTIVE
      2 = OVRD
      3 = TAKOVER_REQ
      4 = FAULT" UBYTE DCSN_subsystem_integrated_CM_EnumDCSN_adm_hmi_msg_display 0 0 0 4 ECU_ADDRESS 0x70010a00 /* @ECU_Address@VeDCSN_hmi_msg_display@ */ /end MEASUREMENT
/begin MEASUREMENT VeDCSN_hmi_icon_display "0 = NO_ICON
      1 = GREY_SOLID
      2 = GREEN_SOLID
      3 = BLUE_SOLID
      4 = RED_FLASH_SLOW
      5 = RED_FLASH_FAST
      6 = RED_SOLID" UBYTE DCSN_subsystem_integrated_CM_EnumDCSN_adm_hmi_icon_display 0 0 0 6 ECU_ADDRESS 0x700109ff /* @ECU_Address@VeDCSN_hmi_icon_display@ */ /end MEASUREMENT
/begin MEASUREMENT VeDCSN_autodrive_control_mode "0 = AUTODRIVE_PASSIVE
      1 = AUTODRIVE_ACTIVATING
      2 = AUTODRIVE_ACTIVATED
      " UBYTE DCSN_subsystem_integrated_CM_EnumDCSN_autodrive_control_mode 0 0 0 2 ECU_ADDRESS 0x700109fe /* @ECU_Address@VeDCSN_autodrive_control_mode@ */ /end MEASUREMENT
/begin COMPU_METHOD AEBS_subsystem_integrated_CM_single "Q = V" RAT_FUNC "%8.6" "" COEFFS 0 1 0 0 0 1 /end COMPU_METHOD
/begin COMPU_METHOD AEBS_subsystem_integrated_CM_int32 "Q = V" RAT_FUNC "%10.0" "" COEFFS 0 1 0 0 0 1 /end COMPU_METHOD
/begin COMPU_METHOD AEBS_subsystem_integrated_CM_uint8 "Q = V" RAT_FUNC "%3.0" "" COEFFS 0 1 0 0 0 1 /end COMPU_METHOD
/begin COMPU_METHOD AEBS_subsystem_integrated_CM_boolean "Q = V" RAT_FUNC "%1.0" "" COEFFS 0 1 0 0 0 1 /end COMPU_METHOD
/begin COMPU_METHOD AEBS_subsystem_integrated_CM_EnumAEBS_FCWState "Enumerated data type: EnumAEBS_FCWState" TAB_VERB "%0.6" "" COMPU_TAB_REF VTAB_FOR_AEBS_subsystem_integrated_CM_EnumAEBS_FCWState /end COMPU_METHOD
/begin COMPU_METHOD AEBS_subsystem_integrated_CM_int8 "Q = V" RAT_FUNC "%3.0" "" COEFFS 0 1 0 0 0 1 /end COMPU_METHOD
/begin COMPU_METHOD AEBS_subsystem_integrated_CM_EnumAEBS_TurnType "Enumerated data type: EnumAEBS_TurnType" TAB_VERB "%0.6" "" COMPU_TAB_REF VTAB_FOR_AEBS_subsystem_integrated_CM_EnumAEBS_TurnType /end COMPU_METHOD
/begin COMPU_METHOD ARBT_subsystem_integrated_CM_single_s "Q = V" RAT_FUNC "%8.6" "s" COEFFS 0 1 0 0 0 1 /end COMPU_METHOD
/begin COMPU_METHOD ARBT_subsystem_integrated_CM_single_m_s2 "Q = V" RAT_FUNC "%8.6" "m/s2" COEFFS 0 1 0 0 0 1 /end COMPU_METHOD
/begin COMPU_METHOD ARBT_subsystem_integrated_CM_single__ "Q = V" RAT_FUNC "%8.6" "%" COEFFS 0 1 0 0 0 1 /end COMPU_METHOD
/begin COMPU_METHOD ARBT_subsystem_integrated_CM_single_deg "Q = V" RAT_FUNC "%8.6" "deg" COEFFS 0 1 0 0 0 1 /end COMPU_METHOD
/begin COMPU_METHOD ARBT_subsystem_integrated_CM_single_ms "Q = V" RAT_FUNC "%8.6" "ms" COEFFS 0 1 0 0 0 1 /end COMPU_METHOD
/begin COMPU_METHOD ARBT_subsystem_integrated_CM_single_sec "Q = V" RAT_FUNC "%8.6" "sec" COEFFS 0 1 0 0 0 1 /end COMPU_METHOD
/begin COMPU_METHOD ARBT_subsystem_integrated_CM_single "Q = V" RAT_FUNC "%8.6" "" COEFFS 0 1 0 0 0 1 /end COMPU_METHOD
/begin COMPU_METHOD ARBT_subsystem_integrated_CM_single_m_s "Q = V" RAT_FUNC "%8.6" "m/s" COEFFS 0 1 0 0 0 1 /end COMPU_METHOD
/begin COMPU_METHOD ARBT_subsystem_integrated_CM_uint8 "Q = V" RAT_FUNC "%3.0" "" COEFFS 0 1 0 0 0 1 /end COMPU_METHOD
/begin COMPU_METHOD ARBT_subsystem_integrated_CM_boolean "Q = V" RAT_FUNC "%1.0" "" COEFFS 0 1 0 0 0 1 /end COMPU_METHOD
/begin COMPU_METHOD ARBT_subsystem_integrated_CM_single_Nm "Q = V" RAT_FUNC "%8.6" "Nm" COEFFS 0 1 0 0 0 1 /end COMPU_METHOD
/begin COMPU_METHOD ARBT_subsystem_integrated_CM_EnumARBT_arbitration_winner "Enumerated data type: EnumARBT_arbitration_winner" TAB_VERB "%0.6" "" COMPU_TAB_REF VTAB_FOR_ARBT_subsystem_integrated_CM_EnumARBT_arbitration_winner /end COMPU_METHOD
/begin COMPU_METHOD COMM_subsystem_integrated_CM_single "Q = V" RAT_FUNC "%8.6" "" COEFFS 0 1 0 0 0 1 /end COMPU_METHOD
/begin COMPU_METHOD COMM_subsystem_integrated_CM_uint8 "Q = V" RAT_FUNC "%3.0" "" COEFFS 0 1 0 0 0 1 /end COMPU_METHOD
/begin COMPU_METHOD COMM_subsystem_integrated_CM_boolean "Q = V" RAT_FUNC "%1.0" "" COEFFS 0 1 0 0 0 1 /end COMPU_METHOD
/begin COMPU_METHOD COMM_subsystem_integrated_CM_int16 "Q = V" RAT_FUNC "%5.0" "" COEFFS 0 1 0 0 0 1 /end COMPU_METHOD
/begin COMPU_METHOD COMM_subsystem_integrated_CM_uint16 "Q = V" RAT_FUNC "%5.0" "" COEFFS 0 1 0 0 0 1 /end COMPU_METHOD
/begin COMPU_METHOD DCSN_subsystem_integrated_CM_single_nm "Q = V" RAT_FUNC "%8.6" "nm" COEFFS 0 1 0 0 0 1 /end COMPU_METHOD
/begin COMPU_METHOD DCSN_subsystem_integrated_CM_single_s "Q = V" RAT_FUNC "%8.6" "s" COEFFS 0 1 0 0 0 1 /end COMPU_METHOD
/begin COMPU_METHOD DCSN_subsystem_integrated_CM_single_m_s "Q = V" RAT_FUNC "%8.6" "m/s" COEFFS 0 1 0 0 0 1 /end COMPU_METHOD
/begin COMPU_METHOD DCSN_subsystem_integrated_CM_uint8 "Q = V" RAT_FUNC "%3.0" "" COEFFS 0 1 0 0 0 1 /end COMPU_METHOD
/begin COMPU_METHOD DCSN_subsystem_integrated_CM_uint8_s "Q = V" RAT_FUNC "%3.0" "s" COEFFS 0 1 0 0 0 1 /end COMPU_METHOD
/begin COMPU_METHOD DCSN_subsystem_integrated_CM_boolean "Q = V" RAT_FUNC "%1.0" "" COEFFS 0 1 0 0 0 1 /end COMPU_METHOD
/begin COMPU_METHOD DCSN_subsystem_integrated_CM_EnumDCSN_adm_main_mode "Enumerated data type: EnumDCSN_adm_main_mode" TAB_VERB "%0.6" "" COMPU_TAB_REF VTAB_FOR_DCSN_subsystem_integrated_CM_EnumDCSN_adm_main_mode /end COMPU_METHOD
/begin COMPU_METHOD DCSN_subsystem_integrated_CM_EnumDCSN_adm_hmi_msg_display "Enumerated data type: EnumDCSN_adm_hmi_msg_display" TAB_VERB "%0.6" "" COMPU_TAB_REF VTAB_FOR_DCSN_subsystem_integrated_CM_EnumDCSN_adm_hmi_msg_display /end COMPU_METHOD
/begin COMPU_METHOD DCSN_subsystem_integrated_CM_EnumDCSN_adm_hmi_icon_display "Enumerated data type: EnumDCSN_adm_hmi_icon_display" TAB_VERB "%0.6" "" COMPU_TAB_REF VTAB_FOR_DCSN_subsystem_integrated_CM_EnumDCSN_adm_hmi_icon_display /end COMPU_METHOD
/begin COMPU_METHOD DCSN_subsystem_integrated_CM_EnumDCSN_autodrive_control_mode "Enumerated data type: EnumDCSN_autodrive_control_mode" TAB_VERB "%0.6" "" COMPU_TAB_REF VTAB_FOR_DCSN_subsystem_integrated_CM_EnumDCSN_autodrive_control_mode /end COMPU_METHOD
/begin COMPU_VTAB VTAB_FOR_AEBS_subsystem_integrated_CM_EnumAEBS_FCWState "Enumerated data type: EnumAEBS_FCWState" TAB_VERB 6 0 "AEBS_FCWState_StandBy" 1 "AEBS_FCWState_Level1Actived" 2 "AEBS_FCWState_Level2Actived" 3 "AEBS_FCWState_Level3Actived" 4 "AEBS_FCWState_Level4Actived" 5 "AEBS_FCWState_Level5Actived" /end COMPU_VTAB
/begin COMPU_VTAB VTAB_FOR_AEBS_subsystem_integrated_CM_EnumAEBS_TurnType "Enumerated data type: EnumAEBS_TurnType" TAB_VERB 4 1 "AEBS_Straight" 2 "AEBS_LeftTurn" 3 "AEBS_RightTurn" 4 "AEBS_TurnInvalid" /end COMPU_VTAB
/begin COMPU_VTAB VTAB_FOR_ARBT_subsystem_integrated_CM_EnumARBT_arbitration_winner "Enumerated data type: EnumARBT_arbitration_winner" TAB_VERB 7 0 "ARBT_NO_REQ" 1 "AEB" 2 "ACC" 3 "LCC" 4 "ALCA" 5 "RSVD1" 6 "RSVD2" /end COMPU_VTAB
/begin COMPU_VTAB VTAB_FOR_DCSN_subsystem_integrated_CM_EnumDCSN_adm_main_mode "Enumerated data type: EnumDCSN_adm_main_mode" TAB_VERB 9 0 "ADM_OFF" 1 "ADM_STANDBY" 2 "ADM_READY" 3 "ADM_ACTIVE" 4 "ADM_STEER_OVRD" 5 "ADM_TAKEOVER_WARNING" 6 "ADM_FAULT_WARNING" 7 "ADM_FAULT_REACTION" 8 "ADM_FAULT_DETECTED" /end COMPU_VTAB
/begin COMPU_VTAB VTAB_FOR_DCSN_subsystem_integrated_CM_EnumDCSN_adm_hmi_msg_display "Enumerated data type: EnumDCSN_adm_hmi_msg_display" TAB_VERB 5 0 "NO_MSG" 1 "ACTIVE" 2 "OVRD" 3 "TAKEOVER_REQ" 4 "FAULT" /end COMPU_VTAB
/begin COMPU_VTAB VTAB_FOR_DCSN_subsystem_integrated_CM_EnumDCSN_adm_hmi_icon_display "Enumerated data type: EnumDCSN_adm_hmi_icon_display" TAB_VERB 7 0 "NO_ICON" 1 "GREY_SOLID" 2 "GREEN_SOLID" 3 "BLUE_SOLID" 4 "RED_FLASH_SLOW" 5 "RED_FLASH_FAST" 6 "RED_SOLID" /end COMPU_VTAB
/begin COMPU_VTAB VTAB_FOR_DCSN_subsystem_integrated_CM_EnumDCSN_autodrive_control_mode "Enumerated data type: EnumDCSN_autodrive_control_mode" TAB_VERB 3 0 "AUTODRIVE_PASIV" 1 "AUTODRIVE_ACTIVATING" 2 "AUTODRIVE_ACTIVATED" /end COMPU_VTAB
/begin GROUP S6_veh_FedBck_update "AEBS_subsystem_integrated/AEBS/AEBS_Enabled/AEBS_Input/veh_FedBck_update"
 /begin REF_MEASUREMENT VfAEBS_FedBck_AccLateral VfAEBS_FedBck_AccLong VfAEBS_FedBck_AccPedPos VfAEBS_FedBck_BrkLightState VfAEBS_FedBck_BrkPedPos VfAEBS_FedBck_Drivemode VfAEBS_FedBck_EPBstate VfAEBS_FedBck_GearValue VfAEBS_FedBck_LeftLampState VfAEBS_FedBck_RightLampState VfAEBS_FedBck_SmallLampState VfAEBS_FedBck_StrAngle VfAEBS_FedBck_Vehspd VfAEBS_FedBck_yawRate /end REF_MEASUREMENT
/end GROUP
/begin GROUP S7_updataFcwWarning "AEBS_subsystem_integrated/AEBS/AEBS_Enabled/AEBS_Output/updataFcwWarning" /begin REF_MEASUREMENT VfAEBS_FCW_active_state VfAEBS_FCW_warn_level /end REF_MEASUREMENT /end GROUP
/begin GROUP S7_updateobsID "AEBS_subsystem_integrated/AEBS/AEBS_Enabled/AEBS_Output/updateobsID" /begin REF_MEASUREMENT VfAEBS_AEBS_obs_id /end REF_MEASUREMENT /end GROUP
/begin GROUP S8_DetermineAEBStatus "AEBS_subsystem_integrated/AEBS/AEBS_Enabled/AEB_Determination/DetermineAEBStatus" /begin SUB_GROUP S39_CalcAEBSAcceleration S39_CheckAEBS_SystemOverride /end SUB_GROUP /begin REF_CHARACTERISTIC KbAEBS_Enable_OutputAEB /end REF_CHARACTERISTIC /begin REF_MEASUREMENT VfAEBS_AEB_request_beforeSend /end REF_MEASUREMENT /end GROUP
/begin GROUP S8_DtrmnThreatEvaluation "AEBS_subsystem_integrated/AEBS/AEBS_Enabled/AEB_Determination/DtrmnThreatEvaluation"
 /begin SUB_GROUP S40_CalcObsAreq S40_Deactive S40_Enable_Evaluation S40_FullBrakeThreat S40_PartialBrakeThreat S40_Prebrake_Threat S40_inhibit /end SUB_GROUP
 /begin REF_CHARACTERISTIC KfAEBS_t_Speed_DebounceTime KfAEBS_v_Speed_DeltaStStThrsh KfAEBS_v_Speed_StandStillThrsh /end REF_CHARACTERISTIC
 /begin REF_MEASUREMENT VfAEBS_veh_standstill /end REF_MEASUREMENT
/end GROUP
/begin GROUP S8_QueueOverride "AEBS_subsystem_integrated/AEBS/AEBS_Enabled/AEB_Determination/QueueOverride" /begin SUB_GROUP S41_ConfirmBrakePedlPsd /end SUB_GROUP
 /begin REF_CHARACTERISTIC KbAEBS_AllowOverride KfAEBS_AccPedelThrshOvrrd KfAEBS_v_SpeedLLThrshOvrrd KfAEBS_v_SpeedRelLThrshOvrrd /end REF_CHARACTERISTIC
/end GROUP
/begin GROUP S9_Subsystem1 "AEBS_subsystem_integrated/AEBS/AEBS_Enabled/AEB_FCWVIPTargetSelection/Subsystem1"
 /begin REF_MEASUREMENT VbAEBS_has_obs_vip VfAEBS_obs_acc_lateral_vip VfAEBS_obs_acc_long_vip VfAEBS_obs_center_x_vip VfAEBS_obs_center_y_vip VfAEBS_obs_delta_dis_vip VfAEBS_obs_delta_speed_vip VfAEBS_obs_dis_lateral_VIP VfAEBS_obs_dis_long_VIP VfAEBS_obs_heading_VIP VfAEBS_obs_id_vip VfAEBS_obs_index_vip VfAEBS_obs_length_VIP VfAEBS_obs_position_state_vip VfAEBS_obs_rp_vip VfAEBS_obs_ttc_vip VfAEBS_obs_type_vip VfAEBS_obs_v_lateral_vip VfAEBS_obs_v_long_vip VfAEBS_obs_width_VIP /end REF_MEASUREMENT
/end GROUP
/begin GROUP S9_TestMode "AEBS_subsystem_integrated/AEBS/AEBS_Enabled/AEB_FCWVIPTargetSelection/TestMode"
 /begin REF_CHARACTERISTIC KbAEBS_Test_HasObsVIP KfAEBS_Test_CeterXVIP KfAEBS_Test_CeterYVIP KfAEBS_Test_DeltaDisVIP KfAEBS_Test_DeltaSpeedVIP KfAEBS_Test_IDVIP KfAEBS_Test_TTCVIP /end REF_CHARACTERISTIC
/end GROUP
/begin GROUP S9_TurnState "AEBS_subsystem_integrated/AEBS/AEBS_Enabled/AEB_FCWVIPTargetSelection/TurnState"
 /begin REF_CHARACTERISTIC KbAEBS_Active_LeftTurn KbAEBS_Active_RightTurn KbAEBS_Active_Straight /end REF_CHARACTERISTIC
 /begin REF_MEASUREMENT VeAEBS_TurnType /end REF_MEASUREMENT
/end GROUP
/begin GROUP S10_DetermineFCWStatus "AEBS_subsystem_integrated/AEBS/AEBS_Enabled/FCW_Determination/DetermineFCWStatus" /begin SUB_GROUP S141_CheckAEBS_SystemOverride /end SUB_GROUP /end GROUP
/begin GROUP S10_ThreatEvaluation "AEBS_subsystem_integrated/AEBS/AEBS_Enabled/FCW_Determination/ThreatEvaluation"
 /begin SUB_GROUP S143_Deactive S143_Enable_Evaluation S143_FCW_level1_Threat S143_FCW_level2_Threat S143_FCW_level3_Threat S143_inhibit /end SUB_GROUP
 /begin REF_CHARACTERISTIC KfAEBS_t_Speed_DebounceTime KfAEBS_v_Speed_DeltaStStThrsh KfAEBS_v_Speed_StandStillThrsh /end REF_CHARACTERISTIC
/end GROUP
/begin GROUP S39_CalcAEBSAcceleration "AEBS_subsystem_integrated/AEBS/AEBS_Enabled/AEB_Determination/DetermineAEBStatus/CalcAEBSAcceleration" /begin SUB_GROUP S42_AccelReqFilter S42_ClacCurrTime /end SUB_GROUP
 /begin REF_CHARACTERISTIC KfAEBS_a_BrakeInit KfAEBS_a_BrakeMax KfAEBS_a_FullBrakeHi KfAEBS_a_FullBrakeLo KfAEBS_a_PartialBrakeHi KfAEBS_a_PartialBrakeLo KfAEBS_t_Time_BrakeInit KfAEBS_t_Time_BrakeRamp KtAEBS_a_BrakeValueLimit /end REF_CHARACTERISTIC
 /begin REF_MEASUREMENT VfAEBS_AEB_accReq_beforeSend /end REF_MEASUREMENT
/end GROUP
/begin GROUP S39_CheckAEBS_SystemOverride "AEBS_subsystem_integrated/AEBS/AEBS_Enabled/AEB_Determination/DetermineAEBStatus/CheckAEBS_SystemOverride"
 /begin REF_CHARACTERISTIC KfAEBS_LoPosValInCllsnRednByBrkg KfAEBS_SpdMinOvrdAccrResetInCllsnRednByBrkg /end REF_CHARACTERISTIC
/end GROUP
/begin GROUP S40_CalcObsAreq "AEBS_subsystem_integrated/AEBS/AEBS_Enabled/AEB_Determination/DtrmnThreatEvaluation/CalcObsAreq" /begin SUB_GROUP S65_Subsystem2 /end SUB_GROUP
 /begin REF_CHARACTERISTIC KfAEBS_a_FullBrakeHi KfAEBS_a_ObjUrgentBrake_Thrsh KfAEBS_t_Time_BrakeDelay KfAEBS_t_Time_ObjUrgentBrk KfAEBS_v_ObjUrgentBrk_speed_Thrsh /end REF_CHARACTERISTIC
 /begin REF_MEASUREMENT VfAEBS_a_obj_absolute_acc VfAEBS_areq VfAEBS_areq_withoutDelay VfAEBS_areq_withoutDelay_UrgentBrk VfAEBS_dis_delay VfAEBS_v_obj_absolute_speed /end REF_MEASUREMENT
/end GROUP
/begin GROUP S40_Deactive "AEBS_subsystem_integrated/AEBS/AEBS_Enabled/AEB_Determination/DtrmnThreatEvaluation/Deactive"
 /begin SUB_GROUP S67_ObjDataChangeDetection S67_RaisingEdgeDelay1 S67_RaisingEdgeDelay2 S67_SpeedReductionMonitoring /end SUB_GROUP
 /begin REF_CHARACTERISTIC KfAEBS_a_Areq_ObjChangThrsd KfAEBS_t_TTC_DeactiveThrsh KfAEBS_t_Time_HasNoVIPDelay KfAEBS_t_Time_TTCHLInhibitAEB /end REF_CHARACTERISTIC
 /begin REF_MEASUREMENT VbAEBS_Deactive_R_NoVIP VbAEBS_Deactive_R_VIPChanged /end REF_MEASUREMENT
/end GROUP
/begin GROUP S40_Enable_Evaluation "AEBS_subsystem_integrated/AEBS/AEBS_Enabled/AEB_Determination/DtrmnThreatEvaluation/Enable Evaluation" /begin REF_MEASUREMENT VfAEBS_AEB_disabled VfAEBS_AEB_enabled /end REF_MEASUREMENT /end GROUP
/begin GROUP S40_FullBrakeThreat "AEBS_subsystem_integrated/AEBS/AEBS_Enabled/AEB_Determination/DtrmnThreatEvaluation/FullBrakeThreat" /begin SUB_GROUP S69_Subsystem /end SUB_GROUP
 /begin REF_CHARACTERISTIC KfAEBS_a_Areq_FullBrkActThrsd KfAEBS_a_Areq_FullBrkDeactThrsd KfAEBS_t_fb_active_delay_turn /end REF_CHARACTERISTIC
 /begin REF_MEASUREMENT VfAEBS_fullBrk_active VfAEBS_fullBrk_dactive /end REF_MEASUREMENT
/end GROUP
/begin GROUP S40_PartialBrakeThreat "AEBS_subsystem_integrated/AEBS/AEBS_Enabled/AEB_Determination/DtrmnThreatEvaluation/PartialBrakeThreat" /begin SUB_GROUP S70_Subsystem /end SUB_GROUP
 /begin REF_CHARACTERISTIC KfAEBS_a_Areq_PartialBrkActThrsd KfAEBS_a_Areq_PartialBrkDeactThrsd KfAEBS_t_TTC_PartialBrkActiveThrsd KfAEBS_t_TTC_PartialBrkDeactiveThrsd KfAEBS_t_pb_active_delay_turn /end REF_CHARACTERISTIC
 /begin REF_MEASUREMENT VfAEBS_partialBrk_active VfAEBS_partialBrk_dactive /end REF_MEASUREMENT
/end GROUP
/begin GROUP S40_Prebrake_Threat "AEBS_subsystem_integrated/AEBS/AEBS_Enabled/AEB_Determination/DtrmnThreatEvaluation/Prebrake Threat"
 /begin REF_CHARACTERISTIC KfAEBS_t_TTC_PreBrkActiveThrsd KfAEBS_t_TTC_PreBrkDeactThrsd /end REF_CHARACTERISTIC
 /begin REF_MEASUREMENT VfAEBS_preBrake_active VfAEBS_preBrake_dactive /end REF_MEASUREMENT
/end GROUP
/begin GROUP S40_inhibit "AEBS_subsystem_integrated/AEBS/AEBS_Enabled/AEB_Determination/DtrmnThreatEvaluation/inhibit" /begin SUB_GROUP S73_Deactive_time S73_speed_inhibit /end SUB_GROUP /begin REF_CHARACTERISTIC KfAEBS_Gear_Value_R KfAEBS_t_Time_TwiceAEBActive /end REF_CHARACTERISTIC /begin REF_MEASUREMENT VfAEBS_AEB_inhibit /end REF_MEASUREMENT /end GROUP
/begin GROUP S141_CheckAEBS_SystemOverride "AEBS_subsystem_integrated/AEBS/AEBS_Enabled/FCW_Determination/DetermineFCWStatus/CheckAEBS_SystemOverride"
 /begin REF_CHARACTERISTIC KfAEBS_LoPosValInCllsnRednByBrkg KfAEBS_SpdMinOvrdAccrResetInCllsnRednByBrkg /end REF_CHARACTERISTIC
/end GROUP
/begin GROUP S143_Deactive "AEBS_subsystem_integrated/AEBS/AEBS_Enabled/FCW_Determination/ThreatEvaluation/Deactive" /begin SUB_GROUP S152_ObjDataChangeDetection S152_RaisingEdgeDelay1 /end SUB_GROUP
 /begin REF_CHARACTERISTIC KfAEBS_t_TTC_DeactiveThrsh KfAEBS_t_TTC_ObjChangThrsd KfAEBS_t_Time_HasNoVIPDelay KfAEBS_t_Time_TTCHLInhibitAEB /end REF_CHARACTERISTIC
/end GROUP
/begin GROUP S143_Enable_Evaluation "AEBS_subsystem_integrated/AEBS/AEBS_Enabled/FCW_Determination/ThreatEvaluation/Enable Evaluation" /begin REF_MEASUREMENT VfAEBS_FCW_disabled VfAEBS_FCW_enabled /end REF_MEASUREMENT /end GROUP
/begin GROUP S143_FCW_level1_Threat "AEBS_subsystem_integrated/AEBS/AEBS_Enabled/FCW_Determination/ThreatEvaluation/FCW_level1 Threat"
 /begin REF_CHARACTERISTIC KfAEBS_t_TTC_FCWLevel1ActiveThrsd KfAEBS_t_TTC_FCWLevel1DeactThrsd /end REF_CHARACTERISTIC
 /begin REF_MEASUREMENT VfAEBS_FCWLev1_active VfAEBS_FCWLev1_dactive /end REF_MEASUREMENT
/end GROUP
/begin GROUP S143_FCW_level2_Threat "AEBS_subsystem_integrated/AEBS/AEBS_Enabled/FCW_Determination/ThreatEvaluation/FCW_level2 Threat"
 /begin REF_CHARACTERISTIC KfAEBS_t_TTC_FCWLevel2ActiveThrsd KfAEBS_t_TTC_FCWLevel2DeactThrsd /end REF_CHARACTERISTIC
 /begin REF_MEASUREMENT VfAEBS_FCWLev2_active VfAEBS_FCWLev2_dactive /end REF_MEASUREMENT
/end GROUP
/begin GROUP S143_FCW_level3_Threat "AEBS_subsystem_integrated/AEBS/AEBS_Enabled/FCW_Determination/ThreatEvaluation/FCW_level3 Threat"
 /begin REF_CHARACTERISTIC KfAEBS_t_TTC_FCWLevel3ActiveThrsd KfAEBS_t_TTC_FCWLevel3DeactThrsd /end REF_CHARACTERISTIC
 /begin REF_MEASUREMENT VfAEBS_FCWLev3_active VfAEBS_FCWLev3_dactive /end REF_MEASUREMENT
/end GROUP
/begin GROUP S143_inhibit "AEBS_subsystem_integrated/AEBS/AEBS_Enabled/FCW_Determination/ThreatEvaluation/inhibit" /begin REF_CHARACTERISTIC KfAEBS_Gear_Value_R /end REF_CHARACTERISTIC /end GROUP
/begin GROUP S42_AccelReqFilter "AEBS_subsystem_integrated/AEBS/AEBS_Enabled/AEB_Determination/DetermineAEBStatus/CalcAEBSAcceleration/AccelReqFilter" /begin REF_CHARACTERISTIC KfAEBS_a_AreqRampRate /end REF_CHARACTERISTIC /begin REF_MEASUREMENT VfAEBS_AEB_acceleration_bf_limit /end REF_MEASUREMENT /end GROUP
/begin GROUP S65_Subsystem2 "AEBS_subsystem_integrated/AEBS/AEBS_Enabled/AEB_Determination/DtrmnThreatEvaluation/CalcObsAreq/Subsystem2" /begin SUB_GROUP S75_Subsystem S75_Subsystem1 /end SUB_GROUP /begin REF_CHARACTERISTIC KfAEBS_a_FullBrakeHi KfAEBS_d_Dis_Safe /end REF_CHARACTERISTIC /end GROUP
/begin GROUP S67_ObjDataChangeDetection "AEBS_subsystem_integrated/AEBS/AEBS_Enabled/AEB_Determination/DtrmnThreatEvaluation/Deactive/ObjDataChangeDetection" /begin REF_CHARACTERISTIC KfAEBS_Change_LateralPosThrsh KfAEBS_Change_LonglPosThrsh /end REF_CHARACTERISTIC /end GROUP
/begin GROUP S67_RaisingEdgeDelay1 "AEBS_subsystem_integrated/AEBS/AEBS_Enabled/AEB_Determination/DtrmnThreatEvaluation/Deactive/RaisingEdgeDelay1" /begin REF_MEASUREMENT VfAEBS_AEB_deactive /end REF_MEASUREMENT /end GROUP
/begin GROUP S67_RaisingEdgeDelay2 "AEBS_subsystem_integrated/AEBS/AEBS_Enabled/AEB_Determination/DtrmnThreatEvaluation/Deactive/RaisingEdgeDelay2" /begin REF_MEASUREMENT VbAEBS_Deactive_R_HighTTC /end REF_MEASUREMENT /end GROUP
/begin GROUP S67_SpeedReductionMonitoring "AEBS_subsystem_integrated/AEBS/AEBS_Enabled/AEB_Determination/DtrmnThreatEvaluation/Deactive/SpeedReductionMonitoring" /begin SUB_GROUP S85_SpeedReductionASILACheck /end SUB_GROUP /begin REF_CHARACTERISTIC KfAEBS_VeloRectThrsdByBrkg KfAEBS_t_TimeBrakeThrsd /end REF_CHARACTERISTIC /begin REF_MEASUREMENT VfAEBS_DeniedDueToSpdRed VfAEBS_DeniedDueToTimeBrake /end REF_MEASUREMENT /end GROUP
/begin GROUP S69_Subsystem "AEBS_subsystem_integrated/AEBS/AEBS_Enabled/AEB_Determination/DtrmnThreatEvaluation/FullBrakeThreat/Subsystem"
 /begin REF_CHARACTERISTIC KbAEBS_use_steerAngle KfAEBS_SteerRate_Limit_hi KfAEBS_SteerRate_Limit_lo KfAEBS_YawRate_Limit_hi KfAEBS_YawRate_Limit_lo /end REF_CHARACTERISTIC
/end GROUP
/begin GROUP S70_Subsystem "AEBS_subsystem_integrated/AEBS/AEBS_Enabled/AEB_Determination/DtrmnThreatEvaluation/PartialBrakeThreat/Subsystem"
 /begin REF_CHARACTERISTIC KbAEBS_use_steerAngle KfAEBS_SteerRate_Limit_hi KfAEBS_SteerRate_Limit_lo KfAEBS_YawRate_Limit_hi KfAEBS_YawRate_Limit_lo /end REF_CHARACTERISTIC
/end GROUP
/begin GROUP S73_speed_inhibit "AEBS_subsystem_integrated/AEBS/AEBS_Enabled/AEB_Determination/DtrmnThreatEvaluation/inhibit/speed_inhibit" /begin REF_CHARACTERISTIC KfAEBS_t_Time_TTCHLInhibitAEB KfAEBS_v_Speed_MaxInhibitAEB /end REF_CHARACTERISTIC /end GROUP
/begin GROUP S152_ObjDataChangeDetection "AEBS_subsystem_integrated/AEBS/AEBS_Enabled/FCW_Determination/ThreatEvaluation/Deactive/ObjDataChangeDetection" /begin REF_CHARACTERISTIC KfAEBS_Change_LateralPosThrsh KfAEBS_Change_LonglPosThrsh /end REF_CHARACTERISTIC /end GROUP
/begin GROUP S152_RaisingEdgeDelay1 "AEBS_subsystem_integrated/AEBS/AEBS_Enabled/FCW_Determination/ThreatEvaluation/Deactive/RaisingEdgeDelay1" /begin REF_MEASUREMENT VfAEBS_FCW_deacitve /end REF_MEASUREMENT /end GROUP
/begin GROUP S75_Subsystem "AEBS_subsystem_integrated/AEBS/AEBS_Enabled/AEB_Determination/DtrmnThreatEvaluation/CalcObsAreq/Subsystem2/Subsystem" /begin REF_CHARACTERISTIC KfAEBS_d_Dis_Safe /end REF_CHARACTERISTIC /end GROUP
/begin GROUP S75_Subsystem1 "AEBS_subsystem_integrated/AEBS/AEBS_Enabled/AEB_Determination/DtrmnThreatEvaluation/CalcObsAreq/Subsystem2/Subsystem1" /begin REF_CHARACTERISTIC KfAEBS_a_Buffer /end REF_CHARACTERISTIC /end GROUP
/begin GROUP S85_SpeedReductionASILACheck "AEBS_subsystem_integrated/AEBS/AEBS_Enabled/AEB_Determination/DtrmnThreatEvaluation/Deactive/SpeedReductionMonitoring/SpeedReductionASILACheck" /begin REF_CHARACTERISTIC KfAEBS_t_Time_ResetVeloRdctThrsd /end REF_CHARACTERISTIC /end GROUP
/begin GROUP ARBT_subsystem_integrated "ARBT_subsystem_integrated" ROOT /begin SUB_GROUP Root_ARBTIntegrated /end SUB_GROUP /end GROUP
/begin GROUP Root_ARBTIntegrated "ARBT_subsystem_integrated/ARBTIntegrated"
 /begin SUB_GROUP S1_AccessoryArbitration S1_BrakeArbitration S1_PowerArbitration S1_RecordTriggerArbitration S1_SteerArbitration S1_WarningArbitration /end SUB_GROUP
/end GROUP
/begin GROUP S1_AccessoryArbitration "ARBT_subsystem_integrated/ARBTIntegrated/AccessoryArbitration"
 /begin SUB_GROUP S3_DtrmnVehStandStill S3_ElectricParkingBrakeControl S3_GearPosControl /end SUB_GROUP
 /begin REF_CHARACTERISTIC KbARBT_SLEW_autohold_active KbARBT_SLEW_gear_ctrl_accel_req KfARBT_autohold_timeout /end REF_CHARACTERISTIC
/end GROUP
/begin GROUP S1_BrakeArbitration "ARBT_subsystem_integrated/ARBTIntegrated/BrakeArbitration"
 /begin REF_CHARACTERISTIC KfARBT_brake_req_lon_a_lowerlimit KfARBT_brake_req_lon_a_upperlimit /end REF_CHARACTERISTIC
 /begin REF_MEASUREMENT VbARBT_brake_ctrl_enbl_to_comm VeARBT_brake_arbt_winner VfARBT_brake_req_lon_a VfARBT_brake_req_lon_a_raw /end REF_MEASUREMENT
/end GROUP
/begin GROUP S1_PowerArbitration "ARBT_subsystem_integrated/ARBTIntegrated/PowerArbitration"
 /begin REF_CHARACTERISTIC KbARBT_power_req_mode_man_ctrl_temp KfARBT_power_req_lon_a_lowerlimit KfARBT_power_req_lon_a_upperlimit /end REF_CHARACTERISTIC
 /begin REF_MEASUREMENT VbARBT_power_ctrl_enbl_to_comm VeARBT_power_arbt_winner VfARBT_power_req_lon_a VfARBT_power_req_lon_a_raw VfARBT_power_req_mode VfARBT_power_req_torque /end REF_MEASUREMENT
/end GROUP
/begin GROUP S1_RecordTriggerArbitration "ARBT_subsystem_integrated/ARBTIntegrated/RecordTriggerArbitration"
 /begin REF_CHARACTERISTIC KfARBT_brk_ped_pos_thrsh_rec_trig KfARBT_lon_a_thrsh_rec_trig KfARBT_t_false_aeb_time_gap_thrsh KfARBT_t_hard_brake_debounce_time KfARBT_t_hard_brake_time_out KfARBT_t_missed_aeb_time_gap_thrsh /end REF_CHARACTERISTIC
 /begin REF_MEASUREMENT VbARBT_aeb_triggered_flag VbARBT_driver_hard_brake_flag VbARBT_false_aeb_flag VbARBT_missed_aeb_flag /end REF_MEASUREMENT
/end GROUP
/begin GROUP S1_SteerArbitration "ARBT_subsystem_integrated/ARBTIntegrated/SteerArbitration"
 /begin REF_CHARACTERISTIC KfARBT_steer_req_strwhl_angle_lowerlimit KfARBT_steer_req_strwhl_angle_upperlimit /end REF_CHARACTERISTIC
 /begin REF_MEASUREMENT VbARBT_steer_ctrl_enbl_to_comm VeARBT_steer_arbt_winner VfARBT_steer_req_mode VfARBT_steer_req_strwhl_angle VfARBT_steer_req_strwhl_angle_raw VfARBT_steer_req_strwhl_torque /end REF_MEASUREMENT
/end GROUP
/begin GROUP S1_WarningArbitration "ARBT_subsystem_integrated/ARBTIntegrated/WarningArbitration"
 /begin REF_MEASUREMENT VbARBT_FCW_level_one VbARBT_FCW_level_two VbARBT_LCW_left_level_one VbARBT_LCW_left_level_two VbARBT_LCW_right_level_one VbARBT_LCW_right_level_two VbARBT_LDW_left VbARBT_LDW_right /end REF_MEASUREMENT
/end GROUP
/begin GROUP S3_DtrmnVehStandStill "ARBT_subsystem_integrated/ARBTIntegrated/AccessoryArbitration/DtrmnVehStandStill"
 /begin REF_CHARACTERISTIC KfARBT_t_speed_debounce_time KfARBT_v_moving_speed_thrsh KfARBT_v_standstill_speed_thrsh /end REF_CHARACTERISTIC
 /begin REF_MEASUREMENT VbARBT_vehicle_standstill /end REF_MEASUREMENT
/end GROUP
/begin GROUP S3_ElectricParkingBrakeControl "ARBT_subsystem_integrated/ARBTIntegrated/AccessoryArbitration/ElectricParkingBrakeControl" /begin REF_CHARACTERISTIC KbARBT_gear_pos_fedbck_valid /end REF_CHARACTERISTIC
 /begin REF_MEASUREMENT VbARBT_EPB_ctrl_enbl_to_comm VbARBT_EPB_ctrl_mode VbARBT_EPB_switch_request /end REF_MEASUREMENT
/end GROUP
/begin GROUP S3_GearPosControl "ARBT_subsystem_integrated/ARBTIntegrated/AccessoryArbitration/GearPosControl"
 /begin REF_MEASUREMENT VbARBT_auto_hold_req VbARBT_gear_ctrl_enbl_to_comm VfARBT_gear_ctrl_state VfARBT_gear_pos_req /end REF_MEASUREMENT
/end GROUP
/begin GROUP COMM_subsystem_integrated "COMM_subsystem_integrated" ROOT /begin SUB_GROUP Root_Receive Root_Transmit /end SUB_GROUP /begin REF_MEASUREMENT VbHWIO_DriverModeComd /end REF_MEASUREMENT /end GROUP
/begin GROUP Root_Receive "COMM_subsystem_integrated/Receive" /begin SUB_GROUP S1_iEV7S S1_iVISTA /end SUB_GROUP /begin REF_CHARACTERISTIC KcCOMM_VehicleCANbusConfig /end REF_CHARACTERISTIC
 /begin REF_MEASUREMENT VcCOMM_Auto_To_Manual_Tips VcCOMM_Decs_FedBck_BrkPedSts VcCOMM_Decs_FedBck_Drivemod VcCOMM_Decs_FedBck_EPBstate VcCOMM_Decs_FedBck_EPSmod VcCOMM_Decs_FedBck_ESCmod VcCOMM_Decs_FedBck_GearValue VcCOMM_Decs_FedBck_KeyState VcCOMM_DriverModeComd VcCOMM_VCU_DirIndicationLH VcCOMM_VCU_DirIndicationRH VcCOMM_VCU_HeadLampHighBeam VcCOMM_VCU_HeadLampLowBeam VfCOMM_AccPedl VfCOMM_Actual_Gear_Ratio VfCOMM_Decs_FedBck_StrAngle VfCOMM_Decs_FedBck_VehSpd VfCOMM_EPS_SteeringTorqueAct VfCOMM_VCU_BrkPedPos VfCOMM_VCU_ESCWhlFLSpd VfCOMM_VCU_ESCWhlFRSpd VfCOMM_VCU_ESCWhlRLSpd VfCOMM_VCU_ESCWhlRRSpd VfCOMM_VCU_LateralAcc VfCOMM_VCU_LongitudinalAcc VfCOMM_VCU_YawRate /end REF_MEASUREMENT
/end GROUP
/begin GROUP Root_Transmit "COMM_subsystem_integrated/Transmit" /begin SUB_GROUP S2_FAW S2_ICPV S2_Test_Mode /end SUB_GROUP
 /begin REF_CHARACTERISTIC KcCOMM_Test_Cmd_EPSXBW_En KcCOMM_Test_Cmd_EPSXBW_En_ovr KcCOMM_Test_Cmd_StrAngle KcCOMM_Test_Cmd_StrAngle_ovr KcCOMM_Test_Decs_Acc_Req KcCOMM_Test_Decs_Acc_Req_ovr KcCOMM_Test_Decs_Acc_Value KcCOMM_Test_Decs_Acc_Value_ovr KcCOMM_Test_Decs_Breake_Req KcCOMM_Test_Decs_Breake_Req_ovr KcCOMM_Test_Decs_Breake_Value KcCOMM_Test_Decs_Breake_Value_ovr KcCOMM_Test_mode KcCOMM_VehicleCANbusConfig /end REF_CHARACTERISTIC
 /begin REF_MEASUREMENT VcCOMM_Decs_Acc_Req VcCOMM_Decs_BckfogLmp_Req VcCOMM_Decs_Breake_Req VcCOMM_Decs_BrkLight_Req VcCOMM_Decs_Control_mod VcCOMM_Decs_DippedBeam_Req VcCOMM_Decs_FrontFogLamp_Req VcCOMM_Decs_Gear_Req VcCOMM_Decs_Gear_Value VcCOMM_Decs_HighBeam_Req VcCOMM_Decs_Horn_Req VcCOMM_Decs_LftLmp_Req VcCOMM_Decs_Light_Req VcCOMM_Decs_RihtLmp_Req VcCOMM_Decs_Steering_Req VcCOMM_Decs_WarnLight_Req VcCOMM_Decs_iBCM_Req VcCOMM_EPB_control_enable VcCOMM_EPB_switch_request VfCOMM_Decs_Acc_Value VfCOMM_Decs_Breake_Value VfCOMM_Decs_SteeringAngle VfCOMM_req_pct_torque_raw /end REF_MEASUREMENT
/end GROUP
/begin GROUP S1_iEV7S "COMM_subsystem_integrated/Receive/iEV7S" /begin REF_CHARACTERISTIC KfCOMM_a_VCULongAccOffset KfCOMM_r_VCULongAccSlope /end REF_CHARACTERISTIC /end GROUP
/begin GROUP S1_iVISTA "COMM_subsystem_integrated/Receive/iVISTA" /begin REF_CHARACTERISTIC KfCOMM_a_VCULongAccOffset KfCOMM_r_VCULongAccSlope /end REF_CHARACTERISTIC /end GROUP
/begin GROUP S2_FAW "COMM_subsystem_integrated/Transmit/FAW" /begin SUB_GROUP S29_Command_Mapping /end SUB_GROUP /begin REF_CHARACTERISTIC KcCOMM_FirstGearRatio /end REF_CHARACTERISTIC /begin REF_MEASUREMENT VfCOMM_req_pct_torque_final /end REF_MEASUREMENT /end GROUP
/begin GROUP S2_ICPV "COMM_subsystem_integrated/Transmit/ICPV" /begin SUB_GROUP S31_EPB_clamped S31_EPB_released S31_EPB_releasing /end SUB_GROUP
 /begin REF_CHARACTERISTIC KcCOMM_BrakePedalMax KcCOMM_BrakePedalMin KcCOMM_GasPedalMax KcCOMM_GasPedalMin /end REF_CHARACTERISTIC
 /begin REF_MEASUREMENT VcCOMM_max_gas_pedal_EPB /end REF_MEASUREMENT
/end GROUP
/begin GROUP S2_Test_Mode "COMM_subsystem_integrated/Transmit/Test_Mode"
 /begin REF_CHARACTERISTIC KcCOMM_Test_BckFogLamp_Req KcCOMM_Test_Checksum_0x150 KcCOMM_Test_Checksum_0x151 KcCOMM_Test_Cmd_ATOModEnable KcCOMM_Test_Cmd_AccPelEnable KcCOMM_Test_Cmd_AccPelPosAct KcCOMM_Test_Cmd_AccPelPosActInv KcCOMM_Test_Cmd_BrakeLightReq KcCOMM_Test_Cmd_BrkPelEnable KcCOMM_Test_Cmd_BrkPelPosAct KcCOMM_Test_Cmd_BrkPelPosActInv KcCOMM_Test_Cmd_Checksum KcCOMM_Test_Cmd_EPSDir KcCOMM_Test_Cmd_EPSXBW_En KcCOMM_Test_Cmd_ICPDTC KcCOMM_Test_Cmd_RCnt KcCOMM_Test_Cmd_StrAngle KcCOMM_Test_Cmd_StrAngleLimit KcCOMM_Test_Cmd_StrAngleSpd KcCOMM_Test_Cmd_TgtSft KcCOMM_Test_Cmd_TgtSftEnable KcCOMM_Test_Cmd_VCUCnt KcCOMM_Test_Decs_Acc_Mod KcCOMM_Test_Decs_Acc_Req KcCOMM_Test_Decs_Acc_Value KcCOMM_Test_Decs_Breake_Req KcCOMM_Test_Decs_Breake_Value KcCOMM_Test_Decs_DippedBeam_Req KcCOMM_Test_Decs_HighBeam_Req KcCOMM_Test_Decs_LftLmp_Req KcCOMM_Test_Decs_Light_Req KcCOMM_Test_Decs_RihtLmp_Req KcCOMM_Test_Decs_iBCM_Req KcCOMM_Test_FrontFogLamp_Req KcCOMM_Test_Horn_Req KcCOMM_Test_HummerSts KcCOMM_Test_Over_Speed KcCOMM_Test_RCnt_0x150 KcCOMM_Test_RCnt_0x151 KcCOMM_Test_SlowDown_Indication KcCOMM_Test_SpeedUp_Indication KcCOMM_Test_Stop_Request KcCOMM_Test_Tar_Torq KcCOMM_Test_Tar_vehiclespd KcCOMM_Test_WarnLight_Req KcCOMM_Test_XBR_EBI_Mode KcCOMM_Test_XBR_Priority KcCOMM_Test_acceleration_fb KcCOMM_Test_cmd_VCUChecksum KcCOMM_Test_driveoff_Req KcCOMM_Test_yaw_rate_fb /end REF_CHARACTERISTIC
/end GROUP
/begin GROUP S29_Command_Mapping "COMM_subsystem_integrated/Transmit/FAW/Command_Mapping" /begin SUB_GROUP S36_T03 /end SUB_GROUP /end GROUP
/begin GROUP S31_EPB_clamped "COMM_subsystem_integrated/Transmit/ICPV/EPB_clamped" /begin REF_CHARACTERISTIC KcCOMM_GasPedalMinEPB /end REF_CHARACTERISTIC /end GROUP
/begin GROUP S31_EPB_released "COMM_subsystem_integrated/Transmit/ICPV/EPB_released" /begin REF_CHARACTERISTIC KcCOMM_GasPedalMax KcCOMM_GasPedalRampEPB /end REF_CHARACTERISTIC /end GROUP
/begin GROUP S31_EPB_releasing "COMM_subsystem_integrated/Transmit/ICPV/EPB_releasing" /begin REF_CHARACTERISTIC KcCOMM_GasPedalMaxEPB KcCOMM_GasPedalRampEPB /end REF_CHARACTERISTIC /end GROUP
/begin GROUP S36_T03 "COMM_subsystem_integrated/Transmit/FAW/Command_Mapping/T03" /begin REF_CHARACTERISTIC KcCOMM_TorqueControlPriority /end REF_CHARACTERISTIC /end GROUP
/begin GROUP DCSN_subsystem_integrated "DCSN_subsystem_integrated" ROOT /begin SUB_GROUP Root_DtrmnDCSN_Integrated /end SUB_GROUP /end GROUP
/begin GROUP Root_DtrmnDCSN_Integrated "DCSN_subsystem_integrated/DtrmnDCSN_Integrated"
 /begin SUB_GROUP S1_DtrmnDCSN_ADM S1_DtrmnDCSN_EnablingManager S1_DtrmnDCSN_TrafficDecider /end SUB_GROUP
/end GROUP
/begin GROUP S1_DtrmnDCSN_ADM "DCSN_subsystem_integrated/DtrmnDCSN_Integrated/DtrmnDCSN_ADM"
 /begin SUB_GROUP S3_CheckDCSN_ACCS_mode S3_CheckDCSN_UsrSwitchStatus S3_DtrmnDCSN_ADMMainManager S3_DtrmnDCSN_DRIVIintentionSimu /end SUB_GROUP
 /begin REF_CHARACTERISTIC KbDCSN_adm_temp_stop_finished KbDCSN_adm_temp_usr_cmd_autodrive_enabled KbDCSN_use_EgmoLinearSpeed KbDCSN_use_EgmoReadyFlag KeDCSN_adm_temp_diag_system_fault KfDCSN_t_max_time_fault_warning KfDCSN_t_max_time_to_takeover KfDCSN_v_adm_temp_veh_setspeed KfDCSN_v_setspeed_thrsh_hi /end REF_CHARACTERISTIC
/end GROUP
/begin GROUP S1_DtrmnDCSN_EnablingManager "DCSN_subsystem_integrated/DtrmnDCSN_Integrated/DtrmnDCSN_EnablingManager"
 /begin SUB_GROUP S4_DtrmnDCSN_EpbCtrlSwitch S4_DtrmnDCSN_GearCtrlSwitch S4_Dtrmn_DCSN_AutoDriveModeManager S4_Dtrmn_EnablingFlagsOSP /end SUB_GROUP
 /begin REF_CHARACTERISTIC KbDCSN_use_EgmoReadyFlag /end REF_CHARACTERISTIC
/end GROUP
/begin GROUP S1_DtrmnDCSN_TrafficDecider "DCSN_subsystem_integrated/DtrmnDCSN_Integrated/DtrmnDCSN_TrafficDecider"
 /begin SUB_GROUP S5_CalcDCSN_OverSpeedWarning S5_CalcDCSN_SpeedLimit S5_CalcDCSN_StopRequest S5_CheckDCSN_InputDataValidity S5_CvrtDCSN_DataSelector S5_MngDCSN_TrafficDeciderManager S5_MngDCSN_TrafficDeciderOutputM /end SUB_GROUP
/end GROUP
/begin GROUP S3_CheckDCSN_ACCS_mode "DCSN_subsystem_integrated/DtrmnDCSN_Integrated/DtrmnDCSN_ADM/CheckDCSN_ACCS_mode" /begin REF_MEASUREMENT VbDCSN_ACC_ready_to_engage /end REF_MEASUREMENT /end GROUP
/begin GROUP S3_CheckDCSN_UsrSwitchStatus "DCSN_subsystem_integrated/DtrmnDCSN_Integrated/DtrmnDCSN_ADM/CheckDCSN_UsrSwitchStatus"
 /begin REF_CHARACTERISTIC KbDCSN_use_vehicle_activate_switch KcDCSN_t_usr_activate_cmd_send_count KeDCSN_usr_cmd_autodrive_activate_man /end REF_CHARACTERISTIC
 /begin REF_MEASUREMENT VeDCSN_usr_cmd_autodrive_activate /end REF_MEASUREMENT
/end GROUP
/begin GROUP S3_DtrmnDCSN_ADMMainManager "DCSN_subsystem_integrated/DtrmnDCSN_Integrated/DtrmnDCSN_ADM/DtrmnDCSN_ADMMainManager"
 /begin SUB_GROUP S9_CheckDCSN_SystemFaultCheck S9_CheckDCSN_VehicleStateCheck /end SUB_GROUP
 /begin REF_CHARACTERISTIC KbDCSN_adm_main_mode_man_ctrl KeDCSN_adm_main_mode_man_value /end REF_CHARACTERISTIC
 /begin REF_MEASUREMENT VeDCSN_adm_main_mode VeDCSN_hmi_icon_display VeDCSN_hmi_msg_display /end REF_MEASUREMENT
/end GROUP
/begin GROUP S3_DtrmnDCSN_DRIVIintentionSimu "DCSN_subsystem_integrated/DtrmnDCSN_Integrated/DtrmnDCSN_ADM/DtrmnDCSN_DRIVIintentionSimu"
 /begin SUB_GROUP S10_DtrmnDCSN_FAWTorqueOverride S10_DtrmnDCSN_TakeOverLogicFAW /end SUB_GROUP
 /begin REF_CHARACTERISTIC KeDCSN_adm_temp_steering_controlmode KfDCSN_M_adm_temp_steering_ovrd_torque KfDCSN_M_adm_temp_steering_resume_torque KfDCSN_t_adm_temp_steering_ovrd_delay KfDCSN_t_adm_temp_steering_resume_delay /end REF_CHARACTERISTIC
 /begin REF_MEASUREMENT VbDCSN_adm_steering_override VbDCSN_adm_steering_resume /end REF_MEASUREMENT
/end GROUP
/begin GROUP S4_DtrmnDCSN_EpbCtrlSwitch "DCSN_subsystem_integrated/DtrmnDCSN_Integrated/DtrmnDCSN_EnablingManager/DtrmnDCSN_EpbCtrlSwitch" /begin REF_CHARACTERISTIC KbDCSN_use_faw_l4_logic /end REF_CHARACTERISTIC /end GROUP
/begin GROUP S4_DtrmnDCSN_GearCtrlSwitch "DCSN_subsystem_integrated/DtrmnDCSN_Integrated/DtrmnDCSN_EnablingManager/DtrmnDCSN_GearCtrlSwitch" /begin REF_CHARACTERISTIC KbDCSN_use_faw_l4_logic /end REF_CHARACTERISTIC /end GROUP
/begin GROUP S4_Dtrmn_DCSN_AutoDriveModeManager "DCSN_subsystem_integrated/DtrmnDCSN_Integrated/DtrmnDCSN_EnablingManager/Dtrmn_DCSN_AutoDriveModeManager"
 /begin SUB_GROUP S28_DtrmnDCSN_AutodriveActDelay S28_DtrmnDCSN_ReActivateLogicFAW S28_MngDCSN_FawModeReverse /end SUB_GROUP
 /begin REF_CHARACTERISTIC KbDCSN_use_SLEW_switch_control_mode KbDCSN_use_faw_l4_logic KbDCSN_use_vehicle_control_mode_fedbak KbDCSN_vehicle_control_mode_man_value KfDCSN_t_autodrive_max_wait_time /end REF_CHARACTERISTIC
/end GROUP
/begin GROUP S4_Dtrmn_EnablingFlagsOSP "DCSN_subsystem_integrated/DtrmnDCSN_Integrated/DtrmnDCSN_EnablingManager/Dtrmn_EnablingFlagsOSP"
 /begin REF_CHARACTERISTIC KbDCSN_SLEW_DriveModeComd_enbl KbDCSN_SLEW_DriveModeComd_value KbDCSN_acc_man_enbl KbDCSN_active_feature_man_ctrl KbDCSN_adm_main_mode_man_ctrl KbDCSN_aeb_man_enbl KbDCSN_alca_man_enbl KbDCSN_autodrive_mode_man_enbl KbDCSN_brake_ctrl_man_enbl KbDCSN_brake_ctrl_man_value KbDCSN_epb_ctrl_man_enbl KbDCSN_epb_ctrl_man_value KbDCSN_fcw_man_enbl KbDCSN_gear_ctrl_man_enbl KbDCSN_gear_ctrl_man_value KbDCSN_lcc_man_enbl KbDCSN_lcw_man_enbl KbDCSN_ldw_man_enbl KbDCSN_passive_feature_man_ctrl KbDCSN_power_ctrl_man_enbl KbDCSN_power_ctrl_man_value KbDCSN_steer_ctrl_man_enbl KbDCSN_steer_ctrl_man_value KbDCSN_use_SLEW_override_logic KeDCSN_autodrive_mode_man_value /end REF_CHARACTERISTIC
 /begin REF_MEASUREMENT VbDCSN_acc_feature_enable VbDCSN_aeb_feature_enable VbDCSN_alca_feature_enable VbDCSN_brake_ctrl_enable VbDCSN_epb_ctrl_enable VbDCSN_fcw_feature_enable VbDCSN_gear_ctrl_enable VbDCSN_lcc_feature_enable VbDCSN_lcw_feature_enable VbDCSN_ldw_feature_enable VbDCSN_power_ctrl_enable VbDCSN_steer_ctrl_enable VeDCSN_autodrive_control_mode /end REF_MEASUREMENT
/end GROUP
/begin GROUP S5_CalcDCSN_OverSpeedWarning "DCSN_subsystem_integrated/DtrmnDCSN_Integrated/DtrmnDCSN_TrafficDecider/CalcDCSN_OverSpeedWarning"
 /begin REF_CHARACTERISTIC KbDCSN_enable_warning_no_input KfDCSN_v_default_warning_speed KfDCSN_v_overspeed_warning_extra /end REF_CHARACTERISTIC
 /begin REF_MEASUREMENT VbDCSN_overspeed_warning /end REF_MEASUREMENT
/end GROUP
/begin GROUP S5_CalcDCSN_SpeedLimit "DCSN_subsystem_integrated/DtrmnDCSN_Integrated/DtrmnDCSN_TrafficDecider/CalcDCSN_SpeedLimit" /begin REF_MEASUREMENT VbDCSN_spd_limt_max_isNaN VbDCSN_speed_limit_input_isNaN /end REF_MEASUREMENT /end GROUP
/begin GROUP S5_CalcDCSN_StopRequest "DCSN_subsystem_integrated/DtrmnDCSN_Integrated/DtrmnDCSN_TrafficDecider/CalcDCSN_StopRequest"
 /begin SUB_GROUP S36_CalcDCSN_RawStopDistance S36_CalcDCSN_SLEWStopDistance S36_CalcDCSN_StopReasonDistance /end SUB_GROUP
/end GROUP
/begin GROUP S5_CheckDCSN_InputDataValidity "DCSN_subsystem_integrated/DtrmnDCSN_Integrated/DtrmnDCSN_TrafficDecider/CheckDCSN_InputDataValidity"
 /begin REF_MEASUREMENT VbDCSN_egmo_is_ready VbDCSN_input_is_ready VbDCSN_mpfu_is_ready /end REF_MEASUREMENT
/end GROUP
/begin GROUP S5_CvrtDCSN_DataSelector "DCSN_subsystem_integrated/DtrmnDCSN_Integrated/DtrmnDCSN_TrafficDecider/CvrtDCSN_DataSelector"
 /begin SUB_GROUP S38_CheckDCSN_num_lanes_isNaN S38_CheckDCSN_num_stop_lines_isNaN /end SUB_GROUP
 /begin REF_MEASUREMENT VbDCSN_accs_stop_finished VfDCSN_vehicle_speed_egmo /end REF_MEASUREMENT
/end GROUP
/begin GROUP S5_MngDCSN_TrafficDeciderManager "DCSN_subsystem_integrated/DtrmnDCSN_Integrated/DtrmnDCSN_TrafficDecider/MngDCSN_TrafficDeciderManager"
 /begin REF_CHARACTERISTIC KbDCSN_overspeed_warning_enable KbDCSN_speed_limit_enable KbDCSN_stop_request_enable /end REF_CHARACTERISTIC
 /begin REF_MEASUREMENT VbDCSN_speed_limit_enabled VbDCSN_stop_request_enabled /end REF_MEASUREMENT
/end GROUP
/begin GROUP S9_CheckDCSN_VehicleStateCheck "DCSN_subsystem_integrated/DtrmnDCSN_Integrated/DtrmnDCSN_ADM/DtrmnDCSN_ADMMainManager/CheckDCSN_VehicleStateCheck" /begin REF_CHARACTERISTIC KbDCSN_use_faw_l4_logic /end REF_CHARACTERISTIC /end GROUP
/begin GROUP S10_DtrmnDCSN_FAWTorqueOverride "DCSN_subsystem_integrated/DtrmnDCSN_Integrated/DtrmnDCSN_ADM/DtrmnDCSN_DRIVIintentionSimu/DtrmnDCSN_FAWTorqueOverride" /begin REF_CHARACTERISTIC KbDCSN_use_faw_l4_logic /end REF_CHARACTERISTIC /end GROUP
/begin GROUP S10_DtrmnDCSN_TakeOverLogicFAW "DCSN_subsystem_integrated/DtrmnDCSN_Integrated/DtrmnDCSN_ADM/DtrmnDCSN_DRIVIintentionSimu/DtrmnDCSN_TakeOverLogicFAW" /begin REF_CHARACTERISTIC KbDCSN_use_faw_l4_logic /end REF_CHARACTERISTIC /end GROUP
/begin GROUP S28_DtrmnDCSN_AutodriveActDelay "DCSN_subsystem_integrated/DtrmnDCSN_Integrated/DtrmnDCSN_EnablingManager/Dtrmn_DCSN_AutoDriveModeManager/DtrmnDCSN_AutodriveActDelay" /begin REF_CHARACTERISTIC KbDCSN_use_faw_l4_logic /end REF_CHARACTERISTIC /end GROUP
/begin GROUP S28_DtrmnDCSN_ReActivateLogicFAW "DCSN_subsystem_integrated/DtrmnDCSN_Integrated/DtrmnDCSN_EnablingManager/Dtrmn_DCSN_AutoDriveModeManager/DtrmnDCSN_ReActivateLogicFAW" /begin REF_CHARACTERISTIC KbDCSN_use_faw_l4_logic /end REF_CHARACTERISTIC /end GROUP
/begin GROUP S28_MngDCSN_FawModeReverse "DCSN_subsystem_integrated/DtrmnDCSN_Integrated/DtrmnDCSN_EnablingManager/Dtrmn_DCSN_AutoDriveModeManager/MngDCSN_FawModeReverse" /begin REF_CHARACTERISTIC KbDCSN_use_faw_l4_logic /end REF_CHARACTERISTIC /end GROUP
/begin GROUP S12_DtrmnDCSN_FawAutodriveMode "DCSN_subsystem_integrated/DtrmnDCSN_Integrated/DtrmnDCSN_ADM/DtrmnDCSN_ADMMainManager/CheckDCSN_VehicleStateCheck/DtrmnDCSN_FawAutodriveMode" /begin REF_CHARACTERISTIC KbDCSN_use_faw_l4_logic /end REF_CHARACTERISTIC /end GROUP
/end MODULE
/end PROJECT
