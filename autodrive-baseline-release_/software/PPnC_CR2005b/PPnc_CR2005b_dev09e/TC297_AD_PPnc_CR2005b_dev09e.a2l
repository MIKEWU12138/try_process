ASAP2_VERSION 1 60
/begin PROJECT hj_adcu "_default_ProjectLongIdentifier"
/begin HEADER "_default_HeaderComment" PROJECT_NO _default_ProjectNr /end HEADER
/begin MODULE _default_ModuleName "_default_ModuleLongIdentifier"
/begin MOD_COMMON "_default_ModCommonComment" DEPOSIT ABSOLUTE BYTE_ORDER MSB_LAST ALIGNMENT_BYTE 1 ALIGNMENT_WORD 2 ALIGNMENT_LONG 4 ALIGNMENT_FLOAT32_IEEE 4 ALIGNMENT_FLOAT64_IEEE 4 /end MOD_COMMON
/begin MOD_COMMON "Mod Common Comment Here" BYTE_ORDER MSB_LAST /end MOD_COMMON
/begin RECORD_LAYOUT Scalar_BOOLEAN FNC_VALUES 1 UBYTE COLUMN_DIR DIRECT /end RECORD_LAYOUT
/begin RECORD_LAYOUT Scalar_UBYTE FNC_VALUES 1 UBYTE COLUMN_DIR DIRECT /end RECORD_LAYOUT
/begin RECORD_LAYOUT Scalar_FLOAT32_IEEE FNC_VALUES 1 FLOAT32_IEEE COLUMN_DIR DIRECT /end RECORD_LAYOUT
/begin RECORD_LAYOUT Lookup1D_BYTE FNC_VALUES 1 SBYTE COLUMN_DIR DIRECT /end RECORD_LAYOUT
/begin RECORD_LAYOUT Lookup1D_X_BYTE AXIS_PTS_X 1 SBYTE INDEX_INCR DIRECT /end RECORD_LAYOUT
/begin RECORD_LAYOUT Lookup1D_UBYTE FNC_VALUES 1 UBYTE COLUMN_DIR DIRECT /end RECORD_LAYOUT
/begin RECORD_LAYOUT Lookup1D_X_UBYTE AXIS_PTS_X 1 UBYTE INDEX_INCR DIRECT /end RECORD_LAYOUT
/begin RECORD_LAYOUT Lookup1D_UWORD FNC_VALUES 1 UWORD COLUMN_DIR DIRECT /end RECORD_LAYOUT
/begin RECORD_LAYOUT Lookup1D_X_UWORD AXIS_PTS_X 1 UWORD INDEX_INCR DIRECT /end RECORD_LAYOUT
/begin RECORD_LAYOUT Lookup1D_WORD FNC_VALUES 1 SWORD COLUMN_DIR DIRECT /end RECORD_LAYOUT
/begin RECORD_LAYOUT Lookup1D_X_WORD AXIS_PTS_X 1 SWORD INDEX_INCR DIRECT /end RECORD_LAYOUT
/begin RECORD_LAYOUT Lookup1D_FLOAT32_IEEE FNC_VALUES 1 FLOAT32_IEEE COLUMN_DIR DIRECT /end RECORD_LAYOUT
/begin RECORD_LAYOUT Lookup1D_X_FLOAT32_IEEE AXIS_PTS_X 1 FLOAT32_IEEE INDEX_INCR DIRECT /end RECORD_LAYOUT
/begin CHARACTERISTIC KtAEBS_FCWL1ActiveTTCThrshld "" CURVE 0x70101600 /* @ECU_Address@KtAEBS_FCWL1ActiveTTCThrshld@ */ Lookup1D_FLOAT32_IEEE 0 AEBS_subsystem_integrated_CM_single -3.4E+38 3.4E+38
 /begin AXIS_DESCR COM_AXIS NO_INPUT_QUANTITY AEBS_subsystem_integrated_CM_single 13 -3.4E+38 3.4E+38 AXIS_PTS_REF KaAEBS_AXIS_DeltaSpeed_Vip /end AXIS_DESCR
/end CHARACTERISTIC
/begin CHARACTERISTIC KtAEBS_FCWL2ActiveTTCThrshld "" CURVE 0x701015cc /* @ECU_Address@KtAEBS_FCWL2ActiveTTCThrshld@ */ Lookup1D_FLOAT32_IEEE 0 AEBS_subsystem_integrated_CM_single -3.4E+38 3.4E+38
 /begin AXIS_DESCR COM_AXIS NO_INPUT_QUANTITY AEBS_subsystem_integrated_CM_single 13 -3.4E+38 3.4E+38 AXIS_PTS_REF KaAEBS_AXIS_DeltaSpeed_Vip /end AXIS_DESCR
/end CHARACTERISTIC
/begin CHARACTERISTIC KtAEBS_FCWL3ActiveTTCThrshld "" CURVE 0x70101598 /* @ECU_Address@KtAEBS_FCWL3ActiveTTCThrshld@ */ Lookup1D_FLOAT32_IEEE 0 AEBS_subsystem_integrated_CM_single -3.4E+38 3.4E+38
 /begin AXIS_DESCR COM_AXIS NO_INPUT_QUANTITY AEBS_subsystem_integrated_CM_single 13 -3.4E+38 3.4E+38 AXIS_PTS_REF KaAEBS_AXIS_DeltaSpeed_Vip /end AXIS_DESCR
/end CHARACTERISTIC
/begin CHARACTERISTIC KtAEBS_a_BrakeValueLimit "" CURVE 0x701012e8 /* @ECU_Address@KtAEBS_a_BrakeValueLimit@ */ Lookup1D_FLOAT32_IEEE 0 AEBS_subsystem_integrated_CM_single -3.4E+38 3.4E+38
 /begin AXIS_DESCR COM_AXIS NO_INPUT_QUANTITY AEBS_subsystem_integrated_CM_single 10 -3.4E+38 3.4E+38 AXIS_PTS_REF KaAEBS_AXIS_Veh_Curvature_vec /end AXIS_DESCR
/end CHARACTERISTIC
/begin CHARACTERISTIC KtAEBS_PrtlBrkActiveTTCThrshld_VRU "" CURVE 0x70101310 /* @ECU_Address@KtAEBS_PrtlBrkActiveTTCThrshld_VRU@ */ Lookup1D_FLOAT32_IEEE 0 AEBS_subsystem_integrated_CM_single -3.4E+38 3.4E+38
 /begin AXIS_DESCR COM_AXIS NO_INPUT_QUANTITY AEBS_subsystem_integrated_CM_single 13 -3.4E+38 3.4E+38 AXIS_PTS_REF KaAEBS_AXIS_DeltaSpeed_Vip /end AXIS_DESCR
/end CHARACTERISTIC
/begin CHARACTERISTIC KtAEBS_PrtlBrkActiveTTCThrshld "" CURVE 0x70101344 /* @ECU_Address@KtAEBS_PrtlBrkActiveTTCThrshld@ */ Lookup1D_FLOAT32_IEEE 0 AEBS_subsystem_integrated_CM_single -3.4E+38 3.4E+38
 /begin AXIS_DESCR COM_AXIS NO_INPUT_QUANTITY AEBS_subsystem_integrated_CM_single 13 -3.4E+38 3.4E+38 AXIS_PTS_REF KaAEBS_AXIS_DeltaSpeed_Vip /end AXIS_DESCR
/end CHARACTERISTIC
/begin CHARACTERISTIC KtAEBS_PreBrkActiveTTCThrshld_VRU "" CURVE 0x70101378 /* @ECU_Address@KtAEBS_PreBrkActiveTTCThrshld_VRU@ */ Lookup1D_FLOAT32_IEEE 0 AEBS_subsystem_integrated_CM_single -3.4E+38 3.4E+38
 /begin AXIS_DESCR COM_AXIS NO_INPUT_QUANTITY AEBS_subsystem_integrated_CM_single 13 -3.4E+38 3.4E+38 AXIS_PTS_REF KaAEBS_AXIS_DeltaSpeed_Vip /end AXIS_DESCR
/end CHARACTERISTIC
/begin CHARACTERISTIC KtAEBS_PreBrkActiveTTCThrshld "" CURVE 0x701013ac /* @ECU_Address@KtAEBS_PreBrkActiveTTCThrshld@ */ Lookup1D_FLOAT32_IEEE 0 AEBS_subsystem_integrated_CM_single -3.4E+38 3.4E+38
 /begin AXIS_DESCR COM_AXIS NO_INPUT_QUANTITY AEBS_subsystem_integrated_CM_single 13 -3.4E+38 3.4E+38 AXIS_PTS_REF KaAEBS_AXIS_DeltaSpeed_Vip /end AXIS_DESCR
/end CHARACTERISTIC
/begin CHARACTERISTIC KtAEBS_veh_acc_inhibit_AEB_thrhd "" CURVE 0x701012c4 /* @ECU_Address@KtAEBS_veh_acc_inhibit_AEB_thrhd@ */ Lookup1D_FLOAT32_IEEE 0 AEBS_subsystem_integrated_CM_single -3.4E+38 3.4E+38
 /begin AXIS_DESCR COM_AXIS VfAEBS_veh_speed_used AEBS_subsystem_integrated_CM_single 9 -3.4E+38 3.4E+38 AXIS_PTS_REF KaAEBS_AXIS_Veh_Speed_vec /end AXIS_DESCR
/end CHARACTERISTIC
/begin CHARACTERISTIC KtAEBS_LateralBuffer_Bicycle "" CURVE 0x7010156c /* @ECU_Address@KtAEBS_LateralBuffer_Bicycle@ */ Lookup1D_FLOAT32_IEEE 0 AEBS_subsystem_integrated_CM_single -3.4E+38 3.4E+38
 /begin AXIS_DESCR COM_AXIS NO_INPUT_QUANTITY AEBS_subsystem_integrated_CM_single 11 -3.4E+38 3.4E+38 AXIS_PTS_REF KaAEBS_AXIS_NearestPointX_vec /end AXIS_DESCR
/end CHARACTERISTIC
/begin CHARACTERISTIC KtAEBS_LateralBuffer_Motor "" CURVE 0x70101540 /* @ECU_Address@KtAEBS_LateralBuffer_Motor@ */ Lookup1D_FLOAT32_IEEE 0 AEBS_subsystem_integrated_CM_single -3.4E+38 3.4E+38
 /begin AXIS_DESCR COM_AXIS NO_INPUT_QUANTITY AEBS_subsystem_integrated_CM_single 11 -3.4E+38 3.4E+38 AXIS_PTS_REF KaAEBS_AXIS_NearestPointX_vec /end AXIS_DESCR
/end CHARACTERISTIC
/begin CHARACTERISTIC KtAEBS_LateralBuffer_Other "" CURVE 0x70101514 /* @ECU_Address@KtAEBS_LateralBuffer_Other@ */ Lookup1D_FLOAT32_IEEE 0 AEBS_subsystem_integrated_CM_single -3.4E+38 3.4E+38
 /begin AXIS_DESCR COM_AXIS NO_INPUT_QUANTITY AEBS_subsystem_integrated_CM_single 11 -3.4E+38 3.4E+38 AXIS_PTS_REF KaAEBS_AXIS_NearestPointX_vec /end AXIS_DESCR
/end CHARACTERISTIC
/begin CHARACTERISTIC KtAEBS_LateralBuffer_Pedstrn "" CURVE 0x701014e8 /* @ECU_Address@KtAEBS_LateralBuffer_Pedstrn@ */ Lookup1D_FLOAT32_IEEE 0 AEBS_subsystem_integrated_CM_single -3.4E+38 3.4E+38
 /begin AXIS_DESCR COM_AXIS NO_INPUT_QUANTITY AEBS_subsystem_integrated_CM_single 11 -3.4E+38 3.4E+38 AXIS_PTS_REF KaAEBS_AXIS_NearestPointX_vec /end AXIS_DESCR
/end CHARACTERISTIC
/begin CHARACTERISTIC KtAEBS_LateralBuffer_Vehicle "" CURVE 0x701014bc /* @ECU_Address@KtAEBS_LateralBuffer_Vehicle@ */ Lookup1D_FLOAT32_IEEE 0 AEBS_subsystem_integrated_CM_single -3.4E+38 3.4E+38
 /begin AXIS_DESCR COM_AXIS NO_INPUT_QUANTITY AEBS_subsystem_integrated_CM_single 11 -3.4E+38 3.4E+38 AXIS_PTS_REF KaAEBS_AXIS_NearestPointX_vec /end AXIS_DESCR
/end CHARACTERISTIC
/begin CHARACTERISTIC KtAEBS_LongBuffer_Bicycle "" CURVE 0x70101490 /* @ECU_Address@KtAEBS_LongBuffer_Bicycle@ */ Lookup1D_FLOAT32_IEEE 0 AEBS_subsystem_integrated_CM_single -3.4E+38 3.4E+38
 /begin AXIS_DESCR COM_AXIS NO_INPUT_QUANTITY AEBS_subsystem_integrated_CM_single 11 -3.4E+38 3.4E+38 AXIS_PTS_REF KaAEBS_AXIS_NearestPointY_vec /end AXIS_DESCR
/end CHARACTERISTIC
/begin CHARACTERISTIC KtAEBS_LongBuffer_Motor "" CURVE 0x70101464 /* @ECU_Address@KtAEBS_LongBuffer_Motor@ */ Lookup1D_FLOAT32_IEEE 0 AEBS_subsystem_integrated_CM_single -3.4E+38 3.4E+38
 /begin AXIS_DESCR COM_AXIS NO_INPUT_QUANTITY AEBS_subsystem_integrated_CM_single 11 -3.4E+38 3.4E+38 AXIS_PTS_REF KaAEBS_AXIS_NearestPointY_vec /end AXIS_DESCR
/end CHARACTERISTIC
/begin CHARACTERISTIC KtAEBS_LongBuffer_Other "" CURVE 0x70101438 /* @ECU_Address@KtAEBS_LongBuffer_Other@ */ Lookup1D_FLOAT32_IEEE 0 AEBS_subsystem_integrated_CM_single -3.4E+38 3.4E+38
 /begin AXIS_DESCR COM_AXIS NO_INPUT_QUANTITY AEBS_subsystem_integrated_CM_single 11 -3.4E+38 3.4E+38 AXIS_PTS_REF KaAEBS_AXIS_NearestPointY_vec /end AXIS_DESCR
/end CHARACTERISTIC
/begin CHARACTERISTIC KtAEBS_LongBuffer_Pedstrn "" CURVE 0x7010140c /* @ECU_Address@KtAEBS_LongBuffer_Pedstrn@ */ Lookup1D_FLOAT32_IEEE 0 AEBS_subsystem_integrated_CM_single -3.4E+38 3.4E+38
 /begin AXIS_DESCR COM_AXIS NO_INPUT_QUANTITY AEBS_subsystem_integrated_CM_single 11 -3.4E+38 3.4E+38 AXIS_PTS_REF KaAEBS_AXIS_NearestPointY_vec /end AXIS_DESCR
/end CHARACTERISTIC
/begin CHARACTERISTIC KtAEBS_LongBuffer_Vehicle "" CURVE 0x701013e0 /* @ECU_Address@KtAEBS_LongBuffer_Vehicle@ */ Lookup1D_FLOAT32_IEEE 0 AEBS_subsystem_integrated_CM_single -3.4E+38 3.4E+38
 /begin AXIS_DESCR COM_AXIS NO_INPUT_QUANTITY AEBS_subsystem_integrated_CM_single 11 -3.4E+38 3.4E+38 AXIS_PTS_REF KaAEBS_AXIS_NearestPointY_vec /end AXIS_DESCR
/end CHARACTERISTIC
/begin CHARACTERISTIC KfAEBS_Change_LateralPosThrsh "Object change lateral position threshold" VALUE 0x701017cc /* @ECU_Address@KfAEBS_Change_LateralPosThrsh@ */ Scalar_FLOAT32_IEEE 0 AEBS_subsystem_integrated_CM_single -3.4E+38 3.4E+38 /end CHARACTERISTIC
/begin CHARACTERISTIC KfAEBS_Change_LonglPosThrsh "Object change longitudinal position threshold" VALUE 0x701017c8 /* @ECU_Address@KfAEBS_Change_LonglPosThrsh@ */ Scalar_FLOAT32_IEEE 0 AEBS_subsystem_integrated_CM_single -3.4E+38 3.4E+38 /end CHARACTERISTIC
/begin CHARACTERISTIC KfAEBS_SpdMinOvrdAccrResetInCllsnRednByBrkg "" VALUE 0x7010179c /* @ECU_Address@KfAEBS_SpdMinOvrdAccrResetInCllsnRednByBrkg@ */ Scalar_FLOAT32_IEEE 0 AEBS_subsystem_integrated_CM_single -3.4E+38 3.4E+38 /end CHARACTERISTIC
/begin CHARACTERISTIC KfAEBS_SteerRate_Limit_hi "" VALUE 0x70101798 /* @ECU_Address@KfAEBS_SteerRate_Limit_hi@ */ Scalar_FLOAT32_IEEE 0 AEBS_subsystem_integrated_CM_single -3.4E+38 3.4E+38 /end CHARACTERISTIC
/begin CHARACTERISTIC KfAEBS_SteerRate_Limit_lo "" VALUE 0x70101794 /* @ECU_Address@KfAEBS_SteerRate_Limit_lo@ */ Scalar_FLOAT32_IEEE 0 AEBS_subsystem_integrated_CM_single -3.4E+38 3.4E+38 /end CHARACTERISTIC
/begin CHARACTERISTIC KfAEBS_StrAngRte_inhbt_AEB_trshd "" VALUE 0x70101790 /* @ECU_Address@KfAEBS_StrAngRte_inhbt_AEB_trshd@ */ Scalar_FLOAT32_IEEE 0 AEBS_subsystem_integrated_CM_single_rad_s -3.4E+38 3.4E+38 /end CHARACTERISTIC
/begin CHARACTERISTIC KfAEBS_VehAcc_inhbt_FCW_thrshld "" VALUE 0x7010178c /* @ECU_Address@KfAEBS_VehAcc_inhbt_FCW_thrshld@ */ Scalar_FLOAT32_IEEE 0 AEBS_subsystem_integrated_CM_single -3.4E+38 3.4E+38 /end CHARACTERISTIC
/begin CHARACTERISTIC KfAEBS_VeloRectThrsdByBrkg "" VALUE 0x70101764 /* @ECU_Address@KfAEBS_VeloRectThrsdByBrkg@ */ Scalar_FLOAT32_IEEE 0 AEBS_subsystem_integrated_CM_single -3.4E+38 3.4E+38 /end CHARACTERISTIC
/begin CHARACTERISTIC KfAEBS_YawRate_Limit_hi "" VALUE 0x70101760 /* @ECU_Address@KfAEBS_YawRate_Limit_hi@ */ Scalar_FLOAT32_IEEE 0 AEBS_subsystem_integrated_CM_single -3.4E+38 3.4E+38 /end CHARACTERISTIC
/begin CHARACTERISTIC KfAEBS_YawRate_Limit_lo "" VALUE 0x7010175c /* @ECU_Address@KfAEBS_YawRate_Limit_lo@ */ Scalar_FLOAT32_IEEE 0 AEBS_subsystem_integrated_CM_single -3.4E+38 3.4E+38 /end CHARACTERISTIC
/begin CHARACTERISTIC KfAEBS_a_AreqRampRate "" VALUE 0x70101750 /* @ECU_Address@KfAEBS_a_AreqRampRate@ */ Scalar_FLOAT32_IEEE 0 AEBS_subsystem_integrated_CM_single -3.4E+38 3.4E+38 /end CHARACTERISTIC
/begin CHARACTERISTIC KfAEBS_a_Areq_FullBrkActThrsd "Acceleration request full brake active threshold" VALUE 0x7010174c /* @ECU_Address@KfAEBS_a_Areq_FullBrkActThrsd@ */ Scalar_FLOAT32_IEEE 0 AEBS_subsystem_integrated_CM_single -3.4E+38 3.4E+38 /end CHARACTERISTIC
/begin CHARACTERISTIC KfAEBS_a_Areq_FullBrkDeactThrsd "Acceleration request full brake dactive threshold(Full brake 
      can be deactived only in a short period)" VALUE 0x70101748 /* @ECU_Address@KfAEBS_a_Areq_FullBrkDeactThrsd@ */ Scalar_FLOAT32_IEEE 0 AEBS_subsystem_integrated_CM_single -3.4E+38 3.4E+38 /end CHARACTERISTIC
/begin CHARACTERISTIC KfAEBS_a_Areq_ObjChangThrsd "When the object is changed, only when the new object's acceleration request
      is samller than a threshold, then, the AEB/FCW can be deactived." VALUE 0x70101744 /* @ECU_Address@KfAEBS_a_Areq_ObjChangThrsd@ */ Scalar_FLOAT32_IEEE 0 AEBS_subsystem_integrated_CM_single -3.4E+38 3.4E+38 /end CHARACTERISTIC
/begin CHARACTERISTIC KfAEBS_a_Areq_PartialBrkActThrsd "Acceleration request partial brake active threshold" VALUE 0x70101740 /* @ECU_Address@KfAEBS_a_Areq_PartialBrkActThrsd@ */ Scalar_FLOAT32_IEEE 0 AEBS_subsystem_integrated_CM_single -3.4E+38 3.4E+38 /end CHARACTERISTIC
/begin CHARACTERISTIC KfAEBS_a_Areq_PartialBrkDeactThrsd "Acceleration request partial brake deactive threshold" VALUE 0x7010173c /* @ECU_Address@KfAEBS_a_Areq_PartialBrkDeactThrsd@ */ Scalar_FLOAT32_IEEE 0 AEBS_subsystem_integrated_CM_single -3.4E+38 3.4E+38 /end CHARACTERISTIC
/begin CHARACTERISTIC KfAEBS_a_BrakeInit "In passensor protected stage,acceleration send at initial step" VALUE 0x70101734 /* @ECU_Address@KfAEBS_a_BrakeInit@ */ Scalar_FLOAT32_IEEE 0 AEBS_subsystem_integrated_CM_single -3.4E+38 3.4E+38 /end CHARACTERISTIC
/begin CHARACTERISTIC KfAEBS_a_BrakeMax "In passensor protected stage,acceleration send maximum" VALUE 0x70101730 /* @ECU_Address@KfAEBS_a_BrakeMax@ */ Scalar_FLOAT32_IEEE 0 AEBS_subsystem_integrated_CM_single -3.4E+38 3.4E+38 /end CHARACTERISTIC
/begin CHARACTERISTIC KfAEBS_a_Buffer "Acceleration send buffer in distance safe" VALUE 0x7010172c /* @ECU_Address@KfAEBS_a_Buffer@ */ Scalar_FLOAT32_IEEE 0 AEBS_subsystem_integrated_CM_single -3.4E+38 3.4E+38 /end CHARACTERISTIC
/begin CHARACTERISTIC KfAEBS_a_FullBrakeHi "Maximum decceleration send in full brake(ex. -5)" VALUE 0x70101728 /* @ECU_Address@KfAEBS_a_FullBrakeHi@ */ Scalar_FLOAT32_IEEE 0 AEBS_subsystem_integrated_CM_single -3.4E+38 3.4E+38 /end CHARACTERISTIC
/begin CHARACTERISTIC KfAEBS_a_FullBrakeLo "Minimum decceleration send in full brake(ex. -2.5)" VALUE 0x70101724 /* @ECU_Address@KfAEBS_a_FullBrakeLo@ */ Scalar_FLOAT32_IEEE 0 AEBS_subsystem_integrated_CM_single -3.4E+38 3.4E+38 /end CHARACTERISTIC
/begin CHARACTERISTIC KfAEBS_a_ObjUrgentBrake_Thrsh "" VALUE 0x70101720 /* @ECU_Address@KfAEBS_a_ObjUrgentBrake_Thrsh@ */ Scalar_FLOAT32_IEEE 0 AEBS_subsystem_integrated_CM_single -3.4E+38 3.4E+38 /end CHARACTERISTIC
/begin CHARACTERISTIC KfAEBS_a_PartialBrakeHi "Maximum decceleration send in partial brake(ex. -4)" VALUE 0x7010171c /* @ECU_Address@KfAEBS_a_PartialBrakeHi@ */ Scalar_FLOAT32_IEEE 0 AEBS_subsystem_integrated_CM_single -3.4E+38 3.4E+38 /end CHARACTERISTIC
/begin CHARACTERISTIC KfAEBS_a_PartialBrakeLo "Minimum decceleration send in partial brake(ex. -2)" VALUE 0x70101718 /* @ECU_Address@KfAEBS_a_PartialBrakeLo@ */ Scalar_FLOAT32_IEEE 0 AEBS_subsystem_integrated_CM_single -3.4E+38 3.4E+38 /end CHARACTERISTIC
/begin CHARACTERISTIC KfAEBS_d_Dis_Safe "Distance safe, when vehicle is stopped, the distance to obj" VALUE 0x70101704 /* @ECU_Address@KfAEBS_d_Dis_Safe@ */ Scalar_FLOAT32_IEEE 0 AEBS_subsystem_integrated_CM_single -3.4E+38 3.4E+38 /end CHARACTERISTIC
/begin CHARACTERISTIC KfAEBS_d_Dis_Safe_VRU "" VALUE 0x70101700 /* @ECU_Address@KfAEBS_d_Dis_Safe_VRU@ */ Scalar_FLOAT32_IEEE 0 AEBS_subsystem_integrated_CM_single -3.4E+38 3.4E+38 /end CHARACTERISTIC
/begin CHARACTERISTIC KfAEBS_d_lateral_max_lostClose "" VALUE 0x701016fc /* @ECU_Address@KfAEBS_d_lateral_max_lostClose@ */ Scalar_FLOAT32_IEEE 0 AEBS_subsystem_integrated_CM_single -3.4E+38 3.4E+38 /end CHARACTERISTIC
/begin CHARACTERISTIC KfAEBS_d_lateral_min_lostClose "" VALUE 0x701016f8 /* @ECU_Address@KfAEBS_d_lateral_min_lostClose@ */ Scalar_FLOAT32_IEEE 0 AEBS_subsystem_integrated_CM_single -3.4E+38 3.4E+38 /end CHARACTERISTIC
/begin CHARACTERISTIC KfAEBS_d_long_max_lostClose "" VALUE 0x701016f4 /* @ECU_Address@KfAEBS_d_long_max_lostClose@ */ Scalar_FLOAT32_IEEE 0 AEBS_subsystem_integrated_CM_single -3.4E+38 3.4E+38 /end CHARACTERISTIC
/begin CHARACTERISTIC KfAEBS_d_long_min_lostClose "" VALUE 0x701016f0 /* @ECU_Address@KfAEBS_d_long_min_lostClose@ */ Scalar_FLOAT32_IEEE 0 AEBS_subsystem_integrated_CM_single -3.4E+38 3.4E+38 /end CHARACTERISTIC
/begin CHARACTERISTIC KfAEBS_t_Speed_DebounceTime "Speed debounce time, used to estimate whether the vheicle is standstill" VALUE 0x701016e4 /* @ECU_Address@KfAEBS_t_Speed_DebounceTime@ */ Scalar_FLOAT32_IEEE 0 AEBS_subsystem_integrated_CM_single -3.4E+38 3.4E+38 /end CHARACTERISTIC
/begin CHARACTERISTIC KfAEBS_t_TTC_DeactiveThrsh "TTC Deactive Thrsh" VALUE 0x701016e0 /* @ECU_Address@KfAEBS_t_TTC_DeactiveThrsh@ */ Scalar_FLOAT32_IEEE 0 AEBS_subsystem_integrated_CM_single -3.4E+38 3.4E+38 /end CHARACTERISTIC
/begin CHARACTERISTIC KfAEBS_t_TTC_FCWLevel1DeactThrsd "TTC_FCW Level1 Deact Thrsd" VALUE 0x701016dc /* @ECU_Address@KfAEBS_t_TTC_FCWLevel1DeactThrsd@ */ Scalar_FLOAT32_IEEE 0 AEBS_subsystem_integrated_CM_single -3.4E+38 3.4E+38 /end CHARACTERISTIC
/begin CHARACTERISTIC KfAEBS_t_TTC_FCWLevel2DeactThrsd "TTC FCW Level2 Deact Thrsd" VALUE 0x701016d8 /* @ECU_Address@KfAEBS_t_TTC_FCWLevel2DeactThrsd@ */ Scalar_FLOAT32_IEEE 0 AEBS_subsystem_integrated_CM_single -3.4E+38 3.4E+38 /end CHARACTERISTIC
/begin CHARACTERISTIC KfAEBS_t_TTC_FCWLevel3DeactThrsd "TTC FCW Level3 Deact Thrsd" VALUE 0x701016d4 /* @ECU_Address@KfAEBS_t_TTC_FCWLevel3DeactThrsd@ */ Scalar_FLOAT32_IEEE 0 AEBS_subsystem_integrated_CM_single -3.4E+38 3.4E+38 /end CHARACTERISTIC
/begin CHARACTERISTIC KfAEBS_t_TTC_ObjChangThrsd "" VALUE 0x701016d0 /* @ECU_Address@KfAEBS_t_TTC_ObjChangThrsd@ */ Scalar_FLOAT32_IEEE 0 AEBS_subsystem_integrated_CM_single -3.4E+38 3.4E+38 /end CHARACTERISTIC
/begin CHARACTERISTIC KfAEBS_t_TTC_PartialBrkDeactiveThrsd "TTC Partial Brk Deactive Thrsd" VALUE 0x701016cc /* @ECU_Address@KfAEBS_t_TTC_PartialBrkDeactiveThrsd@ */ Scalar_FLOAT32_IEEE 0 AEBS_subsystem_integrated_CM_single -3.4E+38 3.4E+38 /end CHARACTERISTIC
/begin CHARACTERISTIC KfAEBS_t_TTC_PreBrkDeactThrsd "KfAEBS TTC PreBrk Deact Thrsd" VALUE 0x701016c8 /* @ECU_Address@KfAEBS_t_TTC_PreBrkDeactThrsd@ */ Scalar_FLOAT32_IEEE 0 AEBS_subsystem_integrated_CM_single -3.4E+38 3.4E+38 /end CHARACTERISTIC
/begin CHARACTERISTIC KfAEBS_t_TimeBrakeThrsd "" VALUE 0x701016c0 /* @ECU_Address@KfAEBS_t_TimeBrakeThrsd@ */ Scalar_FLOAT32_IEEE 0 AEBS_subsystem_integrated_CM_single -3.4E+38 3.4E+38 /end CHARACTERISTIC
/begin CHARACTERISTIC KfAEBS_t_TimePreBrkThrsd "" VALUE 0x701016b8 /* @ECU_Address@KfAEBS_t_TimePreBrkThrsd@ */ Scalar_FLOAT32_IEEE 0 AEBS_subsystem_integrated_CM_single -3.4E+38 3.4E+38 /end CHARACTERISTIC
/begin CHARACTERISTIC KfAEBS_t_Time_BrakeDelay "Time Brake Delay" VALUE 0x701016b0 /* @ECU_Address@KfAEBS_t_Time_BrakeDelay@ */ Scalar_FLOAT32_IEEE 0 AEBS_subsystem_integrated_CM_single -3.4E+38 3.4E+38 /end CHARACTERISTIC
/begin CHARACTERISTIC KfAEBS_t_Time_BrakeInit "Time Brake Init" VALUE 0x701016ac /* @ECU_Address@KfAEBS_t_Time_BrakeInit@ */ Scalar_FLOAT32_IEEE 0 AEBS_subsystem_integrated_CM_single -3.4E+38 3.4E+38 /end CHARACTERISTIC
/begin CHARACTERISTIC KfAEBS_t_Time_BrakeRamp "Time Brake Ramp" VALUE 0x701016a8 /* @ECU_Address@KfAEBS_t_Time_BrakeRamp@ */ Scalar_FLOAT32_IEEE 0 AEBS_subsystem_integrated_CM_single -3.4E+38 3.4E+38 /end CHARACTERISTIC
/begin CHARACTERISTIC KfAEBS_t_Time_HasNoVIPDelay "Time Has No VIP Delay" VALUE 0x701016a4 /* @ECU_Address@KfAEBS_t_Time_HasNoVIPDelay@ */ Scalar_FLOAT32_IEEE 0 AEBS_subsystem_integrated_CM_single -3.4E+38 3.4E+38 /end CHARACTERISTIC
/begin CHARACTERISTIC KfAEBS_t_Time_ObjUrgentBrk "" VALUE 0x7010169c /* @ECU_Address@KfAEBS_t_Time_ObjUrgentBrk@ */ Scalar_FLOAT32_IEEE 0 AEBS_subsystem_integrated_CM_single -3.4E+38 3.4E+38 /end CHARACTERISTIC
/begin CHARACTERISTIC KfAEBS_t_Time_ResetTimeBrkThrsd "" VALUE 0x70101698 /* @ECU_Address@KfAEBS_t_Time_ResetTimeBrkThrsd@ */ Scalar_FLOAT32_IEEE 0 AEBS_subsystem_integrated_CM_single -3.4E+38 3.4E+38 /end CHARACTERISTIC
/begin CHARACTERISTIC KfAEBS_t_Time_ResetVeloRdctThrsd "" VALUE 0x70101694 /* @ECU_Address@KfAEBS_t_Time_ResetVeloRdctThrsd@ */ Scalar_FLOAT32_IEEE 0 AEBS_subsystem_integrated_CM_single -3.4E+38 3.4E+38 /end CHARACTERISTIC
/begin CHARACTERISTIC KfAEBS_t_Time_TTCHLInhibitAEB "" VALUE 0x70101690 /* @ECU_Address@KfAEBS_t_Time_TTCHLInhibitAEB@ */ Scalar_FLOAT32_IEEE 0 AEBS_subsystem_integrated_CM_single -3.4E+38 3.4E+38 /end CHARACTERISTIC
/begin CHARACTERISTIC KfAEBS_t_Time_TwiceAEBActive "" VALUE 0x7010168c /* @ECU_Address@KfAEBS_t_Time_TwiceAEBActive@ */ Scalar_FLOAT32_IEEE 0 AEBS_subsystem_integrated_CM_single -3.4E+38 3.4E+38 /end CHARACTERISTIC
/begin CHARACTERISTIC KfAEBS_t_Time_TwiceFCWActive "" VALUE 0x70101688 /* @ECU_Address@KfAEBS_t_Time_TwiceFCWActive@ */ Scalar_FLOAT32_IEEE 0 AEBS_subsystem_integrated_CM_single -3.4E+38 3.4E+38 /end CHARACTERISTIC
/begin CHARACTERISTIC KfAEBS_t_Time_TwicePreBrkActive "" VALUE 0x70101684 /* @ECU_Address@KfAEBS_t_Time_TwicePreBrkActive@ */ Scalar_FLOAT32_IEEE 0 AEBS_subsystem_integrated_CM_single -3.4E+38 3.4E+38 /end CHARACTERISTIC
/begin CHARACTERISTIC KfAEBS_t_VipCloseLostTimeOut "" VALUE 0x70101680 /* @ECU_Address@KfAEBS_t_VipCloseLostTimeOut@ */ Scalar_FLOAT32_IEEE 0 AEBS_subsystem_integrated_CM_single -3.4E+38 3.4E+38 /end CHARACTERISTIC
/begin CHARACTERISTIC KfAEBS_t_fb_active_delay_turn "" VALUE 0x7010167c /* @ECU_Address@KfAEBS_t_fb_active_delay_turn@ */ Scalar_FLOAT32_IEEE 0 AEBS_subsystem_integrated_CM_single -3.4E+38 3.4E+38 /end CHARACTERISTIC
/begin CHARACTERISTIC KfAEBS_t_pb_active_delay_turn "" VALUE 0x70101678 /* @ECU_Address@KfAEBS_t_pb_active_delay_turn@ */ Scalar_FLOAT32_IEEE 0 AEBS_subsystem_integrated_CM_single -3.4E+38 3.4E+38 /end CHARACTERISTIC
/begin CHARACTERISTIC KfAEBS_v_ObjUrgentBrk_speed_Thrsh "" VALUE 0x70101670 /* @ECU_Address@KfAEBS_v_ObjUrgentBrk_speed_Thrsh@ */ Scalar_FLOAT32_IEEE 0 AEBS_subsystem_integrated_CM_single -3.4E+38 3.4E+38 /end CHARACTERISTIC
/begin CHARACTERISTIC KfAEBS_v_SpdCollisionInhibitAEB "" VALUE 0x7010166c /* @ECU_Address@KfAEBS_v_SpdCollisionInhibitAEB@ */ Scalar_FLOAT32_IEEE 0 AEBS_subsystem_integrated_CM_single -3.4E+38 3.4E+38 /end CHARACTERISTIC
/begin CHARACTERISTIC KfAEBS_v_Speed_DeltaStStThrsh "delta speed, used to estimate whether the vheicle is standstill" VALUE 0x70101660 /* @ECU_Address@KfAEBS_v_Speed_DeltaStStThrsh@ */ Scalar_FLOAT32_IEEE 0 AEBS_subsystem_integrated_CM_single -3.4E+38 3.4E+38 /end CHARACTERISTIC
/begin CHARACTERISTIC KfAEBS_v_Speed_High_InhibitAEB "" VALUE 0x70101658 /* @ECU_Address@KfAEBS_v_Speed_High_InhibitAEB@ */ Scalar_FLOAT32_IEEE 0 AEBS_subsystem_integrated_CM_single -3.4E+38 3.4E+38 /end CHARACTERISTIC
/begin CHARACTERISTIC KfAEBS_v_Speed_MaxInhibitAEB "The speed to active AEB" VALUE 0x70101654 /* @ECU_Address@KfAEBS_v_Speed_MaxInhibitAEB@ */ Scalar_FLOAT32_IEEE 0 AEBS_subsystem_integrated_CM_single -3.4E+38 3.4E+38 /end CHARACTERISTIC
/begin CHARACTERISTIC KfAEBS_v_Speed_StandStillThrsh "Speed, used to estimate whether the vheicle is standstill" VALUE 0x70101648 /* @ECU_Address@KfAEBS_v_Speed_StandStillThrsh@ */ Scalar_FLOAT32_IEEE 0 AEBS_subsystem_integrated_CM_single -3.4E+38 3.4E+38 /end CHARACTERISTIC
/begin CHARACTERISTIC KfAEBS_v_deltaSpeed_InhibitAEB "" VALUE 0x70101644 /* @ECU_Address@KfAEBS_v_deltaSpeed_InhibitAEB@ */ Scalar_FLOAT32_IEEE 0 AEBS_subsystem_integrated_CM_single -3.4E+38 3.4E+38 /end CHARACTERISTIC
/begin CHARACTERISTIC KfAEBS_v_isInHighSpeed_HighThrshd "" VALUE 0x70101640 /* @ECU_Address@KfAEBS_v_isInHighSpeed_HighThrshd@ */ Scalar_FLOAT32_IEEE 0 AEBS_subsystem_integrated_CM_single -3.4E+38 3.4E+38 /end CHARACTERISTIC
/begin CHARACTERISTIC KfAEBS_v_isInHighSpeed_LowThrshd "" VALUE 0x7010163c /* @ECU_Address@KfAEBS_v_isInHighSpeed_LowThrshd@ */ Scalar_FLOAT32_IEEE 0 AEBS_subsystem_integrated_CM_single -3.4E+38 3.4E+38 /end CHARACTERISTIC
/begin CHARACTERISTIC KfAEBS_v_speed_max_lostClose "" VALUE 0x70101638 /* @ECU_Address@KfAEBS_v_speed_max_lostClose@ */ Scalar_FLOAT32_IEEE 0 AEBS_subsystem_integrated_CM_single -3.4E+38 3.4E+38 /end CHARACTERISTIC
/begin CHARACTERISTIC KfAEBS_v_speed_min_lostClose "" VALUE 0x70101634 /* @ECU_Address@KfAEBS_v_speed_min_lostClose@ */ Scalar_FLOAT32_IEEE 0 AEBS_subsystem_integrated_CM_single -3.4E+38 3.4E+38 /end CHARACTERISTIC
/begin CHARACTERISTIC KfAEBS_AccPdl_InhbtDeact_thrshld "" VALUE 0x7010129a /* @ECU_Address@KfAEBS_AccPdl_InhbtDeact_thrshld@ */ Scalar_UBYTE 0 AEBS_subsystem_integrated_CM_uint8 0 255 /end CHARACTERISTIC
/begin CHARACTERISTIC KfAEBS_Confdnc_FullBrkActThrsd "" VALUE 0x70101298 /* @ECU_Address@KfAEBS_Confdnc_FullBrkActThrsd@ */ Scalar_UBYTE 0 AEBS_subsystem_integrated_CM_uint8 0 255 /end CHARACTERISTIC
/begin CHARACTERISTIC KfAEBS_Confdnc_PartialBrkActThrsd "" VALUE 0x70101297 /* @ECU_Address@KfAEBS_Confdnc_PartialBrkActThrsd@ */ Scalar_UBYTE 0 AEBS_subsystem_integrated_CM_uint8 0 255 /end CHARACTERISTIC
/begin CHARACTERISTIC KfAEBS_Confidnc_Deact_thrshld "" VALUE 0x70101296 /* @ECU_Address@KfAEBS_Confidnc_Deact_thrshld@ */ Scalar_UBYTE 0 AEBS_subsystem_integrated_CM_uint8 0 255 /end CHARACTERISTIC
/begin CHARACTERISTIC KfAEBS_Gear_Value_R "Gear_Value_R" VALUE 0x70101291 /* @ECU_Address@KfAEBS_Gear_Value_R@ */ Scalar_UBYTE 0 AEBS_subsystem_integrated_CM_uint8 0 255 /end CHARACTERISTIC
/begin CHARACTERISTIC KfAEBS_LoPosValInCllsnRednByBrkg "" VALUE 0x70101290 /* @ECU_Address@KfAEBS_LoPosValInCllsnRednByBrkg@ */ Scalar_UBYTE 0 AEBS_subsystem_integrated_CM_uint8 0 255 /end CHARACTERISTIC
/begin CHARACTERISTIC KbAEBS_Active_LeftTurn "Left turn collision mitigation active" VALUE 0x7010128f /* @ECU_Address@KbAEBS_Active_LeftTurn@ */ Scalar_BOOLEAN 0 AEBS_subsystem_integrated_CM_boolean 0 1 /end CHARACTERISTIC
/begin CHARACTERISTIC KbAEBS_Active_RightTurn "Right turn collision mitigation active" VALUE 0x7010128e /* @ECU_Address@KbAEBS_Active_RightTurn@ */ Scalar_BOOLEAN 0 AEBS_subsystem_integrated_CM_boolean 0 1 /end CHARACTERISTIC
/begin CHARACTERISTIC KbAEBS_Active_Straight "Ego go straight collision mitigation active" VALUE 0x7010128d /* @ECU_Address@KbAEBS_Active_Straight@ */ Scalar_BOOLEAN 0 AEBS_subsystem_integrated_CM_boolean 0 1 /end CHARACTERISTIC
/begin CHARACTERISTIC KbAEBS_Enable_VRU_Calibration "" VALUE 0x70101282 /* @ECU_Address@KbAEBS_Enable_VRU_Calibration@ */ Scalar_BOOLEAN 0 AEBS_subsystem_integrated_CM_boolean 0 1 /end CHARACTERISTIC
/begin CHARACTERISTIC KbAEBS_enable_PreBrake "" VALUE 0x7010127b /* @ECU_Address@KbAEBS_enable_PreBrake@ */ Scalar_BOOLEAN 0 AEBS_subsystem_integrated_CM_boolean 0 1 /end CHARACTERISTIC
/begin CHARACTERISTIC KbAEBS_use_steerAngle "" VALUE 0x7010127a /* @ECU_Address@KbAEBS_use_steerAngle@ */ Scalar_BOOLEAN 0 AEBS_subsystem_integrated_CM_boolean 0 1 /end CHARACTERISTIC
/begin CHARACTERISTIC KfARBT_autohold_timeout "Unit in second" VALUE 0x70101eb0 /* @ECU_Address@KfARBT_autohold_timeout@ */ Scalar_FLOAT32_IEEE 0 ARBT_subsystem_integrated_CM_single_s -3.4E+38 3.4E+38 /end CHARACTERISTIC
/begin CHARACTERISTIC KfARBT_brake_req_lon_a_lowerlimit "Lower limit for brake longitudinal acceleration request output (in m/s2)" VALUE 0x70101eac /* @ECU_Address@KfARBT_brake_req_lon_a_lowerlimit@ */ Scalar_FLOAT32_IEEE 0 ARBT_subsystem_integrated_CM_single_m_s2 -3.4E+38 3.4E+38 /end CHARACTERISTIC
/begin CHARACTERISTIC KfARBT_brake_req_lon_a_upperlimit "Upper limit for brake longitudinal acceleration request output (in m/s2)" VALUE 0x70101ea8 /* @ECU_Address@KfARBT_brake_req_lon_a_upperlimit@ */ Scalar_FLOAT32_IEEE 0 ARBT_subsystem_integrated_CM_single_m_s2 -3.4E+38 3.4E+38 /end CHARACTERISTIC
/begin CHARACTERISTIC KfARBT_brk_ped_pos_thrsh_rec_trig "Threshold of actual brake pedal position to determine if driver is taking a hard brake" VALUE 0x70101ea4 /* @ECU_Address@KfARBT_brk_ped_pos_thrsh_rec_trig@ */ Scalar_FLOAT32_IEEE 0 ARBT_subsystem_integrated_CM_single__ 0.0 100.0 /end CHARACTERISTIC
/begin CHARACTERISTIC KfARBT_lon_a_thrsh_rec_trig "Threshold of longitudinal acceleration to determine if the driver is taking a hard brake" VALUE 0x70101ea0 /* @ECU_Address@KfARBT_lon_a_thrsh_rec_trig@ */ Scalar_FLOAT32_IEEE 0 ARBT_subsystem_integrated_CM_single_m_s2 -10.0 0.0 /end CHARACTERISTIC
/begin CHARACTERISTIC KfARBT_power_req_lon_a_lowerlimit "Lower limit for power longitudinal acceleration request output (in m/s2)" VALUE 0x70101e9c /* @ECU_Address@KfARBT_power_req_lon_a_lowerlimit@ */ Scalar_FLOAT32_IEEE 0 ARBT_subsystem_integrated_CM_single_m_s2 -3.4E+38 3.4E+38 /end CHARACTERISTIC
/begin CHARACTERISTIC KfARBT_power_req_lon_a_upperlimit "Lower limit for power longitudinal acceleration request output (in m/s2)" VALUE 0x70101e98 /* @ECU_Address@KfARBT_power_req_lon_a_upperlimit@ */ Scalar_FLOAT32_IEEE 0 ARBT_subsystem_integrated_CM_single_m_s2 -3.4E+38 3.4E+38 /end CHARACTERISTIC
/begin CHARACTERISTIC KfARBT_steer_req_strwhl_angle_lowerlimit "Lower limit for steer wheel angle output (in degrees)" VALUE 0x70101e94 /* @ECU_Address@KfARBT_steer_req_strwhl_angle_lowerlimit@ */ Scalar_FLOAT32_IEEE 0 ARBT_subsystem_integrated_CM_single_deg -3.4E+38 3.4E+38 /end CHARACTERISTIC
/begin CHARACTERISTIC KfARBT_steer_req_strwhl_angle_upperlimit "Upper limit for steer wheel angle output (in degrees)" VALUE 0x70101e90 /* @ECU_Address@KfARBT_steer_req_strwhl_angle_upperlimit@ */ Scalar_FLOAT32_IEEE 0 ARBT_subsystem_integrated_CM_single_deg -3.4E+38 3.4E+38 /end CHARACTERISTIC
/begin CHARACTERISTIC KfARBT_t_false_aeb_time_gap_thrsh "Time difference allowed for AEB to be triggered earlier than the start of driver hard braking
      
      Unit in ms
      " VALUE 0x70101e8c /* @ECU_Address@KfARBT_t_false_aeb_time_gap_thrsh@ */ Scalar_FLOAT32_IEEE 0 ARBT_subsystem_integrated_CM_single_ms -3.4E+38 3.4E+38 /end CHARACTERISTIC
/begin CHARACTERISTIC KfARBT_t_hard_brake_debounce_time "Unit in ms. The debounce time to enter hard braking state" VALUE 0x70101e88 /* @ECU_Address@KfARBT_t_hard_brake_debounce_time@ */ Scalar_FLOAT32_IEEE 0 ARBT_subsystem_integrated_CM_single_ms 0.0 3.4E+38 /end CHARACTERISTIC
/begin CHARACTERISTIC KfARBT_t_hard_brake_time_out "Unit in second, time out for hard braking state" VALUE 0x70101e84 /* @ECU_Address@KfARBT_t_hard_brake_time_out@ */ Scalar_FLOAT32_IEEE 0 ARBT_subsystem_integrated_CM_single_sec 0.0 3.4E+38 /end CHARACTERISTIC
/begin CHARACTERISTIC KfARBT_t_missed_aeb_time_gap_thrsh "Time difference allowed for AEB to be triggered later than the start of driver hard braking
      
      Unit in ms
      
      " VALUE 0x70101e80 /* @ECU_Address@KfARBT_t_missed_aeb_time_gap_thrsh@ */ Scalar_FLOAT32_IEEE 0 ARBT_subsystem_integrated_CM_single_ms -3.4E+38 3.4E+38 /end CHARACTERISTIC
/begin CHARACTERISTIC KfARBT_t_speed_debounce_time "" VALUE 0x70101e7c /* @ECU_Address@KfARBT_t_speed_debounce_time@ */ Scalar_FLOAT32_IEEE 0 ARBT_subsystem_integrated_CM_single -3.4E+38 3.4E+38 /end CHARACTERISTIC
/begin CHARACTERISTIC KfARBT_v_moving_speed_thrsh "" VALUE 0x70101e78 /* @ECU_Address@KfARBT_v_moving_speed_thrsh@ */ Scalar_FLOAT32_IEEE 0 ARBT_subsystem_integrated_CM_single_m_s 0.1 1.0 /end CHARACTERISTIC
/begin CHARACTERISTIC KfARBT_v_standstill_speed_thrsh "" VALUE 0x70101e74 /* @ECU_Address@KfARBT_v_standstill_speed_thrsh@ */ Scalar_FLOAT32_IEEE 0 ARBT_subsystem_integrated_CM_single_m_s 0.1 1.0 /end CHARACTERISTIC
/begin CHARACTERISTIC KbARBT_power_req_mode_man_ctrl_temp "" VALUE 0x70101e73 /* @ECU_Address@KbARBT_power_req_mode_man_ctrl_temp@ */ Scalar_UBYTE 0 ARBT_subsystem_integrated_CM_uint8 0 255 /end CHARACTERISTIC
/begin CHARACTERISTIC KbARBT_SLEW_autohold_active "" VALUE 0x70101e72 /* @ECU_Address@KbARBT_SLEW_autohold_active@ */ Scalar_BOOLEAN 0 ARBT_subsystem_integrated_CM_boolean 0 1 /end CHARACTERISTIC
/begin CHARACTERISTIC KbARBT_SLEW_gear_ctrl_accel_req "" VALUE 0x70101e71 /* @ECU_Address@KbARBT_SLEW_gear_ctrl_accel_req@ */ Scalar_BOOLEAN 0 ARBT_subsystem_integrated_CM_boolean 0 1 /end CHARACTERISTIC
/begin CHARACTERISTIC KbARBT_gear_pos_fedbck_valid "Validity flag of gear position feedback signal.
      
      For project vehicle without gear position feedback, this calibration shall be set to 0" VALUE 0x70101e70 /* @ECU_Address@KbARBT_gear_pos_fedbck_valid@ */ Scalar_BOOLEAN 0 ARBT_subsystem_integrated_CM_boolean 0 1 /end CHARACTERISTIC
/begin CHARACTERISTIC KcCOMM_BrakePedalMax "" VALUE 0x7010200c /* @ECU_Address@KcCOMM_BrakePedalMax@ */ Scalar_FLOAT32_IEEE 0 COMM_subsystem_integrated_CM_single -3.4E+38 3.4E+38 /end CHARACTERISTIC
/begin CHARACTERISTIC KcCOMM_BrakePedalMin "" VALUE 0x70102008 /* @ECU_Address@KcCOMM_BrakePedalMin@ */ Scalar_FLOAT32_IEEE 0 COMM_subsystem_integrated_CM_single -3.4E+38 3.4E+38 /end CHARACTERISTIC
/begin CHARACTERISTIC KcCOMM_FirstGearRatio "Gear ratio in 1st gear." VALUE 0x70102004 /* @ECU_Address@KcCOMM_FirstGearRatio@ */ Scalar_FLOAT32_IEEE 0 COMM_subsystem_integrated_CM_single -3.4E+38 3.4E+38 /end CHARACTERISTIC
/begin CHARACTERISTIC KcCOMM_GasPedalMax "" VALUE 0x70102000 /* @ECU_Address@KcCOMM_GasPedalMax@ */ Scalar_FLOAT32_IEEE 0 COMM_subsystem_integrated_CM_single -3.4E+38 3.4E+38 /end CHARACTERISTIC
/begin CHARACTERISTIC KcCOMM_GasPedalMaxEPB "" VALUE 0x70101ffc /* @ECU_Address@KcCOMM_GasPedalMaxEPB@ */ Scalar_FLOAT32_IEEE 0 COMM_subsystem_integrated_CM_single -3.4E+38 3.4E+38 /end CHARACTERISTIC
/begin CHARACTERISTIC KcCOMM_GasPedalMin "" VALUE 0x70101ff8 /* @ECU_Address@KcCOMM_GasPedalMin@ */ Scalar_FLOAT32_IEEE 0 COMM_subsystem_integrated_CM_single -3.4E+38 3.4E+38 /end CHARACTERISTIC
/begin CHARACTERISTIC KcCOMM_GasPedalMinEPB "" VALUE 0x70101ff4 /* @ECU_Address@KcCOMM_GasPedalMinEPB@ */ Scalar_FLOAT32_IEEE 0 COMM_subsystem_integrated_CM_single -3.4E+38 3.4E+38 /end CHARACTERISTIC
/begin CHARACTERISTIC KcCOMM_GasPedalRampEPB "" VALUE 0x70101ff0 /* @ECU_Address@KcCOMM_GasPedalRampEPB@ */ Scalar_FLOAT32_IEEE 0 COMM_subsystem_integrated_CM_single -3.4E+38 3.4E+38 /end CHARACTERISTIC
/begin CHARACTERISTIC KcCOMM_Test_Checksum_0x150 "" VALUE 0x70101fec /* @ECU_Address@KcCOMM_Test_Checksum_0x150@ */ Scalar_FLOAT32_IEEE 0 COMM_subsystem_integrated_CM_single -3.4E+38 3.4E+38 /end CHARACTERISTIC
/begin CHARACTERISTIC KcCOMM_Test_Checksum_0x151 "" VALUE 0x70101fe8 /* @ECU_Address@KcCOMM_Test_Checksum_0x151@ */ Scalar_FLOAT32_IEEE 0 COMM_subsystem_integrated_CM_single -3.4E+38 3.4E+38 /end CHARACTERISTIC
/begin CHARACTERISTIC KcCOMM_Test_Cmd_AccPelPosAct "" VALUE 0x70101fe4 /* @ECU_Address@KcCOMM_Test_Cmd_AccPelPosAct@ */ Scalar_FLOAT32_IEEE 0 COMM_subsystem_integrated_CM_single -3.4E+38 3.4E+38 /end CHARACTERISTIC
/begin CHARACTERISTIC KcCOMM_Test_Cmd_AccPelPosActInv "" VALUE 0x70101fe0 /* @ECU_Address@KcCOMM_Test_Cmd_AccPelPosActInv@ */ Scalar_FLOAT32_IEEE 0 COMM_subsystem_integrated_CM_single -3.4E+38 3.4E+38 /end CHARACTERISTIC
/begin CHARACTERISTIC KcCOMM_Test_Cmd_BrkPelPosAct "" VALUE 0x70101fdc /* @ECU_Address@KcCOMM_Test_Cmd_BrkPelPosAct@ */ Scalar_FLOAT32_IEEE 0 COMM_subsystem_integrated_CM_single -3.4E+38 3.4E+38 /end CHARACTERISTIC
/begin CHARACTERISTIC KcCOMM_Test_Cmd_BrkPelPosActInv "" VALUE 0x70101fd8 /* @ECU_Address@KcCOMM_Test_Cmd_BrkPelPosActInv@ */ Scalar_FLOAT32_IEEE 0 COMM_subsystem_integrated_CM_single -3.4E+38 3.4E+38 /end CHARACTERISTIC
/begin CHARACTERISTIC KcCOMM_Test_Cmd_Checksum "" VALUE 0x70101fd4 /* @ECU_Address@KcCOMM_Test_Cmd_Checksum@ */ Scalar_FLOAT32_IEEE 0 COMM_subsystem_integrated_CM_single -3.4E+38 3.4E+38 /end CHARACTERISTIC
/begin CHARACTERISTIC KcCOMM_Test_Cmd_RCnt "" VALUE 0x70101fd0 /* @ECU_Address@KcCOMM_Test_Cmd_RCnt@ */ Scalar_FLOAT32_IEEE 0 COMM_subsystem_integrated_CM_single -3.4E+38 3.4E+38 /end CHARACTERISTIC
/begin CHARACTERISTIC KcCOMM_Test_Cmd_StrAngle "" VALUE 0x70101fcc /* @ECU_Address@KcCOMM_Test_Cmd_StrAngle@ */ Scalar_FLOAT32_IEEE 0 COMM_subsystem_integrated_CM_single -3.4E+38 3.4E+38 /end CHARACTERISTIC
/begin CHARACTERISTIC KcCOMM_Test_Cmd_StrAngleLimit "" VALUE 0x70101fc8 /* @ECU_Address@KcCOMM_Test_Cmd_StrAngleLimit@ */ Scalar_FLOAT32_IEEE 0 COMM_subsystem_integrated_CM_single -3.4E+38 3.4E+38 /end CHARACTERISTIC
/begin CHARACTERISTIC KcCOMM_Test_Cmd_StrAngleSpd "" VALUE 0x70101fc4 /* @ECU_Address@KcCOMM_Test_Cmd_StrAngleSpd@ */ Scalar_FLOAT32_IEEE 0 COMM_subsystem_integrated_CM_single -3.4E+38 3.4E+38 /end CHARACTERISTIC
/begin CHARACTERISTIC KcCOMM_Test_Cmd_VCUCnt "" VALUE 0x70101fc0 /* @ECU_Address@KcCOMM_Test_Cmd_VCUCnt@ */ Scalar_FLOAT32_IEEE 0 COMM_subsystem_integrated_CM_single -3.4E+38 3.4E+38 /end CHARACTERISTIC
/begin CHARACTERISTIC KcCOMM_Test_Decs_Acc_Value "" VALUE 0x70101fbc /* @ECU_Address@KcCOMM_Test_Decs_Acc_Value@ */ Scalar_FLOAT32_IEEE 0 COMM_subsystem_integrated_CM_single -3.4E+38 3.4E+38 /end CHARACTERISTIC
/begin CHARACTERISTIC KcCOMM_Test_Decs_Breake_Value "" VALUE 0x70101fb8 /* @ECU_Address@KcCOMM_Test_Decs_Breake_Value@ */ Scalar_FLOAT32_IEEE 0 COMM_subsystem_integrated_CM_single -3.4E+38 3.4E+38 /end CHARACTERISTIC
/begin CHARACTERISTIC KcCOMM_Test_RCnt_0x150 "" VALUE 0x70101fb4 /* @ECU_Address@KcCOMM_Test_RCnt_0x150@ */ Scalar_FLOAT32_IEEE 0 COMM_subsystem_integrated_CM_single -3.4E+38 3.4E+38 /end CHARACTERISTIC
/begin CHARACTERISTIC KcCOMM_Test_RCnt_0x151 "" VALUE 0x70101fb0 /* @ECU_Address@KcCOMM_Test_RCnt_0x151@ */ Scalar_FLOAT32_IEEE 0 COMM_subsystem_integrated_CM_single -3.4E+38 3.4E+38 /end CHARACTERISTIC
/begin CHARACTERISTIC KcCOMM_Test_Tar_Torq "" VALUE 0x70101fac /* @ECU_Address@KcCOMM_Test_Tar_Torq@ */ Scalar_FLOAT32_IEEE 0 COMM_subsystem_integrated_CM_single -3.4E+38 3.4E+38 /end CHARACTERISTIC
/begin CHARACTERISTIC KcCOMM_Test_Tar_vehiclespd "" VALUE 0x70101fa8 /* @ECU_Address@KcCOMM_Test_Tar_vehiclespd@ */ Scalar_FLOAT32_IEEE 0 COMM_subsystem_integrated_CM_single -3.4E+38 3.4E+38 /end CHARACTERISTIC
/begin CHARACTERISTIC KcCOMM_Test_acceleration_fb "" VALUE 0x70101fa4 /* @ECU_Address@KcCOMM_Test_acceleration_fb@ */ Scalar_FLOAT32_IEEE 0 COMM_subsystem_integrated_CM_single -3.4E+38 3.4E+38 /end CHARACTERISTIC
/begin CHARACTERISTIC KcCOMM_Test_cmd_VCUChecksum "" VALUE 0x70101fa0 /* @ECU_Address@KcCOMM_Test_cmd_VCUChecksum@ */ Scalar_FLOAT32_IEEE 0 COMM_subsystem_integrated_CM_single -3.4E+38 3.4E+38 /end CHARACTERISTIC
/begin CHARACTERISTIC KcCOMM_Test_yaw_rate_fb "" VALUE 0x70101f9c /* @ECU_Address@KcCOMM_Test_yaw_rate_fb@ */ Scalar_FLOAT32_IEEE 0 COMM_subsystem_integrated_CM_single -3.4E+38 3.4E+38 /end CHARACTERISTIC
/begin CHARACTERISTIC KfACCS_d_VEH_WheelDiameter "This is whell diameter" VALUE 0x70101f98 /* @ECU_Address@KfACCS_d_VEH_WheelDiameter@ */ Scalar_FLOAT32_IEEE 0 COMM_subsystem_integrated_CM_single_mm 0.0 2000.0 /end CHARACTERISTIC
/begin CHARACTERISTIC KfCOMM_Ang_VEH_AngOrigin2FrontWheel "This is the angle between origin to front axle and origin to front wheel" VALUE 0x70101f94 /* @ECU_Address@KfCOMM_Ang_VEH_AngOrigin2FrontWheel@ */ Scalar_FLOAT32_IEEE 0 COMM_subsystem_integrated_CM_single_rad -3.14 3.14 /end CHARACTERISTIC
/begin CHARACTERISTIC KfCOMM_VEH_Mass "Vehicle mass" VALUE 0x70101f90 /* @ECU_Address@KfCOMM_VEH_Mass@ */ Scalar_FLOAT32_IEEE 0 COMM_subsystem_integrated_CM_single_kg 0.0 100000.0 /end CHARACTERISTIC
/begin CHARACTERISTIC KfCOMM_VEH_StiffnessFront "This is cornering stiffness of front wheel" VALUE 0x70101f8c /* @ECU_Address@KfCOMM_VEH_StiffnessFront@ */ Scalar_FLOAT32_IEEE 0 COMM_subsystem_integrated_CM_single_N_deg 0.0 100000.0 /end CHARACTERISTIC
/begin CHARACTERISTIC KfCOMM_VEH_StiffnessRear "This is cornering stiffness of rear wheel" VALUE 0x70101f88 /* @ECU_Address@KfCOMM_VEH_StiffnessRear@ */ Scalar_FLOAT32_IEEE 0 COMM_subsystem_integrated_CM_single_N_deg 0.0 1.0E+6 /end CHARACTERISTIC
/begin CHARACTERISTIC KfCOMM_VEH_YawInertia_Z "Moment of inertia of the whole vehicle around z axis" VALUE 0x70101f84 /* @ECU_Address@KfCOMM_VEH_YawInertia_Z@ */ Scalar_FLOAT32_IEEE 0 COMM_subsystem_integrated_CM_single_kg_m2 0.0 100000.0 /end CHARACTERISTIC
/begin CHARACTERISTIC KfCOMM_a_VCULongAccOffset "Offset to override Longitudinal Acceleration." VALUE 0x70101f80 /* @ECU_Address@KfCOMM_a_VCULongAccOffset@ */ Scalar_FLOAT32_IEEE 0 COMM_subsystem_integrated_CM_single -3.4E+38 3.4E+38 /end CHARACTERISTIC
/begin CHARACTERISTIC KfCOMM_d_VEH_DisCentorid2Front "This is the distance between Cetroid and Front surface" VALUE 0x70101f7c /* @ECU_Address@KfCOMM_d_VEH_DisCentorid2Front@ */ Scalar_FLOAT32_IEEE 0 COMM_subsystem_integrated_CM_single_mm 0.0 10000.0 /end CHARACTERISTIC
/begin CHARACTERISTIC KfCOMM_d_VEH_DisFront2Rear "This is distance between two axes" VALUE 0x70101f78 /* @ECU_Address@KfCOMM_d_VEH_DisFront2Rear@ */ Scalar_FLOAT32_IEEE 0 COMM_subsystem_integrated_CM_single_mm 0.0 10000.0 /end CHARACTERISTIC
/begin CHARACTERISTIC KfCOMM_d_VEH_DisLeft2Right "This is the distance between left wheel and right wheel" VALUE 0x70101f74 /* @ECU_Address@KfCOMM_d_VEH_DisLeft2Right@ */ Scalar_FLOAT32_IEEE 0 COMM_subsystem_integrated_CM_single_mm 0.0 5000.0 /end CHARACTERISTIC
/begin CHARACTERISTIC KfCOMM_d_VEH_DisOrigin2End "This is the distance between the cordinate origin and the rear surface" VALUE 0x70101f70 /* @ECU_Address@KfCOMM_d_VEH_DisOrigin2End@ */ Scalar_FLOAT32_IEEE 0 COMM_subsystem_integrated_CM_single_mm 0.0 10000.0 /end CHARACTERISTIC
/begin CHARACTERISTIC KfCOMM_d_VEH_DisOrigin2FrontWheel "" VALUE 0x70101f6c /* @ECU_Address@KfCOMM_d_VEH_DisOrigin2FrontWheel@ */ Scalar_FLOAT32_IEEE 0 COMM_subsystem_integrated_CM_single_mm 0.0 10000.0 /end CHARACTERISTIC
/begin CHARACTERISTIC KfCOMM_d_VEH_DisOrigin2Head "This is the distance between the coordinate origin and the front surface" VALUE 0x70101f68 /* @ECU_Address@KfCOMM_d_VEH_DisOrigin2Head@ */ Scalar_FLOAT32_IEEE 0 COMM_subsystem_integrated_CM_single_mm 0.0 10000.0 /end CHARACTERISTIC
/begin CHARACTERISTIC KfCOMM_d_VEH_DisOrigin2RearAxle "This is the distance between the cordinate origin and the rear axle" VALUE 0x70101f64 /* @ECU_Address@KfCOMM_d_VEH_DisOrigin2RearAxle@ */ Scalar_FLOAT32_IEEE 0 COMM_subsystem_integrated_CM_single_mm 0.0 10000.0 /end CHARACTERISTIC
/begin CHARACTERISTIC KfCOMM_d_VEH_Length "This is vehicle length" VALUE 0x70101f60 /* @ECU_Address@KfCOMM_d_VEH_Length@ */ Scalar_FLOAT32_IEEE 0 COMM_subsystem_integrated_CM_single_mm 0.0 20000.0 /end CHARACTERISTIC
/begin CHARACTERISTIC KfCOMM_d_VEH_MinTurnRadius "Minimum turning radius" VALUE 0x70101f5c /* @ECU_Address@KfCOMM_d_VEH_MinTurnRadius@ */ Scalar_FLOAT32_IEEE 0 COMM_subsystem_integrated_CM_single_m 0.0 30.0 /end CHARACTERISTIC
/begin CHARACTERISTIC KfCOMM_d_VEH_Width "Vehicle's width" VALUE 0x70101f58 /* @ECU_Address@KfCOMM_d_VEH_Width@ */ Scalar_FLOAT32_IEEE 0 COMM_subsystem_integrated_CM_single_mm 0.0 5000.0 /end CHARACTERISTIC
/begin CHARACTERISTIC KfCOMM_r_VCULongAccSlope "Slope to override Longitudinal Acceleration." VALUE 0x70101f54 /* @ECU_Address@KfCOMM_r_VCULongAccSlope@ */ Scalar_FLOAT32_IEEE 0 COMM_subsystem_integrated_CM_single -3.4E+38 3.4E+38 /end CHARACTERISTIC
/begin CHARACTERISTIC KcCOMM_Test_Cmd_ATOModEnable "" VALUE 0x70101f52 /* @ECU_Address@KcCOMM_Test_Cmd_ATOModEnable@ */ Scalar_UBYTE 0 COMM_subsystem_integrated_CM_uint8 0 255 /end CHARACTERISTIC
/begin CHARACTERISTIC KcCOMM_Test_Cmd_AccPelEnable "" VALUE 0x70101f51 /* @ECU_Address@KcCOMM_Test_Cmd_AccPelEnable@ */ Scalar_UBYTE 0 COMM_subsystem_integrated_CM_uint8 0 255 /end CHARACTERISTIC
/begin CHARACTERISTIC KcCOMM_Test_Cmd_BrkPelEnable "" VALUE 0x70101f50 /* @ECU_Address@KcCOMM_Test_Cmd_BrkPelEnable@ */ Scalar_UBYTE 0 COMM_subsystem_integrated_CM_uint8 0 255 /end CHARACTERISTIC
/begin CHARACTERISTIC KcCOMM_Test_Cmd_ICPDTC "" VALUE 0x70101f4f /* @ECU_Address@KcCOMM_Test_Cmd_ICPDTC@ */ Scalar_UBYTE 0 COMM_subsystem_integrated_CM_uint8 0 255 /end CHARACTERISTIC
/begin CHARACTERISTIC KcCOMM_Test_Cmd_TgtSft "" VALUE 0x70101f4e /* @ECU_Address@KcCOMM_Test_Cmd_TgtSft@ */ Scalar_UBYTE 0 COMM_subsystem_integrated_CM_uint8 0 255 /end CHARACTERISTIC
/begin CHARACTERISTIC KcCOMM_Test_Cmd_TgtSftEnable "" VALUE 0x70101f4d /* @ECU_Address@KcCOMM_Test_Cmd_TgtSftEnable@ */ Scalar_UBYTE 0 COMM_subsystem_integrated_CM_uint8 0 255 /end CHARACTERISTIC
/begin CHARACTERISTIC KcCOMM_Test_Decs_Acc_Mod "" VALUE 0x70101f4c /* @ECU_Address@KcCOMM_Test_Decs_Acc_Mod@ */ Scalar_UBYTE 0 COMM_subsystem_integrated_CM_uint8 0 255 /end CHARACTERISTIC
/begin CHARACTERISTIC KcCOMM_Test_Decs_Acc_Req "" VALUE 0x70101f4b /* @ECU_Address@KcCOMM_Test_Decs_Acc_Req@ */ Scalar_UBYTE 0 COMM_subsystem_integrated_CM_uint8 0 255 /end CHARACTERISTIC
/begin CHARACTERISTIC KcCOMM_Test_Over_Speed "SLEW value for Over Speed." VALUE 0x70101f4a /* @ECU_Address@KcCOMM_Test_Over_Speed@ */ Scalar_UBYTE 0 COMM_subsystem_integrated_CM_uint8 0 255 /end CHARACTERISTIC
/begin CHARACTERISTIC KcCOMM_Test_SlowDown_Indication "SLEW value for SpeedUp_Indication." VALUE 0x70101f49 /* @ECU_Address@KcCOMM_Test_SlowDown_Indication@ */ Scalar_UBYTE 0 COMM_subsystem_integrated_CM_uint8 0 255 /end CHARACTERISTIC
/begin CHARACTERISTIC KcCOMM_Test_SpeedUp_Indication "SLEW value for SpeedUp_Indication." VALUE 0x70101f48 /* @ECU_Address@KcCOMM_Test_SpeedUp_Indication@ */ Scalar_UBYTE 0 COMM_subsystem_integrated_CM_uint8 0 255 /end CHARACTERISTIC
/begin CHARACTERISTIC KcCOMM_Test_Stop_Request "" VALUE 0x70101f47 /* @ECU_Address@KcCOMM_Test_Stop_Request@ */ Scalar_UBYTE 0 COMM_subsystem_integrated_CM_uint8 0 255 /end CHARACTERISTIC
/begin CHARACTERISTIC KcCOMM_Test_XBR_EBI_Mode "" VALUE 0x70101f46 /* @ECU_Address@KcCOMM_Test_XBR_EBI_Mode@ */ Scalar_UBYTE 0 COMM_subsystem_integrated_CM_uint8 0 255 /end CHARACTERISTIC
/begin CHARACTERISTIC KcCOMM_Test_XBR_Priority "" VALUE 0x70101f45 /* @ECU_Address@KcCOMM_Test_XBR_Priority@ */ Scalar_UBYTE 0 COMM_subsystem_integrated_CM_uint8 0 255 /end CHARACTERISTIC
/begin CHARACTERISTIC KcCOMM_Test_driveoff_Req "" VALUE 0x70101f44 /* @ECU_Address@KcCOMM_Test_driveoff_Req@ */ Scalar_UBYTE 0 COMM_subsystem_integrated_CM_uint8 0 255 /end CHARACTERISTIC
/begin CHARACTERISTIC KcCOMM_Test_mode "" VALUE 0x70101f43 /* @ECU_Address@KcCOMM_Test_mode@ */ Scalar_UBYTE 0 COMM_subsystem_integrated_CM_uint8 0 255 /end CHARACTERISTIC
/begin CHARACTERISTIC KcCOMM_TorqCtrlPriority_Active "The priority of the Torque Override Control Mode send to VCU in ADV active state.
      0 - Highest priority.
      1 - High priority.
      2 - Medium priority.
      3 - Low priority." VALUE 0x70101f42 /* @ECU_Address@KcCOMM_TorqCtrlPriority_Active@ */ Scalar_UBYTE 0 COMM_subsystem_integrated_CM_uint8 0 255 /end CHARACTERISTIC
/begin CHARACTERISTIC KcCOMM_TorqCtrlPriority_Default "The priority of the Torque Override Control Mode send to VCU in default state.
      0 - Highest priority.
      1 - High priority.
      2 - Medium priority.
      3 - Low priority." VALUE 0x70101f41 /* @ECU_Address@KcCOMM_TorqCtrlPriority_Default@ */ Scalar_UBYTE 0 COMM_subsystem_integrated_CM_uint8 0 255 /end CHARACTERISTIC
/begin CHARACTERISTIC KcCOMM_VehicleCANbusConfig "Vehicle Platform and CAN Bus Configuration.
      1 - JAC#1;
      2 - JAC#2 or iVISTA;
      3 - ICPV;
      4 - GLB;
      5 - FAW;
      6 - HZBus;
      7 - USdemo." VALUE 0x70101f40 /* @ECU_Address@KcCOMM_VehicleCANbusConfig@ */ Scalar_UBYTE 0 COMM_subsystem_integrated_CM_uint8 0 255 /end CHARACTERISTIC
/begin CHARACTERISTIC KbCOMM_Test_BckFogLamp_Req "" VALUE 0x70101f3f /* @ECU_Address@KbCOMM_Test_BckFogLamp_Req@ */ Scalar_BOOLEAN 0 COMM_subsystem_integrated_CM_boolean 0 1 /end CHARACTERISTIC
/begin CHARACTERISTIC KbCOMM_Test_BrakePrechargeRequest "Test mode value for brake boost precharge request." VALUE 0x70101f3e /* @ECU_Address@KbCOMM_Test_BrakePrechargeRequest@ */ Scalar_BOOLEAN 0 COMM_subsystem_integrated_CM_boolean 0 1 /end CHARACTERISTIC
/begin CHARACTERISTIC KbCOMM_Test_BrakePriorityMode "Test mode for brake request priority mode." VALUE 0x70101f3d /* @ECU_Address@KbCOMM_Test_BrakePriorityMode@ */ Scalar_BOOLEAN 0 COMM_subsystem_integrated_CM_boolean 0 1 /end CHARACTERISTIC
/begin CHARACTERISTIC KbCOMM_Test_Cmd_BrakeLightReq "" VALUE 0x70101f3c /* @ECU_Address@KbCOMM_Test_Cmd_BrakeLightReq@ */ Scalar_BOOLEAN 0 COMM_subsystem_integrated_CM_boolean 0 1 /end CHARACTERISTIC
/begin CHARACTERISTIC KbCOMM_Test_Cmd_EPSDir "" VALUE 0x70101f3b /* @ECU_Address@KbCOMM_Test_Cmd_EPSDir@ */ Scalar_BOOLEAN 0 COMM_subsystem_integrated_CM_boolean 0 1 /end CHARACTERISTIC
/begin CHARACTERISTIC KbCOMM_Test_Decs_DippedBeam_Req "" VALUE 0x70101f3a /* @ECU_Address@KbCOMM_Test_Decs_DippedBeam_Req@ */ Scalar_BOOLEAN 0 COMM_subsystem_integrated_CM_boolean 0 1 /end CHARACTERISTIC
/begin CHARACTERISTIC KbCOMM_Test_Decs_HighBeam_Req "" VALUE 0x70101f39 /* @ECU_Address@KbCOMM_Test_Decs_HighBeam_Req@ */ Scalar_BOOLEAN 0 COMM_subsystem_integrated_CM_boolean 0 1 /end CHARACTERISTIC
/begin CHARACTERISTIC KbCOMM_Test_Decs_LftLmp_Req "" VALUE 0x70101f38 /* @ECU_Address@KbCOMM_Test_Decs_LftLmp_Req@ */ Scalar_BOOLEAN 0 COMM_subsystem_integrated_CM_boolean 0 1 /end CHARACTERISTIC
/begin CHARACTERISTIC KbCOMM_Test_Decs_Light_Req "" VALUE 0x70101f37 /* @ECU_Address@KbCOMM_Test_Decs_Light_Req@ */ Scalar_BOOLEAN 0 COMM_subsystem_integrated_CM_boolean 0 1 /end CHARACTERISTIC
/begin CHARACTERISTIC KbCOMM_Test_Decs_RihtLmp_Req "" VALUE 0x70101f36 /* @ECU_Address@KbCOMM_Test_Decs_RihtLmp_Req@ */ Scalar_BOOLEAN 0 COMM_subsystem_integrated_CM_boolean 0 1 /end CHARACTERISTIC
/begin CHARACTERISTIC KbCOMM_Test_Decs_iBCM_Req "" VALUE 0x70101f35 /* @ECU_Address@KbCOMM_Test_Decs_iBCM_Req@ */ Scalar_BOOLEAN 0 COMM_subsystem_integrated_CM_boolean 0 1 /end CHARACTERISTIC
/begin CHARACTERISTIC KbCOMM_Test_FrontFogLamp_Req "" VALUE 0x70101f34 /* @ECU_Address@KbCOMM_Test_FrontFogLamp_Req@ */ Scalar_BOOLEAN 0 COMM_subsystem_integrated_CM_boolean 0 1 /end CHARACTERISTIC
/begin CHARACTERISTIC KbCOMM_Test_Horn_Req "" VALUE 0x70101f33 /* @ECU_Address@KbCOMM_Test_Horn_Req@ */ Scalar_BOOLEAN 0 COMM_subsystem_integrated_CM_boolean 0 1 /end CHARACTERISTIC
/begin CHARACTERISTIC KbCOMM_Test_HummerSts "" VALUE 0x70101f32 /* @ECU_Address@KbCOMM_Test_HummerSts@ */ Scalar_BOOLEAN 0 COMM_subsystem_integrated_CM_boolean 0 1 /end CHARACTERISTIC
/begin CHARACTERISTIC KbCOMM_Test_WarnLight_Req "" VALUE 0x70101f31 /* @ECU_Address@KbCOMM_Test_WarnLight_Req@ */ Scalar_BOOLEAN 0 COMM_subsystem_integrated_CM_boolean 0 1 /end CHARACTERISTIC
/begin CHARACTERISTIC KbCOMM_VEH_UseNewConfig "This calibartion can change to a new vehicle configure which can be calibrated" VALUE 0x70101f30 /* @ECU_Address@KbCOMM_VEH_UseNewConfig@ */ Scalar_BOOLEAN 0 COMM_subsystem_integrated_CM_boolean 0.0 1.0 /end CHARACTERISTIC
/begin CHARACTERISTIC KcCOMM_Test_Cmd_EPSXBW_En "" VALUE 0x70101f2f /* @ECU_Address@KcCOMM_Test_Cmd_EPSXBW_En@ */ Scalar_BOOLEAN 0 COMM_subsystem_integrated_CM_boolean 0 1 /end CHARACTERISTIC
/begin CHARACTERISTIC KcCOMM_Test_Cmd_EPSXBW_En_ovr "" VALUE 0x70101f2e /* @ECU_Address@KcCOMM_Test_Cmd_EPSXBW_En_ovr@ */ Scalar_BOOLEAN 0 COMM_subsystem_integrated_CM_boolean 0 1 /end CHARACTERISTIC
/begin CHARACTERISTIC KcCOMM_Test_Cmd_StrAngle_ovr "" VALUE 0x70101f2d /* @ECU_Address@KcCOMM_Test_Cmd_StrAngle_ovr@ */ Scalar_BOOLEAN 0 COMM_subsystem_integrated_CM_boolean 0 1 /end CHARACTERISTIC
/begin CHARACTERISTIC KcCOMM_Test_Decs_Acc_Req_ovr "" VALUE 0x70101f2c /* @ECU_Address@KcCOMM_Test_Decs_Acc_Req_ovr@ */ Scalar_BOOLEAN 0 COMM_subsystem_integrated_CM_boolean 0 1 /end CHARACTERISTIC
/begin CHARACTERISTIC KcCOMM_Test_Decs_Acc_Value_ovr "" VALUE 0x70101f2b /* @ECU_Address@KcCOMM_Test_Decs_Acc_Value_ovr@ */ Scalar_BOOLEAN 0 COMM_subsystem_integrated_CM_boolean 0 1 /end CHARACTERISTIC
/begin CHARACTERISTIC KcCOMM_Test_Decs_Breake_Req "" VALUE 0x70101f2a /* @ECU_Address@KcCOMM_Test_Decs_Breake_Req@ */ Scalar_BOOLEAN 0 COMM_subsystem_integrated_CM_boolean 0 1 /end CHARACTERISTIC
/begin CHARACTERISTIC KcCOMM_Test_Decs_Breake_Req_ovr "" VALUE 0x70101f29 /* @ECU_Address@KcCOMM_Test_Decs_Breake_Req_ovr@ */ Scalar_BOOLEAN 0 COMM_subsystem_integrated_CM_boolean 0 1 /end CHARACTERISTIC
/begin CHARACTERISTIC KcCOMM_Test_Decs_Breake_Value_ovr "" VALUE 0x70101f28 /* @ECU_Address@KcCOMM_Test_Decs_Breake_Value_ovr@ */ Scalar_BOOLEAN 0 COMM_subsystem_integrated_CM_boolean 0 1 /end CHARACTERISTIC
/begin CHARACTERISTIC KfDCSN_t_adm_temp_steering_ovrd_delay "when override conditions are met, the time to delay before exit." VALUE 0x7010216c /* @ECU_Address@KfDCSN_t_adm_temp_steering_ovrd_delay@ */ Scalar_FLOAT32_IEEE 0 DCSN_subsystem_integrated_CM_single_s -3.4E+38 3.4E+38 /end CHARACTERISTIC
/begin CHARACTERISTIC KfDCSN_t_adm_temp_steering_resume_delay "When resume conditions are met, the time before re-engaged." VALUE 0x70102168 /* @ECU_Address@KfDCSN_t_adm_temp_steering_resume_delay@ */ Scalar_FLOAT32_IEEE 0 DCSN_subsystem_integrated_CM_single_s -3.4E+38 3.4E+38 /end CHARACTERISTIC
/begin CHARACTERISTIC KfDCSN_t_autodrive_max_wait_time "the maximal wait time before the vehicle response to our activating request" VALUE 0x7010215c /* @ECU_Address@KfDCSN_t_autodrive_max_wait_time@ */ Scalar_FLOAT32_IEEE 0 DCSN_subsystem_integrated_CM_single_s -3.4E+38 3.4E+38 /end CHARACTERISTIC
/begin CHARACTERISTIC KfDCSN_t_max_eps_inhibit_power "The maximal allowed delay time to inhibit power control if EPS cannot response to CMD" VALUE 0x70102158 /* @ECU_Address@KfDCSN_t_max_eps_inhibit_power@ */ Scalar_FLOAT32_IEEE 0 DCSN_subsystem_integrated_CM_single_s 0.0 30.0 /end CHARACTERISTIC
/begin CHARACTERISTIC KfDCSN_t_max_time_fault_warning "allowed reaction time after fault warning and before triggering emergency stop" VALUE 0x70102154 /* @ECU_Address@KfDCSN_t_max_time_fault_warning@ */ Scalar_FLOAT32_IEEE 0 DCSN_subsystem_integrated_CM_single_s -3.4E+38 3.4E+38 /end CHARACTERISTIC
/begin CHARACTERISTIC KfDCSN_t_max_time_to_takeover "allowed reaction time after both lane markers are missed but before autodrive exit" VALUE 0x70102150 /* @ECU_Address@KfDCSN_t_max_time_to_takeover@ */ Scalar_FLOAT32_IEEE 0 DCSN_subsystem_integrated_CM_single_s -3.4E+38 3.4E+38 /end CHARACTERISTIC
/begin CHARACTERISTIC KfDCSN_v_adm_temp_veh_setspeed "Current vehicle acc set speed. 
      Not connect with ACCS yet" VALUE 0x70102138 /* @ECU_Address@KfDCSN_v_adm_temp_veh_setspeed@ */ Scalar_FLOAT32_IEEE 0 DCSN_subsystem_integrated_CM_single_m_s -3.4E+38 3.4E+38 /end CHARACTERISTIC
/begin CHARACTERISTIC KfDCSN_v_default_warning_speed "The maximal speed allowed when input speed limit is missed before warning request." VALUE 0x7010212c /* @ECU_Address@KfDCSN_v_default_warning_speed@ */ Scalar_FLOAT32_IEEE 0 DCSN_subsystem_integrated_CM_single_m_s 0.0 100.0 /end CHARACTERISTIC
/begin CHARACTERISTIC KfDCSN_v_overspeed_warning_extra "The extra speed difference allowed when vehicle speed is higher than speed limit before warning request." VALUE 0x70102128 /* @ECU_Address@KfDCSN_v_overspeed_warning_extra@ */ Scalar_FLOAT32_IEEE 0 DCSN_subsystem_integrated_CM_single_m_s 0.0 10.0 /end CHARACTERISTIC
/begin CHARACTERISTIC KbDCSN_SLEW_DriveModeComd_value "SLEW mode
      the DriveModeComd value" VALUE 0x70102065 /* @ECU_Address@KbDCSN_SLEW_DriveModeComd_value@ */ Scalar_UBYTE 0 DCSN_subsystem_integrated_CM_uint8 0 255 /end CHARACTERISTIC
/begin CHARACTERISTIC KcDCSN_t_usr_activate_cmd_send_count "send count of usr_activate_action, valid when KbDCSN_use_vehicle_activate_switch = true
      unit: seconds" VALUE 0x70102064 /* @ECU_Address@KcDCSN_t_usr_activate_cmd_send_count@ */ Scalar_UBYTE 0 DCSN_subsystem_integrated_CM_uint8 0 255 /end CHARACTERISTIC
/begin CHARACTERISTIC KeDCSN_adm_main_mode_man_value "manual override of adm_main_mode output as uint8:
      
      0 = ADM_OFF
      1 = ADM_STANDBY
      2 = ADM_READY
      3 = ADM_ACTIVE
      4 = ADM_STEER_OVRD
      5 = ADM_TAKEOVER_WARNING
      6 = ADM_FAULT_WARNING76 = ADM_FAULT_REACTION
      8 = ADM_FAULT_DETECTED" VALUE 0x70102063 /* @ECU_Address@KeDCSN_adm_main_mode_man_value@ */ Scalar_UBYTE 0 DCSN_subsystem_integrated_CM_uint8 0 255 /end CHARACTERISTIC
/begin CHARACTERISTIC KeDCSN_adm_temp_diag_system_fault "System faults
      0 = no fault
      1,2 = warning faults
      3,4,5 = exit faults" VALUE 0x70102062 /* @ECU_Address@KeDCSN_adm_temp_diag_system_fault@ */ Scalar_UBYTE 0 DCSN_subsystem_integrated_CM_uint8 0 255 /end CHARACTERISTIC
/begin CHARACTERISTIC KeDCSN_control_mode_man_value "0 = AUTODRIVE_PASIV
      1 = AUTODRIVE_DELAY
      2 = AUTODRIVE_RE_ACTIV
      3 = AUTODRIVE_ACTIVATING
      4 = AUTODRIVE_ACTIVATED" VALUE 0x7010205e /* @ECU_Address@KeDCSN_control_mode_man_value@ */ Scalar_UBYTE 0 DCSN_subsystem_integrated_CM_uint8 0 255 /end CHARACTERISTIC
/begin CHARACTERISTIC KeDCSN_usr_cmd_autodrive_activate_man "0 = Deactivate
      1 = Activate
      2 = Hold" VALUE 0x70102059 /* @ECU_Address@KeDCSN_usr_cmd_autodrive_activate_man@ */ Scalar_UBYTE 0 DCSN_subsystem_integrated_CM_uint8 0 255 /end CHARACTERISTIC
/begin CHARACTERISTIC KbDCSN_SLEW_DriveModeComd_enbl "0 = use COMM DriverModeComd
      1 = use SLEW DriverModeComd" VALUE 0x70102056 /* @ECU_Address@KbDCSN_SLEW_DriveModeComd_enbl@ */ Scalar_BOOLEAN 0 DCSN_subsystem_integrated_CM_boolean 0 1 /end CHARACTERISTIC
/begin CHARACTERISTIC KbDCSN_SLEW_initialization_finished "0 = use initialization finished judgement logic
      1 = initialization finished" VALUE 0x70102055 /* @ECU_Address@KbDCSN_SLEW_initialization_finished@ */ Scalar_BOOLEAN 0 DCSN_subsystem_integrated_CM_boolean 0 1 /end CHARACTERISTIC
/begin CHARACTERISTIC KbDCSN_acc_man_enbl "0 = manual override disabled
      1 = manual override enabled" VALUE 0x70102054 /* @ECU_Address@KbDCSN_acc_man_enbl@ */ Scalar_BOOLEAN 0 DCSN_subsystem_integrated_CM_boolean 0 1 /end CHARACTERISTIC
/begin CHARACTERISTIC KbDCSN_accs_resume_man_enbl "0 = manual accs resume override disabled
      1 = manual accs resume override enabled" VALUE 0x70102053 /* @ECU_Address@KbDCSN_accs_resume_man_enbl@ */ Scalar_BOOLEAN 0 DCSN_subsystem_integrated_CM_boolean 0 1 /end CHARACTERISTIC
/begin CHARACTERISTIC KbDCSN_accs_resume_man_value "manual change lane switch, valid only when KbDCSN_accs_resume_man_enbl = true
      Pulse signal when reverse." VALUE 0x70102052 /* @ECU_Address@KbDCSN_accs_resume_man_value@ */ Scalar_BOOLEAN 0 DCSN_subsystem_integrated_CM_boolean 0 1 /end CHARACTERISTIC
/begin CHARACTERISTIC KbDCSN_active_feature_man_ctrl "For all active features (ACC, LCC, ALCA):
      0 = manual override disabled
      1 = manual override enabled" VALUE 0x70102051 /* @ECU_Address@KbDCSN_active_feature_man_ctrl@ */ Scalar_BOOLEAN 0 DCSN_subsystem_integrated_CM_boolean 0 1 /end CHARACTERISTIC
/begin CHARACTERISTIC KbDCSN_adm_main_mode_man_ctrl "0 = manual override disabled
      1 = manual override enabled" VALUE 0x7010204f /* @ECU_Address@KbDCSN_adm_main_mode_man_ctrl@ */ Scalar_BOOLEAN 0 DCSN_subsystem_integrated_CM_boolean 0 1 /end CHARACTERISTIC
/begin CHARACTERISTIC KbDCSN_adm_temp_stop_finished "0 = not finished
      1 = finished" VALUE 0x7010204e /* @ECU_Address@KbDCSN_adm_temp_stop_finished@ */ Scalar_BOOLEAN 0 DCSN_subsystem_integrated_CM_boolean 0 1 /end CHARACTERISTIC
/begin CHARACTERISTIC KbDCSN_adm_temp_usr_cmd_autodrive_enabled "0 = not enabled
      1 = enabled" VALUE 0x7010204d /* @ECU_Address@KbDCSN_adm_temp_usr_cmd_autodrive_enabled@ */ Scalar_BOOLEAN 0 DCSN_subsystem_integrated_CM_boolean 0 1 /end CHARACTERISTIC
/begin CHARACTERISTIC KbDCSN_aeb_man_enbl "0 = Close AEB
      1 = Open AEB" VALUE 0x7010204c /* @ECU_Address@KbDCSN_aeb_man_enbl@ */ Scalar_BOOLEAN 0 DCSN_subsystem_integrated_CM_boolean 0 1 /end CHARACTERISTIC
/begin CHARACTERISTIC KbDCSN_aeb_usr_switch "AEB feature user switch" VALUE 0x7010204b /* @ECU_Address@KbDCSN_aeb_usr_switch@ */ Scalar_BOOLEAN 0 DCSN_subsystem_integrated_CM_boolean 0 1 /end CHARACTERISTIC
/begin CHARACTERISTIC KbDCSN_alca_man_enbl "0 = manual override disabled
      1 = manual override enabled" VALUE 0x7010204a /* @ECU_Address@KbDCSN_alca_man_enbl@ */ Scalar_BOOLEAN 0 DCSN_subsystem_integrated_CM_boolean 0 1 /end CHARACTERISTIC
/begin CHARACTERISTIC KbDCSN_alca_usr_switch "ALCA feature user switch" VALUE 0x70102049 /* @ECU_Address@KbDCSN_alca_usr_switch@ */ Scalar_BOOLEAN 0 DCSN_subsystem_integrated_CM_boolean 0 1 /end CHARACTERISTIC
/begin CHARACTERISTIC KbDCSN_brake_ctrl_man_enbl "0 = manual override disabled
      1 = manual override enabled" VALUE 0x70102048 /* @ECU_Address@KbDCSN_brake_ctrl_man_enbl@ */ Scalar_BOOLEAN 0 DCSN_subsystem_integrated_CM_boolean 0 1 /end CHARACTERISTIC
/begin CHARACTERISTIC KbDCSN_brake_ctrl_man_value "manual brake control switch, valid only when KbDCSN_brake_ctrl_man_enbl = true
      0 = brake control off
      1 = brake control on" VALUE 0x70102047 /* @ECU_Address@KbDCSN_brake_ctrl_man_value@ */ Scalar_BOOLEAN 0 DCSN_subsystem_integrated_CM_boolean 0 1 /end CHARACTERISTIC
/begin CHARACTERISTIC KbDCSN_bsd_man_enbl "0 = Close BSD
      1 = Open BSD" VALUE 0x70102046 /* @ECU_Address@KbDCSN_bsd_man_enbl@ */ Scalar_BOOLEAN 0 DCSN_subsystem_integrated_CM_boolean 0 1 /end CHARACTERISTIC
/begin CHARACTERISTIC KbDCSN_bsd_usr_switch "BSD feature user switch" VALUE 0x70102045 /* @ECU_Address@KbDCSN_bsd_usr_switch@ */ Scalar_BOOLEAN 0 DCSN_subsystem_integrated_CM_boolean 0 1 /end CHARACTERISTIC
/begin CHARACTERISTIC KbDCSN_change_lane_enable "0 = disable change lane request
      1 = enable change lane request" VALUE 0x70102043 /* @ECU_Address@KbDCSN_change_lane_enable@ */ Scalar_BOOLEAN 0 DCSN_subsystem_integrated_CM_boolean 0 1 /end CHARACTERISTIC
/begin CHARACTERISTIC KbDCSN_control_mode_man_enbl "Override the output auotdirve control main mode.
      0 = not override
      1 = override" VALUE 0x70102040 /* @ECU_Address@KbDCSN_control_mode_man_enbl@ */ Scalar_BOOLEAN 0 DCSN_subsystem_integrated_CM_boolean 0 1 /end CHARACTERISTIC
/begin CHARACTERISTIC KbDCSN_dow_man_enbl "0 = Close DOW
      1 = Open DOW" VALUE 0x7010203f /* @ECU_Address@KbDCSN_dow_man_enbl@ */ Scalar_BOOLEAN 0 DCSN_subsystem_integrated_CM_boolean 0 1 /end CHARACTERISTIC
/begin CHARACTERISTIC KbDCSN_dow_usr_switch "DOW feature user switch" VALUE 0x7010203e /* @ECU_Address@KbDCSN_dow_usr_switch@ */ Scalar_BOOLEAN 0 DCSN_subsystem_integrated_CM_boolean 0 1 /end CHARACTERISTIC
/begin CHARACTERISTIC KbDCSN_enable_warning_no_input "0 = disable warning if no speed limit input
      1 = use default speed limit to warn if no speed limit input" VALUE 0x7010203d /* @ECU_Address@KbDCSN_enable_warning_no_input@ */ Scalar_BOOLEAN 0 DCSN_subsystem_integrated_CM_boolean 0 1 /end CHARACTERISTIC
/begin CHARACTERISTIC KbDCSN_epb_ctrl_man_enbl "0 = manual override disabled
      1 = manual override enabled" VALUE 0x7010203c /* @ECU_Address@KbDCSN_epb_ctrl_man_enbl@ */ Scalar_BOOLEAN 0 DCSN_subsystem_integrated_CM_boolean 0 1 /end CHARACTERISTIC
/begin CHARACTERISTIC KbDCSN_epb_ctrl_man_value "manual epb control switch, valid only when KbDCSN_epb_ctrl_man_enbl = true
      0 = epb release
      1 = epb engage" VALUE 0x7010203b /* @ECU_Address@KbDCSN_epb_ctrl_man_value@ */ Scalar_BOOLEAN 0 DCSN_subsystem_integrated_CM_boolean 0 1 /end CHARACTERISTIC
/begin CHARACTERISTIC KbDCSN_fcta_man_enbl "0 = Close FCTA
      1 = Open FCTA" VALUE 0x7010203a /* @ECU_Address@KbDCSN_fcta_man_enbl@ */ Scalar_BOOLEAN 0 DCSN_subsystem_integrated_CM_boolean 0 1 /end CHARACTERISTIC
/begin CHARACTERISTIC KbDCSN_fcta_usr_switch "FCTA feature user switch" VALUE 0x70102039 /* @ECU_Address@KbDCSN_fcta_usr_switch@ */ Scalar_BOOLEAN 0 DCSN_subsystem_integrated_CM_boolean 0 1 /end CHARACTERISTIC
/begin CHARACTERISTIC KbDCSN_fcw_man_enbl "0 = manual FCW off
      1 = manual FCW on" VALUE 0x70102038 /* @ECU_Address@KbDCSN_fcw_man_enbl@ */ Scalar_BOOLEAN 0 DCSN_subsystem_integrated_CM_boolean 0 1 /end CHARACTERISTIC
/begin CHARACTERISTIC KbDCSN_fcw_usr_switch "FCW feature user switch" VALUE 0x70102037 /* @ECU_Address@KbDCSN_fcw_usr_switch@ */ Scalar_BOOLEAN 0 DCSN_subsystem_integrated_CM_boolean 0 1 /end CHARACTERISTIC
/begin CHARACTERISTIC KbDCSN_gear_ctrl_man_enbl "0 = manual override disabled
      1 = manual override enabled" VALUE 0x70102036 /* @ECU_Address@KbDCSN_gear_ctrl_man_enbl@ */ Scalar_BOOLEAN 0 DCSN_subsystem_integrated_CM_boolean 0 1 /end CHARACTERISTIC
/begin CHARACTERISTIC KbDCSN_gear_ctrl_man_value "manual gear control switch, valid only when KbDCSN_gear_ctrl_man_enbl = true
      0 = gear control off
      1 = gear control on" VALUE 0x70102035 /* @ECU_Address@KbDCSN_gear_ctrl_man_value@ */ Scalar_BOOLEAN 0 DCSN_subsystem_integrated_CM_boolean 0 1 /end CHARACTERISTIC
/begin CHARACTERISTIC KbDCSN_inhibit_power_for_eps_enable "0 = disable power inhibit when EPS is out of control
      1 = enable power inhibit when EPS is out of control" VALUE 0x70102034 /* @ECU_Address@KbDCSN_inhibit_power_for_eps_enable@ */ Scalar_BOOLEAN 0 DCSN_subsystem_integrated_CM_boolean 0 1 /end CHARACTERISTIC
/begin CHARACTERISTIC KbDCSN_lca_man_enbl "0 = Close LCA
      1 = Open LCA" VALUE 0x70102031 /* @ECU_Address@KbDCSN_lca_man_enbl@ */ Scalar_BOOLEAN 0 DCSN_subsystem_integrated_CM_boolean 0 1 /end CHARACTERISTIC
/begin CHARACTERISTIC KbDCSN_lca_usr_switch "LCA feature user switch" VALUE 0x70102030 /* @ECU_Address@KbDCSN_lca_usr_switch@ */ Scalar_BOOLEAN 0 DCSN_subsystem_integrated_CM_boolean 0 1 /end CHARACTERISTIC
/begin CHARACTERISTIC KbDCSN_lcc_man_enbl "0 = manual LCC off
      1 = manual LCC on" VALUE 0x7010202f /* @ECU_Address@KbDCSN_lcc_man_enbl@ */ Scalar_BOOLEAN 0 DCSN_subsystem_integrated_CM_boolean 0 1 /end CHARACTERISTIC
/begin CHARACTERISTIC KbDCSN_lcw_man_enbl "0 = manual LCW off
      1 = manual LCW on" VALUE 0x7010202e /* @ECU_Address@KbDCSN_lcw_man_enbl@ */ Scalar_BOOLEAN 0 DCSN_subsystem_integrated_CM_boolean 0 1 /end CHARACTERISTIC
/begin CHARACTERISTIC KbDCSN_lcw_usr_switch "LCW feature user switch" VALUE 0x7010202d /* @ECU_Address@KbDCSN_lcw_usr_switch@ */ Scalar_BOOLEAN 0 DCSN_subsystem_integrated_CM_boolean 0 1 /end CHARACTERISTIC
/begin CHARACTERISTIC KbDCSN_ldw_man_enbl "0 = manual LDW off
      1 = manual LDW on" VALUE 0x7010202c /* @ECU_Address@KbDCSN_ldw_man_enbl@ */ Scalar_BOOLEAN 0 DCSN_subsystem_integrated_CM_boolean 0 1 /end CHARACTERISTIC
/begin CHARACTERISTIC KbDCSN_ldw_usr_switch "LDW feature user switch" VALUE 0x7010202b /* @ECU_Address@KbDCSN_ldw_usr_switch@ */ Scalar_BOOLEAN 0 DCSN_subsystem_integrated_CM_boolean 0 1 /end CHARACTERISTIC
/begin CHARACTERISTIC KbDCSN_lka_man_enbl "0 = Close LKA
      1 = Open LKA" VALUE 0x7010202a /* @ECU_Address@KbDCSN_lka_man_enbl@ */ Scalar_BOOLEAN 0 DCSN_subsystem_integrated_CM_boolean 0 1 /end CHARACTERISTIC
/begin CHARACTERISTIC KbDCSN_lka_usr_switch "LKA feature user switch" VALUE 0x70102029 /* @ECU_Address@KbDCSN_lka_usr_switch@ */ Scalar_BOOLEAN 0 DCSN_subsystem_integrated_CM_boolean 0 1 /end CHARACTERISTIC
/begin CHARACTERISTIC KbDCSN_overspeed_warning_enable "0 = disable overspeed warning
      1 = enable overspeed warning" VALUE 0x70102028 /* @ECU_Address@KbDCSN_overspeed_warning_enable@ */ Scalar_BOOLEAN 0 DCSN_subsystem_integrated_CM_boolean 0 1 /end CHARACTERISTIC
/begin CHARACTERISTIC KbDCSN_passive_feature_man_ctrl "For all passive features (AEB, FCW, LDW, LCW):
      0 = manual override disabled
      1 = manual override enabled" VALUE 0x70102027 /* @ECU_Address@KbDCSN_passive_feature_man_ctrl@ */ Scalar_BOOLEAN 0 DCSN_subsystem_integrated_CM_boolean 0 1 /end CHARACTERISTIC
/begin CHARACTERISTIC KbDCSN_power_ctrl_man_enbl "0 = manual override disabled
      1 = manual override enabled" VALUE 0x70102026 /* @ECU_Address@KbDCSN_power_ctrl_man_enbl@ */ Scalar_BOOLEAN 0 DCSN_subsystem_integrated_CM_boolean 0 1 /end CHARACTERISTIC
/begin CHARACTERISTIC KbDCSN_power_ctrl_man_value "manual power control switch, valid only when KbDCSN_power_ctrl_man_enbl = true
      0 = power control off
      1 = power control on" VALUE 0x70102025 /* @ECU_Address@KbDCSN_power_ctrl_man_value@ */ Scalar_BOOLEAN 0 DCSN_subsystem_integrated_CM_boolean 0 1 /end CHARACTERISTIC
/begin CHARACTERISTIC KbDCSN_rcta_man_enbl "0 = Close RCTA
      1 = Open RCTA" VALUE 0x70102022 /* @ECU_Address@KbDCSN_rcta_man_enbl@ */ Scalar_BOOLEAN 0 DCSN_subsystem_integrated_CM_boolean 0 1 /end CHARACTERISTIC
/begin CHARACTERISTIC KbDCSN_rcta_usr_switch "RCTA feature user switch" VALUE 0x70102021 /* @ECU_Address@KbDCSN_rcta_usr_switch@ */ Scalar_BOOLEAN 0 DCSN_subsystem_integrated_CM_boolean 0 1 /end CHARACTERISTIC
/begin CHARACTERISTIC KbDCSN_speed_limit_enable "0 = disable speed limit output
      1 = enable speed limit output" VALUE 0x70102020 /* @ECU_Address@KbDCSN_speed_limit_enable@ */ Scalar_BOOLEAN 0 DCSN_subsystem_integrated_CM_boolean 0 1 /end CHARACTERISTIC
/begin CHARACTERISTIC KbDCSN_steer_ctrl_man_enbl "0 = manual override disabled
      1 = manual override enabled" VALUE 0x7010201f /* @ECU_Address@KbDCSN_steer_ctrl_man_enbl@ */ Scalar_BOOLEAN 0 DCSN_subsystem_integrated_CM_boolean 0 1 /end CHARACTERISTIC
/begin CHARACTERISTIC KbDCSN_steer_ctrl_man_value "manual steer control switch, valid only when KbDCSN_steer_ctrl_man_enbl = true
      0 = steer control off
      1 = steer control on" VALUE 0x7010201e /* @ECU_Address@KbDCSN_steer_ctrl_man_value@ */ Scalar_BOOLEAN 0 DCSN_subsystem_integrated_CM_boolean 0 1 /end CHARACTERISTIC
/begin CHARACTERISTIC KbDCSN_stop_request_enable "0 = disable stop request output
      1 = enable stop request output" VALUE 0x7010201c /* @ECU_Address@KbDCSN_stop_request_enable@ */ Scalar_BOOLEAN 0 DCSN_subsystem_integrated_CM_boolean 0 1 /end CHARACTERISTIC
/begin CHARACTERISTIC KbDCSN_takeover_warning_close "temporary used to close ARBT warning output" VALUE 0x7010201a /* @ECU_Address@KbDCSN_takeover_warning_close@ */ Scalar_BOOLEAN 0 DCSN_subsystem_integrated_CM_boolean 0 1 /end CHARACTERISTIC
/begin CHARACTERISTIC KbDCSN_use_EgmoLinearSpeed "0 = Use vehicle CAN velocity
      1 = Use egmo linear velocity" VALUE 0x70102018 /* @ECU_Address@KbDCSN_use_EgmoLinearSpeed@ */ Scalar_BOOLEAN 0 DCSN_subsystem_integrated_CM_boolean 0 1 /end CHARACTERISTIC
/begin CHARACTERISTIC KbDCSN_use_EgmoReadyFlag "0 = use calibration to output EGMO ready flag
      1 = use EGMO ready flag" VALUE 0x70102017 /* @ECU_Address@KbDCSN_use_EgmoReadyFlag@ */ Scalar_BOOLEAN 0 DCSN_subsystem_integrated_CM_boolean 0 1 /end CHARACTERISTIC
/begin CHARACTERISTIC KbDCSN_use_MpfuReadyFlag "0 = use calibration to output MPFU ready flag
      1 = use MPFU ready flag" VALUE 0x70102016 /* @ECU_Address@KbDCSN_use_MpfuReadyFlag@ */ Scalar_BOOLEAN 0 DCSN_subsystem_integrated_CM_boolean 0 1 /end CHARACTERISTIC
/begin CHARACTERISTIC KbDCSN_use_SLEW_override_logic "0 = disable override logic in SLEW
      1 = enable override logic in SLEW
      " VALUE 0x70102015 /* @ECU_Address@KbDCSN_use_SLEW_override_logic@ */ Scalar_BOOLEAN 0 DCSN_subsystem_integrated_CM_boolean 0 1 /end CHARACTERISTIC
/begin CHARACTERISTIC KbDCSN_use_SLEW_switch_control_mode "0 = Use normal control mode logic
      1 = Use driver switch as control mode activated" VALUE 0x70102014 /* @ECU_Address@KbDCSN_use_SLEW_switch_control_mode@ */ Scalar_BOOLEAN 0 DCSN_subsystem_integrated_CM_boolean 0 1 /end CHARACTERISTIC
/begin CHARACTERISTIC KbDCSN_use_faw_l4_logic "0 = use jac l3 logic
      1 = use faw l4 logic" VALUE 0x70102011 /* @ECU_Address@KbDCSN_use_faw_l4_logic@ */ Scalar_BOOLEAN 0 DCSN_subsystem_integrated_CM_boolean 0 1 /end CHARACTERISTIC
/begin CHARACTERISTIC KbDCSN_use_vehicle_activate_switch "0 = use calibration activate switch
      1 = use vehicle activate switch" VALUE 0x70102010 /* @ECU_Address@KbDCSN_use_vehicle_activate_switch@ */ Scalar_BOOLEAN 0 DCSN_subsystem_integrated_CM_boolean 0 1 /end CHARACTERISTIC
/begin AXIS_PTS KaAEBS_AXIS_Veh_Speed_vec "" 0x701017d4 /* @ECU_Address@KaAEBS_AXIS_Veh_Speed_vec@ */ VfAEBS_veh_speed_used Lookup1D_X_FLOAT32_IEEE 0 AEBS_subsystem_integrated_CM_single 9 -3.4E+38 3.4E+38 /end AXIS_PTS
/begin AXIS_PTS KaAEBS_AXIS_DeltaSpeed_Vip "" 0x70101878 /* @ECU_Address@KaAEBS_AXIS_DeltaSpeed_Vip@ */ NO_INPUT_QUANTITY Lookup1D_X_FLOAT32_IEEE 0 AEBS_subsystem_integrated_CM_single 13 -3.4E+38 3.4E+38 /end AXIS_PTS
/begin AXIS_PTS KaAEBS_AXIS_Veh_Curvature_vec "" 0x701017f8 /* @ECU_Address@KaAEBS_AXIS_Veh_Curvature_vec@ */ NO_INPUT_QUANTITY Lookup1D_X_FLOAT32_IEEE 0 AEBS_subsystem_integrated_CM_single 10 -3.4E+38 3.4E+38 /end AXIS_PTS
/begin AXIS_PTS KaAEBS_AXIS_NearestPointX_vec "" 0x7010184c /* @ECU_Address@KaAEBS_AXIS_NearestPointX_vec@ */ NO_INPUT_QUANTITY Lookup1D_X_FLOAT32_IEEE 0 AEBS_subsystem_integrated_CM_single 11 -3.4E+38 3.4E+38 /end AXIS_PTS
/begin AXIS_PTS KaAEBS_AXIS_NearestPointY_vec "" 0x70101820 /* @ECU_Address@KaAEBS_AXIS_NearestPointY_vec@ */ NO_INPUT_QUANTITY Lookup1D_X_FLOAT32_IEEE 0 AEBS_subsystem_integrated_CM_single 11 -3.4E+38 3.4E+38 /end AXIS_PTS
/begin MEASUREMENT VfAEBS_obs_v_long_vip "" FLOAT32_IEEE AEBS_subsystem_integrated_CM_single 0 0 -3.4E+38 3.4E+38 ECU_ADDRESS 0xb000271c /* @ECU_Address@VfAEBS_obs_v_long_vip@ */ /end MEASUREMENT
/begin MEASUREMENT VfAEBS_obs_acc_lateral_vip "" FLOAT32_IEEE AEBS_subsystem_integrated_CM_single 0 0 -3.4E+38 3.4E+38 ECU_ADDRESS 0xb0002718 /* @ECU_Address@VfAEBS_obs_acc_lateral_vip@ */ /end MEASUREMENT
/begin MEASUREMENT VfAEBS_obs_acc_long_vip "" FLOAT32_IEEE AEBS_subsystem_integrated_CM_single 0 0 -3.4E+38 3.4E+38 ECU_ADDRESS 0xb0002714 /* @ECU_Address@VfAEBS_obs_acc_long_vip@ */ /end MEASUREMENT
/begin MEASUREMENT VfAEBS_obs_NP_x_vip "" FLOAT32_IEEE AEBS_subsystem_integrated_CM_single 0 0 -3.4E+38 3.4E+38 ECU_ADDRESS 0xb0002710 /* @ECU_Address@VfAEBS_obs_NP_x_vip@ */ /end MEASUREMENT
/begin MEASUREMENT VfAEBS_obs_NP_y_vip "" FLOAT32_IEEE AEBS_subsystem_integrated_CM_single 0 0 -3.4E+38 3.4E+38 ECU_ADDRESS 0xb000270c /* @ECU_Address@VfAEBS_obs_NP_y_vip@ */ /end MEASUREMENT
/begin MEASUREMENT VfAEBS_obs_heading_VIP "" FLOAT32_IEEE AEBS_subsystem_integrated_CM_single 0 0 -3.4E+38 3.4E+38 ECU_ADDRESS 0xb0002708 /* @ECU_Address@VfAEBS_obs_heading_VIP@ */ /end MEASUREMENT
/begin MEASUREMENT VfAEBS_obs_length_VIP "" FLOAT32_IEEE AEBS_subsystem_integrated_CM_single 0 0 -3.4E+38 3.4E+38 ECU_ADDRESS 0xb0002704 /* @ECU_Address@VfAEBS_obs_length_VIP@ */ /end MEASUREMENT
/begin MEASUREMENT VfAEBS_obs_width_VIP "" FLOAT32_IEEE AEBS_subsystem_integrated_CM_single 0 0 -3.4E+38 3.4E+38 ECU_ADDRESS 0xb0002700 /* @ECU_Address@VfAEBS_obs_width_VIP@ */ /end MEASUREMENT
/begin MEASUREMENT VfAEBS_obs_dis_long_VIP "" FLOAT32_IEEE AEBS_subsystem_integrated_CM_single 0 0 -3.4E+38 3.4E+38 ECU_ADDRESS 0xb00026fc /* @ECU_Address@VfAEBS_obs_dis_long_VIP@ */ /end MEASUREMENT
/begin MEASUREMENT VfAEBS_obs_dis_lateral_VIP "" FLOAT32_IEEE AEBS_subsystem_integrated_CM_single 0 0 -3.4E+38 3.4E+38 ECU_ADDRESS 0xb00026f8 /* @ECU_Address@VfAEBS_obs_dis_lateral_VIP@ */ /end MEASUREMENT
/begin MEASUREMENT VfAEBS_obs_rp_vip "" FLOAT32_IEEE AEBS_subsystem_integrated_CM_single 0 0 -3.4E+38 3.4E+38 ECU_ADDRESS 0xb00026f4 /* @ECU_Address@VfAEBS_obs_rp_vip@ */ /end MEASUREMENT
/begin MEASUREMENT VfAEBS_obs_ttc_vip "" FLOAT32_IEEE AEBS_subsystem_integrated_CM_single 0 0 -3.4E+38 3.4E+38 ECU_ADDRESS 0xb00026f0 /* @ECU_Address@VfAEBS_obs_ttc_vip@ */ /end MEASUREMENT
/begin MEASUREMENT VfAEBS_obs_delta_dis_vip "" FLOAT32_IEEE AEBS_subsystem_integrated_CM_single 0 0 -3.4E+38 3.4E+38 ECU_ADDRESS 0xb00026ec /* @ECU_Address@VfAEBS_obs_delta_dis_vip@ */ /end MEASUREMENT
/begin MEASUREMENT VfAEBS_obs_delta_speed_vip "" FLOAT32_IEEE AEBS_subsystem_integrated_CM_single 0 0 -3.4E+38 3.4E+38 ECU_ADDRESS 0xb00026e8 /* @ECU_Address@VfAEBS_obs_delta_speed_vip@ */ /end MEASUREMENT
/begin MEASUREMENT VfAEBS_obs_v_lateral_vip "" FLOAT32_IEEE AEBS_subsystem_integrated_CM_single 0 0 -3.4E+38 3.4E+38 ECU_ADDRESS 0xb00026e4 /* @ECU_Address@VfAEBS_obs_v_lateral_vip@ */ /end MEASUREMENT
/begin MEASUREMENT VfAEBS_Pre_BrakeActiveTTCThreshold "" FLOAT32_IEEE AEBS_subsystem_integrated_CM_single 0 0 -3.4E+38 3.4E+38 ECU_ADDRESS 0xb00026e0 /* @ECU_Address@VfAEBS_Pre_BrakeActiveTTCThreshold@ */ /end MEASUREMENT
/begin MEASUREMENT VfAEBS_Partial_BrakeActiveTTCThreshold "" FLOAT32_IEEE AEBS_subsystem_integrated_CM_single 0 0 -3.4E+38 3.4E+38 ECU_ADDRESS 0xb00026dc /* @ECU_Address@VfAEBS_Partial_BrakeActiveTTCThreshold@ */ /end MEASUREMENT
/begin MEASUREMENT VfAEBS_v_obj_absolute_speed "" FLOAT32_IEEE AEBS_subsystem_integrated_CM_single 0 0 -3.4E+38 3.4E+38 ECU_ADDRESS 0xb00026d8 /* @ECU_Address@VfAEBS_v_obj_absolute_speed@ */ /end MEASUREMENT
/begin MEASUREMENT VfAEBS_a_obj_absolute_acc "" FLOAT32_IEEE AEBS_subsystem_integrated_CM_single 0 0 -3.4E+38 3.4E+38 ECU_ADDRESS 0xb00026d4 /* @ECU_Address@VfAEBS_a_obj_absolute_acc@ */ /end MEASUREMENT
/begin MEASUREMENT VfAEBS_areq_withoutDelay_UrgentBrk "" FLOAT32_IEEE AEBS_subsystem_integrated_CM_single 0 0 -3.4E+38 3.4E+38 ECU_ADDRESS 0xb00026d0 /* @ECU_Address@VfAEBS_areq_withoutDelay_UrgentBrk@ */ /end MEASUREMENT
/begin MEASUREMENT VfAEBS_areq_withoutDelay "" FLOAT32_IEEE AEBS_subsystem_integrated_CM_single 0 0 -3.4E+38 3.4E+38 ECU_ADDRESS 0xb00026cc /* @ECU_Address@VfAEBS_areq_withoutDelay@ */ /end MEASUREMENT
/begin MEASUREMENT VfAEBS_dis_delay "" FLOAT32_IEEE AEBS_subsystem_integrated_CM_single 0 0 -3.4E+38 3.4E+38 ECU_ADDRESS 0xb00026c8 /* @ECU_Address@VfAEBS_dis_delay@ */ /end MEASUREMENT
/begin MEASUREMENT VfAEBS_dis_safe_used "" FLOAT32_IEEE AEBS_subsystem_integrated_CM_single 0 0 -3.4E+38 3.4E+38 ECU_ADDRESS 0xb00026c4 /* @ECU_Address@VfAEBS_dis_safe_used@ */ /end MEASUREMENT
/begin MEASUREMENT VfAEBS_areq "" FLOAT32_IEEE AEBS_subsystem_integrated_CM_single 0 0 -3.4E+38 3.4E+38 ECU_ADDRESS 0xb00026c0 /* @ECU_Address@VfAEBS_areq@ */ /end MEASUREMENT
/begin MEASUREMENT VfAEBS_AEB_acceleration_af_filter "" FLOAT32_IEEE AEBS_subsystem_integrated_CM_single 0 0 -3.4E+38 3.4E+38 ECU_ADDRESS 0xb00026bc /* @ECU_Address@VfAEBS_AEB_acceleration_af_filter@ */ /end MEASUREMENT
/begin MEASUREMENT VfAEBS_AEB_acceleration_bf_limit "" FLOAT32_IEEE AEBS_subsystem_integrated_CM_single 0 0 -3.4E+38 3.4E+38 ECU_ADDRESS 0xb00026b8 /* @ECU_Address@VfAEBS_AEB_acceleration_bf_limit@ */ /end MEASUREMENT
/begin MEASUREMENT VfAEBS_AEB_accReq_beforeSend "" FLOAT32_IEEE AEBS_subsystem_integrated_CM_single 0 0 -3.4E+38 3.4E+38 ECU_ADDRESS 0xb00026b4 /* @ECU_Address@VfAEBS_AEB_accReq_beforeSend@ */ /end MEASUREMENT
/begin MEASUREMENT VfAEBS_obs_id_vip "" SLONG AEBS_subsystem_integrated_CM_int32 0 0 -2147483648 2147483647 ECU_ADDRESS 0xb0002680 /* @ECU_Address@VfAEBS_obs_id_vip@ */ /end MEASUREMENT
/begin MEASUREMENT VfAEBS_obs_position_zone_VIP "" SBYTE AEBS_subsystem_integrated_CM_int8 0 0 -128 127 ECU_ADDRESS 0xb0002665 /* @ECU_Address@VfAEBS_obs_position_zone_VIP@ */ /end MEASUREMENT
/begin MEASUREMENT VfAEBS_obs_motion_status_VIP "" SBYTE AEBS_subsystem_integrated_CM_int8 0 0 -128 127 ECU_ADDRESS 0xb0002664 /* @ECU_Address@VfAEBS_obs_motion_status_VIP@ */ /end MEASUREMENT
/begin MEASUREMENT VfAEBS_obs_type_vip "" SBYTE AEBS_subsystem_integrated_CM_int8 0 0 -128 127 ECU_ADDRESS 0xb0002663 /* @ECU_Address@VfAEBS_obs_type_vip@ */ /end MEASUREMENT
/begin MEASUREMENT VfAEBS_obs_index_vip "" UBYTE AEBS_subsystem_integrated_CM_uint8 0 0 0 255 ECU_ADDRESS 0xb000261e /* @ECU_Address@VfAEBS_obs_index_vip@ */ /end MEASUREMENT
/begin MEASUREMENT VfAEBS_obs_confidence_VIP "" UBYTE AEBS_subsystem_integrated_CM_uint8 0 0 0 255 ECU_ADDRESS 0xb000261d /* @ECU_Address@VfAEBS_obs_confidence_VIP@ */ /end MEASUREMENT
/begin MEASUREMENT VfAEBS_obs_position_state_vip "" UBYTE AEBS_subsystem_integrated_CM_uint8 0 0 0 255 ECU_ADDRESS 0xb000261c /* @ECU_Address@VfAEBS_obs_position_state_vip@ */ /end MEASUREMENT
/begin MEASUREMENT VfAEBS_FCW_enabled "" UBYTE AEBS_subsystem_integrated_CM_boolean 0 0 0 1 ECU_ADDRESS 0xb000260e /* @ECU_Address@VfAEBS_FCW_enabled@ */ /end MEASUREMENT
/begin MEASUREMENT VbAEBS_FCW_inhbt_AccPedPos "" UBYTE AEBS_subsystem_integrated_CM_boolean 0 0 0 1 ECU_ADDRESS 0xb000260d /* @ECU_Address@VbAEBS_FCW_inhbt_AccPedPos@ */ /end MEASUREMENT
/begin MEASUREMENT VbAEBS_FCW_inhbt_VehAcc "" UBYTE AEBS_subsystem_integrated_CM_boolean 0 0 0 1 ECU_ADDRESS 0xb000260c /* @ECU_Address@VbAEBS_FCW_inhbt_VehAcc@ */ /end MEASUREMENT
/begin MEASUREMENT VbAEBS_FCW_inhbt_DeactTime "" UBYTE AEBS_subsystem_integrated_CM_boolean 0 0 0 1 ECU_ADDRESS 0xb000260b /* @ECU_Address@VbAEBS_FCW_inhbt_DeactTime@ */ /end MEASUREMENT
/begin MEASUREMENT VbAEBS_FCW_inhibit "" UBYTE AEBS_subsystem_integrated_CM_boolean 0 0 0 1 ECU_ADDRESS 0xb000260a /* @ECU_Address@VbAEBS_FCW_inhibit@ */ /end MEASUREMENT
/begin MEASUREMENT VfAEBS_FCWLev1_active "" UBYTE AEBS_subsystem_integrated_CM_boolean 0 0 0 1 ECU_ADDRESS 0xb0002609 /* @ECU_Address@VfAEBS_FCWLev1_active@ */ /end MEASUREMENT
/begin MEASUREMENT VfAEBS_FCWLev1_dactive "" UBYTE AEBS_subsystem_integrated_CM_boolean 0 0 0 1 ECU_ADDRESS 0xb0002608 /* @ECU_Address@VfAEBS_FCWLev1_dactive@ */ /end MEASUREMENT
/begin MEASUREMENT VfAEBS_FCWLev2_active "" UBYTE AEBS_subsystem_integrated_CM_boolean 0 0 0 1 ECU_ADDRESS 0xb0002607 /* @ECU_Address@VfAEBS_FCWLev2_active@ */ /end MEASUREMENT
/begin MEASUREMENT VfAEBS_FCWLev2_dactive "" UBYTE AEBS_subsystem_integrated_CM_boolean 0 0 0 1 ECU_ADDRESS 0xb0002606 /* @ECU_Address@VfAEBS_FCWLev2_dactive@ */ /end MEASUREMENT
/begin MEASUREMENT VfAEBS_FCWLev3_active "" UBYTE AEBS_subsystem_integrated_CM_boolean 0 0 0 1 ECU_ADDRESS 0xb0002605 /* @ECU_Address@VfAEBS_FCWLev3_active@ */ /end MEASUREMENT
/begin MEASUREMENT VfAEBS_FCWLev3_dactive "" UBYTE AEBS_subsystem_integrated_CM_boolean 0 0 0 1 ECU_ADDRESS 0xb0002604 /* @ECU_Address@VfAEBS_FCWLev3_dactive@ */ /end MEASUREMENT
/begin MEASUREMENT VfAEBS_FCW_disabled "" UBYTE AEBS_subsystem_integrated_CM_boolean 0 0 0 1 ECU_ADDRESS 0xb0002603 /* @ECU_Address@VfAEBS_FCW_disabled@ */ /end MEASUREMENT
/begin MEASUREMENT VfAEBS_FCW_deacitve "" UBYTE AEBS_subsystem_integrated_CM_boolean 0 0 0 1 ECU_ADDRESS 0xb0002602 /* @ECU_Address@VfAEBS_FCW_deacitve@ */ /end MEASUREMENT
/begin MEASUREMENT VbAEBS_has_obs_vip "" UBYTE AEBS_subsystem_integrated_CM_boolean 0 0 0 1 ECU_ADDRESS 0xb0002601 /* @ECU_Address@VbAEBS_has_obs_vip@ */ /end MEASUREMENT
/begin MEASUREMENT VfAEBS_Obj_IsVRU "" UBYTE AEBS_subsystem_integrated_CM_boolean 0 0 0 1 ECU_ADDRESS 0xb0002600 /* @ECU_Address@VfAEBS_Obj_IsVRU@ */ /end MEASUREMENT
/begin MEASUREMENT VfAEBS_use_VRU_Calibration "" UBYTE AEBS_subsystem_integrated_CM_boolean 0 0 0 1 ECU_ADDRESS 0xb00025ff /* @ECU_Address@VfAEBS_use_VRU_Calibration@ */ /end MEASUREMENT
/begin MEASUREMENT VfAEBS_LowSpeed_InhibitAEB "" UBYTE AEBS_subsystem_integrated_CM_boolean 0 0 0 1 ECU_ADDRESS 0xb00025fe /* @ECU_Address@VfAEBS_LowSpeed_InhibitAEB@ */ /end MEASUREMENT
/begin MEASUREMENT VfAEBS_HighSpeed_InhibitAEB "" UBYTE AEBS_subsystem_integrated_CM_boolean 0 0 0 1 ECU_ADDRESS 0xb00025fd /* @ECU_Address@VfAEBS_HighSpeed_InhibitAEB@ */ /end MEASUREMENT
/begin MEASUREMENT VfAEBS_VehDeltaSpeed_InhibitAEB "" UBYTE AEBS_subsystem_integrated_CM_boolean 0 0 0 1 ECU_ADDRESS 0xb00025fc /* @ECU_Address@VfAEBS_VehDeltaSpeed_InhibitAEB@ */ /end MEASUREMENT
/begin MEASUREMENT VfAEBS_Speed_InhibitAEB "" UBYTE AEBS_subsystem_integrated_CM_boolean 0 0 0 1 ECU_ADDRESS 0xb00025fb /* @ECU_Address@VfAEBS_Speed_InhibitAEB@ */ /end MEASUREMENT
/begin MEASUREMENT VfAEBS_Gear_InhibitAEB "" UBYTE AEBS_subsystem_integrated_CM_boolean 0 0 0 1 ECU_ADDRESS 0xb00025fa /* @ECU_Address@VfAEBS_Gear_InhibitAEB@ */ /end MEASUREMENT
/begin MEASUREMENT VbAEBS_AEB_inhbt_DeactTime "" UBYTE AEBS_subsystem_integrated_CM_boolean 0 0 0 1 ECU_ADDRESS 0xb00025f9 /* @ECU_Address@VbAEBS_AEB_inhbt_DeactTime@ */ /end MEASUREMENT
/begin MEASUREMENT VbAEBS_AEB_inhbt_AccPdl "" UBYTE AEBS_subsystem_integrated_CM_boolean 0 0 0 1 ECU_ADDRESS 0xb00025f8 /* @ECU_Address@VbAEBS_AEB_inhbt_AccPdl@ */ /end MEASUREMENT
/begin MEASUREMENT VbAEBS_AEB_inhbt_StrAngRte "" UBYTE AEBS_subsystem_integrated_CM_boolean 0 0 0 1 ECU_ADDRESS 0xb00025f7 /* @ECU_Address@VbAEBS_AEB_inhbt_StrAngRte@ */ /end MEASUREMENT
/begin MEASUREMENT VbAEBS_AEB_inhbt_veh_acc "" UBYTE AEBS_subsystem_integrated_CM_boolean 0 0 0 1 ECU_ADDRESS 0xb00025f6 /* @ECU_Address@VbAEBS_AEB_inhbt_veh_acc@ */ /end MEASUREMENT
/begin MEASUREMENT VfAEBS_AEB_inhibit "" UBYTE AEBS_subsystem_integrated_CM_boolean 0 0 0 1 ECU_ADDRESS 0xb00025f5 /* @ECU_Address@VfAEBS_AEB_inhibit@ */ /end MEASUREMENT
/begin MEASUREMENT VbAEBS_PreBrk_inhbt_deactTime "" UBYTE AEBS_subsystem_integrated_CM_boolean 0 0 0 1 ECU_ADDRESS 0xb00025f4 /* @ECU_Address@VbAEBS_PreBrk_inhbt_deactTime@ */ /end MEASUREMENT
/begin MEASUREMENT VbAEBS_preBrake_inhibit "" UBYTE AEBS_subsystem_integrated_CM_boolean 0 0 0 1 ECU_ADDRESS 0xb00025f3 /* @ECU_Address@VbAEBS_preBrake_inhibit@ */ /end MEASUREMENT
/begin MEASUREMENT VfAEBS_preBrake_active "" UBYTE AEBS_subsystem_integrated_CM_boolean 0 0 0 1 ECU_ADDRESS 0xb00025f2 /* @ECU_Address@VfAEBS_preBrake_active@ */ /end MEASUREMENT
/begin MEASUREMENT VfAEBS_partialBrk_active "" UBYTE AEBS_subsystem_integrated_CM_boolean 0 0 0 1 ECU_ADDRESS 0xb00025f1 /* @ECU_Address@VfAEBS_partialBrk_active@ */ /end MEASUREMENT
/begin MEASUREMENT VfAEBS_fullBrk_active "" UBYTE AEBS_subsystem_integrated_CM_boolean 0 0 0 1 ECU_ADDRESS 0xb00025f0 /* @ECU_Address@VfAEBS_fullBrk_active@ */ /end MEASUREMENT
/begin MEASUREMENT VbAEBS_Deactive_R_NoVIP "" UBYTE AEBS_subsystem_integrated_CM_boolean 0 0 0 1 ECU_ADDRESS 0xb00025ef /* @ECU_Address@VbAEBS_Deactive_R_NoVIP@ */ /end MEASUREMENT
/begin MEASUREMENT VbAEBS_vipCloseLost "" UBYTE AEBS_subsystem_integrated_CM_boolean 0 0 0 1 ECU_ADDRESS 0xb00025ee /* @ECU_Address@VbAEBS_vipCloseLost@ */ /end MEASUREMENT
/begin MEASUREMENT VbAEBS_Deactive_R_VIPChanged "" UBYTE AEBS_subsystem_integrated_CM_boolean 0 0 0 1 ECU_ADDRESS 0xb00025ed /* @ECU_Address@VbAEBS_Deactive_R_VIPChanged@ */ /end MEASUREMENT
/begin MEASUREMENT VfAEBS_DeniedDueToSpdRed "" UBYTE AEBS_subsystem_integrated_CM_boolean 0 0 0 1 ECU_ADDRESS 0xb00025ec /* @ECU_Address@VfAEBS_DeniedDueToSpdRed@ */ /end MEASUREMENT
/begin MEASUREMENT VfAEBS_DeniedDueToTimeBrake "" UBYTE AEBS_subsystem_integrated_CM_boolean 0 0 0 1 ECU_ADDRESS 0xb00025eb /* @ECU_Address@VfAEBS_DeniedDueToTimeBrake@ */ /end MEASUREMENT
/begin MEASUREMENT VbAEBS_Deactive_R_Confdnc "" UBYTE AEBS_subsystem_integrated_CM_boolean 0 0 0 1 ECU_ADDRESS 0xb00025ea /* @ECU_Address@VbAEBS_Deactive_R_Confdnc@ */ /end MEASUREMENT
/begin MEASUREMENT VbAEBS_deactive_preBrk_timeOut "" UBYTE AEBS_subsystem_integrated_CM_boolean 0 0 0 1 ECU_ADDRESS 0xb00025e9 /* @ECU_Address@VbAEBS_deactive_preBrk_timeOut@ */ /end MEASUREMENT
/begin MEASUREMENT VfAEBS_AEB_enabled "" UBYTE AEBS_subsystem_integrated_CM_boolean 0 0 0 1 ECU_ADDRESS 0xb00025e8 /* @ECU_Address@VfAEBS_AEB_enabled@ */ /end MEASUREMENT
/begin MEASUREMENT VfAEBS_preBrake_dactive "" UBYTE AEBS_subsystem_integrated_CM_boolean 0 0 0 1 ECU_ADDRESS 0xb00025e7 /* @ECU_Address@VfAEBS_preBrake_dactive@ */ /end MEASUREMENT
/begin MEASUREMENT VfAEBS_partialBrk_dactive "" UBYTE AEBS_subsystem_integrated_CM_boolean 0 0 0 1 ECU_ADDRESS 0xb00025e6 /* @ECU_Address@VfAEBS_partialBrk_dactive@ */ /end MEASUREMENT
/begin MEASUREMENT VfAEBS_fullBrk_dactive "" UBYTE AEBS_subsystem_integrated_CM_boolean 0 0 0 1 ECU_ADDRESS 0xb00025e5 /* @ECU_Address@VfAEBS_fullBrk_dactive@ */ /end MEASUREMENT
/begin MEASUREMENT VfAEBS_AEB_disabled "" UBYTE AEBS_subsystem_integrated_CM_boolean 0 0 0 1 ECU_ADDRESS 0xb00025e4 /* @ECU_Address@VfAEBS_AEB_disabled@ */ /end MEASUREMENT
/begin MEASUREMENT VfAEBS_veh_standstill "" UBYTE AEBS_subsystem_integrated_CM_boolean 0 0 0 1 ECU_ADDRESS 0xb00025e3 /* @ECU_Address@VfAEBS_veh_standstill@ */ /end MEASUREMENT
/begin MEASUREMENT VfAEBS_Vehicle_isInHighSpeed "" UBYTE AEBS_subsystem_integrated_CM_boolean 0 0 0 1 ECU_ADDRESS 0xb00025e2 /* @ECU_Address@VfAEBS_Vehicle_isInHighSpeed@ */ /end MEASUREMENT
/begin MEASUREMENT VfAEBS_AEB_deactive "" UBYTE AEBS_subsystem_integrated_CM_boolean 0 0 0 1 ECU_ADDRESS 0xb00025e1 /* @ECU_Address@VfAEBS_AEB_deactive@ */ /end MEASUREMENT
/begin MEASUREMENT VbAEBS_Deactive_R_HighTTC "" UBYTE AEBS_subsystem_integrated_CM_boolean 0 0 0 1 ECU_ADDRESS 0xb00025e0 /* @ECU_Address@VbAEBS_Deactive_R_HighTTC@ */ /end MEASUREMENT
/begin MEASUREMENT VeAEBS_TurnType "" UBYTE AEBS_subsystem_integrated_CM_EnumAEBS_TurnType 0 0 1 4 ECU_ADDRESS 0xb00025d4 /* @ECU_Address@VeAEBS_TurnType@ */ /end MEASUREMENT
/begin MEASUREMENT VfARBT_steer_req_strwhl_angle "final steer angle req (as deg) after arbitration and saturation" FLOAT32_IEEE ARBT_subsystem_integrated_CM_single_deg 0 0 -3.4E+38 3.4E+38 ECU_ADDRESS 0xb0002cf4 /* @ECU_Address@VfARBT_steer_req_strwhl_angle@ */ /end MEASUREMENT
/begin MEASUREMENT VfARBT_steer_req_strwhl_angle_raw "raw steer angle request after arbitration before saturation" FLOAT32_IEEE ARBT_subsystem_integrated_CM_single_deg 0 0 -3.4E+38 3.4E+38 ECU_ADDRESS 0xb0002cf0 /* @ECU_Address@VfARBT_steer_req_strwhl_angle_raw@ */ /end MEASUREMENT
/begin MEASUREMENT VfARBT_steer_req_strwhl_torque "" FLOAT32_IEEE ARBT_subsystem_integrated_CM_single_Nm 0 0 -3.4E+38 3.4E+38 ECU_ADDRESS 0xb0002cec /* @ECU_Address@VfARBT_steer_req_strwhl_torque@ */ /end MEASUREMENT
/begin MEASUREMENT VfARBT_power_req_lon_a_raw "raw power request after arbitration before saturation" FLOAT32_IEEE ARBT_subsystem_integrated_CM_single_m_s2 0 0 -3.4E+38 3.4E+38 ECU_ADDRESS 0xb0002ce8 /* @ECU_Address@VfARBT_power_req_lon_a_raw@ */ /end MEASUREMENT
/begin MEASUREMENT VfARBT_power_req_lon_a "final power req (as m/s2) after arbitration and saturation" FLOAT32_IEEE ARBT_subsystem_integrated_CM_single_m_s2 0 0 -3.4E+38 3.4E+38 ECU_ADDRESS 0xb0002ce4 /* @ECU_Address@VfARBT_power_req_lon_a@ */ /end MEASUREMENT
/begin MEASUREMENT VfARBT_power_req_torque "" FLOAT32_IEEE ARBT_subsystem_integrated_CM_single 0 0 -3.4E+38 3.4E+38 ECU_ADDRESS 0xb0002ce0 /* @ECU_Address@VfARBT_power_req_torque@ */ /end MEASUREMENT
/begin MEASUREMENT VfARBT_brake_req_lon_a_raw "raw brake request after arbitration before saturation" FLOAT32_IEEE ARBT_subsystem_integrated_CM_single_m_s2 0 0 -3.4E+38 3.4E+38 ECU_ADDRESS 0xb0002cdc /* @ECU_Address@VfARBT_brake_req_lon_a_raw@ */ /end MEASUREMENT
/begin MEASUREMENT VfARBT_brake_req_lon_a "final brake req (as m/s2) after arbitration and saturation" FLOAT32_IEEE ARBT_subsystem_integrated_CM_single_m_s2 0 0 -3.4E+38 3.4E+38 ECU_ADDRESS 0xb0002cd8 /* @ECU_Address@VfARBT_brake_req_lon_a@ */ /end MEASUREMENT
/begin MEASUREMENT VfARBT_steer_req_mode "0 = acceleration mode
      1 = torque mode" UBYTE ARBT_subsystem_integrated_CM_uint8 0 0 0 255 ECU_ADDRESS 0xb0002cd4 /* @ECU_Address@VfARBT_steer_req_mode@ */ /end MEASUREMENT
/begin MEASUREMENT VfARBT_power_req_mode "0 = steering wheel angle
      1 = steering wheel torque" UBYTE ARBT_subsystem_integrated_CM_uint8 0 0 0 255 ECU_ADDRESS 0xb0002cd3 /* @ECU_Address@VfARBT_power_req_mode@ */ /end MEASUREMENT
/begin MEASUREMENT VfARBT_gear_pos_req "Gear Pos Definition
      0->N
      1->D
      13->R
      14->P
      15->Invalid" UBYTE ARBT_subsystem_integrated_CM_uint8 0 0 0 255 ECU_ADDRESS 0xb0002cd2 /* @ECU_Address@VfARBT_gear_pos_req@ */ /end MEASUREMENT
/begin MEASUREMENT VfARBT_gear_ctrl_state "" UBYTE ARBT_subsystem_integrated_CM_uint8 0 0 0 255 ECU_ADDRESS 0xb0002cd1 /* @ECU_Address@VfARBT_gear_ctrl_state@ */ /end MEASUREMENT
/begin MEASUREMENT VbARBT_EPB_ctrl_mode "" UBYTE ARBT_subsystem_integrated_CM_uint8 0 0 0 255 ECU_ADDRESS 0xb0002cd0 /* @ECU_Address@VbARBT_EPB_ctrl_mode@ */ /end MEASUREMENT
/begin MEASUREMENT VbARBT_FCW_level_three "" UBYTE ARBT_subsystem_integrated_CM_boolean 0 0 0 1 ECU_ADDRESS 0xb0002ccf /* @ECU_Address@VbARBT_FCW_level_three@ */ /end MEASUREMENT
/begin MEASUREMENT VbARBT_FCW_level_one "" UBYTE ARBT_subsystem_integrated_CM_boolean 0 0 0 1 ECU_ADDRESS 0xb0002cce /* @ECU_Address@VbARBT_FCW_level_one@ */ /end MEASUREMENT
/begin MEASUREMENT VbARBT_FCW_level_two "" UBYTE ARBT_subsystem_integrated_CM_boolean 0 0 0 1 ECU_ADDRESS 0xb0002ccd /* @ECU_Address@VbARBT_FCW_level_two@ */ /end MEASUREMENT
/begin MEASUREMENT VbARBT_LDW_left "" UBYTE ARBT_subsystem_integrated_CM_boolean 0 0 0 1 ECU_ADDRESS 0xb0002ccc /* @ECU_Address@VbARBT_LDW_left@ */ /end MEASUREMENT
/begin MEASUREMENT VbARBT_BSD_left_low_raw "" UBYTE ARBT_subsystem_integrated_CM_boolean 0 0 0 1 ECU_ADDRESS 0xb0002ccb /* @ECU_Address@VbARBT_BSD_left_low_raw@ */ /end MEASUREMENT
/begin MEASUREMENT VbARBT_BSD_right_low_raw "" UBYTE ARBT_subsystem_integrated_CM_boolean 0 0 0 1 ECU_ADDRESS 0xb0002cca /* @ECU_Address@VbARBT_BSD_right_low_raw@ */ /end MEASUREMENT
/begin MEASUREMENT VbARBT_LCA_left_low_raw "" UBYTE ARBT_subsystem_integrated_CM_boolean 0 0 0 1 ECU_ADDRESS 0xb0002cc9 /* @ECU_Address@VbARBT_LCA_left_low_raw@ */ /end MEASUREMENT
/begin MEASUREMENT VbARBT_LCA_right_low_raw "" UBYTE ARBT_subsystem_integrated_CM_boolean 0 0 0 1 ECU_ADDRESS 0xb0002cc8 /* @ECU_Address@VbARBT_LCA_right_low_raw@ */ /end MEASUREMENT
/begin MEASUREMENT VbARBT_warn_lcw_left_req "" UBYTE ARBT_subsystem_integrated_CM_boolean 0 0 0 1 ECU_ADDRESS 0xb0002cc7 /* @ECU_Address@VbARBT_warn_lcw_left_req@ */ /end MEASUREMENT
/begin MEASUREMENT VbARBT_LDW_right "" UBYTE ARBT_subsystem_integrated_CM_boolean 0 0 0 1 ECU_ADDRESS 0xb0002cc6 /* @ECU_Address@VbARBT_LDW_right@ */ /end MEASUREMENT
/begin MEASUREMENT VbARBT_BSD_left_high_raw "" UBYTE ARBT_subsystem_integrated_CM_boolean 0 0 0 1 ECU_ADDRESS 0xb0002cc5 /* @ECU_Address@VbARBT_BSD_left_high_raw@ */ /end MEASUREMENT
/begin MEASUREMENT VbARBT_LCA_left_high_raw "" UBYTE ARBT_subsystem_integrated_CM_boolean 0 0 0 1 ECU_ADDRESS 0xb0002cc4 /* @ECU_Address@VbARBT_LCA_left_high_raw@ */ /end MEASUREMENT
/begin MEASUREMENT VbARBT_BSD_right_high_raw "" UBYTE ARBT_subsystem_integrated_CM_boolean 0 0 0 1 ECU_ADDRESS 0xb0002cc3 /* @ECU_Address@VbARBT_BSD_right_high_raw@ */ /end MEASUREMENT
/begin MEASUREMENT VbARBT_LCA_right_high_raw "" UBYTE ARBT_subsystem_integrated_CM_boolean 0 0 0 1 ECU_ADDRESS 0xb0002cc2 /* @ECU_Address@VbARBT_LCA_right_high_raw@ */ /end MEASUREMENT
/begin MEASUREMENT VbARBT_FCW_level_four "" UBYTE ARBT_subsystem_integrated_CM_boolean 0 0 0 1 ECU_ADDRESS 0xb0002cc1 /* @ECU_Address@VbARBT_FCW_level_four@ */ /end MEASUREMENT
/begin MEASUREMENT VbARBT_FCW_level_five "" UBYTE ARBT_subsystem_integrated_CM_boolean 0 0 0 1 ECU_ADDRESS 0xb0002cc0 /* @ECU_Address@VbARBT_FCW_level_five@ */ /end MEASUREMENT
/begin MEASUREMENT VbARBT_warn_lcw_right_req "" UBYTE ARBT_subsystem_integrated_CM_boolean 0 0 0 1 ECU_ADDRESS 0xb0002cbf /* @ECU_Address@VbARBT_warn_lcw_right_req@ */ /end MEASUREMENT
/begin MEASUREMENT VbARBT_steer_ctrl_enbl_to_comm "" UBYTE ARBT_subsystem_integrated_CM_boolean 0 0 0 1 ECU_ADDRESS 0xb0002cbe /* @ECU_Address@VbARBT_steer_ctrl_enbl_to_comm@ */ /end MEASUREMENT
/begin MEASUREMENT VbARBT_aeb_triggered_flag "Flag of whether AEB is triggered" UBYTE ARBT_subsystem_integrated_CM_boolean 0 0 0 1 ECU_ADDRESS 0xb0002cbd /* @ECU_Address@VbARBT_aeb_triggered_flag@ */ /end MEASUREMENT
/begin MEASUREMENT VbARBT_missed_aeb_flag "Flag of whether a missed aeb event is detected" UBYTE ARBT_subsystem_integrated_CM_boolean 0 0 0 1 ECU_ADDRESS 0xb0002cbc /* @ECU_Address@VbARBT_missed_aeb_flag@ */ /end MEASUREMENT
/begin MEASUREMENT VbARBT_false_aeb_flag "Flag of whether a false AEB event is detected
      " UBYTE ARBT_subsystem_integrated_CM_boolean 0 0 0 1 ECU_ADDRESS 0xb0002cbb /* @ECU_Address@VbARBT_false_aeb_flag@ */ /end MEASUREMENT
/begin MEASUREMENT VbARBT_driver_hard_brake_flag "Flag of whether driver is taking a hard brake" UBYTE ARBT_subsystem_integrated_CM_boolean 0 0 0 1 ECU_ADDRESS 0xb0002cba /* @ECU_Address@VbARBT_driver_hard_brake_flag@ */ /end MEASUREMENT
/begin MEASUREMENT VbARBT_power_ctrl_enbl_to_comm "" UBYTE ARBT_subsystem_integrated_CM_boolean 0 0 0 1 ECU_ADDRESS 0xb0002cb9 /* @ECU_Address@VbARBT_power_ctrl_enbl_to_comm@ */ /end MEASUREMENT
/begin MEASUREMENT VbARBT_brake_ctrl_enbl_to_comm "" UBYTE ARBT_subsystem_integrated_CM_boolean 0 0 0 1 ECU_ADDRESS 0xb0002cb8 /* @ECU_Address@VbARBT_brake_ctrl_enbl_to_comm@ */ /end MEASUREMENT
/begin MEASUREMENT VbARBT_EPB_ctrl_enbl_to_comm "" UBYTE ARBT_subsystem_integrated_CM_boolean 0 0 0 1 ECU_ADDRESS 0xb0002cb7 /* @ECU_Address@VbARBT_EPB_ctrl_enbl_to_comm@ */ /end MEASUREMENT
/begin MEASUREMENT VbARBT_vehicle_standstill "" UBYTE ARBT_subsystem_integrated_CM_boolean 0 0 0 1 ECU_ADDRESS 0xb0002cb6 /* @ECU_Address@VbARBT_vehicle_standstill@ */ /end MEASUREMENT
/begin MEASUREMENT VbARBT_EPB_switch_request "1 = clamping request
      0 = release request" UBYTE ARBT_subsystem_integrated_CM_boolean 0 0 0 1 ECU_ADDRESS 0xb0002cb5 /* @ECU_Address@VbARBT_EPB_switch_request@ */ /end MEASUREMENT
/begin MEASUREMENT VbARBT_gear_ctrl_enbl_to_comm "" UBYTE ARBT_subsystem_integrated_CM_boolean 0 0 0 1 ECU_ADDRESS 0xb0002cb4 /* @ECU_Address@VbARBT_gear_ctrl_enbl_to_comm@ */ /end MEASUREMENT
/begin MEASUREMENT VbARBT_auto_hold_req "" UBYTE ARBT_subsystem_integrated_CM_boolean 0 0 0 1 ECU_ADDRESS 0xb0002cb3 /* @ECU_Address@VbARBT_auto_hold_req@ */ /end MEASUREMENT
/begin MEASUREMENT VeARBT_steer_arbt_winner "" UBYTE ARBT_subsystem_integrated_CM_EnumARBT_arbitration_winner 0 0 0 6 ECU_ADDRESS 0xb0002cb2 /* @ECU_Address@VeARBT_steer_arbt_winner@ */ /end MEASUREMENT
/begin MEASUREMENT VeARBT_power_arbt_winner "" UBYTE ARBT_subsystem_integrated_CM_EnumARBT_arbitration_winner 0 0 0 6 ECU_ADDRESS 0xb0002cb1 /* @ECU_Address@VeARBT_power_arbt_winner@ */ /end MEASUREMENT
/begin MEASUREMENT VeARBT_brake_arbt_winner "" UBYTE ARBT_subsystem_integrated_CM_EnumARBT_arbitration_winner 0 0 0 6 ECU_ADDRESS 0xb0002cb0 /* @ECU_Address@VeARBT_brake_arbt_winner@ */ /end MEASUREMENT
/begin MEASUREMENT VbHWIO_DriverModeComd "" UBYTE COMM_subsystem_integrated_CM_boolean 0 0 0 1 ECU_ADDRESS 0xb0004136 /* @ECU_Address@VbHWIO_DriverModeComd@ */ /end MEASUREMENT
/begin MEASUREMENT VbHWIO_LeftTurningLightState "" UBYTE COMM_subsystem_integrated_CM_boolean 0 0 0 1 ECU_ADDRESS 0xb0004135 /* @ECU_Address@VbHWIO_LeftTurningLightState@ */ /end MEASUREMENT
/begin MEASUREMENT VbHWIO_RightTurningLightState "" UBYTE COMM_subsystem_integrated_CM_boolean 0 0 0 1 ECU_ADDRESS 0xb0004134 /* @ECU_Address@VbHWIO_RightTurningLightState@ */ /end MEASUREMENT
/begin MEASUREMENT VfCOMM_Decs_Breake_Value "" FLOAT32_IEEE COMM_subsystem_integrated_CM_single 0 0 -3.4E+38 3.4E+38 ECU_ADDRESS 0xb0003e74 /* @ECU_Address@VfCOMM_Decs_Breake_Value@ */ /end MEASUREMENT
/begin MEASUREMENT VfCOMM_Decs_Acc_Value "" FLOAT32_IEEE COMM_subsystem_integrated_CM_single 0 0 -3.4E+38 3.4E+38 ECU_ADDRESS 0xb0003e70 /* @ECU_Address@VfCOMM_Decs_Acc_Value@ */ /end MEASUREMENT
/begin MEASUREMENT VfCOMM_Decs_SteeringAngle "" FLOAT32_IEEE COMM_subsystem_integrated_CM_single 0 0 -3.4E+38 3.4E+38 ECU_ADDRESS 0xb0003e6c /* @ECU_Address@VfCOMM_Decs_SteeringAngle@ */ /end MEASUREMENT
/begin MEASUREMENT VcCOMM_EPB_control_enable "EPB control enable flag." FLOAT32_IEEE COMM_subsystem_integrated_CM_single 0 0 -3.4E+38 3.4E+38 ECU_ADDRESS 0xb0003e68 /* @ECU_Address@VcCOMM_EPB_control_enable@ */ /end MEASUREMENT
/begin MEASUREMENT VcCOMM_EPB_switch_request "EPB Switch request. 0 = Release, 1 = Clamp." FLOAT32_IEEE COMM_subsystem_integrated_CM_single 0 0 -3.4E+38 3.4E+38 ECU_ADDRESS 0xb0003e64 /* @ECU_Address@VcCOMM_EPB_switch_request@ */ /end MEASUREMENT
/begin MEASUREMENT VfCOMM_req_pct_torque_raw "Power requested torque in percentage." FLOAT32_IEEE COMM_subsystem_integrated_CM_single 0 0 -3.4E+38 3.4E+38 ECU_ADDRESS 0xb0003e60 /* @ECU_Address@VfCOMM_req_pct_torque_raw@ */ /end MEASUREMENT
/begin MEASUREMENT VcCOMM_max_gas_pedal_EPB "" FLOAT32_IEEE COMM_subsystem_integrated_CM_single 0 0 -3.4E+38 3.4E+38 ECU_ADDRESS 0xb0003e5c /* @ECU_Address@VcCOMM_max_gas_pedal_EPB@ */ /end MEASUREMENT
/begin MEASUREMENT VfCOMM_EPS_SteeringTorqueAct "" FLOAT32_IEEE COMM_subsystem_integrated_CM_single 0 0 -3.4E+38 3.4E+38 ECU_ADDRESS 0xb0003e58 /* @ECU_Address@VfCOMM_EPS_SteeringTorqueAct@ */ /end MEASUREMENT
/begin MEASUREMENT VfCOMM_VCU_LongitudinalAcc "" FLOAT32_IEEE COMM_subsystem_integrated_CM_single 0 0 -3.4E+38 3.4E+38 ECU_ADDRESS 0xb0003e54 /* @ECU_Address@VfCOMM_VCU_LongitudinalAcc@ */ /end MEASUREMENT
/begin MEASUREMENT VfCOMM_VCU_BrkPedPos "Brake pedal position." FLOAT32_IEEE COMM_subsystem_integrated_CM_single 0 0 -3.4E+38 3.4E+38 ECU_ADDRESS 0xb0003e50 /* @ECU_Address@VfCOMM_VCU_BrkPedPos@ */ /end MEASUREMENT
/begin MEASUREMENT VfCOMM_VCU_YawRate "Yaw Rate." FLOAT32_IEEE COMM_subsystem_integrated_CM_single 0 0 -3.4E+38 3.4E+38 ECU_ADDRESS 0xb0003e4c /* @ECU_Address@VfCOMM_VCU_YawRate@ */ /end MEASUREMENT
/begin MEASUREMENT VfCOMM_VCU_LateralAcc "Lateral acceleration (m/s~2)." FLOAT32_IEEE COMM_subsystem_integrated_CM_single 0 0 -3.4E+38 3.4E+38 ECU_ADDRESS 0xb0003e48 /* @ECU_Address@VfCOMM_VCU_LateralAcc@ */ /end MEASUREMENT
/begin MEASUREMENT VfCOMM_VCU_ESCWhlRRSpd "Rear right wheel speed (kph)." FLOAT32_IEEE COMM_subsystem_integrated_CM_single 0 0 -3.4E+38 3.4E+38 ECU_ADDRESS 0xb0003e44 /* @ECU_Address@VfCOMM_VCU_ESCWhlRRSpd@ */ /end MEASUREMENT
/begin MEASUREMENT VfCOMM_VCU_ESCWhlRLSpd "Rear left wheel speed (kph)." FLOAT32_IEEE COMM_subsystem_integrated_CM_single 0 0 -3.4E+38 3.4E+38 ECU_ADDRESS 0xb0003e40 /* @ECU_Address@VfCOMM_VCU_ESCWhlRLSpd@ */ /end MEASUREMENT
/begin MEASUREMENT VfCOMM_VCU_ESCWhlFRSpd "Front right wheel speed (kph)." FLOAT32_IEEE COMM_subsystem_integrated_CM_single 0 0 -3.4E+38 3.4E+38 ECU_ADDRESS 0xb0003e3c /* @ECU_Address@VfCOMM_VCU_ESCWhlFRSpd@ */ /end MEASUREMENT
/begin MEASUREMENT VfCOMM_VCU_ESCWhlFLSpd "Front left wheel speed (kph)." FLOAT32_IEEE COMM_subsystem_integrated_CM_single 0 0 -3.4E+38 3.4E+38 ECU_ADDRESS 0xb0003e38 /* @ECU_Address@VfCOMM_VCU_ESCWhlFLSpd@ */ /end MEASUREMENT
/begin MEASUREMENT VfCOMM_Actual_Gear_Ratio "" FLOAT32_IEEE COMM_subsystem_integrated_CM_single 0 0 -3.4E+38 3.4E+38 ECU_ADDRESS 0xb0003e34 /* @ECU_Address@VfCOMM_Actual_Gear_Ratio@ */ /end MEASUREMENT
/begin MEASUREMENT VfCOMM_Decs_FedBck_StrAngle "" FLOAT32_IEEE COMM_subsystem_integrated_CM_single 0 0 -3.4E+38 3.4E+38 ECU_ADDRESS 0xb0003e30 /* @ECU_Address@VfCOMM_Decs_FedBck_StrAngle@ */ /end MEASUREMENT
/begin MEASUREMENT VfCOMM_Decs_FedBck_VehSpd "" FLOAT32_IEEE COMM_subsystem_integrated_CM_single 0 0 -3.4E+38 3.4E+38 ECU_ADDRESS 0xb0003e2c /* @ECU_Address@VfCOMM_Decs_FedBck_VehSpd@ */ /end MEASUREMENT
/begin MEASUREMENT VfCOMM_AccPedl "" FLOAT32_IEEE COMM_subsystem_integrated_CM_single 0 0 -3.4E+38 3.4E+38 ECU_ADDRESS 0xb0003e28 /* @ECU_Address@VfCOMM_AccPedl@ */ /end MEASUREMENT
/begin MEASUREMENT VfCOMM_req_pct_torque_final "" SWORD COMM_subsystem_integrated_CM_int16 0 0 -32768 32767 ECU_ADDRESS 0xb0003e26 /* @ECU_Address@VfCOMM_req_pct_torque_final@ */ /end MEASUREMENT
/begin MEASUREMENT VcCOMM_Auto_To_Manual_Tips "" UWORD COMM_subsystem_integrated_CM_uint16 0 0 0 65535 ECU_ADDRESS 0xb0003e24 /* @ECU_Address@VcCOMM_Auto_To_Manual_Tips@ */ /end MEASUREMENT
/begin MEASUREMENT VcCOMM_Decs_Control_mod "" UBYTE COMM_subsystem_integrated_CM_uint8 0 0 0 255 ECU_ADDRESS 0xb0003e22 /* @ECU_Address@VcCOMM_Decs_Control_mod@ */ /end MEASUREMENT
/begin MEASUREMENT VcCOMM_Decs_Gear_Value "" UBYTE COMM_subsystem_integrated_CM_uint8 0 0 0 255 ECU_ADDRESS 0xb0003e21 /* @ECU_Address@VcCOMM_Decs_Gear_Value@ */ /end MEASUREMENT
/begin MEASUREMENT VcCOMM_Decs_Gear_Req "" UBYTE COMM_subsystem_integrated_CM_uint8 0 0 0 255 ECU_ADDRESS 0xb0003e20 /* @ECU_Address@VcCOMM_Decs_Gear_Req@ */ /end MEASUREMENT
/begin MEASUREMENT VcCOMM_Decs_Breake_Req "" UBYTE COMM_subsystem_integrated_CM_uint8 0 0 0 255 ECU_ADDRESS 0xb0003e1f /* @ECU_Address@VcCOMM_Decs_Breake_Req@ */ /end MEASUREMENT
/begin MEASUREMENT VcCOMM_Decs_Acc_Req "" UBYTE COMM_subsystem_integrated_CM_uint8 0 0 0 255 ECU_ADDRESS 0xb0003e1e /* @ECU_Address@VcCOMM_Decs_Acc_Req@ */ /end MEASUREMENT
/begin MEASUREMENT VcCOMM_Decs_Steering_Req "" UBYTE COMM_subsystem_integrated_CM_uint8 0 0 0 255 ECU_ADDRESS 0xb0003e1d /* @ECU_Address@VcCOMM_Decs_Steering_Req@ */ /end MEASUREMENT
/begin MEASUREMENT VcCOMM_Decs_FedBck_EPBstate "" UBYTE COMM_subsystem_integrated_CM_uint8 0 0 0 255 ECU_ADDRESS 0xb0003e1c /* @ECU_Address@VcCOMM_Decs_FedBck_EPBstate@ */ /end MEASUREMENT
/begin MEASUREMENT VcCOMM_DriverModeComd "" UBYTE COMM_subsystem_integrated_CM_uint8 0 0 0 255 ECU_ADDRESS 0xb0003e1b /* @ECU_Address@VcCOMM_DriverModeComd@ */ /end MEASUREMENT
/begin MEASUREMENT VcCOMM_Decs_FedBck_KeyState "Ignition Key State." UBYTE COMM_subsystem_integrated_CM_uint8 0 0 0 255 ECU_ADDRESS 0xb0003e1a /* @ECU_Address@VcCOMM_Decs_FedBck_KeyState@ */ /end MEASUREMENT
/begin MEASUREMENT VcCOMM_VCU_DirIndicationLH "Left turning lamp status." UBYTE COMM_subsystem_integrated_CM_uint8 0 0 0 255 ECU_ADDRESS 0xb0003e19 /* @ECU_Address@VcCOMM_VCU_DirIndicationLH@ */ /end MEASUREMENT
/begin MEASUREMENT VcCOMM_VCU_DirIndicationRH "Right turning lamp status." UBYTE COMM_subsystem_integrated_CM_uint8 0 0 0 255 ECU_ADDRESS 0xb0003e18 /* @ECU_Address@VcCOMM_VCU_DirIndicationRH@ */ /end MEASUREMENT
/begin MEASUREMENT VcCOMM_Decs_FedBck_BrkPedSts "" UBYTE COMM_subsystem_integrated_CM_uint8 0 0 0 255 ECU_ADDRESS 0xb0003e17 /* @ECU_Address@VcCOMM_Decs_FedBck_BrkPedSts@ */ /end MEASUREMENT
/begin MEASUREMENT VcCOMM_VCU_HeadLampLowBeam "" UBYTE COMM_subsystem_integrated_CM_uint8 0 0 0 255 ECU_ADDRESS 0xb0003e16 /* @ECU_Address@VcCOMM_VCU_HeadLampLowBeam@ */ /end MEASUREMENT
/begin MEASUREMENT VcCOMM_VCU_HeadLampHighBeam "" UBYTE COMM_subsystem_integrated_CM_uint8 0 0 0 255 ECU_ADDRESS 0xb0003e15 /* @ECU_Address@VcCOMM_VCU_HeadLampHighBeam@ */ /end MEASUREMENT
/begin MEASUREMENT VcCOMM_Decs_FedBck_EPSmod "" UBYTE COMM_subsystem_integrated_CM_uint8 0 0 0 255 ECU_ADDRESS 0xb0003e14 /* @ECU_Address@VcCOMM_Decs_FedBck_EPSmod@ */ /end MEASUREMENT
/begin MEASUREMENT VcCOMM_Decs_FedBck_ESCmod "" UBYTE COMM_subsystem_integrated_CM_uint8 0 0 0 255 ECU_ADDRESS 0xb0003e13 /* @ECU_Address@VcCOMM_Decs_FedBck_ESCmod@ */ /end MEASUREMENT
/begin MEASUREMENT VcCOMM_Decs_FedBck_Drivemod "" UBYTE COMM_subsystem_integrated_CM_uint8 0 0 0 255 ECU_ADDRESS 0xb0003e12 /* @ECU_Address@VcCOMM_Decs_FedBck_Drivemod@ */ /end MEASUREMENT
/begin MEASUREMENT VcCOMM_Decs_FedBck_GearValue "" UBYTE COMM_subsystem_integrated_CM_uint8 0 0 0 255 ECU_ADDRESS 0xb0003e11 /* @ECU_Address@VcCOMM_Decs_FedBck_GearValue@ */ /end MEASUREMENT
/begin MEASUREMENT VbCOMM_Decs_WarnLight_Req "" UBYTE COMM_subsystem_integrated_CM_boolean 0 0 0 1 ECU_ADDRESS 0xb0003e10 /* @ECU_Address@VbCOMM_Decs_WarnLight_Req@ */ /end MEASUREMENT
/begin MEASUREMENT VbCOMM_Decs_RihtLmp_Req "" UBYTE COMM_subsystem_integrated_CM_boolean 0 0 0 1 ECU_ADDRESS 0xb0003e0f /* @ECU_Address@VbCOMM_Decs_RihtLmp_Req@ */ /end MEASUREMENT
/begin MEASUREMENT VbCOMM_Decs_Light_Req "" UBYTE COMM_subsystem_integrated_CM_boolean 0 0 0 1 ECU_ADDRESS 0xb0003e0e /* @ECU_Address@VbCOMM_Decs_Light_Req@ */ /end MEASUREMENT
/begin MEASUREMENT VbCOMM_Decs_LftLmp_Req "" UBYTE COMM_subsystem_integrated_CM_boolean 0 0 0 1 ECU_ADDRESS 0xb0003e0d /* @ECU_Address@VbCOMM_Decs_LftLmp_Req@ */ /end MEASUREMENT
/begin MEASUREMENT VbCOMM_Decs_Horn_Req "" UBYTE COMM_subsystem_integrated_CM_boolean 0 0 0 1 ECU_ADDRESS 0xb0003e0c /* @ECU_Address@VbCOMM_Decs_Horn_Req@ */ /end MEASUREMENT
/begin MEASUREMENT VbCOMM_Decs_HighBeam_Req "" UBYTE COMM_subsystem_integrated_CM_boolean 0 0 0 1 ECU_ADDRESS 0xb0003e0b /* @ECU_Address@VbCOMM_Decs_HighBeam_Req@ */ /end MEASUREMENT
/begin MEASUREMENT VbCOMM_Decs_FrontFogLamp_Req "" UBYTE COMM_subsystem_integrated_CM_boolean 0 0 0 1 ECU_ADDRESS 0xb0003e0a /* @ECU_Address@VbCOMM_Decs_FrontFogLamp_Req@ */ /end MEASUREMENT
/begin MEASUREMENT VbCOMM_Decs_DippedBeam_Req "" UBYTE COMM_subsystem_integrated_CM_boolean 0 0 0 1 ECU_ADDRESS 0xb0003e09 /* @ECU_Address@VbCOMM_Decs_DippedBeam_Req@ */ /end MEASUREMENT
/begin MEASUREMENT VbCOMM_Decs_BrkLight_Req "" UBYTE COMM_subsystem_integrated_CM_boolean 0 0 0 1 ECU_ADDRESS 0xb0003e08 /* @ECU_Address@VbCOMM_Decs_BrkLight_Req@ */ /end MEASUREMENT
/begin MEASUREMENT VbCOMM_Decs_BckfogLmp_Req "" UBYTE COMM_subsystem_integrated_CM_boolean 0 0 0 1 ECU_ADDRESS 0xb0003e07 /* @ECU_Address@VbCOMM_Decs_BckfogLmp_Req@ */ /end MEASUREMENT
/begin MEASUREMENT VbCOMM_Decs_iBCM_Req "" UBYTE COMM_subsystem_integrated_CM_boolean 0 0 0 1 ECU_ADDRESS 0xb0003e06 /* @ECU_Address@VbCOMM_Decs_iBCM_Req@ */ /end MEASUREMENT
/begin MEASUREMENT VbCOMM_HandsOffWheelDetected "" UBYTE COMM_subsystem_integrated_CM_boolean 0 0 0 1 ECU_ADDRESS 0xb0003e05 /* @ECU_Address@VbCOMM_HandsOffWheelDetected@ */ /end MEASUREMENT
/begin MEASUREMENT VbCOMM_HandsOnWheelDetected "" UBYTE COMM_subsystem_integrated_CM_boolean 0 0 0 1 ECU_ADDRESS 0xb0003e04 /* @ECU_Address@VbCOMM_HandsOnWheelDetected@ */ /end MEASUREMENT
/begin MEASUREMENT VfDCSN_vehicle_speed_egmo "The linear velocity of ego vehicle from egmo" FLOAT32_IEEE DCSN_subsystem_integrated_CM_single_m_s 0 0 -3.4E+38 3.4E+38 ECU_ADDRESS 0x70004310 /* @ECU_Address@VfDCSN_vehicle_speed_egmo@ */ /end MEASUREMENT
/begin MEASUREMENT VeDCSN_usr_cmd_autodrive_activate "usr activate cmd
      0 = deactivate
      1 = activate
      2 = hold" UBYTE DCSN_subsystem_integrated_CM_uint8 0 0 0 255 ECU_ADDRESS 0x70004290 /* @ECU_Address@VeDCSN_usr_cmd_autodrive_activate@ */ /end MEASUREMENT
/begin MEASUREMENT VbDCSN_overspeed_warning "0 = speed in range
      1 = overspeed warning" UBYTE DCSN_subsystem_integrated_CM_boolean 0 0 0 1 ECU_ADDRESS 0x7000428a /* @ECU_Address@VbDCSN_overspeed_warning@ */ /end MEASUREMENT
/begin MEASUREMENT VbDCSN_accs_stop_finished "If ACCS finished the stop request from DCSN" UBYTE DCSN_subsystem_integrated_CM_boolean 0 0 0 1 ECU_ADDRESS 0x70004286 /* @ECU_Address@VbDCSN_accs_stop_finished@ */ /end MEASUREMENT
/begin MEASUREMENT VbDCSN_stop_request_enabled "0 = Sending stop request is disabled
      1 = Sending stop request is ensabled" UBYTE DCSN_subsystem_integrated_CM_boolean 0 0 0 1 ECU_ADDRESS 0x70004282 /* @ECU_Address@VbDCSN_stop_request_enabled@ */ /end MEASUREMENT
/begin MEASUREMENT VbDCSN_egmo_is_ready "0 = egmo not ready
      1 = egmo ready" UBYTE DCSN_subsystem_integrated_CM_boolean 0 0 0 1 ECU_ADDRESS 0x70004272 /* @ECU_Address@VbDCSN_egmo_is_ready@ */ /end MEASUREMENT
/begin MEASUREMENT VbDCSN_mpfu_is_ready "0 = mpfu not ready
      1 = mpfu ready" UBYTE DCSN_subsystem_integrated_CM_boolean 0 0 0 1 ECU_ADDRESS 0x70004271 /* @ECU_Address@VbDCSN_mpfu_is_ready@ */ /end MEASUREMENT
/begin MEASUREMENT VbDCSN_input_is_ready "0 = input data is not ready
      1 = input data is ready" UBYTE DCSN_subsystem_integrated_CM_boolean 0 0 0 1 ECU_ADDRESS 0x70004270 /* @ECU_Address@VbDCSN_input_is_ready@ */ /end MEASUREMENT
/begin MEASUREMENT VbDCSN_speed_limit_enabled "Whether the speed limit output is enabled" UBYTE DCSN_subsystem_integrated_CM_boolean 0 0 0 1 ECU_ADDRESS 0x7000426f /* @ECU_Address@VbDCSN_speed_limit_enabled@ */ /end MEASUREMENT
/begin MEASUREMENT VbDCSN_acc_feature_enable "0 = acc not enabled
      1 = acc enabled" UBYTE DCSN_subsystem_integrated_CM_boolean 0 0 0 1 ECU_ADDRESS 0x7000426a /* @ECU_Address@VbDCSN_acc_feature_enable@ */ /end MEASUREMENT
/begin MEASUREMENT VbDCSN_power_control_inhibit "0 = power control not inhibit
      1 = power control inhibit" UBYTE DCSN_subsystem_integrated_CM_boolean 0 0 0 1 ECU_ADDRESS 0x70004269 /* @ECU_Address@VbDCSN_power_control_inhibit@ */ /end MEASUREMENT
/begin MEASUREMENT VbDCSN_power_ctrl_enable "0 = power not enabled
      1 = power enabled" UBYTE DCSN_subsystem_integrated_CM_boolean 0 0 0 1 ECU_ADDRESS 0x70004268 /* @ECU_Address@VbDCSN_power_ctrl_enable@ */ /end MEASUREMENT
/begin MEASUREMENT VbDCSN_brake_ctrl_enable "0 = brake not enabled
      1 = brake enabled
      " UBYTE DCSN_subsystem_integrated_CM_boolean 0 0 0 1 ECU_ADDRESS 0x70004267 /* @ECU_Address@VbDCSN_brake_ctrl_enable@ */ /end MEASUREMENT
/begin MEASUREMENT VbDCSN_steer_ctrl_enable "0 = steer not enabled
      1 = steer enabled" UBYTE DCSN_subsystem_integrated_CM_boolean 0 0 0 1 ECU_ADDRESS 0x70004266 /* @ECU_Address@VbDCSN_steer_ctrl_enable@ */ /end MEASUREMENT
/begin MEASUREMENT VbDCSN_gear_ctrl_enable "0 = gear not enabled
      1 = gear enabled" UBYTE DCSN_subsystem_integrated_CM_boolean 0 0 0 1 ECU_ADDRESS 0x70004265 /* @ECU_Address@VbDCSN_gear_ctrl_enable@ */ /end MEASUREMENT
/begin MEASUREMENT VbDCSN_epb_ctrl_enable "0 = epb not enabled
      1 = epb enabled" UBYTE DCSN_subsystem_integrated_CM_boolean 0 0 0 1 ECU_ADDRESS 0x70004264 /* @ECU_Address@VbDCSN_epb_ctrl_enable@ */ /end MEASUREMENT
/begin MEASUREMENT VbDCSN_lcc_feature_enable "0 = lcc not enabled
      1 = lcc enabled
      " UBYTE DCSN_subsystem_integrated_CM_boolean 0 0 0 1 ECU_ADDRESS 0x70004263 /* @ECU_Address@VbDCSN_lcc_feature_enable@ */ /end MEASUREMENT
/begin MEASUREMENT VbDCSN_alca_feature_enable "0 = alca not enabled
      1 = alca enabled" UBYTE DCSN_subsystem_integrated_CM_boolean 0 0 0 1 ECU_ADDRESS 0x70004262 /* @ECU_Address@VbDCSN_alca_feature_enable@ */ /end MEASUREMENT
/begin MEASUREMENT VbDCSN_aeb_feature_enable "0 = aeb not enabled
      1 = aeb enabled
      " UBYTE DCSN_subsystem_integrated_CM_boolean 0 0 0 1 ECU_ADDRESS 0x70004261 /* @ECU_Address@VbDCSN_aeb_feature_enable@ */ /end MEASUREMENT
/begin MEASUREMENT VbDCSN_fcw_feature_enable "0 = fcw not enabled
      1 = fcw enabled" UBYTE DCSN_subsystem_integrated_CM_boolean 0 0 0 1 ECU_ADDRESS 0x70004260 /* @ECU_Address@VbDCSN_fcw_feature_enable@ */ /end MEASUREMENT
/begin MEASUREMENT VbDCSN_lcw_feature_enable "0 = lcw not enabled
      1 = lcw enabled
      " UBYTE DCSN_subsystem_integrated_CM_boolean 0 0 0 1 ECU_ADDRESS 0x7000425f /* @ECU_Address@VbDCSN_lcw_feature_enable@ */ /end MEASUREMENT
/begin MEASUREMENT VbDCSN_ldw_feature_enable "0 = ldw not enabled
      1 = ldw enabled
      " UBYTE DCSN_subsystem_integrated_CM_boolean 0 0 0 1 ECU_ADDRESS 0x7000425e /* @ECU_Address@VbDCSN_ldw_feature_enable@ */ /end MEASUREMENT
/begin MEASUREMENT VbDCSN_lka_feature_enable "0 = lka not enabled
      1 = lka enabled
      " UBYTE DCSN_subsystem_integrated_CM_boolean 0 0 0 1 ECU_ADDRESS 0x7000425d /* @ECU_Address@VbDCSN_lka_feature_enable@ */ /end MEASUREMENT
/begin MEASUREMENT VbDCSN_bsd_feature_enable "0 = bsd not enabled
      1 = bsd enabled
      " UBYTE DCSN_subsystem_integrated_CM_boolean 0 0 0 1 ECU_ADDRESS 0x7000425c /* @ECU_Address@VbDCSN_bsd_feature_enable@ */ /end MEASUREMENT
/begin MEASUREMENT VbDCSN_lca_feature_enable "0 = lca not enabled
      1 = lca enabled
      " UBYTE DCSN_subsystem_integrated_CM_boolean 0 0 0 1 ECU_ADDRESS 0x7000425b /* @ECU_Address@VbDCSN_lca_feature_enable@ */ /end MEASUREMENT
/begin MEASUREMENT VbDCSN_rcta_feature_enable "0 = rcta not enabled
      1 = rcta enabled
      " UBYTE DCSN_subsystem_integrated_CM_boolean 0 0 0 1 ECU_ADDRESS 0x7000425a /* @ECU_Address@VbDCSN_rcta_feature_enable@ */ /end MEASUREMENT
/begin MEASUREMENT VbDCSN_fcta_feature_enable "0 = fcta not enabled
      1 = fcta enabled
      " UBYTE DCSN_subsystem_integrated_CM_boolean 0 0 0 1 ECU_ADDRESS 0x70004259 /* @ECU_Address@VbDCSN_fcta_feature_enable@ */ /end MEASUREMENT
/begin MEASUREMENT VbDCSN_dow_feature_enable "0 = dow not enabled
      1 = dow enabled
      " UBYTE DCSN_subsystem_integrated_CM_boolean 0 0 0 1 ECU_ADDRESS 0x70004258 /* @ECU_Address@VbDCSN_dow_feature_enable@ */ /end MEASUREMENT
/begin MEASUREMENT VbDCSN_initialization_finished "Initialization process is finished.
      Including vehicle and controller." UBYTE DCSN_subsystem_integrated_CM_boolean 0 0 0 1 ECU_ADDRESS 0x70004255 /* @ECU_Address@VbDCSN_initialization_finished@ */ /end MEASUREMENT
/begin MEASUREMENT VbDCSN_ACC_ready_to_engage "ACCS subsystem ready" UBYTE DCSN_subsystem_integrated_CM_boolean 0 0 0 1 ECU_ADDRESS 0x70004254 /* @ECU_Address@VbDCSN_ACC_ready_to_engage@ */ /end MEASUREMENT
/begin MEASUREMENT VbDCSN_accs_resume "0 = no accs resume request
      1 = accs resume request" UBYTE DCSN_subsystem_integrated_CM_boolean 0 0 0 1 ECU_ADDRESS 0x70004250 /* @ECU_Address@VbDCSN_accs_resume@ */ /end MEASUREMENT
/begin MEASUREMENT VbDCSN_adm_steering_override "0 = not override
      1 = override" UBYTE DCSN_subsystem_integrated_CM_boolean 0 0 0 1 ECU_ADDRESS 0x7000424f /* @ECU_Address@VbDCSN_adm_steering_override@ */ /end MEASUREMENT
/begin MEASUREMENT VbDCSN_adm_steering_resume "0 = not resume
      1 = resume" UBYTE DCSN_subsystem_integrated_CM_boolean 0 0 0 1 ECU_ADDRESS 0x7000424e /* @ECU_Address@VbDCSN_adm_steering_resume@ */ /end MEASUREMENT
/begin MEASUREMENT VeDCSN_adm_main_mode "0 = ADM_OFF
      1 = ADM_STANDBY
      2 = ADM_READY
      3 = ADM_ACTIVE
      4 = ADM_STEER_OVRD
      5 = ADM_TAKEOVER_WARNING
      6 = ADM_FAULT_WARNING
      7 = ADM_FAULT_REACTION
      8 = ADM_FAULT_DETECTED" UBYTE DCSN_subsystem_integrated_CM_EnumDCSN_adm_main_mode 0 0 0 8 ECU_ADDRESS 0x7000424a /* @ECU_Address@VeDCSN_adm_main_mode@ */ /end MEASUREMENT
/begin MEASUREMENT VeDCSN_hmi_msg_display "0 = NO_MSG
      1 = ACTIVE
      2 = OVRD
      3 = TAKOVER_REQ
      4 = FAULT" UBYTE DCSN_subsystem_integrated_CM_EnumDCSN_adm_hmi_msg_display 0 0 0 4 ECU_ADDRESS 0x70004249 /* @ECU_Address@VeDCSN_hmi_msg_display@ */ /end MEASUREMENT
/begin MEASUREMENT VeDCSN_hmi_icon_display "0 = NO_ICON
      1 = GREY_SOLID
      2 = GREEN_SOLID
      3 = BLUE_SOLID
      4 = RED_FLASH_SLOW
      5 = RED_FLASH_FAST
      6 = RED_SOLID" UBYTE DCSN_subsystem_integrated_CM_EnumDCSN_adm_hmi_icon_display 0 0 0 6 ECU_ADDRESS 0x70004248 /* @ECU_Address@VeDCSN_hmi_icon_display@ */ /end MEASUREMENT
/begin MEASUREMENT VeDCSN_autodrive_control_mode "0 = AUTODRIVE_PASIV
      1 = AUTODRIVE_DELAY
      2 = AUTODRIVE_RE_ACTIV
      3 = AUTODRIVE_ACTIVATING
      4 = AUTODRIVE_ACTIVATED" UBYTE DCSN_subsystem_integrated_CM_EnumDCSN_autodrive_control_mode 0 0 0 4 ECU_ADDRESS 0x70004247 /* @ECU_Address@VeDCSN_autodrive_control_mode@ */ /end MEASUREMENT
/begin COMPU_METHOD AEBS_subsystem_integrated_CM_single "Q = V" RAT_FUNC "%8.6" "" COEFFS 0 1 0 0 0 1 /end COMPU_METHOD
/begin COMPU_METHOD AEBS_subsystem_integrated_CM_single_rad_s "Q = V" RAT_FUNC "%8.6" "rad/s" COEFFS 0 1 0 0 0 1 /end COMPU_METHOD
/begin COMPU_METHOD AEBS_subsystem_integrated_CM_int32 "Q = V" RAT_FUNC "%10.0" "" COEFFS 0 1 0 0 0 1 /end COMPU_METHOD
/begin COMPU_METHOD AEBS_subsystem_integrated_CM_int8 "Q = V" RAT_FUNC "%3.0" "" COEFFS 0 1 0 0 0 1 /end COMPU_METHOD
/begin COMPU_METHOD AEBS_subsystem_integrated_CM_uint8 "Q = V" RAT_FUNC "%3.0" "" COEFFS 0 1 0 0 0 1 /end COMPU_METHOD
/begin COMPU_METHOD AEBS_subsystem_integrated_CM_boolean "Q = V" RAT_FUNC "%1.0" "" COEFFS 0 1 0 0 0 1 /end COMPU_METHOD
/begin COMPU_METHOD AEBS_subsystem_integrated_CM_EnumAEBS_TurnType "Enumerated data type: EnumAEBS_TurnType" TAB_VERB "%0.6" "" COMPU_TAB_REF VTAB_FOR_AEBS_subsystem_integrated_CM_EnumAEBS_TurnType /end COMPU_METHOD
/begin COMPU_METHOD ARBT_subsystem_integrated_CM_single_s "Q = V" RAT_FUNC "%8.6" "s" COEFFS 0 1 0 0 0 1 /end COMPU_METHOD
/begin COMPU_METHOD ARBT_subsystem_integrated_CM_single_m_s2 "Q = V" RAT_FUNC "%8.6" "m/s2" COEFFS 0 1 0 0 0 1 /end COMPU_METHOD
/begin COMPU_METHOD ARBT_subsystem_integrated_CM_single__ "Q = V" RAT_FUNC "%8.6" "%" COEFFS 0 1 0 0 0 1 /end COMPU_METHOD
/begin COMPU_METHOD ARBT_subsystem_integrated_CM_single_deg "Q = V" RAT_FUNC "%8.6" "deg" COEFFS 0 1 0 0 0 1 /end COMPU_METHOD
/begin COMPU_METHOD ARBT_subsystem_integrated_CM_single_ms "Q = V" RAT_FUNC "%8.6" "ms" COEFFS 0 1 0 0 0 1 /end COMPU_METHOD
/begin COMPU_METHOD ARBT_subsystem_integrated_CM_single_sec "Q = V" RAT_FUNC "%8.6" "sec" COEFFS 0 1 0 0 0 1 /end COMPU_METHOD
/begin COMPU_METHOD ARBT_subsystem_integrated_CM_single "Q = V" RAT_FUNC "%8.6" "" COEFFS 0 1 0 0 0 1 /end COMPU_METHOD
/begin COMPU_METHOD ARBT_subsystem_integrated_CM_single_m_s "Q = V" RAT_FUNC "%8.6" "m/s" COEFFS 0 1 0 0 0 1 /end COMPU_METHOD
/begin COMPU_METHOD ARBT_subsystem_integrated_CM_uint8 "Q = V" RAT_FUNC "%3.0" "" COEFFS 0 1 0 0 0 1 /end COMPU_METHOD
/begin COMPU_METHOD ARBT_subsystem_integrated_CM_boolean "Q = V" RAT_FUNC "%1.0" "" COEFFS 0 1 0 0 0 1 /end COMPU_METHOD
/begin COMPU_METHOD ARBT_subsystem_integrated_CM_single_Nm "Q = V" RAT_FUNC "%8.6" "Nm" COEFFS 0 1 0 0 0 1 /end COMPU_METHOD
/begin COMPU_METHOD ARBT_subsystem_integrated_CM_EnumARBT_arbitration_winner "Enumerated data type: EnumARBT_arbitration_winner" TAB_VERB "%0.6" "" COMPU_TAB_REF VTAB_FOR_ARBT_subsystem_integrated_CM_EnumARBT_arbitration_winner /end COMPU_METHOD
/begin COMPU_METHOD COMM_subsystem_integrated_CM_single "Q = V" RAT_FUNC "%8.6" "" COEFFS 0 1 0 0 0 1 /end COMPU_METHOD
/begin COMPU_METHOD COMM_subsystem_integrated_CM_single_mm "Q = V" RAT_FUNC "%8.6" "mm" COEFFS 0 1 0 0 0 1 /end COMPU_METHOD
/begin COMPU_METHOD COMM_subsystem_integrated_CM_single_rad "Q = V" RAT_FUNC "%8.6" "rad" COEFFS 0 1 0 0 0 1 /end COMPU_METHOD
/begin COMPU_METHOD COMM_subsystem_integrated_CM_single_kg "Q = V" RAT_FUNC "%8.6" "kg" COEFFS 0 1 0 0 0 1 /end COMPU_METHOD
/begin COMPU_METHOD COMM_subsystem_integrated_CM_single_N_deg "Q = V" RAT_FUNC "%8.6" "N/deg" COEFFS 0 1 0 0 0 1 /end COMPU_METHOD
/begin COMPU_METHOD COMM_subsystem_integrated_CM_single_kg_m2 "Q = V" RAT_FUNC "%8.6" "kg*m2" COEFFS 0 1 0 0 0 1 /end COMPU_METHOD
/begin COMPU_METHOD COMM_subsystem_integrated_CM_single_m "Q = V" RAT_FUNC "%8.6" "m" COEFFS 0 1 0 0 0 1 /end COMPU_METHOD
/begin COMPU_METHOD COMM_subsystem_integrated_CM_uint8 "Q = V" RAT_FUNC "%3.0" "" COEFFS 0 1 0 0 0 1 /end COMPU_METHOD
/begin COMPU_METHOD COMM_subsystem_integrated_CM_boolean "Q = V" RAT_FUNC "%1.0" "" COEFFS 0 1 0 0 0 1 /end COMPU_METHOD
/begin COMPU_METHOD COMM_subsystem_integrated_CM_int16 "Q = V" RAT_FUNC "%5.0" "" COEFFS 0 1 0 0 0 1 /end COMPU_METHOD
/begin COMPU_METHOD COMM_subsystem_integrated_CM_uint16 "Q = V" RAT_FUNC "%5.0" "" COEFFS 0 1 0 0 0 1 /end COMPU_METHOD
/begin COMPU_METHOD DCSN_subsystem_integrated_CM_single_m_s "Q = V" RAT_FUNC "%8.6" "m/s" COEFFS 0 1 0 0 0 1 /end COMPU_METHOD
/begin COMPU_METHOD DCSN_subsystem_integrated_CM_single_s "Q = V" RAT_FUNC "%8.6" "s" COEFFS 0 1 0 0 0 1 /end COMPU_METHOD
/begin COMPU_METHOD DCSN_subsystem_integrated_CM_uint8 "Q = V" RAT_FUNC "%3.0" "" COEFFS 0 1 0 0 0 1 /end COMPU_METHOD
/begin COMPU_METHOD DCSN_subsystem_integrated_CM_boolean "Q = V" RAT_FUNC "%1.0" "" COEFFS 0 1 0 0 0 1 /end COMPU_METHOD
/begin COMPU_METHOD DCSN_subsystem_integrated_CM_EnumDCSN_adm_main_mode "Enumerated data type: EnumDCSN_adm_main_mode" TAB_VERB "%0.6" "" COMPU_TAB_REF VTAB_FOR_DCSN_subsystem_integrated_CM_EnumDCSN_adm_main_mode /end COMPU_METHOD
/begin COMPU_METHOD DCSN_subsystem_integrated_CM_EnumDCSN_adm_hmi_msg_display "Enumerated data type: EnumDCSN_adm_hmi_msg_display" TAB_VERB "%0.6" "" COMPU_TAB_REF VTAB_FOR_DCSN_subsystem_integrated_CM_EnumDCSN_adm_hmi_msg_display /end COMPU_METHOD
/begin COMPU_METHOD DCSN_subsystem_integrated_CM_EnumDCSN_adm_hmi_icon_display "Enumerated data type: EnumDCSN_adm_hmi_icon_display" TAB_VERB "%0.6" "" COMPU_TAB_REF VTAB_FOR_DCSN_subsystem_integrated_CM_EnumDCSN_adm_hmi_icon_display /end COMPU_METHOD
/begin COMPU_METHOD DCSN_subsystem_integrated_CM_EnumDCSN_autodrive_control_mode "Enumerated data type: EnumDCSN_autodrive_control_mode" TAB_VERB "%0.6" "" COMPU_TAB_REF VTAB_FOR_DCSN_subsystem_integrated_CM_EnumDCSN_autodrive_control_mode /end COMPU_METHOD
/begin COMPU_VTAB VTAB_FOR_AEBS_subsystem_integrated_CM_EnumAEBS_TurnType "Enumerated data type: EnumAEBS_TurnType" TAB_VERB 4 1 "AEBS_Straight" 2 "AEBS_LeftTurn" 3 "AEBS_RightTurn" 4 "AEBS_TurnInvalid" /end COMPU_VTAB
/begin COMPU_VTAB VTAB_FOR_ARBT_subsystem_integrated_CM_EnumARBT_arbitration_winner "Enumerated data type: EnumARBT_arbitration_winner" TAB_VERB 7 0 "ARBT_NO_REQ" 1 "AEB" 2 "ACC" 3 "LCC" 4 "LKA" 5 "BRAKE_OVRD" 6 "RSVD2" /end COMPU_VTAB
/begin COMPU_VTAB VTAB_FOR_DCSN_subsystem_integrated_CM_EnumDCSN_adm_main_mode "Enumerated data type: EnumDCSN_adm_main_mode" TAB_VERB 9 0 "ADM_OFF" 1 "ADM_STANDBY" 2 "ADM_READY" 3 "ADM_ACTIVE" 4 "ADM_STEER_OVRD" 5 "ADM_TAKEOVER_WARNING" 6 "ADM_FAULT_WARNING" 7 "ADM_FAULT_REACTION" 8 "ADM_FAULT_DETECTED" /end COMPU_VTAB
/begin COMPU_VTAB VTAB_FOR_DCSN_subsystem_integrated_CM_EnumDCSN_adm_hmi_msg_display "Enumerated data type: EnumDCSN_adm_hmi_msg_display" TAB_VERB 5 0 "NO_MSG" 1 "ACTIVE" 2 "OVRD" 3 "TAKEOVER_REQ" 4 "FAULT" /end COMPU_VTAB
/begin COMPU_VTAB VTAB_FOR_DCSN_subsystem_integrated_CM_EnumDCSN_adm_hmi_icon_display "Enumerated data type: EnumDCSN_adm_hmi_icon_display" TAB_VERB 7 0 "NO_ICON" 1 "GREY_SOLID" 2 "GREEN_SOLID" 3 "BLUE_SOLID" 4 "RED_FLASH_SLOW" 5 "RED_FLASH_FAST" 6 "RED_SOLID" /end COMPU_VTAB
/begin COMPU_VTAB VTAB_FOR_DCSN_subsystem_integrated_CM_EnumDCSN_autodrive_control_mode "Enumerated data type: EnumDCSN_autodrive_control_mode" TAB_VERB 5 0 "AUTODRIVE_PASIV" 1 "AUTODRIVE_DELAY" 2 "AUTODRIVE_RE_ACTIV" 3 "AUTODRIVE_ACTIVATING" 4 "AUTODRIVE_ACTIVATED" /end COMPU_VTAB
/begin GROUP S9_SubsystemMonitor "AEBS_subsystem_integrated/AEBS/AEBS_Enabled/AEB_FCWVIPTargetSelection/SubsystemMonitor"
 /begin REF_MEASUREMENT VbAEBS_has_obs_vip VfAEBS_obs_NP_x_vip VfAEBS_obs_NP_y_vip VfAEBS_obs_acc_lateral_vip VfAEBS_obs_acc_long_vip VfAEBS_obs_confidence_VIP VfAEBS_obs_delta_dis_vip VfAEBS_obs_delta_speed_vip VfAEBS_obs_dis_lateral_VIP VfAEBS_obs_dis_long_VIP VfAEBS_obs_heading_VIP VfAEBS_obs_id_vip VfAEBS_obs_index_vip VfAEBS_obs_length_VIP VfAEBS_obs_motion_status_VIP VfAEBS_obs_position_state_vip VfAEBS_obs_position_zone_VIP VfAEBS_obs_rp_vip VfAEBS_obs_ttc_vip VfAEBS_obs_type_vip VfAEBS_obs_v_lateral_vip VfAEBS_obs_v_long_vip VfAEBS_obs_width_VIP /end REF_MEASUREMENT
/end GROUP
/begin GROUP S9_TurnState "AEBS_subsystem_integrated/AEBS/AEBS_Enabled/AEB_FCWVIPTargetSelection/TurnState"
 /begin REF_CHARACTERISTIC KbAEBS_Active_LeftTurn KbAEBS_Active_RightTurn KbAEBS_Active_Straight /end REF_CHARACTERISTIC
 /begin REF_MEASUREMENT VeAEBS_TurnType /end REF_MEASUREMENT
/end GROUP
/begin GROUP S10_DetermineFCWStatus "AEBS_subsystem_integrated/AEBS/AEBS_Enabled/FCW_Determination/DetermineFCWStatus" /begin SUB_GROUP S182_CheckAEBS_SystemOverride /end SUB_GROUP /end GROUP
/begin GROUP S10_ThreatEvaluation "AEBS_subsystem_integrated/AEBS/AEBS_Enabled/FCW_Determination/ThreatEvaluation"
 /begin SUB_GROUP S184_Deactive S184_Dtrn_vehicleStandStill S184_Enable_Evaluation S184_FCW_level1_Threat S184_FCW_level2_Threat S184_FCW_level3_Threat S184_inhibit /end SUB_GROUP
/end GROUP
/begin GROUP S39_CalcAEBSAcceleration "AEBS_subsystem_integrated/AEBS/AEBS_Enabled/AEB_Determination/DetermineAEBStatus/CalcAEBSAcceleration"
 /begin SUB_GROUP S42_AccelReqFilter S42_AccelerationLimit S42_ClacCurrTime S42_First_Order_Low_Pass_Filter /end SUB_GROUP
 /begin REF_CHARACTERISTIC KfAEBS_a_BrakeInit KfAEBS_a_BrakeMax KfAEBS_a_FullBrakeHi KfAEBS_a_FullBrakeLo KfAEBS_a_PartialBrakeHi KfAEBS_a_PartialBrakeLo KfAEBS_t_Time_BrakeInit KfAEBS_t_Time_BrakeRamp /end REF_CHARACTERISTIC
/end GROUP
/begin GROUP S39_CheckAEBS_SystemOverride "AEBS_subsystem_integrated/AEBS/AEBS_Enabled/AEB_Determination/DetermineAEBStatus/CheckAEBS_SystemOverride"
 /begin REF_CHARACTERISTIC KfAEBS_LoPosValInCllsnRednByBrkg KfAEBS_SpdMinOvrdAccrResetInCllsnRednByBrkg /end REF_CHARACTERISTIC
/end GROUP
/begin GROUP S40_CalcObsAreq "AEBS_subsystem_integrated/AEBS/AEBS_Enabled/AEB_Determination/DtrmnThreatEvaluation/CalcObsAreq" /begin SUB_GROUP S68_Subsystem2 /end SUB_GROUP
 /begin REF_CHARACTERISTIC KfAEBS_a_FullBrakeHi KfAEBS_a_ObjUrgentBrake_Thrsh KfAEBS_d_Dis_Safe KfAEBS_d_Dis_Safe_VRU KfAEBS_t_Time_BrakeDelay KfAEBS_t_Time_ObjUrgentBrk KfAEBS_v_ObjUrgentBrk_speed_Thrsh /end REF_CHARACTERISTIC
 /begin REF_MEASUREMENT VfAEBS_a_obj_absolute_acc VfAEBS_areq VfAEBS_areq_withoutDelay VfAEBS_areq_withoutDelay_UrgentBrk VfAEBS_dis_delay VfAEBS_dis_safe_used VfAEBS_v_obj_absolute_speed /end REF_MEASUREMENT
/end GROUP
/begin GROUP S40_Deactive "AEBS_subsystem_integrated/AEBS/AEBS_Enabled/AEB_Determination/DtrmnThreatEvaluation/Deactive"
 /begin SUB_GROUP S69_HighTTCDeactive S69_RisingEdgeDelay S69_SpeedReductionMonitoring S69_VIPChange_Deactive S69_VIP_lost_close S69_preBrakeTimeOutDetection /end SUB_GROUP
 /begin REF_CHARACTERISTIC KfAEBS_AccPdl_InhbtDeact_thrshld KfAEBS_Confidnc_Deact_thrshld /end REF_CHARACTERISTIC
 /begin REF_MEASUREMENT VbAEBS_Deactive_R_Confdnc VbAEBS_Deactive_R_NoVIP /end REF_MEASUREMENT
/end GROUP
/begin GROUP S40_Dtrn_VUR_and_VRU_Protection "AEBS_subsystem_integrated/AEBS/AEBS_Enabled/AEB_Determination/DtrmnThreatEvaluation/Dtrn_VUR_and_VRU_Protection" /begin SUB_GROUP S70_Dtrn_VRU_obstacle S70_Dtrn_VehicleSpeedState /end SUB_GROUP /begin REF_CHARACTERISTIC KbAEBS_Enable_VRU_Calibration /end REF_CHARACTERISTIC /begin REF_MEASUREMENT VfAEBS_use_VRU_Calibration /end REF_MEASUREMENT /end GROUP
/begin GROUP S40_Dtrn_vehicleStandStill "AEBS_subsystem_integrated/AEBS/AEBS_Enabled/AEB_Determination/DtrmnThreatEvaluation/Dtrn_vehicleStandStill"
 /begin REF_CHARACTERISTIC KfAEBS_t_Speed_DebounceTime KfAEBS_v_Speed_DeltaStStThrsh KfAEBS_v_Speed_StandStillThrsh /end REF_CHARACTERISTIC
 /begin REF_MEASUREMENT VfAEBS_veh_standstill /end REF_MEASUREMENT
/end GROUP
/begin GROUP S40_Enable_Evaluation "AEBS_subsystem_integrated/AEBS/AEBS_Enabled/AEB_Determination/DtrmnThreatEvaluation/Enable Evaluation" /begin REF_MEASUREMENT VfAEBS_AEB_disabled VfAEBS_AEB_enabled /end REF_MEASUREMENT /end GROUP
/begin GROUP S40_FullBrakeThreat "AEBS_subsystem_integrated/AEBS/AEBS_Enabled/AEB_Determination/DtrmnThreatEvaluation/FullBrakeThreat" /begin SUB_GROUP S73_Subsystem S73_Subsystem1 /end SUB_GROUP
 /begin REF_CHARACTERISTIC KfAEBS_Confdnc_FullBrkActThrsd KfAEBS_a_Areq_FullBrkActThrsd KfAEBS_a_Areq_FullBrkDeactThrsd /end REF_CHARACTERISTIC
 /begin REF_MEASUREMENT VfAEBS_fullBrk_active VfAEBS_fullBrk_dactive /end REF_MEASUREMENT
/end GROUP
/begin GROUP S40_PartialBrakeThreat "AEBS_subsystem_integrated/AEBS/AEBS_Enabled/AEB_Determination/DtrmnThreatEvaluation/PartialBrakeThreat" /begin SUB_GROUP S74_Dtrn_TTC_Threshold S74_Subsystem S74_Subsystem1 /end SUB_GROUP
 /begin REF_CHARACTERISTIC KfAEBS_Confdnc_PartialBrkActThrsd KfAEBS_a_Areq_PartialBrkActThrsd KfAEBS_a_Areq_PartialBrkDeactThrsd KfAEBS_t_TTC_PartialBrkDeactiveThrsd /end REF_CHARACTERISTIC
 /begin REF_MEASUREMENT VfAEBS_partialBrk_active VfAEBS_partialBrk_dactive /end REF_MEASUREMENT
/end GROUP
/begin GROUP S40_Prebrake_Threat "AEBS_subsystem_integrated/AEBS/AEBS_Enabled/AEB_Determination/DtrmnThreatEvaluation/Prebrake Threat" /begin SUB_GROUP S75_Dtrn_TTC_Threshold /end SUB_GROUP /begin REF_CHARACTERISTIC KfAEBS_t_TTC_PreBrkDeactThrsd /end REF_CHARACTERISTIC /begin REF_MEASUREMENT VfAEBS_preBrake_active VfAEBS_preBrake_dactive /end REF_MEASUREMENT /end GROUP
/begin GROUP S40_inhibit "AEBS_subsystem_integrated/AEBS/AEBS_Enabled/AEB_Determination/DtrmnThreatEvaluation/inhibit"
 /begin SUB_GROUP S76_Deactive_time_inhibit S76_Deactive_time_inhibit1 S76_Steer_angle_rate_inhibit S76_speed_inhibit S76_veh_acceleration_inhibit /end SUB_GROUP
 /begin REF_CHARACTERISTIC KbAEBS_enable_PreBrake KfAEBS_AccPdl_InhbtDeact_thrshld KfAEBS_Gear_Value_R /end REF_CHARACTERISTIC
 /begin REF_MEASUREMENT VbAEBS_AEB_inhbt_AccPdl VbAEBS_preBrake_inhibit VfAEBS_AEB_inhibit VfAEBS_Gear_InhibitAEB /end REF_MEASUREMENT
/end GROUP
/begin GROUP S152_Calc_Lateral_long_buffer "AEBS_subsystem_integrated/AEBS/AEBS_Enabled/AEB_FCWVIPTargetSelection/Calc_obs_lateral_long_buffer/Calc_Lateral_long_buffer"
 /begin SUB_GROUP S156_Calc_lateral_buffer S156_Calc_long_buffer S156_ObsIgnore /end SUB_GROUP
/end GROUP
/begin GROUP S182_CheckAEBS_SystemOverride "AEBS_subsystem_integrated/AEBS/AEBS_Enabled/FCW_Determination/DetermineFCWStatus/CheckAEBS_SystemOverride"
 /begin REF_CHARACTERISTIC KfAEBS_LoPosValInCllsnRednByBrkg KfAEBS_SpdMinOvrdAccrResetInCllsnRednByBrkg /end REF_CHARACTERISTIC
/end GROUP
/begin GROUP S184_Deactive "AEBS_subsystem_integrated/AEBS/AEBS_Enabled/FCW_Determination/ThreatEvaluation/Deactive" /begin SUB_GROUP S193_ObjDataChangeDetection S193_RaisingEdgeDelay1 /end SUB_GROUP
 /begin REF_CHARACTERISTIC KfAEBS_t_TTC_DeactiveThrsh KfAEBS_t_TTC_ObjChangThrsd KfAEBS_t_Time_HasNoVIPDelay KfAEBS_t_Time_TTCHLInhibitAEB /end REF_CHARACTERISTIC
/end GROUP
/begin GROUP S184_Dtrn_vehicleStandStill "AEBS_subsystem_integrated/AEBS/AEBS_Enabled/FCW_Determination/ThreatEvaluation/Dtrn_vehicleStandStill"
 /begin REF_CHARACTERISTIC KfAEBS_t_Speed_DebounceTime KfAEBS_v_Speed_DeltaStStThrsh KfAEBS_v_Speed_StandStillThrsh /end REF_CHARACTERISTIC
/end GROUP
/begin GROUP S184_Enable_Evaluation "AEBS_subsystem_integrated/AEBS/AEBS_Enabled/FCW_Determination/ThreatEvaluation/Enable Evaluation" /begin REF_MEASUREMENT VfAEBS_FCW_disabled VfAEBS_FCW_enabled /end REF_MEASUREMENT /end GROUP
/begin GROUP S184_FCW_level1_Threat "AEBS_subsystem_integrated/AEBS/AEBS_Enabled/FCW_Determination/ThreatEvaluation/FCW_level1 Threat"
 /begin REF_CHARACTERISTIC KfAEBS_t_TTC_FCWLevel1DeactThrsd KtAEBS_FCWL1ActiveTTCThrshld /end REF_CHARACTERISTIC
 /begin REF_MEASUREMENT VfAEBS_FCWLev1_active VfAEBS_FCWLev1_dactive /end REF_MEASUREMENT
/end GROUP
/begin GROUP S184_FCW_level2_Threat "AEBS_subsystem_integrated/AEBS/AEBS_Enabled/FCW_Determination/ThreatEvaluation/FCW_level2 Threat"
 /begin REF_CHARACTERISTIC KfAEBS_t_TTC_FCWLevel2DeactThrsd KtAEBS_FCWL2ActiveTTCThrshld /end REF_CHARACTERISTIC
 /begin REF_MEASUREMENT VfAEBS_FCWLev2_active VfAEBS_FCWLev2_dactive /end REF_MEASUREMENT
/end GROUP
/begin GROUP S184_FCW_level3_Threat "AEBS_subsystem_integrated/AEBS/AEBS_Enabled/FCW_Determination/ThreatEvaluation/FCW_level3 Threat"
 /begin REF_CHARACTERISTIC KfAEBS_t_TTC_FCWLevel3DeactThrsd KtAEBS_FCWL3ActiveTTCThrshld /end REF_CHARACTERISTIC
 /begin REF_MEASUREMENT VfAEBS_FCWLev3_active VfAEBS_FCWLev3_dactive /end REF_MEASUREMENT
/end GROUP
/begin GROUP S184_inhibit "AEBS_subsystem_integrated/AEBS/AEBS_Enabled/FCW_Determination/ThreatEvaluation/inhibit" /begin SUB_GROUP S199_Deactive_time_inhibit /end SUB_GROUP
 /begin REF_CHARACTERISTIC KfAEBS_AccPdl_InhbtDeact_thrshld KfAEBS_Gear_Value_R KfAEBS_VehAcc_inhbt_FCW_thrshld /end REF_CHARACTERISTIC
 /begin REF_MEASUREMENT VbAEBS_FCW_inhbt_AccPedPos VbAEBS_FCW_inhbt_VehAcc VbAEBS_FCW_inhibit /end REF_MEASUREMENT
/end GROUP
/begin GROUP S42_AccelReqFilter "AEBS_subsystem_integrated/AEBS/AEBS_Enabled/AEB_Determination/DetermineAEBStatus/CalcAEBSAcceleration/AccelReqFilter" /begin REF_CHARACTERISTIC KfAEBS_a_AreqRampRate /end REF_CHARACTERISTIC /begin REF_MEASUREMENT VfAEBS_AEB_acceleration_bf_limit /end REF_MEASUREMENT /end GROUP
/begin GROUP S42_AccelerationLimit "AEBS_subsystem_integrated/AEBS/AEBS_Enabled/AEB_Determination/DetermineAEBStatus/CalcAEBSAcceleration/AccelerationLimit" /begin REF_CHARACTERISTIC KtAEBS_a_BrakeValueLimit /end REF_CHARACTERISTIC /begin REF_MEASUREMENT VfAEBS_AEB_accReq_beforeSend /end REF_MEASUREMENT /end GROUP
/begin GROUP S42_First_Order_Low_Pass_Filter "AEBS_subsystem_integrated/AEBS/AEBS_Enabled/AEB_Determination/DetermineAEBStatus/CalcAEBSAcceleration/First Order Low Pass Filter" /begin REF_MEASUREMENT VfAEBS_AEB_acceleration_af_filter /end REF_MEASUREMENT /end GROUP
/begin GROUP S68_Subsystem2 "AEBS_subsystem_integrated/AEBS/AEBS_Enabled/AEB_Determination/DtrmnThreatEvaluation/CalcObsAreq/Subsystem2" /begin SUB_GROUP S78_Subsystem1 /end SUB_GROUP /begin REF_CHARACTERISTIC KfAEBS_a_FullBrakeHi /end REF_CHARACTERISTIC /end GROUP
/begin GROUP S69_HighTTCDeactive "AEBS_subsystem_integrated/AEBS/AEBS_Enabled/AEB_Determination/DtrmnThreatEvaluation/Deactive/HighTTCDeactive" /begin SUB_GROUP S82_RaisingEdgeDelay2 /end SUB_GROUP /begin REF_CHARACTERISTIC KfAEBS_t_TTC_DeactiveThrsh KfAEBS_t_Time_TTCHLInhibitAEB /end REF_CHARACTERISTIC /end GROUP
/begin GROUP S69_RisingEdgeDelay "AEBS_subsystem_integrated/AEBS/AEBS_Enabled/AEB_Determination/DtrmnThreatEvaluation/Deactive/RisingEdgeDelay" /begin SUB_GROUP S83_RaisingEdgeDelay /end SUB_GROUP /begin REF_CHARACTERISTIC KfAEBS_t_Time_HasNoVIPDelay /end REF_CHARACTERISTIC /end GROUP
/begin GROUP S69_SpeedReductionMonitoring "AEBS_subsystem_integrated/AEBS/AEBS_Enabled/AEB_Determination/DtrmnThreatEvaluation/Deactive/SpeedReductionMonitoring" /begin SUB_GROUP S84_SpeedReductionASILACheck /end SUB_GROUP /begin REF_CHARACTERISTIC KfAEBS_VeloRectThrsdByBrkg KfAEBS_t_TimeBrakeThrsd /end REF_CHARACTERISTIC /begin REF_MEASUREMENT VfAEBS_DeniedDueToSpdRed VfAEBS_DeniedDueToTimeBrake /end REF_MEASUREMENT /end GROUP
/begin GROUP S69_VIPChange_Deactive "AEBS_subsystem_integrated/AEBS/AEBS_Enabled/AEB_Determination/DtrmnThreatEvaluation/Deactive/VIPChange_Deactive" /begin SUB_GROUP S85_ObjDataChangeDetection /end SUB_GROUP /begin REF_CHARACTERISTIC KfAEBS_a_Areq_ObjChangThrsd /end REF_CHARACTERISTIC /begin REF_MEASUREMENT VbAEBS_Deactive_R_VIPChanged /end REF_MEASUREMENT /end GROUP
/begin GROUP S69_VIP_lost_close "AEBS_subsystem_integrated/AEBS/AEBS_Enabled/AEB_Determination/DtrmnThreatEvaluation/Deactive/VIP_lost_close" /begin SUB_GROUP S86_vipCloseLostTimeOut /end SUB_GROUP
 /begin REF_CHARACTERISTIC KfAEBS_d_lateral_max_lostClose KfAEBS_d_lateral_min_lostClose KfAEBS_d_long_max_lostClose KfAEBS_d_long_min_lostClose KfAEBS_v_speed_max_lostClose KfAEBS_v_speed_min_lostClose /end REF_CHARACTERISTIC
 /begin REF_MEASUREMENT VbAEBS_vipCloseLost /end REF_MEASUREMENT
/end GROUP
/begin GROUP S69_preBrakeTimeOutDetection "AEBS_subsystem_integrated/AEBS/AEBS_Enabled/AEB_Determination/DtrmnThreatEvaluation/Deactive/preBrakeTimeOutDetection" /begin REF_CHARACTERISTIC KfAEBS_t_TimePreBrkThrsd /end REF_CHARACTERISTIC /begin REF_MEASUREMENT VbAEBS_deactive_preBrk_timeOut /end REF_MEASUREMENT /end GROUP
/begin GROUP S70_Dtrn_VRU_obstacle "AEBS_subsystem_integrated/AEBS/AEBS_Enabled/AEB_Determination/DtrmnThreatEvaluation/Dtrn_VUR_and_VRU_Protection/Dtrn_VRU_obstacle" /begin REF_MEASUREMENT VfAEBS_Obj_IsVRU /end REF_MEASUREMENT /end GROUP
/begin GROUP S70_Dtrn_VehicleSpeedState "AEBS_subsystem_integrated/AEBS/AEBS_Enabled/AEB_Determination/DtrmnThreatEvaluation/Dtrn_VUR_and_VRU_Protection/Dtrn_VehicleSpeedState"
 /begin REF_CHARACTERISTIC KfAEBS_v_isInHighSpeed_HighThrshd KfAEBS_v_isInHighSpeed_LowThrshd /end REF_CHARACTERISTIC
 /begin REF_MEASUREMENT VfAEBS_Vehicle_isInHighSpeed /end REF_MEASUREMENT
/end GROUP
/begin GROUP S73_Subsystem "AEBS_subsystem_integrated/AEBS/AEBS_Enabled/AEB_Determination/DtrmnThreatEvaluation/FullBrakeThreat/Subsystem"
 /begin REF_CHARACTERISTIC KbAEBS_use_steerAngle KfAEBS_SteerRate_Limit_hi KfAEBS_SteerRate_Limit_lo KfAEBS_YawRate_Limit_hi KfAEBS_YawRate_Limit_lo /end REF_CHARACTERISTIC
/end GROUP
/begin GROUP S73_Subsystem1 "AEBS_subsystem_integrated/AEBS/AEBS_Enabled/AEB_Determination/DtrmnThreatEvaluation/FullBrakeThreat/Subsystem1" /begin REF_CHARACTERISTIC KfAEBS_t_fb_active_delay_turn /end REF_CHARACTERISTIC /end GROUP
/begin GROUP S74_Dtrn_TTC_Threshold "AEBS_subsystem_integrated/AEBS/AEBS_Enabled/AEB_Determination/DtrmnThreatEvaluation/PartialBrakeThreat/Dtrn_TTC_Threshold"
 /begin REF_CHARACTERISTIC KtAEBS_PrtlBrkActiveTTCThrshld KtAEBS_PrtlBrkActiveTTCThrshld_VRU /end REF_CHARACTERISTIC
 /begin REF_MEASUREMENT VfAEBS_Partial_BrakeActiveTTCThreshold /end REF_MEASUREMENT
/end GROUP
/begin GROUP S74_Subsystem "AEBS_subsystem_integrated/AEBS/AEBS_Enabled/AEB_Determination/DtrmnThreatEvaluation/PartialBrakeThreat/Subsystem"
 /begin REF_CHARACTERISTIC KbAEBS_use_steerAngle KfAEBS_SteerRate_Limit_hi KfAEBS_SteerRate_Limit_lo KfAEBS_YawRate_Limit_hi KfAEBS_YawRate_Limit_lo /end REF_CHARACTERISTIC
/end GROUP
/begin GROUP S74_Subsystem1 "AEBS_subsystem_integrated/AEBS/AEBS_Enabled/AEB_Determination/DtrmnThreatEvaluation/PartialBrakeThreat/Subsystem1" /begin REF_CHARACTERISTIC KfAEBS_t_pb_active_delay_turn /end REF_CHARACTERISTIC /end GROUP
/begin GROUP S75_Dtrn_TTC_Threshold "AEBS_subsystem_integrated/AEBS/AEBS_Enabled/AEB_Determination/DtrmnThreatEvaluation/Prebrake Threat/Dtrn_TTC_Threshold"
 /begin REF_CHARACTERISTIC KtAEBS_PreBrkActiveTTCThrshld KtAEBS_PreBrkActiveTTCThrshld_VRU /end REF_CHARACTERISTIC
 /begin REF_MEASUREMENT VfAEBS_Pre_BrakeActiveTTCThreshold /end REF_MEASUREMENT
/end GROUP
/begin GROUP S76_Deactive_time_inhibit "AEBS_subsystem_integrated/AEBS/AEBS_Enabled/AEB_Determination/DtrmnThreatEvaluation/inhibit/Deactive_time_inhibit" /begin REF_CHARACTERISTIC KfAEBS_t_Time_TwiceAEBActive /end REF_CHARACTERISTIC /begin REF_MEASUREMENT VbAEBS_AEB_inhbt_DeactTime /end REF_MEASUREMENT /end GROUP
/begin GROUP S76_Deactive_time_inhibit1 "AEBS_subsystem_integrated/AEBS/AEBS_Enabled/AEB_Determination/DtrmnThreatEvaluation/inhibit/Deactive_time_inhibit1" /begin REF_CHARACTERISTIC KfAEBS_t_Time_TwicePreBrkActive /end REF_CHARACTERISTIC /begin REF_MEASUREMENT VbAEBS_PreBrk_inhbt_deactTime /end REF_MEASUREMENT /end GROUP
/begin GROUP S76_Steer_angle_rate_inhibit "AEBS_subsystem_integrated/AEBS/AEBS_Enabled/AEB_Determination/DtrmnThreatEvaluation/inhibit/Steer_angle_rate_inhibit" /begin REF_CHARACTERISTIC KfAEBS_StrAngRte_inhbt_AEB_trshd /end REF_CHARACTERISTIC /begin REF_MEASUREMENT VbAEBS_AEB_inhbt_StrAngRte /end REF_MEASUREMENT /end GROUP
/begin GROUP S76_speed_inhibit "AEBS_subsystem_integrated/AEBS/AEBS_Enabled/AEB_Determination/DtrmnThreatEvaluation/inhibit/speed_inhibit"
 /begin REF_CHARACTERISTIC KfAEBS_t_Time_TTCHLInhibitAEB KfAEBS_v_SpdCollisionInhibitAEB KfAEBS_v_Speed_High_InhibitAEB KfAEBS_v_Speed_MaxInhibitAEB KfAEBS_v_deltaSpeed_InhibitAEB /end REF_CHARACTERISTIC
 /begin REF_MEASUREMENT VfAEBS_HighSpeed_InhibitAEB VfAEBS_LowSpeed_InhibitAEB VfAEBS_Speed_InhibitAEB VfAEBS_VehDeltaSpeed_InhibitAEB /end REF_MEASUREMENT
/end GROUP
/begin GROUP S76_veh_acceleration_inhibit "AEBS_subsystem_integrated/AEBS/AEBS_Enabled/AEB_Determination/DtrmnThreatEvaluation/inhibit/veh_acceleration_inhibit" /begin REF_CHARACTERISTIC KtAEBS_veh_acc_inhibit_AEB_thrhd /end REF_CHARACTERISTIC /begin REF_MEASUREMENT VbAEBS_AEB_inhbt_veh_acc /end REF_MEASUREMENT /end GROUP
/begin GROUP S156_Calc_lateral_buffer "AEBS_subsystem_integrated/AEBS/AEBS_Enabled/AEB_FCWVIPTargetSelection/Calc_obs_lateral_long_buffer/Calc_Lateral_long_buffer/Calc_lateral_buffer"
 /begin SUB_GROUP S157_Bicycle S157_Motorcycle S157_Other S157_Pedestrain S157_VehicleBusTruck /end SUB_GROUP
/end GROUP
/begin GROUP S156_Calc_long_buffer "AEBS_subsystem_integrated/AEBS/AEBS_Enabled/AEB_FCWVIPTargetSelection/Calc_obs_lateral_long_buffer/Calc_Lateral_long_buffer/Calc_long_buffer"
 /begin SUB_GROUP S158_Bicycle S158_Motorcycle S158_Other S158_Pedestrain S158_VehicleBusTruck /end SUB_GROUP
/end GROUP
/begin GROUP S193_ObjDataChangeDetection "AEBS_subsystem_integrated/AEBS/AEBS_Enabled/FCW_Determination/ThreatEvaluation/Deactive/ObjDataChangeDetection" /begin REF_CHARACTERISTIC KfAEBS_Change_LateralPosThrsh KfAEBS_Change_LonglPosThrsh /end REF_CHARACTERISTIC /end GROUP
/begin GROUP S193_RaisingEdgeDelay1 "AEBS_subsystem_integrated/AEBS/AEBS_Enabled/FCW_Determination/ThreatEvaluation/Deactive/RaisingEdgeDelay1" /begin REF_MEASUREMENT VfAEBS_FCW_deacitve /end REF_MEASUREMENT /end GROUP
/begin GROUP S199_Deactive_time_inhibit "AEBS_subsystem_integrated/AEBS/AEBS_Enabled/FCW_Determination/ThreatEvaluation/inhibit/Deactive_time_inhibit" /begin REF_CHARACTERISTIC KfAEBS_t_Time_TwiceFCWActive /end REF_CHARACTERISTIC /begin REF_MEASUREMENT VbAEBS_FCW_inhbt_DeactTime /end REF_MEASUREMENT /end GROUP
/begin GROUP S78_Subsystem1 "AEBS_subsystem_integrated/AEBS/AEBS_Enabled/AEB_Determination/DtrmnThreatEvaluation/CalcObsAreq/Subsystem2/Subsystem1" /begin REF_CHARACTERISTIC KfAEBS_a_Buffer /end REF_CHARACTERISTIC /end GROUP
/begin GROUP S82_RaisingEdgeDelay2 "AEBS_subsystem_integrated/AEBS/AEBS_Enabled/AEB_Determination/DtrmnThreatEvaluation/Deactive/HighTTCDeactive/RaisingEdgeDelay2" /begin REF_MEASUREMENT VbAEBS_Deactive_R_HighTTC /end REF_MEASUREMENT /end GROUP
/begin GROUP S83_RaisingEdgeDelay "AEBS_subsystem_integrated/AEBS/AEBS_Enabled/AEB_Determination/DtrmnThreatEvaluation/Deactive/RisingEdgeDelay/RaisingEdgeDelay" /begin REF_MEASUREMENT VfAEBS_AEB_deactive /end REF_MEASUREMENT /end GROUP
/begin GROUP S84_SpeedReductionASILACheck "AEBS_subsystem_integrated/AEBS/AEBS_Enabled/AEB_Determination/DtrmnThreatEvaluation/Deactive/SpeedReductionMonitoring/SpeedReductionASILACheck"
 /begin REF_CHARACTERISTIC KfAEBS_t_Time_ResetTimeBrkThrsd KfAEBS_t_Time_ResetVeloRdctThrsd /end REF_CHARACTERISTIC
/end GROUP
/begin GROUP S85_ObjDataChangeDetection "AEBS_subsystem_integrated/AEBS/AEBS_Enabled/AEB_Determination/DtrmnThreatEvaluation/Deactive/VIPChange_Deactive/ObjDataChangeDetection" /begin REF_CHARACTERISTIC KfAEBS_Change_LateralPosThrsh KfAEBS_Change_LonglPosThrsh /end REF_CHARACTERISTIC /end GROUP
/begin GROUP S86_vipCloseLostTimeOut "AEBS_subsystem_integrated/AEBS/AEBS_Enabled/AEB_Determination/DtrmnThreatEvaluation/Deactive/VIP_lost_close/vipCloseLostTimeOut" /begin REF_CHARACTERISTIC KfAEBS_t_VipCloseLostTimeOut /end REF_CHARACTERISTIC /end GROUP
/begin GROUP S157_Bicycle "AEBS_subsystem_integrated/AEBS/AEBS_Enabled/AEB_FCWVIPTargetSelection/Calc_obs_lateral_long_buffer/Calc_Lateral_long_buffer/Calc_lateral_buffer/Bicycle" /begin REF_CHARACTERISTIC KtAEBS_LateralBuffer_Bicycle /end REF_CHARACTERISTIC /end GROUP
/begin GROUP S157_Motorcycle "AEBS_subsystem_integrated/AEBS/AEBS_Enabled/AEB_FCWVIPTargetSelection/Calc_obs_lateral_long_buffer/Calc_Lateral_long_buffer/Calc_lateral_buffer/Motorcycle" /begin REF_CHARACTERISTIC KtAEBS_LateralBuffer_Motor /end REF_CHARACTERISTIC /end GROUP
/begin GROUP S157_Other "AEBS_subsystem_integrated/AEBS/AEBS_Enabled/AEB_FCWVIPTargetSelection/Calc_obs_lateral_long_buffer/Calc_Lateral_long_buffer/Calc_lateral_buffer/Other" /begin REF_CHARACTERISTIC KtAEBS_LateralBuffer_Other /end REF_CHARACTERISTIC /end GROUP
/begin GROUP S157_Pedestrain "AEBS_subsystem_integrated/AEBS/AEBS_Enabled/AEB_FCWVIPTargetSelection/Calc_obs_lateral_long_buffer/Calc_Lateral_long_buffer/Calc_lateral_buffer/Pedestrain" /begin REF_CHARACTERISTIC KtAEBS_LateralBuffer_Pedstrn /end REF_CHARACTERISTIC /end GROUP
/begin GROUP S157_VehicleBusTruck "AEBS_subsystem_integrated/AEBS/AEBS_Enabled/AEB_FCWVIPTargetSelection/Calc_obs_lateral_long_buffer/Calc_Lateral_long_buffer/Calc_lateral_buffer/VehicleBusTruck" /begin REF_CHARACTERISTIC KtAEBS_LateralBuffer_Vehicle /end REF_CHARACTERISTIC /end GROUP
/begin GROUP S158_Bicycle "AEBS_subsystem_integrated/AEBS/AEBS_Enabled/AEB_FCWVIPTargetSelection/Calc_obs_lateral_long_buffer/Calc_Lateral_long_buffer/Calc_long_buffer/Bicycle" /begin REF_CHARACTERISTIC KtAEBS_LongBuffer_Bicycle /end REF_CHARACTERISTIC /end GROUP
/begin GROUP S158_Motorcycle "AEBS_subsystem_integrated/AEBS/AEBS_Enabled/AEB_FCWVIPTargetSelection/Calc_obs_lateral_long_buffer/Calc_Lateral_long_buffer/Calc_long_buffer/Motorcycle" /begin REF_CHARACTERISTIC KtAEBS_LongBuffer_Motor /end REF_CHARACTERISTIC /end GROUP
/begin GROUP S158_Other "AEBS_subsystem_integrated/AEBS/AEBS_Enabled/AEB_FCWVIPTargetSelection/Calc_obs_lateral_long_buffer/Calc_Lateral_long_buffer/Calc_long_buffer/Other" /begin REF_CHARACTERISTIC KtAEBS_LongBuffer_Other /end REF_CHARACTERISTIC /end GROUP
/begin GROUP S158_Pedestrain "AEBS_subsystem_integrated/AEBS/AEBS_Enabled/AEB_FCWVIPTargetSelection/Calc_obs_lateral_long_buffer/Calc_Lateral_long_buffer/Calc_long_buffer/Pedestrain" /begin REF_CHARACTERISTIC KtAEBS_LongBuffer_Pedstrn /end REF_CHARACTERISTIC /end GROUP
/begin GROUP S158_VehicleBusTruck "AEBS_subsystem_integrated/AEBS/AEBS_Enabled/AEB_FCWVIPTargetSelection/Calc_obs_lateral_long_buffer/Calc_Lateral_long_buffer/Calc_long_buffer/VehicleBusTruck" /begin REF_CHARACTERISTIC KtAEBS_LongBuffer_Vehicle /end REF_CHARACTERISTIC /end GROUP
/begin GROUP ARBT_subsystem_integrated "ARBT_subsystem_integrated" ROOT /begin SUB_GROUP Root_ARBTIntegrated /end SUB_GROUP /end GROUP
/begin GROUP Root_ARBTIntegrated "ARBT_subsystem_integrated/ARBTIntegrated"
 /begin SUB_GROUP S1_AccessoryArbitration S1_BrakeArbitration S1_PowerArbitration S1_RecordTriggerArbitration S1_SteerArbitration S1_WarningArbitration /end SUB_GROUP
/end GROUP
/begin GROUP S1_AccessoryArbitration "ARBT_subsystem_integrated/ARBTIntegrated/AccessoryArbitration"
 /begin SUB_GROUP S3_DtrmnVehStandStill S3_ElectricParkingBrakeControl S3_GearPosControl /end SUB_GROUP
 /begin REF_CHARACTERISTIC KbARBT_SLEW_autohold_active KbARBT_SLEW_gear_ctrl_accel_req KfARBT_autohold_timeout /end REF_CHARACTERISTIC
/end GROUP
/begin GROUP S1_BrakeArbitration "ARBT_subsystem_integrated/ARBTIntegrated/BrakeArbitration"
 /begin REF_CHARACTERISTIC KfARBT_brake_req_lon_a_lowerlimit KfARBT_brake_req_lon_a_upperlimit /end REF_CHARACTERISTIC
 /begin REF_MEASUREMENT VbARBT_brake_ctrl_enbl_to_comm VeARBT_brake_arbt_winner VfARBT_brake_req_lon_a VfARBT_brake_req_lon_a_raw /end REF_MEASUREMENT
/end GROUP
/begin GROUP S1_PowerArbitration "ARBT_subsystem_integrated/ARBTIntegrated/PowerArbitration"
 /begin REF_CHARACTERISTIC KbARBT_power_req_mode_man_ctrl_temp KfARBT_power_req_lon_a_lowerlimit KfARBT_power_req_lon_a_upperlimit /end REF_CHARACTERISTIC
 /begin REF_MEASUREMENT VbARBT_power_ctrl_enbl_to_comm VeARBT_power_arbt_winner VfARBT_power_req_lon_a VfARBT_power_req_lon_a_raw VfARBT_power_req_mode VfARBT_power_req_torque /end REF_MEASUREMENT
/end GROUP
/begin GROUP S1_RecordTriggerArbitration "ARBT_subsystem_integrated/ARBTIntegrated/RecordTriggerArbitration"
 /begin REF_CHARACTERISTIC KfARBT_brk_ped_pos_thrsh_rec_trig KfARBT_lon_a_thrsh_rec_trig KfARBT_t_false_aeb_time_gap_thrsh KfARBT_t_hard_brake_debounce_time KfARBT_t_hard_brake_time_out KfARBT_t_missed_aeb_time_gap_thrsh /end REF_CHARACTERISTIC
 /begin REF_MEASUREMENT VbARBT_aeb_triggered_flag VbARBT_driver_hard_brake_flag VbARBT_false_aeb_flag VbARBT_missed_aeb_flag /end REF_MEASUREMENT
/end GROUP
/begin GROUP S1_SteerArbitration "ARBT_subsystem_integrated/ARBTIntegrated/SteerArbitration"
 /begin REF_CHARACTERISTIC KfARBT_steer_req_strwhl_angle_lowerlimit KfARBT_steer_req_strwhl_angle_upperlimit /end REF_CHARACTERISTIC
 /begin REF_MEASUREMENT VbARBT_steer_ctrl_enbl_to_comm VeARBT_steer_arbt_winner VfARBT_steer_req_mode VfARBT_steer_req_strwhl_angle VfARBT_steer_req_strwhl_angle_raw VfARBT_steer_req_strwhl_torque /end REF_MEASUREMENT
/end GROUP
/begin GROUP S1_WarningArbitration "ARBT_subsystem_integrated/ARBTIntegrated/WarningArbitration"
 /begin REF_MEASUREMENT VbARBT_BSD_left_high_raw VbARBT_BSD_left_low_raw VbARBT_BSD_right_high_raw VbARBT_BSD_right_low_raw VbARBT_FCW_level_five VbARBT_FCW_level_four VbARBT_FCW_level_one VbARBT_FCW_level_three VbARBT_FCW_level_two VbARBT_LCA_left_high_raw VbARBT_LCA_left_low_raw VbARBT_LCA_right_high_raw VbARBT_LCA_right_low_raw VbARBT_LDW_left VbARBT_LDW_right VbARBT_warn_lcw_left_req VbARBT_warn_lcw_right_req /end REF_MEASUREMENT
/end GROUP
/begin GROUP S3_DtrmnVehStandStill "ARBT_subsystem_integrated/ARBTIntegrated/AccessoryArbitration/DtrmnVehStandStill"
 /begin REF_CHARACTERISTIC KfARBT_t_speed_debounce_time KfARBT_v_moving_speed_thrsh KfARBT_v_standstill_speed_thrsh /end REF_CHARACTERISTIC
 /begin REF_MEASUREMENT VbARBT_vehicle_standstill /end REF_MEASUREMENT
/end GROUP
/begin GROUP S3_ElectricParkingBrakeControl "ARBT_subsystem_integrated/ARBTIntegrated/AccessoryArbitration/ElectricParkingBrakeControl" /begin REF_CHARACTERISTIC KbARBT_gear_pos_fedbck_valid /end REF_CHARACTERISTIC
 /begin REF_MEASUREMENT VbARBT_EPB_ctrl_enbl_to_comm VbARBT_EPB_ctrl_mode VbARBT_EPB_switch_request /end REF_MEASUREMENT
/end GROUP
/begin GROUP S3_GearPosControl "ARBT_subsystem_integrated/ARBTIntegrated/AccessoryArbitration/GearPosControl"
 /begin REF_MEASUREMENT VbARBT_auto_hold_req VbARBT_gear_ctrl_enbl_to_comm VfARBT_gear_ctrl_state VfARBT_gear_pos_req /end REF_MEASUREMENT
/end GROUP
/begin GROUP COMM_subsystem_integrated "COMM_subsystem_integrated" ROOT /begin SUB_GROUP Root_Receive Root_Transmit /end SUB_GROUP
 /begin REF_MEASUREMENT VbHWIO_DriverModeComd VbHWIO_LeftTurningLightState VbHWIO_RightTurningLightState /end REF_MEASUREMENT
/end GROUP
/begin GROUP Root_Receive "COMM_subsystem_integrated/Receive" /begin SUB_GROUP S1_Subsystem S1_iEV7S S1_iVISTA /end SUB_GROUP /begin REF_CHARACTERISTIC KbCOMM_VEH_UseNewConfig KcCOMM_VehicleCANbusConfig /end REF_CHARACTERISTIC
 /begin REF_MEASUREMENT VbCOMM_HandsOffWheelDetected VbCOMM_HandsOnWheelDetected VcCOMM_Auto_To_Manual_Tips VcCOMM_Decs_FedBck_BrkPedSts VcCOMM_Decs_FedBck_Drivemod VcCOMM_Decs_FedBck_EPBstate VcCOMM_Decs_FedBck_EPSmod VcCOMM_Decs_FedBck_ESCmod VcCOMM_Decs_FedBck_GearValue VcCOMM_Decs_FedBck_KeyState VcCOMM_DriverModeComd VcCOMM_VCU_DirIndicationLH VcCOMM_VCU_DirIndicationRH VcCOMM_VCU_HeadLampHighBeam VcCOMM_VCU_HeadLampLowBeam VfCOMM_AccPedl VfCOMM_Actual_Gear_Ratio VfCOMM_Decs_FedBck_StrAngle VfCOMM_Decs_FedBck_VehSpd VfCOMM_EPS_SteeringTorqueAct VfCOMM_VCU_BrkPedPos VfCOMM_VCU_ESCWhlFLSpd VfCOMM_VCU_ESCWhlFRSpd VfCOMM_VCU_ESCWhlRLSpd VfCOMM_VCU_ESCWhlRRSpd VfCOMM_VCU_LateralAcc VfCOMM_VCU_LongitudinalAcc VfCOMM_VCU_YawRate /end REF_MEASUREMENT
/end GROUP
/begin GROUP Root_Transmit "COMM_subsystem_integrated/Transmit" /begin SUB_GROUP S2_FAW S2_ICPV S2_Test_Mode /end SUB_GROUP
 /begin REF_CHARACTERISTIC KcCOMM_Test_Cmd_EPSXBW_En KcCOMM_Test_Cmd_EPSXBW_En_ovr KcCOMM_Test_Cmd_StrAngle KcCOMM_Test_Cmd_StrAngle_ovr KcCOMM_Test_Decs_Acc_Req KcCOMM_Test_Decs_Acc_Req_ovr KcCOMM_Test_Decs_Acc_Value KcCOMM_Test_Decs_Acc_Value_ovr KcCOMM_Test_Decs_Breake_Req KcCOMM_Test_Decs_Breake_Req_ovr KcCOMM_Test_Decs_Breake_Value KcCOMM_Test_Decs_Breake_Value_ovr KcCOMM_Test_mode KcCOMM_VehicleCANbusConfig /end REF_CHARACTERISTIC
 /begin REF_MEASUREMENT VbCOMM_Decs_BckfogLmp_Req VbCOMM_Decs_BrkLight_Req VbCOMM_Decs_DippedBeam_Req VbCOMM_Decs_FrontFogLamp_Req VbCOMM_Decs_HighBeam_Req VbCOMM_Decs_Horn_Req VbCOMM_Decs_LftLmp_Req VbCOMM_Decs_Light_Req VbCOMM_Decs_RihtLmp_Req VbCOMM_Decs_WarnLight_Req VbCOMM_Decs_iBCM_Req VcCOMM_Decs_Acc_Req VcCOMM_Decs_Breake_Req VcCOMM_Decs_Control_mod VcCOMM_Decs_Gear_Req VcCOMM_Decs_Gear_Value VcCOMM_Decs_Steering_Req VcCOMM_EPB_control_enable VcCOMM_EPB_switch_request VfCOMM_Decs_Acc_Value VfCOMM_Decs_Breake_Value VfCOMM_Decs_SteeringAngle VfCOMM_req_pct_torque_raw /end REF_MEASUREMENT
/end GROUP
/begin GROUP S1_Subsystem "COMM_subsystem_integrated/Receive/Subsystem"
 /begin REF_CHARACTERISTIC KfACCS_d_VEH_WheelDiameter KfCOMM_Ang_VEH_AngOrigin2FrontWheel KfCOMM_VEH_Mass KfCOMM_VEH_StiffnessFront KfCOMM_VEH_StiffnessRear KfCOMM_VEH_YawInertia_Z KfCOMM_d_VEH_DisCentorid2Front KfCOMM_d_VEH_DisFront2Rear KfCOMM_d_VEH_DisLeft2Right KfCOMM_d_VEH_DisOrigin2End KfCOMM_d_VEH_DisOrigin2FrontWheel KfCOMM_d_VEH_DisOrigin2Head KfCOMM_d_VEH_DisOrigin2RearAxle KfCOMM_d_VEH_Length KfCOMM_d_VEH_MinTurnRadius KfCOMM_d_VEH_Width /end REF_CHARACTERISTIC
/end GROUP
/begin GROUP S1_iEV7S "COMM_subsystem_integrated/Receive/iEV7S" /begin REF_CHARACTERISTIC KfCOMM_a_VCULongAccOffset KfCOMM_r_VCULongAccSlope /end REF_CHARACTERISTIC /end GROUP
/begin GROUP S1_iVISTA "COMM_subsystem_integrated/Receive/iVISTA" /begin REF_CHARACTERISTIC KfCOMM_a_VCULongAccOffset KfCOMM_r_VCULongAccSlope /end REF_CHARACTERISTIC /end GROUP
/begin GROUP S2_FAW "COMM_subsystem_integrated/Transmit/FAW" /begin SUB_GROUP S40_Command_Mapping /end SUB_GROUP /begin REF_CHARACTERISTIC KcCOMM_FirstGearRatio /end REF_CHARACTERISTIC /begin REF_MEASUREMENT VfCOMM_req_pct_torque_final /end REF_MEASUREMENT /end GROUP
/begin GROUP S2_ICPV "COMM_subsystem_integrated/Transmit/ICPV" /begin SUB_GROUP S41_EPB_clamped S41_EPB_released S41_EPB_releasing /end SUB_GROUP
 /begin REF_CHARACTERISTIC KcCOMM_BrakePedalMax KcCOMM_BrakePedalMin KcCOMM_GasPedalMax KcCOMM_GasPedalMin /end REF_CHARACTERISTIC
 /begin REF_MEASUREMENT VcCOMM_max_gas_pedal_EPB /end REF_MEASUREMENT
/end GROUP
/begin GROUP S2_Test_Mode "COMM_subsystem_integrated/Transmit/Test_Mode"
 /begin REF_CHARACTERISTIC KbCOMM_Test_BckFogLamp_Req KbCOMM_Test_BrakePrechargeRequest KbCOMM_Test_BrakePriorityMode KbCOMM_Test_Cmd_BrakeLightReq KbCOMM_Test_Cmd_EPSDir KbCOMM_Test_Decs_DippedBeam_Req KbCOMM_Test_Decs_HighBeam_Req KbCOMM_Test_Decs_LftLmp_Req KbCOMM_Test_Decs_Light_Req KbCOMM_Test_Decs_RihtLmp_Req KbCOMM_Test_Decs_iBCM_Req KbCOMM_Test_FrontFogLamp_Req KbCOMM_Test_Horn_Req KbCOMM_Test_HummerSts KbCOMM_Test_WarnLight_Req KcCOMM_Test_Checksum_0x150 KcCOMM_Test_Checksum_0x151 KcCOMM_Test_Cmd_ATOModEnable KcCOMM_Test_Cmd_AccPelEnable KcCOMM_Test_Cmd_AccPelPosAct KcCOMM_Test_Cmd_AccPelPosActInv KcCOMM_Test_Cmd_BrkPelEnable KcCOMM_Test_Cmd_BrkPelPosAct KcCOMM_Test_Cmd_BrkPelPosActInv KcCOMM_Test_Cmd_Checksum KcCOMM_Test_Cmd_EPSXBW_En KcCOMM_Test_Cmd_ICPDTC KcCOMM_Test_Cmd_RCnt KcCOMM_Test_Cmd_StrAngle KcCOMM_Test_Cmd_StrAngleLimit KcCOMM_Test_Cmd_StrAngleSpd KcCOMM_Test_Cmd_TgtSft KcCOMM_Test_Cmd_TgtSftEnable KcCOMM_Test_Cmd_VCUCnt KcCOMM_Test_Decs_Acc_Mod KcCOMM_Test_Decs_Acc_Req KcCOMM_Test_Decs_Acc_Value KcCOMM_Test_Decs_Breake_Req KcCOMM_Test_Decs_Breake_Value KcCOMM_Test_Over_Speed KcCOMM_Test_RCnt_0x150 KcCOMM_Test_RCnt_0x151 KcCOMM_Test_SlowDown_Indication KcCOMM_Test_SpeedUp_Indication KcCOMM_Test_Stop_Request KcCOMM_Test_Tar_Torq KcCOMM_Test_Tar_vehiclespd KcCOMM_Test_XBR_EBI_Mode KcCOMM_Test_XBR_Priority KcCOMM_Test_acceleration_fb KcCOMM_Test_cmd_VCUChecksum KcCOMM_Test_driveoff_Req KcCOMM_Test_yaw_rate_fb /end REF_CHARACTERISTIC
/end GROUP
/begin GROUP S40_Command_Mapping "COMM_subsystem_integrated/Transmit/FAW/Command_Mapping" /begin SUB_GROUP S46_T03 /end SUB_GROUP /begin REF_CHARACTERISTIC KbCOMM_Test_Decs_iBCM_Req /end REF_CHARACTERISTIC /end GROUP
/begin GROUP S41_EPB_clamped "COMM_subsystem_integrated/Transmit/ICPV/EPB_clamped" /begin REF_CHARACTERISTIC KcCOMM_GasPedalMinEPB /end REF_CHARACTERISTIC /end GROUP
/begin GROUP S41_EPB_released "COMM_subsystem_integrated/Transmit/ICPV/EPB_released" /begin REF_CHARACTERISTIC KcCOMM_GasPedalMax KcCOMM_GasPedalRampEPB /end REF_CHARACTERISTIC /end GROUP
/begin GROUP S41_EPB_releasing "COMM_subsystem_integrated/Transmit/ICPV/EPB_releasing" /begin REF_CHARACTERISTIC KcCOMM_GasPedalMaxEPB KcCOMM_GasPedalRampEPB /end REF_CHARACTERISTIC /end GROUP
/begin GROUP S46_T03 "COMM_subsystem_integrated/Transmit/FAW/Command_Mapping/T03"
 /begin REF_CHARACTERISTIC KcCOMM_TorqCtrlPriority_Active KcCOMM_TorqCtrlPriority_Default /end REF_CHARACTERISTIC
/end GROUP
/begin GROUP DCSN_subsystem_integrated "DCSN_subsystem_integrated" ROOT /begin SUB_GROUP Root_DtrmnDCSN_Integrated /end SUB_GROUP /end GROUP
/begin GROUP Root_DtrmnDCSN_Integrated "DCSN_subsystem_integrated/DtrmnDCSN_Integrated"
 /begin SUB_GROUP S1_DtrmnDCSN_ADM S1_DtrmnDCSN_EnablingManager S1_DtrmnDCSN_TrafficDecider /end SUB_GROUP
/end GROUP
/begin GROUP S1_DtrmnDCSN_ADM "DCSN_subsystem_integrated/DtrmnDCSN_Integrated/DtrmnDCSN_ADM"
 /begin SUB_GROUP S3_CheckDCSN_ACCS_mode S3_CheckDCSN_UsrSwitchStatus S3_DtrmnDCSN_ADMMainManager S3_DtrmnDCSN_DRIVIintentionSimu S3_DtrmnDCSN_InitializationManager /end SUB_GROUP
 /begin REF_CHARACTERISTIC KbDCSN_accs_resume_man_enbl KbDCSN_accs_resume_man_value KbDCSN_use_EgmoLinearSpeed KbDCSN_use_EgmoReadyFlag KbDCSN_use_MpfuReadyFlag /end REF_CHARACTERISTIC
 /begin REF_MEASUREMENT VbDCSN_accs_resume /end REF_MEASUREMENT
/end GROUP
/begin GROUP S1_DtrmnDCSN_EnablingManager "DCSN_subsystem_integrated/DtrmnDCSN_Integrated/DtrmnDCSN_EnablingManager"
 /begin SUB_GROUP S4_DtrmnDCSN_ActiveFeatureSwitch S4_DtrmnDCSN_AutoDriveModeManager S4_DtrmnDCSN_EpbCtrlSwitch S4_DtrmnDCSN_GearCtrlSwitch S4_DtrmnDCSN_PowerControlInhibit S4_DtrmnDCSN_SteerCtrlSwitch S4_Dtrmn_EnablingFlagsOSP /end SUB_GROUP
 /begin REF_CHARACTERISTIC KbDCSN_aeb_usr_switch KbDCSN_bsd_usr_switch KbDCSN_dow_usr_switch KbDCSN_fcta_usr_switch KbDCSN_fcw_usr_switch KbDCSN_lca_usr_switch KbDCSN_lcw_usr_switch KbDCSN_ldw_usr_switch KbDCSN_lka_usr_switch KbDCSN_rcta_usr_switch KbDCSN_use_EgmoReadyFlag /end REF_CHARACTERISTIC
/end GROUP
/begin GROUP S1_DtrmnDCSN_TrafficDecider "DCSN_subsystem_integrated/DtrmnDCSN_Integrated/DtrmnDCSN_TrafficDecider"
 /begin SUB_GROUP S5_CalcDCSN_OverSpeedWarning S5_CalcDCSN_SpeedLimit S5_CalcDCSN_StopRequest S5_CheckDCSN_InputDataValidity S5_CvrtDCSN_DataSelector S5_DtrmnDCSN_ChangeLaneReq S5_MngDCSN_TrafficDeciderManager S5_MngDCSN_TrafficDeciderOutputM /end SUB_GROUP
/end GROUP
/begin GROUP S3_CheckDCSN_ACCS_mode "DCSN_subsystem_integrated/DtrmnDCSN_Integrated/DtrmnDCSN_ADM/CheckDCSN_ACCS_mode" /begin REF_MEASUREMENT VbDCSN_ACC_ready_to_engage /end REF_MEASUREMENT /end GROUP
/begin GROUP S3_CheckDCSN_UsrSwitchStatus "DCSN_subsystem_integrated/DtrmnDCSN_Integrated/DtrmnDCSN_ADM/CheckDCSN_UsrSwitchStatus"
 /begin REF_CHARACTERISTIC KbDCSN_use_vehicle_activate_switch KcDCSN_t_usr_activate_cmd_send_count KeDCSN_usr_cmd_autodrive_activate_man /end REF_CHARACTERISTIC
 /begin REF_MEASUREMENT VeDCSN_usr_cmd_autodrive_activate /end REF_MEASUREMENT
/end GROUP
/begin GROUP S3_DtrmnDCSN_ADMMainManager "DCSN_subsystem_integrated/DtrmnDCSN_Integrated/DtrmnDCSN_ADM/DtrmnDCSN_ADMMainManager"
 /begin SUB_GROUP S8_CheckDCSN_StateCheck S8_CheckDCSN_SystemFaultCheck S8_DtrmnDCSN_CondActivation /end SUB_GROUP
 /begin REF_CHARACTERISTIC KbDCSN_adm_main_mode_man_ctrl KbDCSN_adm_temp_stop_finished KbDCSN_adm_temp_usr_cmd_autodrive_enabled KbDCSN_takeover_warning_close KeDCSN_adm_main_mode_man_value KeDCSN_adm_temp_diag_system_fault KfDCSN_t_max_time_fault_warning KfDCSN_t_max_time_to_takeover KfDCSN_v_adm_temp_veh_setspeed /end REF_CHARACTERISTIC
 /begin REF_MEASUREMENT VeDCSN_adm_main_mode VeDCSN_hmi_icon_display VeDCSN_hmi_msg_display /end REF_MEASUREMENT
/end GROUP
/begin GROUP S3_DtrmnDCSN_DRIVIintentionSimu "DCSN_subsystem_integrated/DtrmnDCSN_Integrated/DtrmnDCSN_ADM/DtrmnDCSN_DRIVIintentionSimu"
 /begin SUB_GROUP S9_DtrmnDCSN_FAWTorqueOverride S9_DtrmnDCSN_TakeOverLogicFAW S9_SteerOvrrideTorque S9_SteerResumeTorque /end SUB_GROUP
 /begin REF_CHARACTERISTIC KfDCSN_t_adm_temp_steering_ovrd_delay KfDCSN_t_adm_temp_steering_resume_delay /end REF_CHARACTERISTIC
 /begin REF_MEASUREMENT VbDCSN_adm_steering_override VbDCSN_adm_steering_resume /end REF_MEASUREMENT
/end GROUP
/begin GROUP S3_DtrmnDCSN_InitializationManager "DCSN_subsystem_integrated/DtrmnDCSN_Integrated/DtrmnDCSN_ADM/DtrmnDCSN_InitializationManager"
 /begin REF_CHARACTERISTIC KbDCSN_SLEW_initialization_finished KbDCSN_use_faw_l4_logic /end REF_CHARACTERISTIC
 /begin REF_MEASUREMENT VbDCSN_initialization_finished /end REF_MEASUREMENT
/end GROUP
/begin GROUP S4_DtrmnDCSN_ActiveFeatureSwitch "DCSN_subsystem_integrated/DtrmnDCSN_Integrated/DtrmnDCSN_EnablingManager/DtrmnDCSN_ActiveFeatureSwitch" /begin REF_CHARACTERISTIC KbDCSN_alca_usr_switch /end REF_CHARACTERISTIC /end GROUP
/begin GROUP S4_DtrmnDCSN_AutoDriveModeManager "DCSN_subsystem_integrated/DtrmnDCSN_Integrated/DtrmnDCSN_EnablingManager/DtrmnDCSN_AutoDriveModeManager"
 /begin SUB_GROUP S53_DtrmnDCSN_ACCSResumeReq S53_DtrmnDCSN_AutodriveActDelay S53_DtrmnDCSN_ReActivateLogicFAW /end SUB_GROUP
 /begin REF_CHARACTERISTIC KbDCSN_use_SLEW_switch_control_mode KfDCSN_t_autodrive_max_wait_time /end REF_CHARACTERISTIC
/end GROUP
/begin GROUP S4_DtrmnDCSN_EpbCtrlSwitch "DCSN_subsystem_integrated/DtrmnDCSN_Integrated/DtrmnDCSN_EnablingManager/DtrmnDCSN_EpbCtrlSwitch" /begin REF_CHARACTERISTIC KbDCSN_use_faw_l4_logic /end REF_CHARACTERISTIC /end GROUP
/begin GROUP S4_DtrmnDCSN_GearCtrlSwitch "DCSN_subsystem_integrated/DtrmnDCSN_Integrated/DtrmnDCSN_EnablingManager/DtrmnDCSN_GearCtrlSwitch" /begin REF_CHARACTERISTIC KbDCSN_use_faw_l4_logic /end REF_CHARACTERISTIC /end GROUP
/begin GROUP S4_DtrmnDCSN_PowerControlInhibit "DCSN_subsystem_integrated/DtrmnDCSN_Integrated/DtrmnDCSN_EnablingManager/DtrmnDCSN_PowerControlInhibit"
 /begin REF_CHARACTERISTIC KbDCSN_inhibit_power_for_eps_enable KfDCSN_t_max_eps_inhibit_power /end REF_CHARACTERISTIC
 /begin REF_MEASUREMENT VbDCSN_power_control_inhibit /end REF_MEASUREMENT
/end GROUP
/begin GROUP S4_DtrmnDCSN_SteerCtrlSwitch "DCSN_subsystem_integrated/DtrmnDCSN_Integrated/DtrmnDCSN_EnablingManager/DtrmnDCSN_SteerCtrlSwitch"
 /begin REF_CHARACTERISTIC KbDCSN_adm_main_mode_man_ctrl KbDCSN_use_SLEW_override_logic /end REF_CHARACTERISTIC
/end GROUP
/begin GROUP S4_Dtrmn_EnablingFlagsOSP "DCSN_subsystem_integrated/DtrmnDCSN_Integrated/DtrmnDCSN_EnablingManager/Dtrmn_EnablingFlagsOSP"
 /begin REF_CHARACTERISTIC KbDCSN_SLEW_DriveModeComd_enbl KbDCSN_SLEW_DriveModeComd_value KbDCSN_acc_man_enbl KbDCSN_active_feature_man_ctrl KbDCSN_aeb_man_enbl KbDCSN_alca_man_enbl KbDCSN_brake_ctrl_man_enbl KbDCSN_brake_ctrl_man_value KbDCSN_bsd_man_enbl KbDCSN_control_mode_man_enbl KbDCSN_dow_man_enbl KbDCSN_epb_ctrl_man_enbl KbDCSN_epb_ctrl_man_value KbDCSN_fcta_man_enbl KbDCSN_fcw_man_enbl KbDCSN_gear_ctrl_man_enbl KbDCSN_gear_ctrl_man_value KbDCSN_lca_man_enbl KbDCSN_lcc_man_enbl KbDCSN_lcw_man_enbl KbDCSN_ldw_man_enbl KbDCSN_lka_man_enbl KbDCSN_passive_feature_man_ctrl KbDCSN_power_ctrl_man_enbl KbDCSN_power_ctrl_man_value KbDCSN_rcta_man_enbl KbDCSN_steer_ctrl_man_enbl KbDCSN_steer_ctrl_man_value KeDCSN_control_mode_man_value /end REF_CHARACTERISTIC
 /begin REF_MEASUREMENT VbDCSN_acc_feature_enable VbDCSN_aeb_feature_enable VbDCSN_alca_feature_enable VbDCSN_brake_ctrl_enable VbDCSN_bsd_feature_enable VbDCSN_dow_feature_enable VbDCSN_epb_ctrl_enable VbDCSN_fcta_feature_enable VbDCSN_fcw_feature_enable VbDCSN_gear_ctrl_enable VbDCSN_lca_feature_enable VbDCSN_lcc_feature_enable VbDCSN_lcw_feature_enable VbDCSN_ldw_feature_enable VbDCSN_lka_feature_enable VbDCSN_power_ctrl_enable VbDCSN_rcta_feature_enable VbDCSN_steer_ctrl_enable VeDCSN_autodrive_control_mode /end REF_MEASUREMENT
/end GROUP
/begin GROUP S5_CalcDCSN_OverSpeedWarning "DCSN_subsystem_integrated/DtrmnDCSN_Integrated/DtrmnDCSN_TrafficDecider/CalcDCSN_OverSpeedWarning"
 /begin REF_CHARACTERISTIC KbDCSN_enable_warning_no_input KfDCSN_v_default_warning_speed KfDCSN_v_overspeed_warning_extra /end REF_CHARACTERISTIC
 /begin REF_MEASUREMENT VbDCSN_overspeed_warning /end REF_MEASUREMENT
/end GROUP
/begin GROUP S5_CalcDCSN_SpeedLimit "DCSN_subsystem_integrated/DtrmnDCSN_Integrated/DtrmnDCSN_TrafficDecider/CalcDCSN_SpeedLimit"
 /begin SUB_GROUP S67_CalcDCSN_curvature_speed_limit S67_CalcDCSN_ego_lane_speed_limit /end SUB_GROUP
/end GROUP
/begin GROUP S5_CalcDCSN_StopRequest "DCSN_subsystem_integrated/DtrmnDCSN_Integrated/DtrmnDCSN_TrafficDecider/CalcDCSN_StopRequest"
 /begin SUB_GROUP S68_CalcDCSN_RawStopDistance S68_CalcDCSN_SLEWStopDistance S68_CalcDCSN_StopReasonDistance /end SUB_GROUP
/end GROUP
/begin GROUP S5_CheckDCSN_InputDataValidity "DCSN_subsystem_integrated/DtrmnDCSN_Integrated/DtrmnDCSN_TrafficDecider/CheckDCSN_InputDataValidity"
 /begin REF_MEASUREMENT VbDCSN_egmo_is_ready VbDCSN_input_is_ready VbDCSN_mpfu_is_ready /end REF_MEASUREMENT
/end GROUP
/begin GROUP S5_CvrtDCSN_DataSelector "DCSN_subsystem_integrated/DtrmnDCSN_Integrated/DtrmnDCSN_TrafficDecider/CvrtDCSN_DataSelector"
 /begin SUB_GROUP S70_CheckDCSN_num_lane_markers_isNaN S70_CheckDCSN_num_lanes_isNaN S70_CheckDCSN_num_road_edges_isNaN S70_CheckDCSN_num_stop_lines_isNaN /end SUB_GROUP
 /begin REF_MEASUREMENT VbDCSN_accs_stop_finished VfDCSN_vehicle_speed_egmo /end REF_MEASUREMENT
/end GROUP
/begin GROUP S5_DtrmnDCSN_ChangeLaneReq "DCSN_subsystem_integrated/DtrmnDCSN_Integrated/DtrmnDCSN_TrafficDecider/DtrmnDCSN_ChangeLaneReq" /begin SUB_GROUP S71_DtrmnDCSN_UsrChangeLaneReq /end SUB_GROUP /end GROUP
/begin GROUP S5_MngDCSN_TrafficDeciderManager "DCSN_subsystem_integrated/DtrmnDCSN_Integrated/DtrmnDCSN_TrafficDecider/MngDCSN_TrafficDeciderManager"
 /begin REF_CHARACTERISTIC KbDCSN_change_lane_enable KbDCSN_overspeed_warning_enable KbDCSN_speed_limit_enable KbDCSN_stop_request_enable /end REF_CHARACTERISTIC
 /begin REF_MEASUREMENT VbDCSN_speed_limit_enabled VbDCSN_stop_request_enabled /end REF_MEASUREMENT
/end GROUP
/begin GROUP S9_DtrmnDCSN_FAWTorqueOverride "DCSN_subsystem_integrated/DtrmnDCSN_Integrated/DtrmnDCSN_ADM/DtrmnDCSN_DRIVIintentionSimu/DtrmnDCSN_FAWTorqueOverride" /begin REF_CHARACTERISTIC KbDCSN_use_faw_l4_logic /end REF_CHARACTERISTIC /end GROUP
/begin GROUP S9_DtrmnDCSN_TakeOverLogicFAW "DCSN_subsystem_integrated/DtrmnDCSN_Integrated/DtrmnDCSN_ADM/DtrmnDCSN_DRIVIintentionSimu/DtrmnDCSN_TakeOverLogicFAW" /begin REF_CHARACTERISTIC KbDCSN_use_faw_l4_logic /end REF_CHARACTERISTIC /end GROUP
/begin GROUP S9_SteerOvrrideTorque "DCSN_subsystem_integrated/DtrmnDCSN_Integrated/DtrmnDCSN_ADM/DtrmnDCSN_DRIVIintentionSimu/SteerOvrrideTorque" /begin REF_CHARACTERISTIC KbDCSN_use_faw_l4_logic /end REF_CHARACTERISTIC /end GROUP
/begin GROUP S9_SteerResumeTorque "DCSN_subsystem_integrated/DtrmnDCSN_Integrated/DtrmnDCSN_ADM/DtrmnDCSN_DRIVIintentionSimu/SteerResumeTorque" /begin REF_CHARACTERISTIC KbDCSN_use_faw_l4_logic /end REF_CHARACTERISTIC /end GROUP
/begin GROUP S53_DtrmnDCSN_ACCSResumeReq "DCSN_subsystem_integrated/DtrmnDCSN_Integrated/DtrmnDCSN_EnablingManager/DtrmnDCSN_AutoDriveModeManager/DtrmnDCSN_ACCSResumeReq" /begin REF_CHARACTERISTIC KbDCSN_use_faw_l4_logic /end REF_CHARACTERISTIC /end GROUP
/begin GROUP S53_DtrmnDCSN_AutodriveActDelay "DCSN_subsystem_integrated/DtrmnDCSN_Integrated/DtrmnDCSN_EnablingManager/DtrmnDCSN_AutoDriveModeManager/DtrmnDCSN_AutodriveActDelay" /begin REF_CHARACTERISTIC KbDCSN_use_faw_l4_logic /end REF_CHARACTERISTIC /end GROUP
/begin GROUP S53_DtrmnDCSN_ReActivateLogicFAW "DCSN_subsystem_integrated/DtrmnDCSN_Integrated/DtrmnDCSN_EnablingManager/DtrmnDCSN_AutoDriveModeManager/DtrmnDCSN_ReActivateLogicFAW" /begin REF_CHARACTERISTIC KbDCSN_use_faw_l4_logic /end REF_CHARACTERISTIC /end GROUP
/begin GROUP S15_CheckDCSN_VehicleActivation "DCSN_subsystem_integrated/DtrmnDCSN_Integrated/DtrmnDCSN_ADM/DtrmnDCSN_ADMMainManager/CheckDCSN_StateCheck/CheckDCSN_ActivationStateCheck/CheckDCSN_VehicleActivation" /begin REF_CHARACTERISTIC KbDCSN_use_faw_l4_logic /end REF_CHARACTERISTIC /end GROUP
/begin GROUP S16_CheckDCSN_VehicleExit "DCSN_subsystem_integrated/DtrmnDCSN_Integrated/DtrmnDCSN_ADM/DtrmnDCSN_ADMMainManager/CheckDCSN_StateCheck/CheckDCSN_ExitStateCheck/CheckDCSN_VehicleExit" /begin REF_CHARACTERISTIC KbDCSN_use_faw_l4_logic /end REF_CHARACTERISTIC /end GROUP
/end MODULE
/end PROJECT
