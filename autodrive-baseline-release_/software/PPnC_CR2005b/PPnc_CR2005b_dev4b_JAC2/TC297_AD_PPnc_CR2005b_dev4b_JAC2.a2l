ASAP2_VERSION 1 60
/begin PROJECT hj_adcu "_default_ProjectLongIdentifier"
/begin HEADER "_default_HeaderComment" PROJECT_NO _default_ProjectNr /end HEADER
/begin MODULE _default_ModuleName "_default_ModuleLongIdentifier"
/begin MOD_COMMON "_default_ModCommonComment" DEPOSIT ABSOLUTE BYTE_ORDER MSB_LAST ALIGNMENT_BYTE 1 ALIGNMENT_WORD 2 ALIGNMENT_LONG 4 ALIGNMENT_FLOAT32_IEEE 4 ALIGNMENT_FLOAT64_IEEE 4 /end MOD_COMMON
/begin MOD_COMMON "Mod Common Comment Here" BYTE_ORDER MSB_LAST /end MOD_COMMON
/begin RECORD_LAYOUT Scalar_BOOLEAN FNC_VALUES 1 UBYTE COLUMN_DIR DIRECT /end RECORD_LAYOUT
/begin RECORD_LAYOUT Scalar_UBYTE FNC_VALUES 1 UBYTE COLUMN_DIR DIRECT /end RECORD_LAYOUT
/begin RECORD_LAYOUT Scalar_UWORD FNC_VALUES 1 UWORD COLUMN_DIR DIRECT /end RECORD_LAYOUT
/begin RECORD_LAYOUT Scalar_FLOAT32_IEEE FNC_VALUES 1 FLOAT32_IEEE COLUMN_DIR DIRECT /end RECORD_LAYOUT
/begin RECORD_LAYOUT Lookup1D_FLOAT32_IEEE FNC_VALUES 1 FLOAT32_IEEE COLUMN_DIR DIRECT /end RECORD_LAYOUT
/begin RECORD_LAYOUT Lookup1D_X_FLOAT32_IEEE AXIS_PTS_X 1 FLOAT32_IEEE INDEX_INCR DIRECT /end RECORD_LAYOUT
/begin RECORD_LAYOUT Lookup2D_X_BOOLEAN AXIS_PTS_X 1 UBYTE INDEX_INCR DIRECT /end RECORD_LAYOUT
/begin RECORD_LAYOUT Lookup2D_UBYTE FNC_VALUES 1 UBYTE COLUMN_DIR DIRECT /end RECORD_LAYOUT
/begin RECORD_LAYOUT Lookup2D_X_UBYTE AXIS_PTS_X 1 UBYTE INDEX_INCR DIRECT /end RECORD_LAYOUT
/begin RECORD_LAYOUT Lookup2D_BYTE FNC_VALUES 1 SBYTE COLUMN_DIR DIRECT /end RECORD_LAYOUT
/begin RECORD_LAYOUT Lookup2D_X_BYTE AXIS_PTS_X 1 SBYTE INDEX_INCR DIRECT /end RECORD_LAYOUT
/begin RECORD_LAYOUT Lookup2D_UWORD FNC_VALUES 1 UWORD COLUMN_DIR DIRECT /end RECORD_LAYOUT
/begin RECORD_LAYOUT Lookup2D_X_UWORD AXIS_PTS_X 1 UWORD INDEX_INCR DIRECT /end RECORD_LAYOUT
/begin RECORD_LAYOUT Lookup2D_WORD FNC_VALUES 1 SWORD COLUMN_DIR DIRECT /end RECORD_LAYOUT
/begin RECORD_LAYOUT Lookup2D_X_WORD AXIS_PTS_X 1 SWORD INDEX_INCR DIRECT /end RECORD_LAYOUT
/begin RECORD_LAYOUT Lookup2D_ULONG FNC_VALUES 1 ULONG COLUMN_DIR DIRECT /end RECORD_LAYOUT
/begin RECORD_LAYOUT Lookup2D_X_ULONG AXIS_PTS_X 1 ULONG INDEX_INCR DIRECT /end RECORD_LAYOUT
/begin RECORD_LAYOUT Lookup2D_LONG FNC_VALUES 1 SLONG COLUMN_DIR DIRECT /end RECORD_LAYOUT
/begin RECORD_LAYOUT Lookup2D_X_LONG AXIS_PTS_X 1 SLONG INDEX_INCR DIRECT /end RECORD_LAYOUT
/begin RECORD_LAYOUT Lookup2D_FLOAT64_IEEE FNC_VALUES 1 FLOAT64_IEEE COLUMN_DIR DIRECT /end RECORD_LAYOUT
/begin RECORD_LAYOUT Lookup2D_X_FLOAT64_IEEE AXIS_PTS_X 1 FLOAT64_IEEE INDEX_INCR DIRECT /end RECORD_LAYOUT
/begin CHARACTERISTIC KtACCS_t_CalOpenAccelForStopFrmDCSN "Want how long to stop the vehicle" CURVE 0x7010002c /* @ECU_Address@KtACCS_t_CalOpenAccelForStopFrmDCSN@ */ Lookup1D_FLOAT32_IEEE 0 ACCS_subsystem_integrated_CM_single_s 0.0 1200.0
 /begin AXIS_DESCR COM_AXIS NO_INPUT_QUANTITY ACCS_subsystem_integrated_CM_single_m 6 0.0 200.0 AXIS_PTS_REF KtACCS_AXIS_OpenAccelStop_StopDis /end AXIS_DESCR
/end CHARACTERISTIC
/begin CHARACTERISTIC KtACCS_a_OpenAccel_SpeedCtrl "This is open acceleration table under speed control mode,it is the function of speed error" CURVE 0x701009b0 /* @ECU_Address@KtACCS_a_OpenAccel_SpeedCtrl@ */ Lookup1D_FLOAT32_IEEE 0 ACCS_subsystem_integrated_CM_single_m_s2 -4.0 4.0
 /begin AXIS_DESCR COM_AXIS NO_INPUT_QUANTITY ACCS_subsystem_integrated_CM_single_m_s 7 -30.0 30.0 AXIS_PTS_REF KtACCS_AXIS_OpenAccelSpedCtrl_SpedErr /end AXIS_DESCR
/end CHARACTERISTIC
/begin CHARACTERISTIC KtACCS_a_OpenAccel_LowSpeedCtrl "his is open acceleration table under low speed control mode,it is the function of speed error" CURVE 0x701009cc /* @ECU_Address@KtACCS_a_OpenAccel_LowSpeedCtrl@ */ Lookup1D_FLOAT32_IEEE 0 ACCS_subsystem_integrated_CM_single_m_s2 -4.0 4.0
 /begin AXIS_DESCR COM_AXIS NO_INPUT_QUANTITY ACCS_subsystem_integrated_CM_single_m_s 7 -45.0 45.0 AXIS_PTS_REF KtACCS_AXIS_OpenAccelLowSpedCtrl_SpedErr /end AXIS_DESCR
/end CHARACTERISTIC
/begin CHARACTERISTIC KtACCS_a_OpenAccel_Launch "This is open acceleration table under launch control mode,it is the function of Ego current speed" CURVE 0x701009e8 /* @ECU_Address@KtACCS_a_OpenAccel_Launch@ */ Lookup1D_FLOAT32_IEEE 0 ACCS_subsystem_integrated_CM_single_m_s2 -4.0 4.0
 /begin AXIS_DESCR COM_AXIS NO_INPUT_QUANTITY ACCS_subsystem_integrated_CM_single_m_s 6 0.0 50.0 AXIS_PTS_REF KtACCS_AXIS_OpenAccelLaunch_CurSpd /end AXIS_DESCR
/end CHARACTERISTIC
/begin CHARACTERISTIC KtACCS_a_StopStatus_Accel "When KbACCS_UseStopStatus_Accel=true, accel will be form this cal during status is Stop.This cal is the function of pitch" CURVE 0x70100988 /* @ECU_Address@KtACCS_a_StopStatus_Accel@ */ Lookup1D_FLOAT32_IEEE 0 ACCS_subsystem_integrated_CM_single_m_s2 -4.0 0.0
 /begin AXIS_DESCR COM_AXIS NO_INPUT_QUANTITY ACCS_subsystem_integrated_CM_single_deg 10 0.0 90.0 AXIS_PTS_REF KtACCS_AXIS_StopStatus_Accel_Pitch /end AXIS_DESCR
/end CHARACTERISTIC
/begin CHARACTERISTIC KfLDWS_Ang_BkToCnrAng "The angle X axis and the line connecting center of rear axle and front tire." VALUE 0x70102398 /* @ECU_Address@KfLDWS_Ang_BkToCnrAng@ */ Scalar_FLOAT32_IEEE 0 LDWS_subsystem_integrated_CM_single_rad 0.0 1.5707963267948966 /end CHARACTERISTIC
/begin CHARACTERISTIC KfLDWS_Ang_SuppSteerAngThrsh "The suppression threshold for Steer Angle" VALUE 0x70102394 /* @ECU_Address@KfLDWS_Ang_SuppSteerAngThrsh@ */ Scalar_FLOAT32_IEEE 0 LDWS_subsystem_integrated_CM_single__ 0.0 360.0 /end CHARACTERISTIC
/begin CHARACTERISTIC KfLDWS_M_SuppTorque "The torque limit that could be treated as suppression" VALUE 0x70102390 /* @ECU_Address@KfLDWS_M_SuppTorque@ */ Scalar_FLOAT32_IEEE 0 LDWS_subsystem_integrated_CM_single_NM 0.0 10.0 /end CHARACTERISTIC
/begin CHARACTERISTIC KfLDWS_d_BkToFrtCnrDist "The distance between one fo the front tires to the center of rear axle." VALUE 0x70102384 /* @ECU_Address@KfLDWS_d_BkToFrtCnrDist@ */ Scalar_FLOAT32_IEEE 0 LDWS_subsystem_integrated_CM_single_m 0.0 20.0 /end CHARACTERISTIC
/begin CHARACTERISTIC KfLDWS_d_EdgBuff "The edge buffer that added to the calcualted distance to lane markers" VALUE 0x70102380 /* @ECU_Address@KfLDWS_d_EdgBuff@ */ Scalar_FLOAT32_IEEE 0 LDWS_subsystem_integrated_CM_single_m -2.0 2.0 /end CHARACTERISTIC
/begin CHARACTERISTIC KfLDWS_d_WarnLineLvlOne "When vehicle speed is higher than 1.0m/s, the earliest warning line shall be placed no more than 1.5m inside the lane boundary." VALUE 0x70102374 /* @ECU_Address@KfLDWS_d_WarnLineLvlOne@ */ Scalar_FLOAT32_IEEE 0 LDWS_subsystem_integrated_CM_single_m 0.0 1.5 /end CHARACTERISTIC
/begin CHARACTERISTIC KfLDWS_d_WarnLineLvlThree "When vehicle speed is not higher than 0.5 m/s, the earliest warning line shall be placed no more than 0.75m inside the lane boundary." VALUE 0x70102370 /* @ECU_Address@KfLDWS_d_WarnLineLvlThree@ */ Scalar_FLOAT32_IEEE 0 LDWS_subsystem_integrated_CM_single_m 0.0 0.75 /end CHARACTERISTIC
/begin CHARACTERISTIC KfLDWS_k_CurvBuffCoe "The coefficient that multiples the distance to lanemarker when the vehicle is driving under large curavture." VALUE 0x7010236c /* @ECU_Address@KfLDWS_k_CurvBuffCoe@ */ Scalar_FLOAT32_IEEE 0 LDWS_subsystem_integrated_CM_single 0.0 2.0 /end CHARACTERISTIC
/begin CHARACTERISTIC KfLDWS_k_WarnLineLvlTwo "When vehicle speed is higher than 0.5m/s but not  higher than 1.0m/s, the earliest warning line shall be placed no more than 1.5*Va m inside the lane boundary" VALUE 0x70102368 /* @ECU_Address@KfLDWS_k_WarnLineLvlTwo@ */ Scalar_FLOAT32_IEEE 0 LDWS_subsystem_integrated_CM_single 0.0 1.5 /end CHARACTERISTIC
/begin CHARACTERISTIC KfLDWS_t_TLCThrsh "Time to lane crossing threshold" VALUE 0x70102364 /* @ECU_Address@KfLDWS_t_TLCThrsh@ */ Scalar_FLOAT32_IEEE 0 LDWS_subsystem_integrated_CM_single_s 0.0 2.0 /end CHARACTERISTIC
/begin CHARACTERISTIC KfLDWS_v_SuppSteerRateThrsh "The suppression threshold for Steer Rate" VALUE 0x70102358 /* @ECU_Address@KfLDWS_v_SuppSteerRateThrsh@ */ Scalar_FLOAT32_IEEE 0 LDWS_subsystem_integrated_CM_single___s 0.0 360.0 /end CHARACTERISTIC
/begin CHARACTERISTIC KfLDWS_t_LnMkrMissThrsh "The maximum time that a lane marker could termporarily go missing" VALUE 0x7010234a /* @ECU_Address@KfLDWS_t_LnMkrMissThrsh@ */ Scalar_UWORD 0 LDWS_subsystem_integrated_CM_uint16 0.0 1000.0 /end CHARACTERISTIC
/begin CHARACTERISTIC KfLDWS_t_SuppIndiTime "The time that indicator could be treated as suppression" VALUE 0x7010233c /* @ECU_Address@KfLDWS_t_SuppIndiTime@ */ Scalar_UWORD 0 LDWS_subsystem_integrated_CM_uint16 0.0 1000.0 /end CHARACTERISTIC
/begin CHARACTERISTIC KfLDWS_t_SuppSteerAngTime "The time that steer angle could be treated as suppression" VALUE 0x7010233a /* @ECU_Address@KfLDWS_t_SuppSteerAngTime@ */ Scalar_UWORD 0 LDWS_subsystem_integrated_CM_uint16 0.0 1000.0 /end CHARACTERISTIC
/begin CHARACTERISTIC KfLDWS_t_SuppSteerRateTime "The time that steer rate could be treated as suppression" VALUE 0x70102338 /* @ECU_Address@KfLDWS_t_SuppSteerRateTime@ */ Scalar_UWORD 0 LDWS_subsystem_integrated_CM_uint16 0.0 1000.0 /end CHARACTERISTIC
/begin CHARACTERISTIC KfLDWS_t_SuppTorqueTime "The time that steer toque could be treated as suppression" VALUE 0x70102336 /* @ECU_Address@KfLDWS_t_SuppTorqueTime@ */ Scalar_UWORD 0 LDWS_subsystem_integrated_CM_uint16 0.0 1000.0 /end CHARACTERISTIC
/begin CHARACTERISTIC KfLDWS_r_LaMkrQlt "Lane marker quality threshold" VALUE 0x70102335 /* @ECU_Address@KfLDWS_r_LaMkrQlt@ */ Scalar_UBYTE 0 LDWS_subsystem_integrated_CM_uint8 0.0 100.0 /end CHARACTERISTIC
/begin CHARACTERISTIC KbLDWS_ThetaSwitch "" VALUE 0x70102331 /* @ECU_Address@KbLDWS_ThetaSwitch@ */ Scalar_BOOLEAN 0 LDWS_subsystem_integrated_CM_boolean 0.0 1.0 /end CHARACTERISTIC
/begin CHARACTERISTIC KfAEBD_a_AccelDeviation "" VALUE 0x70101270 /* @ECU_Address@KfAEBD_a_AccelDeviation@ */ Scalar_FLOAT32_IEEE 0 AEBD_subsystem_integrated_CM_single 0.0 10.0 /end CHARACTERISTIC
/begin CHARACTERISTIC KcAEBD_ErrorCountThrsh "" VALUE 0x7010126e /* @ECU_Address@KcAEBD_ErrorCountThrsh@ */ Scalar_UWORD 0 AEBD_subsystem_integrated_CM_uint16 0.0 65535.0 /end CHARACTERISTIC
/begin CHARACTERISTIC KfAEBD_t_WaitTimeThrsh "" VALUE 0x7010126c /* @ECU_Address@KfAEBD_t_WaitTimeThrsh@ */ Scalar_UBYTE 0 AEBD_subsystem_integrated_CM_uint8 0.0 200.0 /end CHARACTERISTIC
/begin CHARACTERISTIC KbAEBD_ADCU_CANError "" VALUE 0x7010126b /* @ECU_Address@KbAEBD_ADCU_CANError@ */ Scalar_BOOLEAN 0 AEBD_subsystem_integrated_CM_boolean 0.0 1.0 /end CHARACTERISTIC
/begin CHARACTERISTIC KbAEBD_AccelerationSensorError "" VALUE 0x7010126a /* @ECU_Address@KbAEBD_AccelerationSensorError@ */ Scalar_BOOLEAN 0 AEBD_subsystem_integrated_CM_boolean 0.0 1.0 /end CHARACTERISTIC
/begin CHARACTERISTIC KbAEBD_ESCError "" VALUE 0x70101269 /* @ECU_Address@KbAEBD_ESCError@ */ Scalar_BOOLEAN 0 AEBD_subsystem_integrated_CM_boolean 0.0 1.0 /end CHARACTERISTIC
/begin CHARACTERISTIC KbAEBD_ErrorClear "" VALUE 0x70101268 /* @ECU_Address@KbAEBD_ErrorClear@ */ Scalar_BOOLEAN 0 AEBD_subsystem_integrated_CM_boolean 0.0 1.0 /end CHARACTERISTIC
/begin CHARACTERISTIC KfALCA_d_DefaultLaneLength "" VALUE 0x701018c0 /* @ECU_Address@KfALCA_d_DefaultLaneLength@ */ Scalar_FLOAT32_IEEE 0 ALCA_subsystem_integrated_CM_single_m 0.0 1000.0 /end CHARACTERISTIC
/begin CHARACTERISTIC KfALCA_d_Dist2LaneChangeFinish "Max distance for determine lane change finished." VALUE 0x701018bc /* @ECU_Address@KfALCA_d_Dist2LaneChangeFinish@ */ Scalar_FLOAT32_IEEE 0 ALCA_subsystem_integrated_CM_single_m 0.1 3.75 /end CHARACTERISTIC
/begin CHARACTERISTIC KfALCA_d_EgoVehWheelBase "" VALUE 0x701018b8 /* @ECU_Address@KfALCA_d_EgoVehWheelBase@ */ Scalar_FLOAT32_IEEE 0 ALCA_subsystem_integrated_CM_single_m -3.4E+38 3.4E+38 /end CHARACTERISTIC
/begin CHARACTERISTIC KfALCA_d_EgoVehWidth "The width of EGO." VALUE 0x701018b4 /* @ECU_Address@KfALCA_d_EgoVehWidth@ */ Scalar_FLOAT32_IEEE 0 ALCA_subsystem_integrated_CM_single_m 1.5 5.0 /end CHARACTERISTIC
/begin CHARACTERISTIC KfALCA_d_EnterSecondStageThrsh "" VALUE 0x701018b0 /* @ECU_Address@KfALCA_d_EnterSecondStageThrsh@ */ Scalar_FLOAT32_IEEE 0 ALCA_subsystem_integrated_CM_single_m 0.0 3.0 /end CHARACTERISTIC
/begin CHARACTERISTIC KfALCA_d_LaneWidthMax "Max width of lane." VALUE 0x701018ac /* @ECU_Address@KfALCA_d_LaneWidthMax@ */ Scalar_FLOAT32_IEEE 0 ALCA_subsystem_integrated_CM_single_m 0.1 4.0 /end CHARACTERISTIC
/begin CHARACTERISTIC KfALCA_d_TouchedNewLaneDist "Min jump distance for touched new lane." VALUE 0x701018a8 /* @ECU_Address@KfALCA_d_TouchedNewLaneDist@ */ Scalar_FLOAT32_IEEE 0 ALCA_subsystem_integrated_CM_single_m 0.0 3.75 /end CHARACTERISTIC
/begin CHARACTERISTIC KfALCA_r_CoeffStrwhl2Radius "" VALUE 0x701018a4 /* @ECU_Address@KfALCA_r_CoeffStrwhl2Radius@ */ Scalar_FLOAT32_IEEE 0 ALCA_subsystem_integrated_CM_single -3.4E+38 3.4E+38 /end CHARACTERISTIC
/begin CHARACTERISTIC KfALCA_r_ComfortableVRatio "" VALUE 0x701018a0 /* @ECU_Address@KfALCA_r_ComfortableVRatio@ */ Scalar_FLOAT32_IEEE 0 ALCA_subsystem_integrated_CM_single 0.01 1.0 /end CHARACTERISTIC
/begin CHARACTERISTIC KfALCA_r_EgoVehStrwhl2FrtwhlRatio "" VALUE 0x7010189c /* @ECU_Address@KfALCA_r_EgoVehStrwhl2FrtwhlRatio@ */ Scalar_FLOAT32_IEEE 0 ALCA_subsystem_integrated_CM_single -3.4E+38 3.4E+38 /end CHARACTERISTIC
/begin CHARACTERISTIC KfALCA_r_EgoWidth2LaneWidthRation "Target lane width must > ego_veh_width * KfALCA_r_EgoWidth2LaneWidthRation." VALUE 0x70101898 /* @ECU_Address@KfALCA_r_EgoWidth2LaneWidthRation@ */ Scalar_FLOAT32_IEEE 0 ALCA_subsystem_integrated_CM_single 0.1 3.0 /end CHARACTERISTIC
/begin CHARACTERISTIC KfALCA_r_OutputLarteralVRatioInterrupt "" VALUE 0x70101894 /* @ECU_Address@KfALCA_r_OutputLarteralVRatioInterrupt@ */ Scalar_FLOAT32_IEEE 0 ALCA_subsystem_integrated_CM_single 0.01 5.0 /end CHARACTERISTIC
/begin CHARACTERISTIC KfALCA_t_ExitFinishDelay "The time of wait for exit Finish state (Cooling time)." VALUE 0x70101890 /* @ECU_Address@KfALCA_t_ExitFinishDelay@ */ Scalar_FLOAT32_IEEE 0 ALCA_subsystem_integrated_CM_single_s 0.01 3.0 /end CHARACTERISTIC
/begin CHARACTERISTIC KfALCA_t_ExitHandoverDelay "The time of wait for exit Waitting state. ALCA will inform some info to driver In Waitting state." VALUE 0x7010188c /* @ECU_Address@KfALCA_t_ExitHandoverDelay@ */ Scalar_FLOAT32_IEEE 0 ALCA_subsystem_integrated_CM_single_s 0.01 8.0 /end CHARACTERISTIC
/begin CHARACTERISTIC KfALCA_t_ExitWaitingDelay "The time of wait for exit Waitting state. ALCA will inform some info to driver In Waitting state." VALUE 0x70101888 /* @ECU_Address@KfALCA_t_ExitWaitingDelay@ */ Scalar_FLOAT32_IEEE 0 ALCA_subsystem_integrated_CM_single_s 0.01 8.0 /end CHARACTERISTIC
/begin CHARACTERISTIC KfALCA_t_HoldTimeForAccept "" VALUE 0x70101884 /* @ECU_Address@KfALCA_t_HoldTimeForAccept@ */ Scalar_FLOAT32_IEEE 0 ALCA_subsystem_integrated_CM_single 0.0 10.0 /end CHARACTERISTIC
/begin CHARACTERISTIC KfALCA_t_HoldTimeForComplete "" VALUE 0x70101880 /* @ECU_Address@KfALCA_t_HoldTimeForComplete@ */ Scalar_FLOAT32_IEEE 0 ALCA_subsystem_integrated_CM_single_s 0.0 6.0 /end CHARACTERISTIC
/begin CHARACTERISTIC KfALCA_t_LaneChangeTimeMax "Max time of lane change (s)." VALUE 0x7010187c /* @ECU_Address@KfALCA_t_LaneChangeTimeMax@ */ Scalar_FLOAT32_IEEE 0 ALCA_subsystem_integrated_CM_single_s 0.0 16.0 /end CHARACTERISTIC
/begin CHARACTERISTIC KfALCA_t_LaneChangeTimeMin "Min time of lane change (s)." VALUE 0x70101878 /* @ECU_Address@KfALCA_t_LaneChangeTimeMin@ */ Scalar_FLOAT32_IEEE 0 ALCA_subsystem_integrated_CM_single_s 0.0 16.0 /end CHARACTERISTIC
/begin CHARACTERISTIC KfALCA_t_PeriodFunctionCall "The time of Period-Function-Call." VALUE 0x70101874 /* @ECU_Address@KfALCA_t_PeriodFunctionCall@ */ Scalar_FLOAT32_IEEE 0 ALCA_subsystem_integrated_CM_single_s 0.01 1.0 /end CHARACTERISTIC
/begin CHARACTERISTIC KfALCA_t_TimeNReceivedThrsh "The threshold of time that not received OBFU/MPFU/EGMO data." VALUE 0x70101870 /* @ECU_Address@KfALCA_t_TimeNReceivedThrsh@ */ Scalar_FLOAT32_IEEE 0 ALCA_subsystem_integrated_CM_single_s 0.0 1.0 /end CHARACTERISTIC
/begin CHARACTERISTIC KfALCA_t_WaitForDriverActionMax "The time of wait for driver`s commond in Inform state." VALUE 0x7010186c /* @ECU_Address@KfALCA_t_WaitForDriverActionMax@ */ Scalar_FLOAT32_IEEE 0 ALCA_subsystem_integrated_CM_single_s 0.0 6.0 /end CHARACTERISTIC
/begin CHARACTERISTIC KfALCA_v_LateralSpeedOfSecondStage "" VALUE 0x70101868 /* @ECU_Address@KfALCA_v_LateralSpeedOfSecondStage@ */ Scalar_FLOAT32_IEEE 0 ALCA_subsystem_integrated_CM_single 0.0 3.0 /end CHARACTERISTIC
/begin CHARACTERISTIC KfALCA_v_SpeedLaneChangeEnblMax "The veh_speed threshold for lane change enable. (high)" VALUE 0x70101864 /* @ECU_Address@KfALCA_v_SpeedLaneChangeEnblMax@ */ Scalar_FLOAT32_IEEE 0 ALCA_subsystem_integrated_CM_single_m_s 0.0 40.0 /end CHARACTERISTIC
/begin CHARACTERISTIC KfALCA_v_SpeedLaneChangeEnblMin "The veh_speed threshold for lane change enable. (low)" VALUE 0x70101860 /* @ECU_Address@KfALCA_v_SpeedLaneChangeEnblMin@ */ Scalar_FLOAT32_IEEE 0 ALCA_subsystem_integrated_CM_single_m_s -1.0 30.0 /end CHARACTERISTIC
/begin CHARACTERISTIC KfAlCA_d_CheckOBFUForwardDistMax "Max forward distance for check obstacles." VALUE 0x7010185c /* @ECU_Address@KfAlCA_d_CheckOBFUForwardDistMax@ */ Scalar_FLOAT32_IEEE 0 ALCA_subsystem_integrated_CM_single_m 0.0 1000.0 /end CHARACTERISTIC
/begin CHARACTERISTIC KbALCA_ChanggLaneCancelReqOvrd "" VALUE 0x7010185a /* @ECU_Address@KbALCA_ChanggLaneCancelReqOvrd@ */ Scalar_BOOLEAN 0 ALCA_subsystem_integrated_CM_boolean 0 1 /end CHARACTERISTIC
/begin CHARACTERISTIC KbALCA_ChanggLaneReqOvrd "" VALUE 0x70101859 /* @ECU_Address@KbALCA_ChanggLaneReqOvrd@ */ Scalar_BOOLEAN 0 ALCA_subsystem_integrated_CM_boolean 0 1 /end CHARACTERISTIC
/begin CHARACTERISTIC KbALCA_EnblCheckMPFUFusionStatus "Enable check MPFU fusion status." VALUE 0x70101858 /* @ECU_Address@KbALCA_EnblCheckMPFUFusionStatus@ */ Scalar_BOOLEAN 0 ALCA_subsystem_integrated_CM_boolean 0 1 /end CHARACTERISTIC
/begin CHARACTERISTIC KbALCA_EnblCheckMPFULaneMarkerType "Enable check MPFU lane marker type." VALUE 0x70101857 /* @ECU_Address@KbALCA_EnblCheckMPFULaneMarkerType@ */ Scalar_BOOLEAN 0 ALCA_subsystem_integrated_CM_boolean 0 1 /end CHARACTERISTIC
/begin CHARACTERISTIC KbALCA_EnblCheckObstacles "" VALUE 0x70101856 /* @ECU_Address@KbALCA_EnblCheckObstacles@ */ Scalar_BOOLEAN 0 ALCA_subsystem_integrated_CM_boolean 0 1 /end CHARACTERISTIC
/begin CHARACTERISTIC KbALCA_EnblCheckTimestamp "Enable check timestamp of MPFU/EGMO/OBFU." VALUE 0x70101855 /* @ECU_Address@KbALCA_EnblCheckTimestamp@ */ Scalar_BOOLEAN 0 ALCA_subsystem_integrated_CM_boolean 0 1 /end CHARACTERISTIC
/begin CHARACTERISTIC KbALCA_EnblInterrupt "" VALUE 0x70101854 /* @ECU_Address@KbALCA_EnblInterrupt@ */ Scalar_BOOLEAN 0 ALCA_subsystem_integrated_CM_boolean 0 1 /end CHARACTERISTIC
/begin CHARACTERISTIC KbALCA_EnblNewMethodForLCTime "" VALUE 0x70101853 /* @ECU_Address@KbALCA_EnblNewMethodForLCTime@ */ Scalar_BOOLEAN 0 ALCA_subsystem_integrated_CM_boolean 0 1 /end CHARACTERISTIC
/begin CHARACTERISTIC KbALCA_EnblOvrdInterruptAction "" VALUE 0x70101852 /* @ECU_Address@KbALCA_EnblOvrdInterruptAction@ */ Scalar_BOOLEAN 0 ALCA_subsystem_integrated_CM_boolean 0 1 /end CHARACTERISTIC
/begin CHARACTERISTIC KbALCA_EnblOvrdLaneLength "" VALUE 0x70101851 /* @ECU_Address@KbALCA_EnblOvrdLaneLength@ */ Scalar_BOOLEAN 0 ALCA_subsystem_integrated_CM_boolean 0 1 /end CHARACTERISTIC
/begin CHARACTERISTIC KbALCA_EnblOvrdLaneWidth "" VALUE 0x70101850 /* @ECU_Address@KbALCA_EnblOvrdLaneWidth@ */ Scalar_BOOLEAN 0 ALCA_subsystem_integrated_CM_boolean 0 1 /end CHARACTERISTIC
/begin CHARACTERISTIC KbALCA_EnblOvrdReqFromECSN "" VALUE 0x7010184f /* @ECU_Address@KbALCA_EnblOvrdReqFromECSN@ */ Scalar_BOOLEAN 0 ALCA_subsystem_integrated_CM_boolean 0 1 /end CHARACTERISTIC
/begin CHARACTERISTIC KbALCA_OvrdLaneChangeTime "" VALUE 0x7010184e /* @ECU_Address@KbALCA_OvrdLaneChangeTime@ */ Scalar_BOOLEAN 0 ALCA_subsystem_integrated_CM_boolean 0 1 /end CHARACTERISTIC
/begin CHARACTERISTIC KbALCA_UseNewAPI_Of_MPFU "" VALUE 0x7010184d /* @ECU_Address@KbALCA_UseNewAPI_Of_MPFU@ */ Scalar_BOOLEAN 0 ALCA_subsystem_integrated_CM_boolean 0 1 /end CHARACTERISTIC
/begin CHARACTERISTIC KeALCA_ChangeLaneReqSideOvrd "" VALUE 0x7010184c /* @ECU_Address@KeALCA_ChangeLaneReqSideOvrd@ */ Scalar_UBYTE 0 ALCA_subsystem_integrated_CM_EnumDCSN_driving_direction 0 2 /end CHARACTERISTIC
/begin CHARACTERISTIC KtLKAS_r_OffstCtrlPropGain "" CURVE 0x701023b0 /* @ECU_Address@KtLKAS_r_OffstCtrlPropGain@ */ Lookup1D_FLOAT32_IEEE 0 LKAS_subsystem_integrated_CM_single -3.4E+38 3.4E+38
 /begin AXIS_DESCR COM_AXIS NO_INPUT_QUANTITY LKAS_subsystem_integrated_CM_single 8 -3.4E+38 3.4E+38 AXIS_PTS_REF KtLKAS_AXIS_OffstCtrlPropGain /end AXIS_DESCR
/end CHARACTERISTIC
/begin CHARACTERISTIC KtLKAS_r_OffstCtrlDiffGain "" CURVE 0x701023d0 /* @ECU_Address@KtLKAS_r_OffstCtrlDiffGain@ */ Lookup1D_FLOAT32_IEEE 0 LKAS_subsystem_integrated_CM_single -3.4E+38 3.4E+38
 /begin AXIS_DESCR COM_AXIS NO_INPUT_QUANTITY LKAS_subsystem_integrated_CM_single 8 -3.4E+38 3.4E+38 AXIS_PTS_REF KtLKAS_AXIS_OffstCtrlDiffGain /end AXIS_DESCR
/end CHARACTERISTIC
/begin CHARACTERISTIC KfLKAS_Ang_BkToCnrAng "The angle X axis and the line connecting center of rear axle and front tire." VALUE 0x701024e8 /* @ECU_Address@KfLKAS_Ang_BkToCnrAng@ */ Scalar_FLOAT32_IEEE 0 LKAS_subsystem_integrated_CM_single_rad 0.0 3.14 /end CHARACTERISTIC
/begin CHARACTERISTIC KfLKAS_Ang_SteerOffset "" VALUE 0x701024e4 /* @ECU_Address@KfLKAS_Ang_SteerOffset@ */ Scalar_FLOAT32_IEEE 0 LKAS_subsystem_integrated_CM_single -3.4E+38 3.4E+38 /end CHARACTERISTIC
/begin CHARACTERISTIC KfLKAS_Ang_StrAngLwrLimit "" VALUE 0x701024e0 /* @ECU_Address@KfLKAS_Ang_StrAngLwrLimit@ */ Scalar_FLOAT32_IEEE 0 LKAS_subsystem_integrated_CM_single_degree -3.4E+38 3.4E+38 /end CHARACTERISTIC
/begin CHARACTERISTIC KfLKAS_Ang_StrAngUprLimit "" VALUE 0x701024dc /* @ECU_Address@KfLKAS_Ang_StrAngUprLimit@ */ Scalar_FLOAT32_IEEE 0 LKAS_subsystem_integrated_CM_single_degree -3.4E+38 3.4E+38 /end CHARACTERISTIC
/begin CHARACTERISTIC KfLKAS_C_CfForLatCtrl "Front tire cornering stiffness." VALUE 0x701024d8 /* @ECU_Address@KfLKAS_C_CfForLatCtrl@ */ Scalar_FLOAT32_IEEE 0 LKAS_subsystem_integrated_CM_single_N_rad -3.4E+38 3.4E+38 /end CHARACTERISTIC
/begin CHARACTERISTIC KfLKAS_C_CrForLatCtrl "Rear tire cornering stiffness." VALUE 0x701024d4 /* @ECU_Address@KfLKAS_C_CrForLatCtrl@ */ Scalar_FLOAT32_IEEE 0 LKAS_subsystem_integrated_CM_single_N_rad -3.4E+38 3.4E+38 /end CHARACTERISTIC
/begin CHARACTERISTIC KfLKAS_CallFreq "Frequency used for delay block, if the frequency is larger, the delay time is longer." VALUE 0x701024d0 /* @ECU_Address@KfLKAS_CallFreq@ */ Scalar_FLOAT32_IEEE 0 LKAS_subsystem_integrated_CM_single_1_s 10.0 20.0 /end CHARACTERISTIC
/begin CHARACTERISTIC KfLKAS_a_AMaxInPathToTrig_sLKA "The max acceleration in generated trajectory that allows triggering LKAS." VALUE 0x701024cc /* @ECU_Address@KfLKAS_a_AMaxInPathToTrig_sLKA@ */ Scalar_FLOAT32_IEEE 0 LKAS_subsystem_integrated_CM_single 0.0 5.0 /end CHARACTERISTIC
/begin CHARACTERISTIC KfLKAS_a_SarnOfRelALatForPahCalcn "The saturation used for vehicle acceleration relative to lane marker." VALUE 0x701024c8 /* @ECU_Address@KfLKAS_a_SarnOfRelALatForPahCalcn@ */ Scalar_FLOAT32_IEEE 0 LKAS_subsystem_integrated_CM_single_m_s_2 0.1 0.2 /end CHARACTERISTIC
/begin CHARACTERISTIC KfLKAS_c_CurvUprBnd "The curavature upperbound that determines whether to use extra buffer coefficient." VALUE 0x701024c4 /* @ECU_Address@KfLKAS_c_CurvUprBnd@ */ Scalar_FLOAT32_IEEE 0 LKAS_subsystem_integrated_CM_single_1_m 0.0 0.01 /end CHARACTERISTIC
/begin CHARACTERISTIC KfLKAS_c_CurveSuppOff "When the road curvature is smaller than CurveSuppOff, it is considered that the road is straight." VALUE 0x701024c0 /* @ECU_Address@KfLKAS_c_CurveSuppOff@ */ Scalar_FLOAT32_IEEE 0 LKAS_subsystem_integrated_CM_single_1_m 0.0 0.5 /end CHARACTERISTIC
/begin CHARACTERISTIC KfLKAS_c_CurveSuppOn "When the road curvature is bigger than CurveSuppOn, it is considered that the road is not straight." VALUE 0x701024bc /* @ECU_Address@KfLKAS_c_CurveSuppOn@ */ Scalar_FLOAT32_IEEE 0 LKAS_subsystem_integrated_CM_single_1_m 1.0 2.0 /end CHARACTERISTIC
/begin CHARACTERISTIC KfLKAS_c_MaxCurvStep "The maximum change allowed for curvature at one step." VALUE 0x701024b8 /* @ECU_Address@KfLKAS_c_MaxCurvStep@ */ Scalar_FLOAT32_IEEE 0 LKAS_subsystem_integrated_CM_single_1_m 1.0 2.0 /end CHARACTERISTIC
/begin CHARACTERISTIC KfLKAS_d_BkToFrtCnrDist "The distance between one fo the front tires to the center of rear axle." VALUE 0x701024b4 /* @ECU_Address@KfLKAS_d_BkToFrtCnrDist@ */ Scalar_FLOAT32_IEEE 0 LKAS_subsystem_integrated_CM_single_m 0.0 10.0 /end CHARACTERISTIC
/begin CHARACTERISTIC KfLKAS_d_EdgBuff "The edge buffer that added to the calcualted distance to lane markers" VALUE 0x701024b0 /* @ECU_Address@KfLKAS_d_EdgBuff@ */ Scalar_FLOAT32_IEEE 0 LKAS_subsystem_integrated_CM_single_m -2.0 2.0 /end CHARACTERISTIC
/begin CHARACTERISTIC KfLKAS_d_ExtraMargin "" VALUE 0x701024ac /* @ECU_Address@KfLKAS_d_ExtraMargin@ */ Scalar_FLOAT32_IEEE 0 LKAS_subsystem_integrated_CM_single -3.4E+38 3.4E+38 /end CHARACTERISTIC
/begin CHARACTERISTIC KfLKAS_d_LfForLatCtrl "The distance beetween front axle and center of mass." VALUE 0x701024a8 /* @ECU_Address@KfLKAS_d_LfForLatCtrl@ */ Scalar_FLOAT32_IEEE 0 LKAS_subsystem_integrated_CM_single_m 0.0 10.0 /end CHARACTERISTIC
/begin CHARACTERISTIC KfLKAS_d_LrForLatCtrl "The distance beetween front axle and center of mass." VALUE 0x701024a4 /* @ECU_Address@KfLKAS_d_LrForLatCtrl@ */ Scalar_FLOAT32_IEEE 0 LKAS_subsystem_integrated_CM_single_m 0.0 10.0 /end CHARACTERISTIC
/begin CHARACTERISTIC KfLKAS_d_MaxEnblLaneWidth "If the road lane width is larger than the max enable lane width, the LKA function will not be activated." VALUE 0x701024a0 /* @ECU_Address@KfLKAS_d_MaxEnblLaneWidth@ */ Scalar_FLOAT32_IEEE 0 LKAS_subsystem_integrated_CM_single_m 4.0 5.0 /end CHARACTERISTIC
/begin CHARACTERISTIC KfLKAS_d_MaxOffstStep "The maximum change allowed for offset at one step." VALUE 0x7010249c /* @ECU_Address@KfLKAS_d_MaxOffstStep@ */ Scalar_FLOAT32_IEEE 0 LKAS_subsystem_integrated_CM_single_m 1.0 2.0 /end CHARACTERISTIC
/begin CHARACTERISTIC KfLKAS_d_MinDeltaPosFirst "If the lateral offset minus extra margin is bigger than minimum delta position first, the LKA function will not be activated." VALUE 0x70102498 /* @ECU_Address@KfLKAS_d_MinDeltaPosFirst@ */ Scalar_FLOAT32_IEEE 0 LKAS_subsystem_integrated_CM_single_m 0.1 0.2 /end CHARACTERISTIC
/begin CHARACTERISTIC KfLKAS_d_MinDeltaPosSec "If the lateral offset minus extra margin is smaller than minimum delta position , the LKA function will not be activated." VALUE 0x70102494 /* @ECU_Address@KfLKAS_d_MinDeltaPosSec@ */ Scalar_FLOAT32_IEEE 0 LKAS_subsystem_integrated_CM_single_m 0.1 0.2 /end CHARACTERISTIC
/begin CHARACTERISTIC KfLKAS_d_MinDisLaneWidthMargin "The lane width is disabled if the current lane width is smaller than the vehicle width plus Minimum Disable Lane Width Margin" VALUE 0x70102490 /* @ECU_Address@KfLKAS_d_MinDisLaneWidthMargin@ */ Scalar_FLOAT32_IEEE 0 LKAS_subsystem_integrated_CM_single_m 0.0 0.4 /end CHARACTERISTIC
/begin CHARACTERISTIC KfLKAS_d_MinEnblLaneWidthMargin "The lane width is enabled, if the current lane width is largrer than the vehicle width plus minimum enable lane width margin." VALUE 0x7010248c /* @ECU_Address@KfLKAS_d_MinEnblLaneWidthMargin@ */ Scalar_FLOAT32_IEEE 0 LKAS_subsystem_integrated_CM_single_m 0.5 1.0 /end CHARACTERISTIC
/begin CHARACTERISTIC KfLKAS_d_OffsAtMinDeltaPos "The offset to lane marker at the end of the caculated trajectory." VALUE 0x70102488 /* @ECU_Address@KfLKAS_d_OffsAtMinDeltaPos@ */ Scalar_FLOAT32_IEEE 0 LKAS_subsystem_integrated_CM_single_m 0.0 0.2 /end CHARACTERISTIC
/begin CHARACTERISTIC KfLKAS_d_OffstCtrlr_DeadZone "" VALUE 0x70102484 /* @ECU_Address@KfLKAS_d_OffstCtrlr_DeadZone@ */ Scalar_FLOAT32_IEEE 0 LKAS_subsystem_integrated_CM_single_m 0.0 1.0 /end CHARACTERISTIC
/begin CHARACTERISTIC KfLKAS_d_PosVal "The threshold used for trajectory generation." VALUE 0x70102480 /* @ECU_Address@KfLKAS_d_PosVal@ */ Scalar_FLOAT32_IEEE 0 LKAS_subsystem_integrated_CM_single_m 0.5 1.0 /end CHARACTERISTIC
/begin CHARACTERISTIC KfLKAS_d_VehicleWheelBase "" VALUE 0x7010247c /* @ECU_Address@KfLKAS_d_VehicleWheelBase@ */ Scalar_FLOAT32_IEEE 0 LKAS_subsystem_integrated_CM_single_m 0.0 10.0 /end CHARACTERISTIC
/begin CHARACTERISTIC KfLKAS_d_VehicleWidth "" VALUE 0x70102478 /* @ECU_Address@KfLKAS_d_VehicleWidth@ */ Scalar_FLOAT32_IEEE 0 LKAS_subsystem_integrated_CM_single_m 0.0 5.0 /end CHARACTERISTIC
/begin CHARACTERISTIC KfLKAS_d_WarnLineLvlOne "When vehicle speed is higher than 1.0m/s, the earliest warning line shall be placed no more than 1.5m inside the lane boundary." VALUE 0x70102474 /* @ECU_Address@KfLKAS_d_WarnLineLvlOne@ */ Scalar_FLOAT32_IEEE 0 LKAS_subsystem_integrated_CM_single_m 0.0 1.5 /end CHARACTERISTIC
/begin CHARACTERISTIC KfLKAS_d_WarnLineLvlThree "When vehicle speed is not higher than 0.5 m/s, the earliest warning line shall be placed no more than 0.75m inside the lane boundary." VALUE 0x70102470 /* @ECU_Address@KfLKAS_d_WarnLineLvlThree@ */ Scalar_FLOAT32_IEEE 0 LKAS_subsystem_integrated_CM_single_m 0.0 0.75 /end CHARACTERISTIC
/begin CHARACTERISTIC KfLKAS_j_MaxTrigJerk_sLKA "The max jerk in generated trajectory that allows to trigger LKAS." VALUE 0x7010246c /* @ECU_Address@KfLKAS_j_MaxTrigJerk_sLKA@ */ Scalar_FLOAT32_IEEE 0 LKAS_subsystem_integrated_CM_single_m__s__3_ 0.0 5.0 /end CHARACTERISTIC
/begin CHARACTERISTIC KfLKAS_k_StrAngFiltr "" VALUE 0x70102468 /* @ECU_Address@KfLKAS_k_StrAngFiltr@ */ Scalar_FLOAT32_IEEE 0 LKAS_subsystem_integrated_CM_single 0.0 1.0 /end CHARACTERISTIC
/begin CHARACTERISTIC KfLKAS_m_MForLatCtrl "The mass of vehicle being used in two-wheel model calculation." VALUE 0x70102464 /* @ECU_Address@KfLKAS_m_MForLatCtrl@ */ Scalar_FLOAT32_IEEE 0 LKAS_subsystem_integrated_CM_single_kg 0.0 10000.0 /end CHARACTERISTIC
/begin CHARACTERISTIC KfLKAS_r_CurvBuffCoe "The coefficient that multiples the distance to lanemarker when the vehicle is driving under large curavture." VALUE 0x70102460 /* @ECU_Address@KfLKAS_r_CurvBuffCoe@ */ Scalar_FLOAT32_IEEE 0 LKAS_subsystem_integrated_CM_single 0.0 2.0 /end CHARACTERISTIC
/begin CHARACTERISTIC KfLKAS_r_PGainForVlat "The proportional gain for Vlat in lateral controller." VALUE 0x7010245c /* @ECU_Address@KfLKAS_r_PGainForVlat@ */ Scalar_FLOAT32_IEEE 0 LKAS_subsystem_integrated_CM_single 0.0 20.0 /end CHARACTERISTIC
/begin CHARACTERISTIC KfLKAS_r_StrRatioForLatCtrl "Steer ratio used in two-wheel model" VALUE 0x70102458 /* @ECU_Address@KfLKAS_r_StrRatioForLatCtrl@ */ Scalar_FLOAT32_IEEE 0 LKAS_subsystem_integrated_CM_single 0.0 30.0 /end CHARACTERISTIC
/begin CHARACTERISTIC KfLKAS_r_WarnLineLvlTwo "When vehicle speed is higher than 0.5m/s but not  higher than 1.0m/s, the earliest warning line shall be placed no more than 1.5*Va m inside the lane boundary" VALUE 0x70102454 /* @ECU_Address@KfLKAS_r_WarnLineLvlTwo@ */ Scalar_FLOAT32_IEEE 0 LKAS_subsystem_integrated_CM_single 0.0 1.5 /end CHARACTERISTIC
/begin CHARACTERISTIC KfLKAS_t_MaxIntvTime "Max intervention time that allows in a single time." VALUE 0x70102450 /* @ECU_Address@KfLKAS_t_MaxIntvTime@ */ Scalar_FLOAT32_IEEE 0 LKAS_subsystem_integrated_CM_single_s 0.0 50.0 /end CHARACTERISTIC
/begin CHARACTERISTIC KfLKAS_t_RoadEnblOKHoldLow "The road is enabled if the time of road lane width enable is larger than RoadEnableOKHoldLow." VALUE 0x7010244c /* @ECU_Address@KfLKAS_t_RoadEnblOKHoldLow@ */ Scalar_FLOAT32_IEEE 0 LKAS_subsystem_integrated_CM_single_s 1.0 2.0 /end CHARACTERISTIC
/begin CHARACTERISTIC KfLKAS_t_TLCThrsh "Time to lane crossing (TTLC) threshold." VALUE 0x70102448 /* @ECU_Address@KfLKAS_t_TLCThrsh@ */ Scalar_FLOAT32_IEEE 0 LKAS_subsystem_integrated_CM_single_s 0.0 2.0 /end CHARACTERISTIC
/begin CHARACTERISTIC KfLKAS_t_TMaxNeeded_sLKA "The max time allowed in generated trajectory to trigger LKAS." VALUE 0x70102444 /* @ECU_Address@KfLKAS_t_TMaxNeeded_sLKA@ */ Scalar_FLOAT32_IEEE 0 LKAS_subsystem_integrated_CM_single_s 0.0 50.0 /end CHARACTERISTIC
/begin CHARACTERISTIC KfLKAS_v_MaxStepForVLat "The max change allowed for lateral velocity at one step." VALUE 0x70102440 /* @ECU_Address@KfLKAS_v_MaxStepForVLat@ */ Scalar_FLOAT32_IEEE 0 LKAS_subsystem_integrated_CM_single_m_s 1.0 2.0 /end CHARACTERISTIC
/begin CHARACTERISTIC KfLKAS_v_VMaxToTrigZeroPath_sLKA "The max lateral velocity that allows to use zero trajectory." VALUE 0x7010243c /* @ECU_Address@KfLKAS_v_VMaxToTrigZeroPath_sLKA@ */ Scalar_FLOAT32_IEEE 0 LKAS_subsystem_integrated_CM_single_m_s 0.0 5.0 /end CHARACTERISTIC
/begin CHARACTERISTIC KfLKAS_v_VlatCtrlr_DeadZone "" VALUE 0x70102438 /* @ECU_Address@KfLKAS_v_VlatCtrlr_DeadZone@ */ Scalar_FLOAT32_IEEE 0 LKAS_subsystem_integrated_CM_single_m_s 0.0 1.0 /end CHARACTERISTIC
/begin CHARACTERISTIC KfLKAS_v_VlatMaxForCmpl "The max lateral velocity used for inervention completion." VALUE 0x70102434 /* @ECU_Address@KfLKAS_v_VlatMaxForCmpl@ */ Scalar_FLOAT32_IEEE 0 LKAS_subsystem_integrated_CM_single_m_s 0.0 5.0 /end CHARACTERISTIC
/begin CHARACTERISTIC KfLKAS_v_VlatMinForCmpl "The max lateral velocity used for inervention completion." VALUE 0x70102430 /* @ECU_Address@KfLKAS_v_VlatMinForCmpl@ */ Scalar_FLOAT32_IEEE 0 LKAS_subsystem_integrated_CM_single_m_s 0.0 5.0 /end CHARACTERISTIC
/begin CHARACTERISTIC KcLKAS_CntSample "The sample time that state machine uses in a loop." VALUE 0x701023ae /* @ECU_Address@KcLKAS_CntSample@ */ Scalar_UWORD 0 LKAS_subsystem_integrated_CM_uint16 1.0 10.0 /end CHARACTERISTIC
/begin CHARACTERISTIC KfLKAS_t_LnMkrMissThrsh "The maximum time that a lane marker could termporarily go missing" VALUE 0x701023ac /* @ECU_Address@KfLKAS_t_LnMkrMissThrsh@ */ Scalar_UWORD 0 LKAS_subsystem_integrated_CM_uint16_10ms 0.0 1000.0 /end CHARACTERISTIC
/begin CHARACTERISTIC KfLKAS_t_TDelayForAct_sLKA "Time delay for activation to increase robustness." VALUE 0x701023aa /* @ECU_Address@KfLKAS_t_TDelayForAct_sLKA@ */ Scalar_UWORD 0 LKAS_subsystem_integrated_CM_uint16_10ms 0.0 100.0 /end CHARACTERISTIC
/begin CHARACTERISTIC KfLKAS_t_TDelayForCmpl_sLKA "" VALUE 0x701023a8 /* @ECU_Address@KfLKAS_t_TDelayForCmpl_sLKA@ */ Scalar_UWORD 0 LKAS_subsystem_integrated_CM_uint16_10ms 0.0 100.0 /end CHARACTERISTIC
/begin CHARACTERISTIC KfLKAS_t_TimeDlyAbort "Time delay for activation abort." VALUE 0x701023a6 /* @ECU_Address@KfLKAS_t_TimeDlyAbort@ */ Scalar_UWORD 0 LKAS_subsystem_integrated_CM_uint16_10ms 0.0 1000.0 /end CHARACTERISTIC
/begin CHARACTERISTIC KfLKAS_r_QlyVld "Lane marker quality threshold" VALUE 0x701023a4 /* @ECU_Address@KfLKAS_r_QlyVld@ */ Scalar_UBYTE 0 LKAS_subsystem_integrated_CM_uint8 0.0 100.0 /end CHARACTERISTIC
/begin CHARACTERISTIC KbLKAS_A0Trigger_Temp "" VALUE 0x701023a3 /* @ECU_Address@KbLKAS_A0Trigger_Temp@ */ Scalar_BOOLEAN 0 LKAS_subsystem_integrated_CM_boolean 0 1 /end CHARACTERISTIC
/begin CHARACTERISTIC KbLKAS_AbortSwitch_Temp "" VALUE 0x701023a2 /* @ECU_Address@KbLKAS_AbortSwitch_Temp@ */ Scalar_BOOLEAN 0 LKAS_subsystem_integrated_CM_boolean 0 1 /end CHARACTERISTIC
/begin CHARACTERISTIC KbLKAS_NotUseOffstForCmpl_Temp "" VALUE 0x701023a1 /* @ECU_Address@KbLKAS_NotUseOffstForCmpl_Temp@ */ Scalar_BOOLEAN 0 LKAS_subsystem_integrated_CM_boolean 0 1 /end CHARACTERISTIC
/begin CHARACTERISTIC KbLKAS_SuppSwitch_Temp "" VALUE 0x701023a0 /* @ECU_Address@KbLKAS_SuppSwitch_Temp@ */ Scalar_BOOLEAN 0 LKAS_subsystem_integrated_CM_boolean 0.0 1.0 /end CHARACTERISTIC
/begin CHARACTERISTIC KbLKAS_TargetSwitch_Temp "" VALUE 0x7010239f /* @ECU_Address@KbLKAS_TargetSwitch_Temp@ */ Scalar_BOOLEAN 0 LKAS_subsystem_integrated_CM_boolean 0 1 /end CHARACTERISTIC
/begin CHARACTERISTIC KbLKAS_TriggerLDWSwitch "The switch that uses LDWS triggering conditions." VALUE 0x7010239e /* @ECU_Address@KbLKAS_TriggerLDWSwitch@ */ Scalar_BOOLEAN 0 LKAS_subsystem_integrated_CM_boolean 0.0 1.0 /end CHARACTERISTIC
/begin CHARACTERISTIC KbLKAS_UseInsidePathForCmpl_Temp "" VALUE 0x7010239d /* @ECU_Address@KbLKAS_UseInsidePathForCmpl_Temp@ */ Scalar_BOOLEAN 0 LKAS_subsystem_integrated_CM_boolean 0 1 /end CHARACTERISTIC
/begin CHARACTERISTIC KbLKAS_UseVmaxForCmpl_Temp "" VALUE 0x7010239c /* @ECU_Address@KbLKAS_UseVmaxForCmpl_Temp@ */ Scalar_BOOLEAN 0 LKAS_subsystem_integrated_CM_boolean 0 1 /end CHARACTERISTIC
/begin AXIS_PTS KtACCS_AXIS_OpenAccelStop_StopDis "The axis for the calibration KtACCS_t_CalOpenAccelForStopFrmDCSN" 0x70100ec0 /* @ECU_Address@KtACCS_AXIS_OpenAccelStop_StopDis@ */ NO_INPUT_QUANTITY Lookup1D_X_FLOAT32_IEEE 0 ACCS_subsystem_integrated_CM_single_m 6 0.0 200.0 /end AXIS_PTS
/begin AXIS_PTS KtACCS_AXIS_OpenAccelSpedCtrl_SpedErr "This is speed error axis for KtACCS_OpenAccel_SpeedCtrl" 0x70100ed8 /* @ECU_Address@KtACCS_AXIS_OpenAccelSpedCtrl_SpedErr@ */ NO_INPUT_QUANTITY Lookup1D_X_FLOAT32_IEEE 0 ACCS_subsystem_integrated_CM_single_m_s 7 -30.0 30.0 /end AXIS_PTS
/begin AXIS_PTS KtACCS_AXIS_OpenAccelLowSpedCtrl_SpedErr "This is speed error axis for KtACCS_a_OpenAccel_LowSpeedCtrl" 0x70100ef4 /* @ECU_Address@KtACCS_AXIS_OpenAccelLowSpedCtrl_SpedErr@ */ NO_INPUT_QUANTITY Lookup1D_X_FLOAT32_IEEE 0 ACCS_subsystem_integrated_CM_single_m_s 7 -45.0 45.0 /end AXIS_PTS
/begin AXIS_PTS KtACCS_AXIS_OpenAccelLaunch_CurSpd "This is vehcile speed axis for KtACCS_OpenAccel_Launch" 0x70100f10 /* @ECU_Address@KtACCS_AXIS_OpenAccelLaunch_CurSpd@ */ NO_INPUT_QUANTITY Lookup1D_X_FLOAT32_IEEE 0 ACCS_subsystem_integrated_CM_single_m_s 6 0.0 50.0 /end AXIS_PTS
/begin AXIS_PTS KtACCS_AXIS_StopStatus_Accel_Pitch "This is Pitch axis for KtACCS_StopStatus_Accel" 0x70100e28 /* @ECU_Address@KtACCS_AXIS_StopStatus_Accel_Pitch@ */ NO_INPUT_QUANTITY Lookup1D_X_FLOAT32_IEEE 0 ACCS_subsystem_integrated_CM_single_deg 10 0.0 90.0 /end AXIS_PTS
/begin AXIS_PTS KtLKAS_AXIS_OffstCtrlPropGain "" 0x701023f0 /* @ECU_Address@KtLKAS_AXIS_OffstCtrlPropGain@ */ NO_INPUT_QUANTITY Lookup1D_X_FLOAT32_IEEE 0 LKAS_subsystem_integrated_CM_single 8 -3.4E+38 3.4E+38 /end AXIS_PTS
/begin AXIS_PTS KtLKAS_AXIS_OffstCtrlDiffGain "" 0x70102410 /* @ECU_Address@KtLKAS_AXIS_OffstCtrlDiffGain@ */ NO_INPUT_QUANTITY Lookup1D_X_FLOAT32_IEEE 0 LKAS_subsystem_integrated_CM_single 8 -3.4E+38 3.4E+38 /end AXIS_PTS
/begin MEASUREMENT VfLDWS_Theta "The angle between linear velocity and heading" FLOAT32_IEEE LDWS_subsystem_integrated_CM_single 0 0 -3.4E+38 3.4E+38 ECU_ADDRESS 0xb000518c /* @ECU_Address@VfLDWS_Theta@ */ /end MEASUREMENT
/begin MEASUREMENT VfLDWS_VLatLe "" FLOAT32_IEEE LDWS_subsystem_integrated_CM_single 0 0 -3.4E+38 3.4E+38 ECU_ADDRESS 0xb0005180 /* @ECU_Address@VfLDWS_VLatLe@ */ /end MEASUREMENT
/begin MEASUREMENT VfLDWS_EdgeLaneLe "The vertical distacne between left front wheel and left lane marker" FLOAT32_IEEE LDWS_subsystem_integrated_CM_single 0 0 -3.4E+38 3.4E+38 ECU_ADDRESS 0xb000517c /* @ECU_Address@VfLDWS_EdgeLaneLe@ */ /end MEASUREMENT
/begin MEASUREMENT VfLDWS_TLCLe "The time to collision of left side" FLOAT32_IEEE LDWS_subsystem_integrated_CM_single 0 0 -3.4E+38 3.4E+38 ECU_ADDRESS 0xb0005178 /* @ECU_Address@VfLDWS_TLCLe@ */ /end MEASUREMENT
/begin MEASUREMENT VfLDWS_EdgeLaneRi "The vertical distacne between right front wheel and right lane marker" FLOAT32_IEEE LDWS_subsystem_integrated_CM_single 0 0 -3.4E+38 3.4E+38 ECU_ADDRESS 0xb0005174 /* @ECU_Address@VfLDWS_EdgeLaneRi@ */ /end MEASUREMENT
/begin MEASUREMENT VfLDWS_VLatRi "" FLOAT32_IEEE LDWS_subsystem_integrated_CM_single 0 0 -3.4E+38 3.4E+38 ECU_ADDRESS 0xb0005170 /* @ECU_Address@VfLDWS_VLatRi@ */ /end MEASUREMENT
/begin MEASUREMENT VfLDWS_TLCRi "The time to collision of right side" FLOAT32_IEEE LDWS_subsystem_integrated_CM_single 0 0 -3.4E+38 3.4E+38 ECU_ADDRESS 0xb000516c /* @ECU_Address@VfLDWS_TLCRi@ */ /end MEASUREMENT
/begin MEASUREMENT VbLDWS_IsOnLeLine "The vehicle is on left lane marker or not" UBYTE LDWS_subsystem_integrated_CM_boolean 0 0 0 1 ECU_ADDRESS 0xb0005146 /* @ECU_Address@VbLDWS_IsOnLeLine@ */ /end MEASUREMENT
/begin MEASUREMENT VbLDWS_LeadDrctn "The heading of vehicle is left or right. True is on left, fale is on right." UBYTE LDWS_subsystem_integrated_CM_boolean 0 0 0 1 ECU_ADDRESS 0xb0005145 /* @ECU_Address@VbLDWS_LeadDrctn@ */ /end MEASUREMENT
/begin MEASUREMENT VbLDWS_IsOnRiLine "The vehicle is on right lane marker or not" UBYTE LDWS_subsystem_integrated_CM_boolean 0 0 0 1 ECU_ADDRESS 0xb0005143 /* @ECU_Address@VbLDWS_IsOnRiLine@ */ /end MEASUREMENT
/begin MEASUREMENT VbLDWS_SuppLe "The left LDW is whether suppressed or not" UBYTE LDWS_subsystem_integrated_CM_boolean 0 0 0 1 ECU_ADDRESS 0xb0005141 /* @ECU_Address@VbLDWS_SuppLe@ */ /end MEASUREMENT
/begin MEASUREMENT VbLDWS_SuppRi "The right LDW is whether suppressed or not" UBYTE LDWS_subsystem_integrated_CM_boolean 0 0 0 1 ECU_ADDRESS 0xb0005140 /* @ECU_Address@VbLDWS_SuppRi@ */ /end MEASUREMENT
/begin MEASUREMENT VbLDWS_RdEnblLe "The left Lane Marker is whether enabled or not" UBYTE LDWS_subsystem_integrated_CM_boolean 0 0 0 1 ECU_ADDRESS 0xb000513f /* @ECU_Address@VbLDWS_RdEnblLe@ */ /end MEASUREMENT
/begin MEASUREMENT VbLDWS_RdEnblRi "The right Lane Marker is whether enabled or not" UBYTE LDWS_subsystem_integrated_CM_boolean 0 0 0 1 ECU_ADDRESS 0xb000513e /* @ECU_Address@VbLDWS_RdEnblRi@ */ /end MEASUREMENT
/begin MEASUREMENT VfAEBD_AEB_a "" FLOAT32_IEEE AEBD_subsystem_integrated_CM_single 0 0 -3.4E+38 3.4E+38 ECU_ADDRESS 0xb00020c4 /* @ECU_Address@VfAEBD_AEB_a@ */ /end MEASUREMENT
/begin MEASUREMENT VcAEBD_ErrorCount "" UWORD AEBD_subsystem_integrated_CM_uint16 0 0 0 65535 ECU_ADDRESS 0xb00020c2 /* @ECU_Address@VcAEBD_ErrorCount@ */ /end MEASUREMENT
/begin MEASUREMENT VfAEBD_t_DelayTime "" UBYTE AEBD_subsystem_integrated_CM_uint8 0 0 0 255 ECU_ADDRESS 0xb00020c1 /* @ECU_Address@VfAEBD_t_DelayTime@ */ /end MEASUREMENT
/begin MEASUREMENT VbAEBD_Error "" UBYTE AEBD_subsystem_integrated_CM_boolean 0 0 0 1 ECU_ADDRESS 0xb00020c0 /* @ECU_Address@VbAEBD_Error@ */ /end MEASUREMENT
/begin MEASUREMENT VbAEBD_Suppress "" UBYTE AEBD_subsystem_integrated_CM_boolean 0 0 0 1 ECU_ADDRESS 0xb00020bf /* @ECU_Address@VbAEBD_Suppress@ */ /end MEASUREMENT
/begin MEASUREMENT VbAEBD_Pedoff "" UBYTE AEBD_subsystem_integrated_CM_boolean 0 0 0 1 ECU_ADDRESS 0xb00020be /* @ECU_Address@VbAEBD_Pedoff@ */ /end MEASUREMENT
/begin MEASUREMENT VbAEBD_AEBaError "" UBYTE AEBD_subsystem_integrated_CM_boolean 0 0 0 1 ECU_ADDRESS 0xb00020bd /* @ECU_Address@VbAEBD_AEBaError@ */ /end MEASUREMENT
/begin MEASUREMENT VbAEBD_AEBrequest "" UBYTE AEBD_subsystem_integrated_CM_boolean 0 0 0 1 ECU_ADDRESS 0xb00020bc /* @ECU_Address@VbAEBD_AEBrequest@ */ /end MEASUREMENT
/begin MEASUREMENT VfALCA_v_LateralSpeedOutput "ALCA outpurt." FLOAT32_IEEE ALCA_subsystem_integrated_CM_single_m_s 0 0 -3.4E+38 3.4E+38 ECU_ADDRESS 0xb0002dc4 /* @ECU_Address@VfALCA_v_LateralSpeedOutput@ */ /end MEASUREMENT
/begin MEASUREMENT VfALCA_d_LateralDist2GoFromLCCS "Larteral distance to go from LCCS." FLOAT32_IEEE ALCA_subsystem_integrated_CM_single_m 0 0 -3.4E+38 3.4E+38 ECU_ADDRESS 0xb0002dc0 /* @ECU_Address@VfALCA_d_LateralDist2GoFromLCCS@ */ /end MEASUREMENT
/begin MEASUREMENT VfALCA_LeftLaneMarker_C0 "" FLOAT32_IEEE ALCA_subsystem_integrated_CM_single 0 0 -3.4E+38 3.4E+38 ECU_ADDRESS 0xb0002dbc /* @ECU_Address@VfALCA_LeftLaneMarker_C0@ */ /end MEASUREMENT
/begin MEASUREMENT VfALCA_LeftLaneMarker_C1 "" FLOAT32_IEEE ALCA_subsystem_integrated_CM_single 0 0 -3.4E+38 3.4E+38 ECU_ADDRESS 0xb0002db8 /* @ECU_Address@VfALCA_LeftLaneMarker_C1@ */ /end MEASUREMENT
/begin MEASUREMENT VfALCA_LeftLaneMarker_C2 "" FLOAT32_IEEE ALCA_subsystem_integrated_CM_single 0 0 -3.4E+38 3.4E+38 ECU_ADDRESS 0xb0002db4 /* @ECU_Address@VfALCA_LeftLaneMarker_C2@ */ /end MEASUREMENT
/begin MEASUREMENT VfALCA_LeftLaneMarker_C3 "" FLOAT32_IEEE ALCA_subsystem_integrated_CM_single 0 0 -3.4E+38 3.4E+38 ECU_ADDRESS 0xb0002db0 /* @ECU_Address@VfALCA_LeftLaneMarker_C3@ */ /end MEASUREMENT
/begin MEASUREMENT VfALCA_LeftDist2Host "Distance-to-host of left lane marker." FLOAT32_IEEE ALCA_subsystem_integrated_CM_single_m 0 0 -3.4E+38 3.4E+38 ECU_ADDRESS 0xb0002dac /* @ECU_Address@VfALCA_LeftDist2Host@ */ /end MEASUREMENT
/begin MEASUREMENT VfALCA_RightLaneMarker_C0 "" FLOAT32_IEEE ALCA_subsystem_integrated_CM_single 0 0 -3.4E+38 3.4E+38 ECU_ADDRESS 0xb0002da8 /* @ECU_Address@VfALCA_RightLaneMarker_C0@ */ /end MEASUREMENT
/begin MEASUREMENT VfALCA_RightLaneMarker_C1 "" FLOAT32_IEEE ALCA_subsystem_integrated_CM_single 0 0 -3.4E+38 3.4E+38 ECU_ADDRESS 0xb0002da4 /* @ECU_Address@VfALCA_RightLaneMarker_C1@ */ /end MEASUREMENT
/begin MEASUREMENT VfALCA_RightLaneMarker_C2 "" FLOAT32_IEEE ALCA_subsystem_integrated_CM_single 0 0 -3.4E+38 3.4E+38 ECU_ADDRESS 0xb0002da0 /* @ECU_Address@VfALCA_RightLaneMarker_C2@ */ /end MEASUREMENT
/begin MEASUREMENT VfALCA_RightLaneMarker_C3 "" FLOAT32_IEEE ALCA_subsystem_integrated_CM_single 0 0 -3.4E+38 3.4E+38 ECU_ADDRESS 0xb0002d9c /* @ECU_Address@VfALCA_RightLaneMarker_C3@ */ /end MEASUREMENT
/begin MEASUREMENT VfALCA_RightDist2Host "Distance-to-host of right lane marker." FLOAT32_IEEE ALCA_subsystem_integrated_CM_single_m 0 0 -3.4E+38 3.4E+38 ECU_ADDRESS 0xb0002d98 /* @ECU_Address@VfALCA_RightDist2Host@ */ /end MEASUREMENT
/begin MEASUREMENT VfALCA_v_VehSpeed "Speed of ego veh." FLOAT32_IEEE ALCA_subsystem_integrated_CM_single_m_s 0 0 -3.4E+38 3.4E+38 ECU_ADDRESS 0xb0002d94 /* @ECU_Address@VfALCA_v_VehSpeed@ */ /end MEASUREMENT
/begin MEASUREMENT VfALCA_v_VehVx "Speed of ego veh." FLOAT32_IEEE ALCA_subsystem_integrated_CM_single_m_s 0 0 -3.4E+38 3.4E+38 ECU_ADDRESS 0xb0002d90 /* @ECU_Address@VfALCA_v_VehVx@ */ /end MEASUREMENT
/begin MEASUREMENT VfALCA_v_VehVy "Speed of ego veh." FLOAT32_IEEE ALCA_subsystem_integrated_CM_single_m_s 0 0 -3.4E+38 3.4E+38 ECU_ADDRESS 0xb0002d8c /* @ECU_Address@VfALCA_v_VehVy@ */ /end MEASUREMENT
/begin MEASUREMENT VfALCA_ObstacleNearest_x "" FLOAT32_IEEE ALCA_subsystem_integrated_CM_single 0 0 -3.4E+38 3.4E+38 ECU_ADDRESS 0xb0002d88 /* @ECU_Address@VfALCA_ObstacleNearest_x@ */ /end MEASUREMENT
/begin MEASUREMENT VfALCA_ObstacleNearest_y "" FLOAT32_IEEE ALCA_subsystem_integrated_CM_single 0 0 -3.4E+38 3.4E+38 ECU_ADDRESS 0xb0002d84 /* @ECU_Address@VfALCA_ObstacleNearest_y@ */ /end MEASUREMENT
/begin MEASUREMENT VfALCA_ObstacleCenter_x "" FLOAT32_IEEE ALCA_subsystem_integrated_CM_single 0 0 -3.4E+38 3.4E+38 ECU_ADDRESS 0xb0002d80 /* @ECU_Address@VfALCA_ObstacleCenter_x@ */ /end MEASUREMENT
/begin MEASUREMENT VfALCA_v_Obstacle_Vx "" FLOAT32_IEEE ALCA_subsystem_integrated_CM_single_m_s 0 0 -3.4E+38 3.4E+38 ECU_ADDRESS 0xb0002d7c /* @ECU_Address@VfALCA_v_Obstacle_Vx@ */ /end MEASUREMENT
/begin MEASUREMENT VfALCA_v_Obstacle_Vy "" FLOAT32_IEEE ALCA_subsystem_integrated_CM_single_m_s 0 0 -3.4E+38 3.4E+38 ECU_ADDRESS 0xb0002d78 /* @ECU_Address@VfALCA_v_Obstacle_Vy@ */ /end MEASUREMENT
/begin MEASUREMENT VfALCA_ObstacleCenter_y "" FLOAT32_IEEE ALCA_subsystem_integrated_CM_single 0 0 -3.4E+38 3.4E+38 ECU_ADDRESS 0xb0002d74 /* @ECU_Address@VfALCA_ObstacleCenter_y@ */ /end MEASUREMENT
/begin MEASUREMENT VfALCA_ObstacleLength "" FLOAT32_IEEE ALCA_subsystem_integrated_CM_single_m 0 0 -3.4E+38 3.4E+38 ECU_ADDRESS 0xb0002d70 /* @ECU_Address@VfALCA_ObstacleLength@ */ /end MEASUREMENT
/begin MEASUREMENT VfALCA_ObstacleWidth "" FLOAT32_IEEE ALCA_subsystem_integrated_CM_single_m 0 0 -3.4E+38 3.4E+38 ECU_ADDRESS 0xb0002d6c /* @ECU_Address@VfALCA_ObstacleWidth@ */ /end MEASUREMENT
/begin MEASUREMENT VfALCA_ObstacleHeading "" FLOAT32_IEEE ALCA_subsystem_integrated_CM_single 0 0 -3.4E+38 3.4E+38 ECU_ADDRESS 0xb0002d68 /* @ECU_Address@VfALCA_ObstacleHeading@ */ /end MEASUREMENT
/begin MEASUREMENT VfALCA_t_LCTime "" FLOAT32_IEEE ALCA_subsystem_integrated_CM_single_s 0 0 -3.4E+38 3.4E+38 ECU_ADDRESS 0xb0002d64 /* @ECU_Address@VfALCA_t_LCTime@ */ /end MEASUREMENT
/begin MEASUREMENT VfALCA_d_Host2TargetLaneCenter "Distance of ost to target lane center." FLOAT32_IEEE ALCA_subsystem_integrated_CM_single_m 0 0 -3.4E+38 3.4E+38 ECU_ADDRESS 0xb0002d60 /* @ECU_Address@VfALCA_d_Host2TargetLaneCenter@ */ /end MEASUREMENT
/begin MEASUREMENT VfALCA_d_EGOLaneCenter2Host "Distance of ost to ego lane center." FLOAT32_IEEE ALCA_subsystem_integrated_CM_single_m 0 0 -3.4E+38 3.4E+38 ECU_ADDRESS 0xb0002d5c /* @ECU_Address@VfALCA_d_EGOLaneCenter2Host@ */ /end MEASUREMENT
/begin MEASUREMENT VfALCA_d_TargetSideLaneMarker2Host "Distance of host to request-side-lane-marker." FLOAT32_IEEE ALCA_subsystem_integrated_CM_single_m 0 0 -3.4E+38 3.4E+38 ECU_ADDRESS 0xb0002d58 /* @ECU_Address@VfALCA_d_TargetSideLaneMarker2Host@ */ /end MEASUREMENT
/begin MEASUREMENT VfALCA_ObstacleID "" SLONG ALCA_subsystem_integrated_CM_int32 0 0 -2147483648 2147483647 ECU_ADDRESS 0xb0002d54 /* @ECU_Address@VfALCA_ObstacleID@ */ /end MEASUREMENT
/begin MEASUREMENT VfALCA_LeftLaneMarkerFusionStatus "Left Lane Marker`s Fusion Status" SBYTE ALCA_subsystem_integrated_CM_int8 0 0 -128 127 ECU_ADDRESS 0xb0002d52 /* @ECU_Address@VfALCA_LeftLaneMarkerFusionStatus@ */ /end MEASUREMENT
/begin MEASUREMENT VfALCA_LeftLaneMarkerType "Left Lane Marker`s type." SBYTE ALCA_subsystem_integrated_CM_int8 0 0 -128 127 ECU_ADDRESS 0xb0002d51 /* @ECU_Address@VfALCA_LeftLaneMarkerType@ */ /end MEASUREMENT
/begin MEASUREMENT VfALCA_RightLaneMarkerFusionStatus "Right Lane Marker`s Fusion Status" SBYTE ALCA_subsystem_integrated_CM_int8 0 0 -128 127 ECU_ADDRESS 0xb0002d50 /* @ECU_Address@VfALCA_RightLaneMarkerFusionStatus@ */ /end MEASUREMENT
/begin MEASUREMENT VfALCA_RightLaneMarkerType "Right Lane Marker`s  type" SBYTE ALCA_subsystem_integrated_CM_int8 0 0 -128 127 ECU_ADDRESS 0xb0002d4f /* @ECU_Address@VfALCA_RightLaneMarkerType@ */ /end MEASUREMENT
/begin MEASUREMENT VfALCA_FaultOutput "ALCA outpurt." UBYTE ALCA_subsystem_integrated_CM_uint8 0 0 0 255 ECU_ADDRESS 0xb0002d4e /* @ECU_Address@VfALCA_FaultOutput@ */ /end MEASUREMENT
/begin MEASUREMENT VfALCA_FaultInit "Fault before outpurt." UBYTE ALCA_subsystem_integrated_CM_uint8 0 0 0 255 ECU_ADDRESS 0xb0002d4d /* @ECU_Address@VfALCA_FaultInit@ */ /end MEASUREMENT
/begin MEASUREMENT KfALCA_InterruptAction "" UBYTE ALCA_subsystem_integrated_CM_uint8 0 0 0 255 ECU_ADDRESS 0xb0002d4c /* @ECU_Address@KfALCA_InterruptAction@ */ /end MEASUREMENT
/begin MEASUREMENT VbALCA_ALCAEnableFromDCSN "ALCA enable from Dcsn." UBYTE ALCA_subsystem_integrated_CM_boolean 0 0 0 1 ECU_ADDRESS 0xb0002d4b /* @ECU_Address@VbALCA_ALCAEnableFromDCSN@ */ /end MEASUREMENT
/begin MEASUREMENT VbALCA_RequestOutput "ALCA outpurt." UBYTE ALCA_subsystem_integrated_CM_boolean 0 0 0 1 ECU_ADDRESS 0xb0002d4a /* @ECU_Address@VbALCA_RequestOutput@ */ /end MEASUREMENT
/begin MEASUREMENT VfALCA_v_InterruptOutput "" UBYTE ALCA_subsystem_integrated_CM_boolean 0 0 0 1 ECU_ADDRESS 0xb0002d49 /* @ECU_Address@VfALCA_v_InterruptOutput@ */ /end MEASUREMENT
/begin MEASUREMENT VbALCA_LC_CancelReqFromDCSN "Lane change cancel request from DCSN." UBYTE ALCA_subsystem_integrated_CM_boolean 0 0 0 1 ECU_ADDRESS 0xb0002d48 /* @ECU_Address@VbALCA_LC_CancelReqFromDCSN@ */ /end MEASUREMENT
/begin MEASUREMENT VbALCA_LC_ReqFromDCSN "Lane change from DCSN." UBYTE ALCA_subsystem_integrated_CM_boolean 0 0 0 1 ECU_ADDRESS 0xb0002d47 /* @ECU_Address@VbALCA_LC_ReqFromDCSN@ */ /end MEASUREMENT
/begin MEASUREMENT VbALCA_LC_Req "Lane change from DCSN." UBYTE ALCA_subsystem_integrated_CM_boolean 0 0 0 1 ECU_ADDRESS 0xb0002d46 /* @ECU_Address@VbALCA_LC_Req@ */ /end MEASUREMENT
/begin MEASUREMENT VbALCA_LC_CancelReq "Lane change cancel request from DCSN." UBYTE ALCA_subsystem_integrated_CM_boolean 0 0 0 1 ECU_ADDRESS 0xb0002d45 /* @ECU_Address@VbALCA_LC_CancelReq@ */ /end MEASUREMENT
/begin MEASUREMENT VbALCA_ResetLaneChangeReq "Reset lane change request from DCSN." UBYTE ALCA_subsystem_integrated_CM_boolean 0 0 0 1 ECU_ADDRESS 0xb0002d44 /* @ECU_Address@VbALCA_ResetLaneChangeReq@ */ /end MEASUREMENT
/begin MEASUREMENT VbALCA_LC_Complete "Lane change complete flag." UBYTE ALCA_subsystem_integrated_CM_boolean 0 0 0 1 ECU_ADDRESS 0xb0002d43 /* @ECU_Address@VbALCA_LC_Complete@ */ /end MEASUREMENT
/begin MEASUREMENT VbALCA_TouchedNewLane "Has touched new lane." UBYTE ALCA_subsystem_integrated_CM_boolean 0 0 0 1 ECU_ADDRESS 0xb0002d42 /* @ECU_Address@VbALCA_TouchedNewLane@ */ /end MEASUREMENT
/begin MEASUREMENT VeALCA_ReqSideOutput "ALCA outpurt." UBYTE ALCA_subsystem_integrated_CM_EnumDCSN_driving_direction 0 0 0 2 ECU_ADDRESS 0xb0002d41 /* @ECU_Address@VeALCA_ReqSideOutput@ */ /end MEASUREMENT
/begin MEASUREMENT VeALCA_ReqSideFromDCSN "Request side from DCSN." UBYTE ALCA_subsystem_integrated_CM_EnumDCSN_driving_direction 0 0 0 2 ECU_ADDRESS 0xb0002d40 /* @ECU_Address@VeALCA_ReqSideFromDCSN@ */ /end MEASUREMENT
/begin MEASUREMENT VeALCA_ReqSide "Request side from DCSN." UBYTE ALCA_subsystem_integrated_CM_EnumDCSN_driving_direction 0 0 0 2 ECU_ADDRESS 0xb0002d3f /* @ECU_Address@VeALCA_ReqSide@ */ /end MEASUREMENT
/begin MEASUREMENT VeALCA_StateOutput "ALCA outpurt." UBYTE ALCA_subsystem_integrated_CM_EnumALCA_state 0 0 0 7 ECU_ADDRESS 0xb0002d3e /* @ECU_Address@VeALCA_StateOutput@ */ /end MEASUREMENT
/begin MEASUREMENT VeALCA_NotFulfillReasonOutput "ALCA outpurt." UBYTE ALCA_subsystem_integrated_CM_EnumALCA_not_fulfill_reason 0 0 0 9 ECU_ADDRESS 0xb0002d3d /* @ECU_Address@VeALCA_NotFulfillReasonOutput@ */ /end MEASUREMENT
/begin MEASUREMENT VfALCA_v_InterruptTypeOutput "" UBYTE ALCA_subsystem_integrated_CM_EnumALCA_interrupt_type 0 0 0 2 ECU_ADDRESS 0xb0002d3c /* @ECU_Address@VfALCA_v_InterruptTypeOutput@ */ /end MEASUREMENT
/begin MEASUREMENT VfALCA_TargetLaneLength "" FLOAT32_IEEE ALCA_subsystem_integrated_CM_single 0 0 -3.4E+38 3.4E+38 ECU_ADDRESS 0xb0002d38 /* @ECU_Address@VfALCA_TargetLaneLength@ */ /end MEASUREMENT
/begin MEASUREMENT VfALCA_TargetLaneWidth "" FLOAT32_IEEE ALCA_subsystem_integrated_CM_single 0 0 -3.4E+38 3.4E+38 ECU_ADDRESS 0xb0002d34 /* @ECU_Address@VfALCA_TargetLaneWidth@ */ /end MEASUREMENT
/begin MEASUREMENT VfALCA_d_EGOLaneLength "Length of ego lane." FLOAT32_IEEE ALCA_subsystem_integrated_CM_single_m 0 0 -3.4E+38 3.4E+38 ECU_ADDRESS 0xb0002d30 /* @ECU_Address@VfALCA_d_EGOLaneLength@ */ /end MEASUREMENT
/begin MEASUREMENT VfALCA_d_EGOLaneWidth "Width of ego lane." FLOAT32_IEEE ALCA_subsystem_integrated_CM_single_m 0 0 -3.4E+38 3.4E+38 ECU_ADDRESS 0xb0002d2c /* @ECU_Address@VfALCA_d_EGOLaneWidth@ */ /end MEASUREMENT
/begin MEASUREMENT VfALCA_v_VehLonSpeed2LaneMarker "" FLOAT32_IEEE ALCA_subsystem_integrated_CM_single 0 0 -3.4E+38 3.4E+38 ECU_ADDRESS 0xb0002d28 /* @ECU_Address@VfALCA_v_VehLonSpeed2LaneMarker@ */ /end MEASUREMENT
/begin MEASUREMENT VfALCA_TargetLaneType "" SBYTE ALCA_subsystem_integrated_CM_int8 0 0 -128 127 ECU_ADDRESS 0xb0002d25 /* @ECU_Address@VfALCA_TargetLaneType@ */ /end MEASUREMENT
/begin MEASUREMENT VfALCA_TargetSideLaneMarkerType "" SBYTE ALCA_subsystem_integrated_CM_int8 0 0 -128 127 ECU_ADDRESS 0xb0002d24 /* @ECU_Address@VfALCA_TargetSideLaneMarkerType@ */ /end MEASUREMENT
/begin MEASUREMENT VfALCA_HasLeftLane "Has left lane." UBYTE ALCA_subsystem_integrated_CM_boolean 0 0 0 1 ECU_ADDRESS 0xb0002d23 /* @ECU_Address@VfALCA_HasLeftLane@ */ /end MEASUREMENT
/begin MEASUREMENT VfALCA_HasRightLane "Has right lane." UBYTE ALCA_subsystem_integrated_CM_boolean 0 0 0 1 ECU_ADDRESS 0xb0002d22 /* @ECU_Address@VfALCA_HasRightLane@ */ /end MEASUREMENT
/begin MEASUREMENT VfLKAS_Vlat_sLKA "" FLOAT32_IEEE LKAS_subsystem_integrated_CM_single 0 0 -3.4E+38 3.4E+38 ECU_ADDRESS 0xb000549c /* @ECU_Address@VfLKAS_Vlat_sLKA@ */ /end MEASUREMENT
/begin MEASUREMENT VfLKAS_L_DistToCross_sLKA "" FLOAT32_IEEE LKAS_subsystem_integrated_CM_single 0 0 -3.4E+38 3.4E+38 ECU_ADDRESS 0xb0005498 /* @ECU_Address@VfLKAS_L_DistToCross_sLKA@ */ /end MEASUREMENT
/begin MEASUREMENT VfLKAS_L_ExtraMargin_sLKA "" FLOAT32_IEEE LKAS_subsystem_integrated_CM_single 0 0 -3.4E+38 3.4E+38 ECU_ADDRESS 0xb0005494 /* @ECU_Address@VfLKAS_L_ExtraMargin_sLKA@ */ /end MEASUREMENT
/begin MEASUREMENT VfLKAS_A_ALatRelLaneMkr_sLKA "" FLOAT32_IEEE LKAS_subsystem_integrated_CM_single 0 0 -3.4E+38 3.4E+38 ECU_ADDRESS 0xb0005490 /* @ECU_Address@VfLKAS_A_ALatRelLaneMkr_sLKA@ */ /end MEASUREMENT
/begin MEASUREMENT VfLKAS_A_ALatRelLaneMkrLe "" FLOAT32_IEEE LKAS_subsystem_integrated_CM_single 0 0 -3.4E+38 3.4E+38 ECU_ADDRESS 0xb000548c /* @ECU_Address@VfLKAS_A_ALatRelLaneMkrLe@ */ /end MEASUREMENT
/begin MEASUREMENT VfLKAS_A_ALatRelLaneMkrRi "" FLOAT32_IEEE LKAS_subsystem_integrated_CM_single 0 0 -3.4E+38 3.4E+38 ECU_ADDRESS 0xb0005488 /* @ECU_Address@VfLKAS_A_ALatRelLaneMkrRi@ */ /end MEASUREMENT
/begin MEASUREMENT VfLKAS_Vlong_sLKA "" FLOAT32_IEEE LKAS_subsystem_integrated_CM_single 0 0 -3.4E+38 3.4E+38 ECU_ADDRESS 0xb0005484 /* @ECU_Address@VfLKAS_Vlong_sLKA@ */ /end MEASUREMENT
/begin MEASUREMENT VfLKAS_vlat_0 "" FLOAT32_IEEE LKAS_subsystem_integrated_CM_single 0 0 -3.4E+38 3.4E+38 ECU_ADDRESS 0xb0005480 /* @ECU_Address@VfLKAS_vlat_0@ */ /end MEASUREMENT
/begin MEASUREMENT VfLKAS_alat_0 "" FLOAT32_IEEE LKAS_subsystem_integrated_CM_single 0 0 -3.4E+38 3.4E+38 ECU_ADDRESS 0xb000547c /* @ECU_Address@VfLKAS_alat_0@ */ /end MEASUREMENT
/begin MEASUREMENT VfLKAS_delta_pos_sLKA "" FLOAT32_IEEE LKAS_subsystem_integrated_CM_single 0 0 -3.4E+38 3.4E+38 ECU_ADDRESS 0xb0005478 /* @ECU_Address@VfLKAS_delta_pos_sLKA@ */ /end MEASUREMENT
/begin MEASUREMENT VfLKAS_TimeNeeded_sLKA "" FLOAT32_IEEE LKAS_subsystem_integrated_CM_single 0 0 -3.4E+38 3.4E+38 ECU_ADDRESS 0xb0005474 /* @ECU_Address@VfLKAS_TimeNeeded_sLKA@ */ /end MEASUREMENT
/begin MEASUREMENT VfLKAS_end_offst_sLKA "" FLOAT32_IEEE LKAS_subsystem_integrated_CM_single 0 0 -3.4E+38 3.4E+38 ECU_ADDRESS 0xb0005470 /* @ECU_Address@VfLKAS_end_offst_sLKA@ */ /end MEASUREMENT
/begin MEASUREMENT VfLKAS_dt_sLKA "" FLOAT32_IEEE LKAS_subsystem_integrated_CM_single 0 0 -3.4E+38 3.4E+38 ECU_ADDRESS 0xb000546c /* @ECU_Address@VfLKAS_dt_sLKA@ */ /end MEASUREMENT
/begin MEASUREMENT VfLKAS_A0_sLKA "" FLOAT32_IEEE LKAS_subsystem_integrated_CM_single 0 0 -3.4E+38 3.4E+38 ECU_ADDRESS 0xb0005468 /* @ECU_Address@VfLKAS_A0_sLKA@ */ /end MEASUREMENT
/begin MEASUREMENT VfLKAS_Am_sLKA "" FLOAT32_IEEE LKAS_subsystem_integrated_CM_single 0 0 -3.4E+38 3.4E+38 ECU_ADDRESS 0xb0005464 /* @ECU_Address@VfLKAS_Am_sLKA@ */ /end MEASUREMENT
/begin MEASUREMENT VfLKAS_Ae_sLKA "" FLOAT32_IEEE LKAS_subsystem_integrated_CM_single 0 0 -3.4E+38 3.4E+38 ECU_ADDRESS 0xb0005460 /* @ECU_Address@VfLKAS_Ae_sLKA@ */ /end MEASUREMENT
/begin MEASUREMENT VfLKAS_Am1 "" FLOAT32_IEEE LKAS_subsystem_integrated_CM_single 0 0 -3.4E+38 3.4E+38 ECU_ADDRESS 0xb000545c /* @ECU_Address@VfLKAS_Am1@ */ /end MEASUREMENT
/begin MEASUREMENT VfLKAS_Am2 "" FLOAT32_IEEE LKAS_subsystem_integrated_CM_single 0 0 -3.4E+38 3.4E+38 ECU_ADDRESS 0xb0005458 /* @ECU_Address@VfLKAS_Am2@ */ /end MEASUREMENT
/begin MEASUREMENT VfLKAS_dt1 "" FLOAT32_IEEE LKAS_subsystem_integrated_CM_single 0 0 -3.4E+38 3.4E+38 ECU_ADDRESS 0xb0005454 /* @ECU_Address@VfLKAS_dt1@ */ /end MEASUREMENT
/begin MEASUREMENT VfLKAS_dt2 "" FLOAT32_IEEE LKAS_subsystem_integrated_CM_single 0 0 -3.4E+38 3.4E+38 ECU_ADDRESS 0xb0005450 /* @ECU_Address@VfLKAS_dt2@ */ /end MEASUREMENT
/begin MEASUREMENT VfLKAS_JerkNeeded_sLkA "" FLOAT32_IEEE LKAS_subsystem_integrated_CM_single 0 0 -3.4E+38 3.4E+38 ECU_ADDRESS 0xb000544c /* @ECU_Address@VfLKAS_JerkNeeded_sLkA@ */ /end MEASUREMENT
/begin MEASUREMENT VfLKAS_LatAccNeeded_sLKA "" FLOAT32_IEEE LKAS_subsystem_integrated_CM_single 0 0 -3.4E+38 3.4E+38 ECU_ADDRESS 0xb0005448 /* @ECU_Address@VfLKAS_LatAccNeeded_sLKA@ */ /end MEASUREMENT
/begin MEASUREMENT VfLKAS_FirstEndPos "" FLOAT32_IEEE LKAS_subsystem_integrated_CM_single 0 0 -3.4E+38 3.4E+38 ECU_ADDRESS 0xb0005444 /* @ECU_Address@VfLKAS_FirstEndPos@ */ /end MEASUREMENT
/begin MEASUREMENT VfLKAS_FirstEndVlat "" FLOAT32_IEEE LKAS_subsystem_integrated_CM_single 0 0 -3.4E+38 3.4E+38 ECU_ADDRESS 0xb0005440 /* @ECU_Address@VfLKAS_FirstEndVlat@ */ /end MEASUREMENT
/begin MEASUREMENT VfLKAS_SecEndPos "" FLOAT32_IEEE LKAS_subsystem_integrated_CM_single 0 0 -3.4E+38 3.4E+38 ECU_ADDRESS 0xb000543c /* @ECU_Address@VfLKAS_SecEndPos@ */ /end MEASUREMENT
/begin MEASUREMENT VfLKAS_SecEndVlat "" FLOAT32_IEEE LKAS_subsystem_integrated_CM_single 0 0 -3.4E+38 3.4E+38 ECU_ADDRESS 0xb0005438 /* @ECU_Address@VfLKAS_SecEndVlat@ */ /end MEASUREMENT
/begin MEASUREMENT VfLKAS_V_Latleft "" FLOAT32_IEEE LKAS_subsystem_integrated_CM_single 0 0 -3.4E+38 3.4E+38 ECU_ADDRESS 0xb0005434 /* @ECU_Address@VfLKAS_V_Latleft@ */ /end MEASUREMENT
/begin MEASUREMENT VfLKAS_L_OffstLeft "" FLOAT32_IEEE LKAS_subsystem_integrated_CM_single 0 0 -3.4E+38 3.4E+38 ECU_ADDRESS 0xb0005430 /* @ECU_Address@VfLKAS_L_OffstLeft@ */ /end MEASUREMENT
/begin MEASUREMENT VfLKAS_Heading "" FLOAT32_IEEE LKAS_subsystem_integrated_CM_single 0 0 -3.4E+38 3.4E+38 ECU_ADDRESS 0xb000542c /* @ECU_Address@VfLKAS_Heading@ */ /end MEASUREMENT
/begin MEASUREMENT VfLKAS_VLatRight "" FLOAT32_IEEE LKAS_subsystem_integrated_CM_single 0 0 -3.4E+38 3.4E+38 ECU_ADDRESS 0xb0005428 /* @ECU_Address@VfLKAS_VLatRight@ */ /end MEASUREMENT
/begin MEASUREMENT VfLKAS_OffstRi_sLKA "" FLOAT32_IEEE LKAS_subsystem_integrated_CM_single 0 0 -3.4E+38 3.4E+38 ECU_ADDRESS 0xb0005424 /* @ECU_Address@VfLKAS_OffstRi_sLKA@ */ /end MEASUREMENT
/begin MEASUREMENT VfLKAS_Cr_Road "" FLOAT32_IEEE LKAS_subsystem_integrated_CM_single 0 0 -3.4E+38 3.4E+38 ECU_ADDRESS 0xb0005420 /* @ECU_Address@VfLKAS_Cr_Road@ */ /end MEASUREMENT
/begin MEASUREMENT VfLKAS_LaneWidth "" FLOAT32_IEEE LKAS_subsystem_integrated_CM_single 0 0 -3.4E+38 3.4E+38 ECU_ADDRESS 0xb000541c /* @ECU_Address@VfLKAS_LaneWidth@ */ /end MEASUREMENT
/begin MEASUREMENT VfLKAS_Velocity_x "" FLOAT32_IEEE LKAS_subsystem_integrated_CM_single 0 0 -3.4E+38 3.4E+38 ECU_ADDRESS 0xb0005418 /* @ECU_Address@VfLKAS_Velocity_x@ */ /end MEASUREMENT
/begin MEASUREMENT VfLKAS_yaw_rate_utm "" FLOAT32_IEEE LKAS_subsystem_integrated_CM_single 0 0 -3.4E+38 3.4E+38 ECU_ADDRESS 0xb0005414 /* @ECU_Address@VfLKAS_yaw_rate_utm@ */ /end MEASUREMENT
/begin MEASUREMENT VfLKAS_Acceleration_x "" FLOAT32_IEEE LKAS_subsystem_integrated_CM_single 0 0 -3.4E+38 3.4E+38 ECU_ADDRESS 0xb0005410 /* @ECU_Address@VfLKAS_Acceleration_x@ */ /end MEASUREMENT
/begin MEASUREMENT VfLKAS_Acce_y "" FLOAT32_IEEE LKAS_subsystem_integrated_CM_single 0 0 -3.4E+38 3.4E+38 ECU_ADDRESS 0xb000540c /* @ECU_Address@VfLKAS_Acce_y@ */ /end MEASUREMENT
/begin MEASUREMENT VfLKAS_T_AftIntvStart_IntOut "" FLOAT32_IEEE LKAS_subsystem_integrated_CM_single 0 0 -3.4E+38 3.4E+38 ECU_ADDRESS 0xb0005408 /* @ECU_Address@VfLKAS_T_AftIntvStart_IntOut@ */ /end MEASUREMENT
/begin MEASUREMENT VfLKAS_RiC0 "" FLOAT32_IEEE LKAS_subsystem_integrated_CM_single 0 0 -3.4E+38 3.4E+38 ECU_ADDRESS 0xb0005404 /* @ECU_Address@VfLKAS_RiC0@ */ /end MEASUREMENT
/begin MEASUREMENT VfLKAS_RiC1 "" FLOAT32_IEEE LKAS_subsystem_integrated_CM_single 0 0 -3.4E+38 3.4E+38 ECU_ADDRESS 0xb0005400 /* @ECU_Address@VfLKAS_RiC1@ */ /end MEASUREMENT
/begin MEASUREMENT VfLKAS_RiC2 "" FLOAT32_IEEE LKAS_subsystem_integrated_CM_single 0 0 -3.4E+38 3.4E+38 ECU_ADDRESS 0xb00053fc /* @ECU_Address@VfLKAS_RiC2@ */ /end MEASUREMENT
/begin MEASUREMENT VfLKAS_Ri_Length "" FLOAT32_IEEE LKAS_subsystem_integrated_CM_single 0 0 -3.4E+38 3.4E+38 ECU_ADDRESS 0xb00053f8 /* @ECU_Address@VfLKAS_Ri_Length@ */ /end MEASUREMENT
/begin MEASUREMENT VfLKAS_L_DistToCrossRight "" FLOAT32_IEEE LKAS_subsystem_integrated_CM_single 0 0 -3.4E+38 3.4E+38 ECU_ADDRESS 0xb00053f4 /* @ECU_Address@VfLKAS_L_DistToCrossRight@ */ /end MEASUREMENT
/begin MEASUREMENT VfLAKS_LeC0 "" FLOAT32_IEEE LKAS_subsystem_integrated_CM_single 0 0 -3.4E+38 3.4E+38 ECU_ADDRESS 0xb00053f0 /* @ECU_Address@VfLAKS_LeC0@ */ /end MEASUREMENT
/begin MEASUREMENT VfLAKS_LeC1 "" FLOAT32_IEEE LKAS_subsystem_integrated_CM_single 0 0 -3.4E+38 3.4E+38 ECU_ADDRESS 0xb00053ec /* @ECU_Address@VfLAKS_LeC1@ */ /end MEASUREMENT
/begin MEASUREMENT VfLKAS_LeC2 "" FLOAT32_IEEE LKAS_subsystem_integrated_CM_single 0 0 -3.4E+38 3.4E+38 ECU_ADDRESS 0xb00053e8 /* @ECU_Address@VfLKAS_LeC2@ */ /end MEASUREMENT
/begin MEASUREMENT VfLKAS_LeLength "" FLOAT32_IEEE LKAS_subsystem_integrated_CM_single 0 0 -3.4E+38 3.4E+38 ECU_ADDRESS 0xb00053e4 /* @ECU_Address@VfLKAS_LeLength@ */ /end MEASUREMENT
/begin MEASUREMENT VfLKAS_L_DisToCrossLeft "" FLOAT32_IEEE LKAS_subsystem_integrated_CM_single 0 0 -3.4E+38 3.4E+38 ECU_ADDRESS 0xb00053e0 /* @ECU_Address@VfLKAS_L_DisToCrossLeft@ */ /end MEASUREMENT
/begin MEASUREMENT VfLKAS_T_AftIntvStart "" FLOAT32_IEEE LKAS_subsystem_integrated_CM_single 0 0 -3.4E+38 3.4E+38 ECU_ADDRESS 0xb00053dc /* @ECU_Address@VfLKAS_T_AftIntvStart@ */ /end MEASUREMENT
/begin MEASUREMENT VfLKAS_dtFreezed_sLKA "" FLOAT32_IEEE LKAS_subsystem_integrated_CM_single 0 0 -3.4E+38 3.4E+38 ECU_ADDRESS 0xb00053d8 /* @ECU_Address@VfLKAS_dtFreezed_sLKA@ */ /end MEASUREMENT
/begin MEASUREMENT VfLKAS_AmFreezed_sLKA "" FLOAT32_IEEE LKAS_subsystem_integrated_CM_single 0 0 -3.4E+38 3.4E+38 ECU_ADDRESS 0xb00053d4 /* @ECU_Address@VfLKAS_AmFreezed_sLKA@ */ /end MEASUREMENT
/begin MEASUREMENT VfLKAS_V0Freezed_sLKA "" FLOAT32_IEEE LKAS_subsystem_integrated_CM_single 0 0 -3.4E+38 3.4E+38 ECU_ADDRESS 0xb00053d0 /* @ECU_Address@VfLKAS_V0Freezed_sLKA@ */ /end MEASUREMENT
/begin MEASUREMENT VfLKAS_A0Freezed_sLKA "" FLOAT32_IEEE LKAS_subsystem_integrated_CM_single 0 0 -3.4E+38 3.4E+38 ECU_ADDRESS 0xb00053cc /* @ECU_Address@VfLKAS_A0Freezed_sLKA@ */ /end MEASUREMENT
/begin MEASUREMENT VfLKAS_AeFreezed_sLKA "" FLOAT32_IEEE LKAS_subsystem_integrated_CM_single 0 0 -3.4E+38 3.4E+38 ECU_ADDRESS 0xb00053c8 /* @ECU_Address@VfLKAS_AeFreezed_sLKA@ */ /end MEASUREMENT
/begin MEASUREMENT VfLKAS_Jerk2 "" FLOAT32_IEEE LKAS_subsystem_integrated_CM_single 0 0 -3.4E+38 3.4E+38 ECU_ADDRESS 0xb00053c4 /* @ECU_Address@VfLKAS_Jerk2@ */ /end MEASUREMENT
/begin MEASUREMENT VfLKAS_TargetDist_Freezed2 "" FLOAT32_IEEE LKAS_subsystem_integrated_CM_single 0 0 -3.4E+38 3.4E+38 ECU_ADDRESS 0xb00053c0 /* @ECU_Address@VfLKAS_TargetDist_Freezed2@ */ /end MEASUREMENT
/begin MEASUREMENT VfLKAS_Jerk1 "" FLOAT32_IEEE LKAS_subsystem_integrated_CM_single 0 0 -3.4E+38 3.4E+38 ECU_ADDRESS 0xb00053bc /* @ECU_Address@VfLKAS_Jerk1@ */ /end MEASUREMENT
/begin MEASUREMENT VfLKAS_TargetDist_Freezed1 "" FLOAT32_IEEE LKAS_subsystem_integrated_CM_single 0 0 -3.4E+38 3.4E+38 ECU_ADDRESS 0xb00053b8 /* @ECU_Address@VfLKAS_TargetDist_Freezed1@ */ /end MEASUREMENT
/begin MEASUREMENT VfLKAS_TargetV "" FLOAT32_IEEE LKAS_subsystem_integrated_CM_single 0 0 -3.4E+38 3.4E+38 ECU_ADDRESS 0xb00053b4 /* @ECU_Address@VfLKAS_TargetV@ */ /end MEASUREMENT
/begin MEASUREMENT VfLKAS_Offst_Actual "" FLOAT32_IEEE LKAS_subsystem_integrated_CM_single 0 0 -3.4E+38 3.4E+38 ECU_ADDRESS 0xb00053b0 /* @ECU_Address@VfLKAS_Offst_Actual@ */ /end MEASUREMENT
/begin MEASUREMENT VfLKAS_Offst_start "" FLOAT32_IEEE LKAS_subsystem_integrated_CM_single 0 0 -3.4E+38 3.4E+38 ECU_ADDRESS 0xb00053ac /* @ECU_Address@VfLKAS_Offst_start@ */ /end MEASUREMENT
/begin MEASUREMENT VfLKAS_DesiredDistToEdge "" FLOAT32_IEEE LKAS_subsystem_integrated_CM_single 0 0 -3.4E+38 3.4E+38 ECU_ADDRESS 0xb00053a8 /* @ECU_Address@VfLKAS_DesiredDistToEdge@ */ /end MEASUREMENT
/begin MEASUREMENT VfLKAS_OffstError "" FLOAT32_IEEE LKAS_subsystem_integrated_CM_single 0 0 -3.4E+38 3.4E+38 ECU_ADDRESS 0xb00053a4 /* @ECU_Address@VfLKAS_OffstError@ */ /end MEASUREMENT
/begin MEASUREMENT VfLKAS_Offst_ErrorDiff "" FLOAT32_IEEE LKAS_subsystem_integrated_CM_single 0 0 -3.4E+38 3.4E+38 ECU_ADDRESS 0xb00053a0 /* @ECU_Address@VfLKAS_Offst_ErrorDiff@ */ /end MEASUREMENT
/begin MEASUREMENT VfLKAS_Vlat_Desired "" FLOAT32_IEEE LKAS_subsystem_integrated_CM_single 0 0 -3.4E+38 3.4E+38 ECU_ADDRESS 0xb000539c /* @ECU_Address@VfLKAS_Vlat_Desired@ */ /end MEASUREMENT
/begin MEASUREMENT VfLKAS_VlatError "" FLOAT32_IEEE LKAS_subsystem_integrated_CM_single 0 0 -3.4E+38 3.4E+38 ECU_ADDRESS 0xb0005398 /* @ECU_Address@VfLKAS_VlatError@ */ /end MEASUREMENT
/begin MEASUREMENT VfLKAS_Vlat_ErrorDiff "" FLOAT32_IEEE LKAS_subsystem_integrated_CM_single 0 0 -3.4E+38 3.4E+38 ECU_ADDRESS 0xb0005394 /* @ECU_Address@VfLKAS_Vlat_ErrorDiff@ */ /end MEASUREMENT
/begin MEASUREMENT VfLKAS_TargetA "" FLOAT32_IEEE LKAS_subsystem_integrated_CM_single 0 0 -3.4E+38 3.4E+38 ECU_ADDRESS 0xb0005390 /* @ECU_Address@VfLKAS_TargetA@ */ /end MEASUREMENT
/begin MEASUREMENT VfLKAS_Alat_Desired "" FLOAT32_IEEE LKAS_subsystem_integrated_CM_single 0 0 -3.4E+38 3.4E+38 ECU_ADDRESS 0xb000538c /* @ECU_Address@VfLKAS_Alat_Desired@ */ /end MEASUREMENT
/begin MEASUREMENT VfLKAS_YawRateDesired "" FLOAT32_IEEE LKAS_subsystem_integrated_CM_single 0 0 -3.4E+38 3.4E+38 ECU_ADDRESS 0xb0005388 /* @ECU_Address@VfLKAS_YawRateDesired@ */ /end MEASUREMENT
/begin MEASUREMENT VfLKAS_SteerAngleRequest "" FLOAT32_IEEE LKAS_subsystem_integrated_CM_single 0 0 -3.4E+38 3.4E+38 ECU_ADDRESS 0xb0005384 /* @ECU_Address@VfLKAS_SteerAngleRequest@ */ /end MEASUREMENT
/begin MEASUREMENT VfLKAS_StrAngFilted "" FLOAT32_IEEE LKAS_subsystem_integrated_CM_single 0 0 -3.4E+38 3.4E+38 ECU_ADDRESS 0xb0005380 /* @ECU_Address@VfLKAS_StrAngFilted@ */ /end MEASUREMENT
/begin MEASUREMENT VfLKAS_SteerAngleRequest_Saturated "" FLOAT32_IEEE LKAS_subsystem_integrated_CM_single 0 0 -3.4E+38 3.4E+38 ECU_ADDRESS 0xb000537c /* @ECU_Address@VfLKAS_SteerAngleRequest_Saturated@ */ /end MEASUREMENT
/begin MEASUREMENT VfLKAS_TargetA_2 "" FLOAT32_IEEE LKAS_subsystem_integrated_CM_single 0 0 -3.4E+38 3.4E+38 ECU_ADDRESS 0xb0005378 /* @ECU_Address@VfLKAS_TargetA_2@ */ /end MEASUREMENT
/begin MEASUREMENT VfLKAS_TargetDist_2 "" FLOAT32_IEEE LKAS_subsystem_integrated_CM_single 0 0 -3.4E+38 3.4E+38 ECU_ADDRESS 0xb0005374 /* @ECU_Address@VfLKAS_TargetDist_2@ */ /end MEASUREMENT
/begin MEASUREMENT VfLKAS_TargetV_2 "" FLOAT32_IEEE LKAS_subsystem_integrated_CM_single 0 0 -3.4E+38 3.4E+38 ECU_ADDRESS 0xb0005370 /* @ECU_Address@VfLKAS_TargetV_2@ */ /end MEASUREMENT
/begin MEASUREMENT VfLKAS_TargetA_1 "" FLOAT32_IEEE LKAS_subsystem_integrated_CM_single 0 0 -3.4E+38 3.4E+38 ECU_ADDRESS 0xb000536c /* @ECU_Address@VfLKAS_TargetA_1@ */ /end MEASUREMENT
/begin MEASUREMENT VfLKAS_V0Increment "" FLOAT32_IEEE LKAS_subsystem_integrated_CM_single 0 0 -3.4E+38 3.4E+38 ECU_ADDRESS 0xb0005368 /* @ECU_Address@VfLKAS_V0Increment@ */ /end MEASUREMENT
/begin MEASUREMENT VfLKAS_TargetDist_1 "" FLOAT32_IEEE LKAS_subsystem_integrated_CM_single 0 0 -3.4E+38 3.4E+38 ECU_ADDRESS 0xb0005364 /* @ECU_Address@VfLKAS_TargetDist_1@ */ /end MEASUREMENT
/begin MEASUREMENT VfLKAS_TargetV_1 "" FLOAT32_IEEE LKAS_subsystem_integrated_CM_single 0 0 -3.4E+38 3.4E+38 ECU_ADDRESS 0xb0005360 /* @ECU_Address@VfLKAS_TargetV_1@ */ /end MEASUREMENT
/begin MEASUREMENT VfLKAS_TargetDist "" FLOAT32_IEEE LKAS_subsystem_integrated_CM_single 0 0 -3.4E+38 3.4E+38 ECU_ADDRESS 0xb000535c /* @ECU_Address@VfLKAS_TargetDist@ */ /end MEASUREMENT
/begin MEASUREMENT VfLKAS_QlyLe "" UBYTE LKAS_subsystem_integrated_CM_uint8 0 0 0 255 ECU_ADDRESS 0xb0005359 /* @ECU_Address@VfLKAS_QlyLe@ */ /end MEASUREMENT
/begin MEASUREMENT VfLKAS_QlyRi "" UBYTE LKAS_subsystem_integrated_CM_uint8 0 0 0 255 ECU_ADDRESS 0xb0005358 /* @ECU_Address@VfLKAS_QlyRi@ */ /end MEASUREMENT
/begin MEASUREMENT VfLKAS_AbortID "" UBYTE LKAS_subsystem_integrated_CM_uint8 0 0 0 255 ECU_ADDRESS 0xb0005357 /* @ECU_Address@VfLKAS_AbortID@ */ /end MEASUREMENT
/begin MEASUREMENT VbLKAS_zero_trajectory_found "" UBYTE LKAS_subsystem_integrated_CM_boolean 0 0 0 1 ECU_ADDRESS 0xb0005356 /* @ECU_Address@VbLKAS_zero_trajectory_found@ */ /end MEASUREMENT
/begin MEASUREMENT VbLKAS_LaneWidthEnbl "" UBYTE LKAS_subsystem_integrated_CM_boolean 0 0 0 1 ECU_ADDRESS 0xb0005355 /* @ECU_Address@VbLKAS_LaneWidthEnbl@ */ /end MEASUREMENT
/begin MEASUREMENT VbLKAS_RoadEnblRi "" UBYTE LKAS_subsystem_integrated_CM_boolean 0 0 0 1 ECU_ADDRESS 0xb0005354 /* @ECU_Address@VbLKAS_RoadEnblRi@ */ /end MEASUREMENT
/begin MEASUREMENT VbLKAS_RoadEnblLe "" UBYTE LKAS_subsystem_integrated_CM_boolean 0 0 0 1 ECU_ADDRESS 0xb0005353 /* @ECU_Address@VbLKAS_RoadEnblLe@ */ /end MEASUREMENT
/begin MEASUREMENT VbLKAS__RoadEnbl "" UBYTE LKAS_subsystem_integrated_CM_boolean 0 0 0 1 ECU_ADDRESS 0xb0005352 /* @ECU_Address@VbLKAS__RoadEnbl@ */ /end MEASUREMENT
/begin MEASUREMENT VbLKAS_InnerCurvLe_sLKA "" UBYTE LKAS_subsystem_integrated_CM_boolean 0 0 0 1 ECU_ADDRESS 0xb0005351 /* @ECU_Address@VbLKAS_InnerCurvLe_sLKA@ */ /end MEASUREMENT
/begin MEASUREMENT VbLKAS_InnerCurvRi_sLKA "" UBYTE LKAS_subsystem_integrated_CM_boolean 0 0 0 1 ECU_ADDRESS 0xb0005350 /* @ECU_Address@VbLKAS_InnerCurvRi_sLKA@ */ /end MEASUREMENT
/begin MEASUREMENT VbLKAS_SolutionFoundForAm "" UBYTE LKAS_subsystem_integrated_CM_boolean 0 0 0 1 ECU_ADDRESS 0xb000534f /* @ECU_Address@VbLKAS_SolutionFoundForAm@ */ /end MEASUREMENT
/begin MEASUREMENT VbLKAS_TrajectoryFound_sLKA "" UBYTE LKAS_subsystem_integrated_CM_boolean 0 0 0 1 ECU_ADDRESS 0xb000534e /* @ECU_Address@VbLKAS_TrajectoryFound_sLKA@ */ /end MEASUREMENT
/begin MEASUREMENT VbLKAS_FirstEndPositionOK "" UBYTE LKAS_subsystem_integrated_CM_boolean 0 0 0 1 ECU_ADDRESS 0xb000534d /* @ECU_Address@VbLKAS_FirstEndPositionOK@ */ /end MEASUREMENT
/begin MEASUREMENT VbLKAS_FirstEndVLatOK "" UBYTE LKAS_subsystem_integrated_CM_boolean 0 0 0 1 ECU_ADDRESS 0xb000534c /* @ECU_Address@VbLKAS_FirstEndVLatOK@ */ /end MEASUREMENT
/begin MEASUREMENT VbLKAS_TrajectoryFoundAm1 "" UBYTE LKAS_subsystem_integrated_CM_boolean 0 0 0 1 ECU_ADDRESS 0xb000534b /* @ECU_Address@VbLKAS_TrajectoryFoundAm1@ */ /end MEASUREMENT
/begin MEASUREMENT VbLKAS_SecEndPositionOK "" UBYTE LKAS_subsystem_integrated_CM_boolean 0 0 0 1 ECU_ADDRESS 0xb000534a /* @ECU_Address@VbLKAS_SecEndPositionOK@ */ /end MEASUREMENT
/begin MEASUREMENT VbLKAS_SecEndVLatOK "" UBYTE LKAS_subsystem_integrated_CM_boolean 0 0 0 1 ECU_ADDRESS 0xb0005349 /* @ECU_Address@VbLKAS_SecEndVLatOK@ */ /end MEASUREMENT
/begin MEASUREMENT VbLKAS_TrajectoryFoundAm2 "" UBYTE LKAS_subsystem_integrated_CM_boolean 0 0 0 1 ECU_ADDRESS 0xb0005348 /* @ECU_Address@VbLKAS_TrajectoryFoundAm2@ */ /end MEASUREMENT
/begin MEASUREMENT VbLKAS_QlyValidLe "" UBYTE LKAS_subsystem_integrated_CM_boolean 0 0 0 1 ECU_ADDRESS 0xb0005347 /* @ECU_Address@VbLKAS_QlyValidLe@ */ /end MEASUREMENT
/begin MEASUREMENT VbLKAS_LeftVLatStep "" UBYTE LKAS_subsystem_integrated_CM_boolean 0 0 0 1 ECU_ADDRESS 0xb0005346 /* @ECU_Address@VbLKAS_LeftVLatStep@ */ /end MEASUREMENT
/begin MEASUREMENT VbLKAS_LeftCurvStep "" UBYTE LKAS_subsystem_integrated_CM_boolean 0 0 0 1 ECU_ADDRESS 0xb0005345 /* @ECU_Address@VbLKAS_LeftCurvStep@ */ /end MEASUREMENT
/begin MEASUREMENT VbLKAS_LeftOffstStep "" UBYTE LKAS_subsystem_integrated_CM_boolean 0 0 0 1 ECU_ADDRESS 0xb0005344 /* @ECU_Address@VbLKAS_LeftOffstStep@ */ /end MEASUREMENT
/begin MEASUREMENT VbLKAS_QlyValidRi "" UBYTE LKAS_subsystem_integrated_CM_boolean 0 0 0 1 ECU_ADDRESS 0xb0005343 /* @ECU_Address@VbLKAS_QlyValidRi@ */ /end MEASUREMENT
/begin MEASUREMENT VbLKAS_RightVlatStep "" UBYTE LKAS_subsystem_integrated_CM_boolean 0 0 0 1 ECU_ADDRESS 0xb0005342 /* @ECU_Address@VbLKAS_RightVlatStep@ */ /end MEASUREMENT
/begin MEASUREMENT VbLKAS_RightCurvStep "" UBYTE LKAS_subsystem_integrated_CM_boolean 0 0 0 1 ECU_ADDRESS 0xb0005341 /* @ECU_Address@VbLKAS_RightCurvStep@ */ /end MEASUREMENT
/begin MEASUREMENT VbLKAS_RightOffstStep "" UBYTE LKAS_subsystem_integrated_CM_boolean 0 0 0 1 ECU_ADDRESS 0xb0005340 /* @ECU_Address@VbLKAS_RightOffstStep@ */ /end MEASUREMENT
/begin MEASUREMENT VbLKAS_IsIntvCompleted_sLKA_IntOut "" UBYTE LKAS_subsystem_integrated_CM_boolean 0 0 0 1 ECU_ADDRESS 0xb000533f /* @ECU_Address@VbLKAS_IsIntvCompleted_sLKA_IntOut@ */ /end MEASUREMENT
/begin MEASUREMENT VbLKAS_IsLDWSTriggered "" UBYTE LKAS_subsystem_integrated_CM_boolean 0 0 0 1 ECU_ADDRESS 0xb000533e /* @ECU_Address@VbLKAS_IsLDWSTriggered@ */ /end MEASUREMENT
/begin MEASUREMENT VbLKAS_IsPathAccPlausible "" UBYTE LKAS_subsystem_integrated_CM_boolean 0 0 0 1 ECU_ADDRESS 0xb000533d /* @ECU_Address@VbLKAS_IsPathAccPlausible@ */ /end MEASUREMENT
/begin MEASUREMENT VbLKAS_IsTrajInTrigZone "" UBYTE LKAS_subsystem_integrated_CM_boolean 0 0 0 1 ECU_ADDRESS 0xb000533c /* @ECU_Address@VbLKAS_IsTrajInTrigZone@ */ /end MEASUREMENT
/begin MEASUREMENT VbLKAS_IsTrajectoryFound "" UBYTE LKAS_subsystem_integrated_CM_boolean 0 0 0 1 ECU_ADDRESS 0xb000533b /* @ECU_Address@VbLKAS_IsTrajectoryFound@ */ /end MEASUREMENT
/begin MEASUREMENT VbLKAS_IsVlatOkForZeroPath "" UBYTE LKAS_subsystem_integrated_CM_boolean 0 0 0 1 ECU_ADDRESS 0xb000533a /* @ECU_Address@VbLKAS_IsVlatOkForZeroPath@ */ /end MEASUREMENT
/begin MEASUREMENT VbLKAS_IsTrackingIntvSide "" UBYTE LKAS_subsystem_integrated_CM_boolean 0 0 0 1 ECU_ADDRESS 0xb0005339 /* @ECU_Address@VbLKAS_IsTrackingIntvSide@ */ /end MEASUREMENT
/begin MEASUREMENT VbLKAS_IsVlatTowardsIntvSide "" UBYTE LKAS_subsystem_integrated_CM_boolean 0 0 0 1 ECU_ADDRESS 0xb0005338 /* @ECU_Address@VbLKAS_IsVlatTowardsIntvSide@ */ /end MEASUREMENT
/begin MEASUREMENT VbLKAS_IsActivated_sLKA "" UBYTE LKAS_subsystem_integrated_CM_boolean 0 0 0 1 ECU_ADDRESS 0xb0005337 /* @ECU_Address@VbLKAS_IsActivated_sLKA@ */ /end MEASUREMENT
/begin MEASUREMENT VbLKAS_LeftChangeLane "" UBYTE LKAS_subsystem_integrated_CM_boolean 0 0 0 1 ECU_ADDRESS 0xb0005336 /* @ECU_Address@VbLKAS_LeftChangeLane@ */ /end MEASUREMENT
/begin MEASUREMENT VbLKAS_InnerCurvLe "" UBYTE LKAS_subsystem_integrated_CM_boolean 0 0 0 1 ECU_ADDRESS 0xb0005335 /* @ECU_Address@VbLKAS_InnerCurvLe@ */ /end MEASUREMENT
/begin MEASUREMENT VbLKAS_NotQualDrpLeft "" UBYTE LKAS_subsystem_integrated_CM_boolean 0 0 0 1 ECU_ADDRESS 0xb0005334 /* @ECU_Address@VbLKAS_NotQualDrpLeft@ */ /end MEASUREMENT
/begin MEASUREMENT VbLKAS_DlyAftAbort "" UBYTE LKAS_subsystem_integrated_CM_boolean 0 0 0 1 ECU_ADDRESS 0xb0005333 /* @ECU_Address@VbLKAS_DlyAftAbort@ */ /end MEASUREMENT
/begin MEASUREMENT VbLKAS_IsSuppLe "" UBYTE LKAS_subsystem_integrated_CM_boolean 0 0 0 1 ECU_ADDRESS 0xb0005332 /* @ECU_Address@VbLKAS_IsSuppLe@ */ /end MEASUREMENT
/begin MEASUREMENT VbLKAS_RightChangeLane "" UBYTE LKAS_subsystem_integrated_CM_boolean 0 0 0 1 ECU_ADDRESS 0xb0005331 /* @ECU_Address@VbLKAS_RightChangeLane@ */ /end MEASUREMENT
/begin MEASUREMENT VbLKAS_InnerCurvRi "" UBYTE LKAS_subsystem_integrated_CM_boolean 0 0 0 1 ECU_ADDRESS 0xb0005330 /* @ECU_Address@VbLKAS_InnerCurvRi@ */ /end MEASUREMENT
/begin MEASUREMENT VbLKAS_NotQualDrpRight "" UBYTE LKAS_subsystem_integrated_CM_boolean 0 0 0 1 ECU_ADDRESS 0xb000532f /* @ECU_Address@VbLKAS_NotQualDrpRight@ */ /end MEASUREMENT
/begin MEASUREMENT VbLKAS_IsSuppRi "" UBYTE LKAS_subsystem_integrated_CM_boolean 0 0 0 1 ECU_ADDRESS 0xb000532e /* @ECU_Address@VbLKAS_IsSuppRi@ */ /end MEASUREMENT
/begin MEASUREMENT VbLKAS_Intv_Request "" UBYTE LKAS_subsystem_integrated_CM_boolean 0 0 0 1 ECU_ADDRESS 0xb000532d /* @ECU_Address@VbLKAS_Intv_Request@ */ /end MEASUREMENT
/begin MEASUREMENT VbLKAS_IsInsidePath "" UBYTE LKAS_subsystem_integrated_CM_boolean 0 0 0 1 ECU_ADDRESS 0xb000532c /* @ECU_Address@VbLKAS_IsInsidePath@ */ /end MEASUREMENT
/begin MEASUREMENT VbLKAS_IsVlatTowardsLaneCenter "" UBYTE LKAS_subsystem_integrated_CM_boolean 0 0 0 1 ECU_ADDRESS 0xb000532b /* @ECU_Address@VbLKAS_IsVlatTowardsLaneCenter@ */ /end MEASUREMENT
/begin MEASUREMENT VbLKAS_IsVmaxReached "" UBYTE LKAS_subsystem_integrated_CM_boolean 0 0 0 1 ECU_ADDRESS 0xb000532a /* @ECU_Address@VbLKAS_IsVmaxReached@ */ /end MEASUREMENT
/begin MEASUREMENT VbLKAS_IsIntvCompleted "" UBYTE LKAS_subsystem_integrated_CM_boolean 0 0 0 1 ECU_ADDRESS 0xb0005329 /* @ECU_Address@VbLKAS_IsIntvCompleted@ */ /end MEASUREMENT
/begin MEASUREMENT VbLKAS_IsAbortIntv "" UBYTE LKAS_subsystem_integrated_CM_boolean 0 0 0 1 ECU_ADDRESS 0xb0005328 /* @ECU_Address@VbLKAS_IsAbortIntv@ */ /end MEASUREMENT
/begin MEASUREMENT VbLKAS_IsDelayAftAbort "" UBYTE LKAS_subsystem_integrated_CM_boolean 0 0 0 1 ECU_ADDRESS 0xb0005327 /* @ECU_Address@VbLKAS_IsDelayAftAbort@ */ /end MEASUREMENT
/begin MEASUREMENT VbLKAS_Trigger_Traj_2 "" UBYTE LKAS_subsystem_integrated_CM_boolean 0 0 0 1 ECU_ADDRESS 0xb0005326 /* @ECU_Address@VbLKAS_Trigger_Traj_2@ */ /end MEASUREMENT
/begin MEASUREMENT VbLKAS_Trigger_Traj_1 "" UBYTE LKAS_subsystem_integrated_CM_boolean 0 0 0 1 ECU_ADDRESS 0xb0005325 /* @ECU_Address@VbLKAS_Trigger_Traj_1@ */ /end MEASUREMENT
/begin MEASUREMENT VeLKAS_IntvTyp_sLKA_IntOut "" UBYTE LKAS_subsystem_integrated_CM_EnumLKAS_IntvTyp 0 0 0 1 ECU_ADDRESS 0xb0005324 /* @ECU_Address@VeLKAS_IntvTyp_sLKA_IntOut@ */ /end MEASUREMENT
/begin MEASUREMENT VeLKAS_IntvTyp_sLKA "" UBYTE LKAS_subsystem_integrated_CM_EnumLKAS_IntvTyp 0 0 0 1 ECU_ADDRESS 0xb0005323 /* @ECU_Address@VeLKAS_IntvTyp_sLKA@ */ /end MEASUREMENT
/begin MEASUREMENT VeLKAS_IntvSideReq_sLKA "" UBYTE LKAS_subsystem_integrated_CM_EnumLKAS_IntvSide 0 0 0 2 ECU_ADDRESS 0xb0005322 /* @ECU_Address@VeLKAS_IntvSideReq_sLKA@ */ /end MEASUREMENT
/begin MEASUREMENT VeLKAS_IntvSide_sLKA_IntOut "" UBYTE LKAS_subsystem_integrated_CM_EnumLKAS_IntvSide 0 0 0 2 ECU_ADDRESS 0xb0005321 /* @ECU_Address@VeLKAS_IntvSide_sLKA_IntOut@ */ /end MEASUREMENT
/begin MEASUREMENT VeLKAS_IntvSide_sLKA "" UBYTE LKAS_subsystem_integrated_CM_EnumLKAS_IntvSide 0 0 0 2 ECU_ADDRESS 0xb0005320 /* @ECU_Address@VeLKAS_IntvSide_sLKA@ */ /end MEASUREMENT
/begin MEASUREMENT VeLKAS_IntvMgrSt_sLKA "" UBYTE LKAS_subsystem_integrated_CM_EnumLKAS_IntvMgrSt 0 0 0 3 ECU_ADDRESS 0xb000531f /* @ECU_Address@VeLKAS_IntvMgrSt_sLKA@ */ /end MEASUREMENT
/begin MEASUREMENT VeLKAS_CtrlRefReq_sLKA "" UBYTE LKAS_subsystem_integrated_CM_EnumLKAS_CtrlRefTypVcc 0 0 0 2 ECU_ADDRESS 0xb000531e /* @ECU_Address@VeLKAS_CtrlRefReq_sLKA@ */ /end MEASUREMENT
/begin MEASUREMENT VeLKAS_CtrlRef_sLKA_IntOut "" UBYTE LKAS_subsystem_integrated_CM_EnumLKAS_CtrlRefTypVcc 0 0 0 2 ECU_ADDRESS 0xb000531d /* @ECU_Address@VeLKAS_CtrlRef_sLKA_IntOut@ */ /end MEASUREMENT
/begin MEASUREMENT VeLKAS_CtrlRef_sLKA "" UBYTE LKAS_subsystem_integrated_CM_EnumLKAS_CtrlRefTypVcc 0 0 0 2 ECU_ADDRESS 0xb000531c /* @ECU_Address@VeLKAS_CtrlRef_sLKA@ */ /end MEASUREMENT
/begin MEASUREMENT VeLKAS_LineLeftOk "" UBYTE LKAS_subsystem_integrated_CM_EnumLKAS_LaneMkrQly 0 0 0 1 ECU_ADDRESS 0xb000531b /* @ECU_Address@VeLKAS_LineLeftOk@ */ /end MEASUREMENT
/begin MEASUREMENT VeLKAS_LineRightOK "" UBYTE LKAS_subsystem_integrated_CM_EnumLKAS_LaneMkrQly 0 0 0 1 ECU_ADDRESS 0xb000531a /* @ECU_Address@VeLKAS_LineRightOK@ */ /end MEASUREMENT
/begin MEASUREMENT VeLKAS_SystemSt_sLKA "" UBYTE LKAS_subsystem_integrated_CM_EnumLKAS_SystemSt 0 0 0 1 ECU_ADDRESS 0xb0005319 /* @ECU_Address@VeLKAS_SystemSt_sLKA@ */ /end MEASUREMENT
/begin MEASUREMENT VeLKAS_OnStateSt_sLKA "" UBYTE LKAS_subsystem_integrated_CM_EnumLKAS_OnStateSt 0 0 0 5 ECU_ADDRESS 0xb0005318 /* @ECU_Address@VeLKAS_OnStateSt_sLKA@ */ /end MEASUREMENT
/begin MEASUREMENT ADCtrl_Thruput_MS "" FLOAT32_IEEE ad_ctrl_thruput_measurement_CM_ms 0 0 -3.4E+38 3.4E+38 ECU_ADDRESS 0xb00055c4 /* @ECU_Address@ADCtrl_Thruput_MS@ */ /end MEASUREMENT
/begin MEASUREMENT COMM_Subsystem_Intergreted_Receive_Period "" UWORD ad_ctrl_subfunction_measurement_CM_us 0 0 0 4E+9 ECU_ADDRESS 0xb00054c6 /* @ECU_Address@COMM_Subsystem_Intergreted_Receive_Period@ */ /end MEASUREMENT
/begin MEASUREMENT DCSN_Subsystem_Integrated_Period "" UWORD ad_ctrl_subfunction_measurement_CM_us 0 0 0 4E+9 ECU_ADDRESS 0xb00054c4 /* @ECU_Address@DCSN_Subsystem_Integrated_Period@ */ /end MEASUREMENT
/begin MEASUREMENT AEBS_Subsystem_Integrated_Period "" UWORD ad_ctrl_subfunction_measurement_CM_us 0 0 0 4E+9 ECU_ADDRESS 0xb00054c2 /* @ECU_Address@AEBS_Subsystem_Integrated_Period@ */ /end MEASUREMENT
/begin MEASUREMENT ACCS_Subsystem_Integrated_Period "" UWORD ad_ctrl_subfunction_measurement_CM_us 0 0 0 4E+9 ECU_ADDRESS 0xb00054c0 /* @ECU_Address@ACCS_Subsystem_Integrated_Period@ */ /end MEASUREMENT
/begin MEASUREMENT LCCS_Subsystem_Integrated_Period "" UWORD ad_ctrl_subfunction_measurement_CM_us 0 0 0 4E+9 ECU_ADDRESS 0xb00054be /* @ECU_Address@LCCS_Subsystem_Integrated_Period@ */ /end MEASUREMENT
/begin MEASUREMENT AEBD_Subsystem_Integrated_Period "" UWORD ad_ctrl_subfunction_measurement_CM_us 0 0 0 4E+9 ECU_ADDRESS 0xb00054b6 /* @ECU_Address@AEBD_Subsystem_Integrated_Period@ */ /end MEASUREMENT
/begin MEASUREMENT LCWS_Subsystem_Integrated_Period "" UWORD ad_ctrl_subfunction_measurement_CM_us 0 0 0 4E+9 ECU_ADDRESS 0xb00054bc /* @ECU_Address@LCWS_Subsystem_Integrated_Period@ */ /end MEASUREMENT
/begin MEASUREMENT LDWS_Subsystem_Integrated_Period "" UWORD ad_ctrl_subfunction_measurement_CM_us 0 0 0 4E+9 ECU_ADDRESS 0xb00054ba /* @ECU_Address@LDWS_Subsystem_Integrated_Period@ */ /end MEASUREMENT
/begin MEASUREMENT arbt_Subsystem_Integrated_Period "" UWORD ad_ctrl_subfunction_measurement_CM_us 0 0 0 4E+9 ECU_ADDRESS 0xb00054b8 /* @ECU_Address@arbt_Subsystem_Integrated_Period@ */ /end MEASUREMENT
/begin MEASUREMENT COMM_Subsystem_Integrated_Transmit_Period "" UWORD ad_ctrl_subfunction_measurement_CM_us 0 0 0 4E+9 ECU_ADDRESS 0xb00054b0 /* @ECU_Address@COMM_Subsystem_Integrated_Transmit_Period@ */ /end MEASUREMENT
/begin MEASUREMENT ALCA_Subsystem_Integrated_Period "" UWORD ad_ctrl_subfunction_measurement_CM_us 0 0 0 4E+9 ECU_ADDRESS 0xb00054b4 /* @ECU_Address@ALCA_Subsystem_Integrated_Period@ */ /end MEASUREMENT
/begin MEASUREMENT LKAS_Subsystem_Integrated_Period "" UWORD ad_ctrl_subfunction_measurement_CM_us 0 0 0 4E+9 ECU_ADDRESS 0xb00054b2 /* @ECU_Address@LKAS_Subsystem_Integrated_Period@ */ /end MEASUREMENT
/begin MEASUREMENT os_core0_tick_cnt "" ULONG ad_ctrl_thruput_measurement_CM_ms 0 0 0 3.4E+38 ECU_ADDRESS 0xb0007310 /* @ECU_Address@os_core0_tick_cnt@ */ /end MEASUREMENT
/begin MEASUREMENT Entry_ADCtrl_STM_Cnt "ADCtrl entry STM_0_3 counter. 1us = Entry_ADCtrl_STM_Cnt*4096.0/100" ULONG ad_ctrl_thruput_measurement_CM_ms 0 0 0 3.4E+38 ECU_ADDRESS 0xb00055d0 /* @ECU_Address@Entry_ADCtrl_STM_Cnt@ */ /end MEASUREMENT
/begin MEASUREMENT Com_stRxUDPFrm17001 "UDP_COMM_Err_Info" UBYTE diag_info_monitor 0 0 0 255 ECU_ADDRESS 0xb00054d0 /* @ECU_Address@Com_stRxUDPFrm17001@ */ /end MEASUREMENT
/begin MEASUREMENT diag_communication_error_codes "UDP_COMM_Err_Info" UBYTE diag_info_monitor 0 0 0 255 ARRAY_SIZE 32 ECU_ADDRESS 0xb0005514 /* @ECU_Address@diag_communication_error_codes@ */ /end MEASUREMENT
/begin MEASUREMENT diag_sensor_error_codes "UDP_COMM_Err_Info" UBYTE diag_info_monitor 0 0 0 255 ARRAY_SIZE 32 ECU_ADDRESS 0xb00054f4 /* @ECU_Address@diag_sensor_error_codes@ */ /end MEASUREMENT
/begin MEASUREMENT diag_module_error_codes "UDP_COMM_Err_Info" UBYTE diag_info_monitor 0 0 0 255 ARRAY_SIZE 32 ECU_ADDRESS 0xb00054d4 /* @ECU_Address@diag_module_error_codes@ */ /end MEASUREMENT
/begin COMPU_METHOD ACCS_subsystem_integrated_CM_single_s "Q = V" RAT_FUNC "%8.6" "s" COEFFS 0 1 0 0 0 1 /end COMPU_METHOD
/begin COMPU_METHOD ACCS_subsystem_integrated_CM_single_m "Q = V" RAT_FUNC "%8.6" "m" COEFFS 0 1 0 0 0 1 /end COMPU_METHOD
/begin COMPU_METHOD ACCS_subsystem_integrated_CM_single_m_s2 "Q = V" RAT_FUNC "%8.6" "m/s2" COEFFS 0 1 0 0 0 1 /end COMPU_METHOD
/begin COMPU_METHOD ACCS_subsystem_integrated_CM_single_m_s "Q = V" RAT_FUNC "%8.6" "m/s" COEFFS 0 1 0 0 0 1 /end COMPU_METHOD
/begin COMPU_METHOD ACCS_subsystem_integrated_CM_single_deg "Q = V" RAT_FUNC "%8.6" "deg" COEFFS 0 1 0 0 0 1 /end COMPU_METHOD
/begin COMPU_METHOD LDWS_subsystem_integrated_CM_single_rad "Q = V" RAT_FUNC "%8.6" "rad" COEFFS 0 1 0 0 0 1 /end COMPU_METHOD
/begin COMPU_METHOD LDWS_subsystem_integrated_CM_single__ "Q = V" RAT_FUNC "%8.6" "��" COEFFS 0 1 0 0 0 1 /end COMPU_METHOD
/begin COMPU_METHOD LDWS_subsystem_integrated_CM_single_NM "Q = V" RAT_FUNC "%8.6" "NM" COEFFS 0 1 0 0 0 1 /end COMPU_METHOD
/begin COMPU_METHOD LDWS_subsystem_integrated_CM_single_m "Q = V" RAT_FUNC "%8.6" "m" COEFFS 0 1 0 0 0 1 /end COMPU_METHOD
/begin COMPU_METHOD LDWS_subsystem_integrated_CM_single "Q = V" RAT_FUNC "%8.6" "" COEFFS 0 1 0 0 0 1 /end COMPU_METHOD
/begin COMPU_METHOD LDWS_subsystem_integrated_CM_single_s "Q = V" RAT_FUNC "%8.6" "s" COEFFS 0 1 0 0 0 1 /end COMPU_METHOD
/begin COMPU_METHOD LDWS_subsystem_integrated_CM_single___s "Q = V" RAT_FUNC "%8.6" "��/s" COEFFS 0 1 0 0 0 1 /end COMPU_METHOD
/begin COMPU_METHOD LDWS_subsystem_integrated_CM_uint16 "Q = V" RAT_FUNC "%5.0" "" COEFFS 0 1 0 0 0 1 /end COMPU_METHOD
/begin COMPU_METHOD LDWS_subsystem_integrated_CM_uint8 "Q = V" RAT_FUNC "%3.0" "" COEFFS 0 1 0 0 0 1 /end COMPU_METHOD
/begin COMPU_METHOD LDWS_subsystem_integrated_CM_boolean "Q = V" RAT_FUNC "%1.0" "" COEFFS 0 1 0 0 0 1 /end COMPU_METHOD
/begin COMPU_METHOD AEBD_subsystem_integrated_CM_single "Q = V" RAT_FUNC "%8.6" "" COEFFS 0 1 0 0 0 1 /end COMPU_METHOD
/begin COMPU_METHOD AEBD_subsystem_integrated_CM_uint16 "Q = V" RAT_FUNC "%5.0" "" COEFFS 0 1 0 0 0 1 /end COMPU_METHOD
/begin COMPU_METHOD AEBD_subsystem_integrated_CM_uint8 "Q = V" RAT_FUNC "%3.0" "" COEFFS 0 1 0 0 0 1 /end COMPU_METHOD
/begin COMPU_METHOD AEBD_subsystem_integrated_CM_boolean "Q = V" RAT_FUNC "%1.0" "" COEFFS 0 1 0 0 0 1 /end COMPU_METHOD
/begin COMPU_METHOD ALCA_subsystem_integrated_CM_single_m "Q = V" RAT_FUNC "%8.6" "m" COEFFS 0 1 0 0 0 1 /end COMPU_METHOD
/begin COMPU_METHOD ALCA_subsystem_integrated_CM_single "Q = V" RAT_FUNC "%8.6" "" COEFFS 0 1 0 0 0 1 /end COMPU_METHOD
/begin COMPU_METHOD ALCA_subsystem_integrated_CM_single_s "Q = V" RAT_FUNC "%8.6" "s" COEFFS 0 1 0 0 0 1 /end COMPU_METHOD
/begin COMPU_METHOD ALCA_subsystem_integrated_CM_single_m_s "Q = V" RAT_FUNC "%8.6" "m/s" COEFFS 0 1 0 0 0 1 /end COMPU_METHOD
/begin COMPU_METHOD ALCA_subsystem_integrated_CM_boolean "Q = V" RAT_FUNC "%1.0" "" COEFFS 0 1 0 0 0 1 /end COMPU_METHOD
/begin COMPU_METHOD ALCA_subsystem_integrated_CM_EnumDCSN_driving_direction "Enumerated data type: EnumDCSN_driving_direction" TAB_VERB "%0.6" "" COMPU_TAB_REF VTAB_FOR_ALCA_subsystem_integrated_CM_EnumDCSN_driving_direction /end COMPU_METHOD
/begin COMPU_METHOD ALCA_subsystem_integrated_CM_int32 "Q = V" RAT_FUNC "%10.0" "" COEFFS 0 1 0 0 0 1 /end COMPU_METHOD
/begin COMPU_METHOD ALCA_subsystem_integrated_CM_int8 "Q = V" RAT_FUNC "%3.0" "" COEFFS 0 1 0 0 0 1 /end COMPU_METHOD
/begin COMPU_METHOD ALCA_subsystem_integrated_CM_uint8 "Q = V" RAT_FUNC "%3.0" "" COEFFS 0 1 0 0 0 1 /end COMPU_METHOD
/begin COMPU_METHOD ALCA_subsystem_integrated_CM_EnumALCA_state "Enumerated data type: EnumALCA_state" TAB_VERB "%0.6" "" COMPU_TAB_REF VTAB_FOR_ALCA_subsystem_integrated_CM_EnumALCA_state /end COMPU_METHOD
/begin COMPU_METHOD ALCA_subsystem_integrated_CM_EnumALCA_not_fulfill_reason "Enumerated data type: EnumALCA_not_fulfill_reason" TAB_VERB "%0.6" "" COMPU_TAB_REF VTAB_FOR_ALCA_subsystem_integrated_CM_EnumALCA_not_fulfill_reason /end COMPU_METHOD
/begin COMPU_METHOD ALCA_subsystem_integrated_CM_EnumALCA_interrupt_type "Enumerated data type: EnumALCA_interrupt_type" TAB_VERB "%0.6" "" COMPU_TAB_REF VTAB_FOR_ALCA_subsystem_integrated_CM_EnumALCA_interrupt_type /end COMPU_METHOD
/begin COMPU_METHOD LKAS_subsystem_integrated_CM_single "Q = V" RAT_FUNC "%8.6" "" COEFFS 0 1 0 0 0 1 /end COMPU_METHOD
/begin COMPU_METHOD LKAS_subsystem_integrated_CM_single_rad "Q = V" RAT_FUNC "%8.6" "rad" COEFFS 0 1 0 0 0 1 /end COMPU_METHOD
/begin COMPU_METHOD LKAS_subsystem_integrated_CM_single_degree "Q = V" RAT_FUNC "%8.6" "degree" COEFFS 0 1 0 0 0 1 /end COMPU_METHOD
/begin COMPU_METHOD LKAS_subsystem_integrated_CM_single_N_rad "Q = V" RAT_FUNC "%8.6" "N/rad" COEFFS 0 1 0 0 0 1 /end COMPU_METHOD
/begin COMPU_METHOD LKAS_subsystem_integrated_CM_single_1_s "Q = V" RAT_FUNC "%8.6" "1/s" COEFFS 0 1 0 0 0 1 /end COMPU_METHOD
/begin COMPU_METHOD LKAS_subsystem_integrated_CM_single_m_s_2 "Q = V" RAT_FUNC "%8.6" "m/s^2" COEFFS 0 1 0 0 0 1 /end COMPU_METHOD
/begin COMPU_METHOD LKAS_subsystem_integrated_CM_single_1_m "Q = V" RAT_FUNC "%8.6" "1/m" COEFFS 0 1 0 0 0 1 /end COMPU_METHOD
/begin COMPU_METHOD LKAS_subsystem_integrated_CM_single_m "Q = V" RAT_FUNC "%8.6" "m" COEFFS 0 1 0 0 0 1 /end COMPU_METHOD
/begin COMPU_METHOD LKAS_subsystem_integrated_CM_single_m__s__3_ "Q = V" RAT_FUNC "%8.6" "m/(s^-3)" COEFFS 0 1 0 0 0 1 /end COMPU_METHOD
/begin COMPU_METHOD LKAS_subsystem_integrated_CM_single_kg "Q = V" RAT_FUNC "%8.6" "kg" COEFFS 0 1 0 0 0 1 /end COMPU_METHOD
/begin COMPU_METHOD LKAS_subsystem_integrated_CM_single_s "Q = V" RAT_FUNC "%8.6" "s" COEFFS 0 1 0 0 0 1 /end COMPU_METHOD
/begin COMPU_METHOD LKAS_subsystem_integrated_CM_single_m_s "Q = V" RAT_FUNC "%8.6" "m/s" COEFFS 0 1 0 0 0 1 /end COMPU_METHOD
/begin COMPU_METHOD LKAS_subsystem_integrated_CM_uint16 "Q = V" RAT_FUNC "%5.0" "" COEFFS 0 1 0 0 0 1 /end COMPU_METHOD
/begin COMPU_METHOD LKAS_subsystem_integrated_CM_uint16_10ms "Q = V" RAT_FUNC "%5.0" "10ms" COEFFS 0 1 0 0 0 1 /end COMPU_METHOD
/begin COMPU_METHOD LKAS_subsystem_integrated_CM_uint8 "Q = V" RAT_FUNC "%3.0" "" COEFFS 0 1 0 0 0 1 /end COMPU_METHOD
/begin COMPU_METHOD LKAS_subsystem_integrated_CM_boolean "Q = V" RAT_FUNC "%1.0" "" COEFFS 0 1 0 0 0 1 /end COMPU_METHOD
/begin COMPU_METHOD LKAS_subsystem_integrated_CM_EnumLKAS_IntvTyp "Enumerated data type: EnumLKAS_IntvTyp" TAB_VERB "%0.6" "" COMPU_TAB_REF VTAB_FOR_LKAS_subsystem_integrated_CM_EnumLKAS_IntvTyp /end COMPU_METHOD
/begin COMPU_METHOD LKAS_subsystem_integrated_CM_EnumLKAS_IntvSide "Enumerated data type: EnumLKAS_IntvSide" TAB_VERB "%0.6" "" COMPU_TAB_REF VTAB_FOR_LKAS_subsystem_integrated_CM_EnumLKAS_IntvSide /end COMPU_METHOD
/begin COMPU_METHOD LKAS_subsystem_integrated_CM_EnumLKAS_IntvMgrSt "Enumerated data type: EnumLKAS_IntvMgrSt" TAB_VERB "%0.6" "" COMPU_TAB_REF VTAB_FOR_LKAS_subsystem_integrated_CM_EnumLKAS_IntvMgrSt /end COMPU_METHOD
/begin COMPU_METHOD LKAS_subsystem_integrated_CM_EnumLKAS_CtrlRefTypVcc "Enumerated data type: EnumLKAS_CtrlRefTypVcc" TAB_VERB "%0.6" "" COMPU_TAB_REF VTAB_FOR_LKAS_subsystem_integrated_CM_EnumLKAS_CtrlRefTypVcc /end COMPU_METHOD
/begin COMPU_METHOD LKAS_subsystem_integrated_CM_EnumLKAS_LaneMkrQly "Enumerated data type: EnumLKAS_LaneMkrQly" TAB_VERB "%0.6" "" COMPU_TAB_REF VTAB_FOR_LKAS_subsystem_integrated_CM_EnumLKAS_LaneMkrQly /end COMPU_METHOD
/begin COMPU_METHOD LKAS_subsystem_integrated_CM_EnumLKAS_SystemSt "Enumerated data type: EnumLKAS_SystemSt" TAB_VERB "%0.6" "" COMPU_TAB_REF VTAB_FOR_LKAS_subsystem_integrated_CM_EnumLKAS_SystemSt /end COMPU_METHOD
/begin COMPU_METHOD LKAS_subsystem_integrated_CM_EnumLKAS_OnStateSt "Enumerated data type: EnumLKAS_OnStateSt" TAB_VERB "%0.6" "" COMPU_TAB_REF VTAB_FOR_LKAS_subsystem_integrated_CM_EnumLKAS_OnStateSt /end COMPU_METHOD
/begin COMPU_METHOD ad_ctrl_thruput_measurement_CM_ms "Q = V" RAT_FUNC "%8.6" "ms" COEFFS 0 1 0 0 0 1 /end COMPU_METHOD
/begin COMPU_METHOD ad_ctrl_subfunction_measurement_CM_us "Q = V" RAT_FUNC "%8.0" "us" COEFFS 0 1 0 0 0 1 /end COMPU_METHOD
/begin COMPU_METHOD diag_info_monitor "Q = V" IDENTICAL "%8.0" "" COEFFS 0 1 0 0 0 1 /end COMPU_METHOD
/begin COMPU_VTAB VTAB_FOR_ALCA_subsystem_integrated_CM_EnumDCSN_driving_direction "Enumerated data type: EnumDCSN_driving_direction" TAB_VERB 3 0 "FORWARD" 1 "LEFT" 2 "RIGHT" /end COMPU_VTAB
/begin COMPU_VTAB VTAB_FOR_ALCA_subsystem_integrated_CM_EnumALCA_state "Enumerated data type: EnumALCA_state" TAB_VERB 8 0 "ALCA_state_OFF" 1 "ALCA_state_Standby" 2 "ALCA_state_Activated" 3 "ALCA_state_Waiting" 4 "ALCA_state_Inform" 5 "ALCA_state_Finish" 6 "ALCA_state_Handover" 7 "ALCA_state_Abort" /end COMPU_VTAB
/begin COMPU_VTAB VTAB_FOR_ALCA_subsystem_integrated_CM_EnumALCA_not_fulfill_reason "Enumerated data type: EnumALCA_not_fulfill_reason" TAB_VERB 10 0 "ALCA_not_fulfill_reason_no_request" 1 "ALCA_not_fulfill_reason_no_lane" 2 "ALCA_not_fulfill_reason_mpfu_reject" 3 "ALCA_not_fulfill_reason_has_obstacle" 4 "ALCA_not_fulfill_reason_low_speed" 5 "ALCA_not_fulfill_reason_high_speed" 6 "ALCA_not_fulfill_reason_dangerous_conditions" 7 "ALCA_not_fulfill_reason_system_error" 8 "ALCA_not_fulfill_reason_too_often" 9 "ALCA_not_fulfill_reason_check_fulfilled" /end COMPU_VTAB
/begin COMPU_VTAB VTAB_FOR_ALCA_subsystem_integrated_CM_EnumALCA_interrupt_type "Enumerated data type: EnumALCA_interrupt_type" TAB_VERB 3 0 "ALCA_interrupt_type_no" 1 "ALCA_interrupt_type_driver_cancel" 2 "ALCA_interrupt_type_has_obstacle" /end COMPU_VTAB
/begin COMPU_VTAB VTAB_FOR_LKAS_subsystem_integrated_CM_EnumLKAS_IntvTyp "Enumerated data type: EnumLKAS_IntvTyp" TAB_VERB 2 0 "LKAS_NoIntvTyp" 1 "LKAS_SftyLaneKeepAid" /end COMPU_VTAB
/begin COMPU_VTAB VTAB_FOR_LKAS_subsystem_integrated_CM_EnumLKAS_IntvSide "Enumerated data type: EnumLKAS_IntvSide" TAB_VERB 3 0 "LKAS_NoIntvSide" 1 "LKAS_IntvSideLe" 2 "LKAS_IntvSideRi" /end COMPU_VTAB
/begin COMPU_VTAB VTAB_FOR_LKAS_subsystem_integrated_CM_EnumLKAS_IntvMgrSt "Enumerated data type: EnumLKAS_IntvMgrSt" TAB_VERB 4 0 "LKAS_NoIntv" 1 "LKAS_Intv" 2 "LKAS_abort" 3 "LKAS_Completed" /end COMPU_VTAB
/begin COMPU_VTAB VTAB_FOR_LKAS_subsystem_integrated_CM_EnumLKAS_CtrlRefTypVcc "Enumerated data type: EnumLKAS_CtrlRefTypVcc" TAB_VERB 3 0 "LKAS_NoRef" 1 "LKAS_LaneMkrToClsLe" 2 "LKAS_LaneMkrToClsRi" /end COMPU_VTAB
/begin COMPU_VTAB VTAB_FOR_LKAS_subsystem_integrated_CM_EnumLKAS_LaneMkrQly "Enumerated data type: EnumLKAS_LaneMkrQly" TAB_VERB 2 1 "VldForEnag" 0 "NotVld" /end COMPU_VTAB
/begin COMPU_VTAB VTAB_FOR_LKAS_subsystem_integrated_CM_EnumLKAS_SystemSt "Enumerated data type: EnumLKAS_SystemSt" TAB_VERB 2 0 "LKAS_Off" 1 "LKAS_On" /end COMPU_VTAB
/begin COMPU_VTAB VTAB_FOR_LKAS_subsystem_integrated_CM_EnumLKAS_OnStateSt "Enumerated data type: EnumLKAS_OnStateSt" TAB_VERB 6 0 "LKAS_Enabling" 1 "LKAS_Standby" 2 "LKAS_Active" 3 "LKAS_Suppressed" 4 "LKAS_completed" 5 "LKAS_aborted" /end COMPU_VTAB
/begin GROUP S6_Subsystem "LDWS_subsystem_integrated/LDWS_subsystem_integrated/Road_Enable_Estimator/Subsystem" /begin REF_CHARACTERISTIC KfLDWS_r_LaMkrQlt KfLDWS_t_LnMkrMissThrsh /end REF_CHARACTERISTIC /begin REF_MEASUREMENT VbLDWS_RdEnblLe /end REF_MEASUREMENT /end GROUP
/begin GROUP S6_Subsystem1 "LDWS_subsystem_integrated/LDWS_subsystem_integrated/Road_Enable_Estimator/Subsystem1" /begin REF_CHARACTERISTIC KfLDWS_r_LaMkrQlt KfLDWS_t_LnMkrMissThrsh /end REF_CHARACTERISTIC /begin REF_MEASUREMENT VbLDWS_RdEnblRi /end REF_MEASUREMENT /end GROUP
/begin GROUP S7_DtrmnSuppLe "LDWS_subsystem_integrated/LDWS_subsystem_integrated/SuppressionManager/DtrmnSuppLe"
 /begin REF_CHARACTERISTIC KfLDWS_Ang_SuppSteerAngThrsh KfLDWS_M_SuppTorque KfLDWS_t_SuppIndiTime KfLDWS_t_SuppSteerAngTime KfLDWS_t_SuppSteerRateTime KfLDWS_t_SuppTorqueTime KfLDWS_v_SuppSteerRateThrsh /end REF_CHARACTERISTIC
 /begin REF_MEASUREMENT VbLDWS_SuppLe /end REF_MEASUREMENT
/end GROUP
/begin GROUP S7_DtrmnSuppRi "LDWS_subsystem_integrated/LDWS_subsystem_integrated/SuppressionManager/DtrmnSuppRi"
 /begin REF_CHARACTERISTIC KfLDWS_Ang_SuppSteerAngThrsh KfLDWS_M_SuppTorque KfLDWS_t_SuppIndiTime KfLDWS_t_SuppSteerAngTime KfLDWS_t_SuppSteerRateTime KfLDWS_t_SuppTorqueTime KfLDWS_v_SuppSteerRateThrsh /end REF_CHARACTERISTIC
 /begin REF_MEASUREMENT VbLDWS_SuppRi /end REF_MEASUREMENT
/end GROUP
/begin GROUP S8_DtrmnActLe "LDWS_subsystem_integrated/LDWS_subsystem_integrated/TriggerManager/DtrmnActLe" /begin REF_CHARACTERISTIC KfLDWS_t_TLCThrsh /end REF_CHARACTERISTIC /end GROUP
/begin GROUP S8_DtrmnActRi "LDWS_subsystem_integrated/LDWS_subsystem_integrated/TriggerManager/DtrmnActRi" /begin REF_CHARACTERISTIC KfLDWS_t_TLCThrsh /end REF_CHARACTERISTIC /end GROUP
/begin GROUP S8_LanePositionConstraint "LDWS_subsystem_integrated/LDWS_subsystem_integrated/TriggerManager/LanePositionConstraint" /begin SUB_GROUP S46_DtrmnIsOnLeLine S46_DtrmnIsOnRiLine /end SUB_GROUP /end GROUP
/begin GROUP S8_LeadDirectionCondition "LDWS_subsystem_integrated/LDWS_subsystem_integrated/TriggerManager/LeadDirectionCondition" /begin REF_MEASUREMENT VbLDWS_LeadDrctn /end REF_MEASUREMENT /end GROUP
/begin GROUP S8_TTLCondition "LDWS_subsystem_integrated/LDWS_subsystem_integrated/TriggerManager/TTLCondition" /begin SUB_GROUP S48_TLC_calculation S48_v_lat_calculation /end SUB_GROUP /end GROUP
/begin GROUP S8_ThetaCalc "LDWS_subsystem_integrated/LDWS_subsystem_integrated/TriggerManager/ThetaCalc" /begin REF_CHARACTERISTIC KbLDWS_ThetaSwitch /end REF_CHARACTERISTIC /begin REF_MEASUREMENT VfLDWS_Theta /end REF_MEASUREMENT /end GROUP
/begin GROUP S8_VehicleToBdlnCalc "LDWS_subsystem_integrated/LDWS_subsystem_integrated/TriggerManager/VehicleToBdlnCalc"
 /begin REF_CHARACTERISTIC KfLDWS_Ang_BkToCnrAng KfLDWS_d_BkToFrtCnrDist KfLDWS_d_EdgBuff KfLDWS_k_CurvBuffCoe /end REF_CHARACTERISTIC
 /begin REF_MEASUREMENT VfLDWS_EdgeLaneLe VfLDWS_EdgeLaneRi /end REF_MEASUREMENT
/end GROUP
/begin GROUP S46_DtrmnIsOnLeLine "LDWS_subsystem_integrated/LDWS_subsystem_integrated/TriggerManager/LanePositionConstraint/DtrmnIsOnLeLine"
 /begin REF_CHARACTERISTIC KfLDWS_d_WarnLineLvlOne KfLDWS_d_WarnLineLvlThree KfLDWS_k_WarnLineLvlTwo /end REF_CHARACTERISTIC
 /begin REF_MEASUREMENT VbLDWS_IsOnLeLine /end REF_MEASUREMENT
/end GROUP
/begin GROUP S46_DtrmnIsOnRiLine "LDWS_subsystem_integrated/LDWS_subsystem_integrated/TriggerManager/LanePositionConstraint/DtrmnIsOnRiLine"
 /begin REF_CHARACTERISTIC KfLDWS_d_WarnLineLvlOne KfLDWS_d_WarnLineLvlThree KfLDWS_k_WarnLineLvlTwo /end REF_CHARACTERISTIC
 /begin REF_MEASUREMENT VbLDWS_IsOnRiLine /end REF_MEASUREMENT
/end GROUP
/begin GROUP S48_TLC_calculation "LDWS_subsystem_integrated/LDWS_subsystem_integrated/TriggerManager/TTLCondition/TLC_calculation" /begin REF_MEASUREMENT VfLDWS_TLCLe VfLDWS_TLCRi /end REF_MEASUREMENT /end GROUP
/begin GROUP S48_v_lat_calculation "LDWS_subsystem_integrated/LDWS_subsystem_integrated/TriggerManager/TTLCondition/v_lat_calculation" /begin REF_MEASUREMENT VfLDWS_VLatLe VfLDWS_VLatRi /end REF_MEASUREMENT /end GROUP
/begin GROUP AEBD_subsystem_integrated "AEBD_subsystem_integrated" ROOT /begin SUB_GROUP Root_AEBD_Subsystem /end SUB_GROUP /end GROUP
/begin GROUP Root_AEBD_Subsystem "AEBD_subsystem_integrated/AEBD_Subsystem"
 /begin REF_CHARACTERISTIC KbAEBD_ADCU_CANError KbAEBD_AccelerationSensorError KbAEBD_ESCError KbAEBD_ErrorClear KcAEBD_ErrorCountThrsh KfAEBD_a_AccelDeviation KfAEBD_t_WaitTimeThrsh /end REF_CHARACTERISTIC
 /begin REF_MEASUREMENT VbAEBD_AEBaError VbAEBD_AEBrequest VbAEBD_Error VbAEBD_Pedoff VbAEBD_Suppress VcAEBD_ErrorCount VfAEBD_AEB_a VfAEBD_t_DelayTime /end REF_MEASUREMENT
/end GROUP
/begin GROUP ALCA_subsystem_integrated "ALCA_subsystem_integrated" ROOT /begin SUB_GROUP Root_ALCA /end SUB_GROUP
 /begin REF_MEASUREMENT VfALCA_HasLeftLane VfALCA_HasRightLane VfALCA_TargetLaneLength VfALCA_TargetLaneType VfALCA_TargetLaneWidth VfALCA_TargetSideLaneMarkerType VfALCA_d_EGOLaneLength VfALCA_d_EGOLaneWidth VfALCA_v_VehLonSpeed2LaneMarker /end REF_MEASUREMENT
/end GROUP
/begin GROUP Root_ALCA "ALCA_subsystem_integrated/ALCA" /begin SUB_GROUP S1_ALCA_Enabled /end SUB_GROUP
 /begin REF_MEASUREMENT VbALCA_ALCAEnableFromDCSN VbALCA_RequestOutput VeALCA_NotFulfillReasonOutput VeALCA_ReqSideOutput VeALCA_StateOutput VfALCA_FaultOutput VfALCA_v_InterruptOutput VfALCA_v_InterruptTypeOutput VfALCA_v_LateralSpeedOutput /end REF_MEASUREMENT
/end GROUP
/begin GROUP S1_ALCA_Enabled "ALCA_subsystem_integrated/ALCA/ALCA_Enabled"
 /begin SUB_GROUP S3_ALCA_CalcLateralV_ S3_ALCA_CheckLCConditions S3_ALCA_DtrmnALCAState S3_ALCA_Init_global S3_ALCA_InputDataProcess /end SUB_GROUP
 /begin REF_CHARACTERISTIC KbALCA_EnblOvrdInterruptAction KbALCA_UseNewAPI_Of_MPFU KfALCA_d_EgoVehWidth KfALCA_d_LaneWidthMax KfALCA_d_TouchedNewLaneDist KfALCA_t_LaneChangeTimeMax KfALCA_t_LaneChangeTimeMin /end REF_CHARACTERISTIC
 /begin REF_MEASUREMENT VfALCA_d_LateralDist2GoFromLCCS /end REF_MEASUREMENT
/end GROUP
/begin GROUP S3_ALCA_CalcLateralV_ "ALCA_subsystem_integrated/ALCA/ALCA_Enabled/ALCA_CalcLateralV "
 /begin REF_CHARACTERISTIC KfALCA_d_EnterSecondStageThrsh KfALCA_r_OutputLarteralVRatioInterrupt KfALCA_v_LateralSpeedOfSecondStage /end REF_CHARACTERISTIC
/end GROUP
/begin GROUP S3_ALCA_CheckLCConditions "ALCA_subsystem_integrated/ALCA/ALCA_Enabled/ALCA_CheckLCConditions" /begin SUB_GROUP S8_ALCA_Init_global3 S8_MonitorOBFU /end SUB_GROUP
 /begin REF_CHARACTERISTIC KbALCA_EnblCheckMPFULaneMarkerType KbALCA_EnblCheckObstacles KbALCA_EnblNewMethodForLCTime KbALCA_EnblOvrdLaneLength KbALCA_EnblOvrdLaneWidth KbALCA_OvrdLaneChangeTime KfALCA_d_DefaultLaneLength KfALCA_d_Dist2LaneChangeFinish KfALCA_r_ComfortableVRatio KfALCA_r_EgoWidth2LaneWidthRation KfALCA_t_HoldTimeForAccept KfALCA_t_HoldTimeForComplete KfALCA_t_LaneChangeTimeMax KfALCA_v_SpeedLaneChangeEnblMax KfALCA_v_SpeedLaneChangeEnblMin KfAlCA_d_CheckOBFUForwardDistMax /end REF_CHARACTERISTIC
 /begin REF_MEASUREMENT VbALCA_LC_Complete VbALCA_TouchedNewLane VfALCA_d_EGOLaneCenter2Host VfALCA_d_Host2TargetLaneCenter VfALCA_d_TargetSideLaneMarker2Host VfALCA_t_LCTime /end REF_MEASUREMENT
/end GROUP
/begin GROUP S3_ALCA_DtrmnALCAState "ALCA_subsystem_integrated/ALCA/ALCA_Enabled/ALCA_DtrmnALCAState" /begin SUB_GROUP S10_ALCA_Init_global4 /end SUB_GROUP
 /begin REF_CHARACTERISTIC KbALCA_EnblInterrupt KfALCA_t_ExitFinishDelay KfALCA_t_ExitHandoverDelay KfALCA_t_ExitWaitingDelay KfALCA_t_PeriodFunctionCall KfALCA_t_WaitForDriverActionMax /end REF_CHARACTERISTIC
 /begin REF_MEASUREMENT KfALCA_InterruptAction VbALCA_ResetLaneChangeReq /end REF_MEASUREMENT
/end GROUP
/begin GROUP S3_ALCA_Init_global "ALCA_subsystem_integrated/ALCA/ALCA_Enabled/ALCA_Init_global"
 /begin REF_CHARACTERISTIC KbALCA_EnblOvrdInterruptAction KbALCA_UseNewAPI_Of_MPFU KfALCA_d_EgoVehWidth KfALCA_d_LaneWidthMax KfALCA_d_TouchedNewLaneDist KfALCA_t_LaneChangeTimeMax KfALCA_t_LaneChangeTimeMin /end REF_CHARACTERISTIC
/end GROUP
/begin GROUP S3_ALCA_InputDataProcess "ALCA_subsystem_integrated/ALCA/ALCA_Enabled/ALCA_InputDataProcess"
 /begin SUB_GROUP S12_ALCA_Dtrm_dcsn_info S12_ALCA_FaultDetection S12_ALCA_Init_global2 S12_ALCA_adc_path_prediction /end SUB_GROUP
 /begin REF_CHARACTERISTIC KbALCA_EnblCheckMPFUFusionStatus KbALCA_EnblCheckTimestamp /end REF_CHARACTERISTIC
 /begin REF_MEASUREMENT VfALCA_LeftDist2Host VfALCA_LeftLaneMarkerFusionStatus VfALCA_LeftLaneMarkerType VfALCA_LeftLaneMarker_C0 VfALCA_LeftLaneMarker_C1 VfALCA_LeftLaneMarker_C2 VfALCA_LeftLaneMarker_C3 VfALCA_RightDist2Host VfALCA_RightLaneMarkerFusionStatus VfALCA_RightLaneMarkerType VfALCA_RightLaneMarker_C0 VfALCA_RightLaneMarker_C1 VfALCA_RightLaneMarker_C2 VfALCA_RightLaneMarker_C3 VfALCA_v_VehSpeed VfALCA_v_VehVx VfALCA_v_VehVy /end REF_MEASUREMENT
/end GROUP
/begin GROUP S8_ALCA_Init_global3 "ALCA_subsystem_integrated/ALCA/ALCA_Enabled/ALCA_CheckLCConditions/ALCA_Init_global3"
 /begin REF_CHARACTERISTIC KbALCA_EnblCheckMPFULaneMarkerType KbALCA_EnblCheckObstacles KbALCA_EnblNewMethodForLCTime KbALCA_EnblOvrdLaneLength KbALCA_EnblOvrdLaneWidth KfALCA_d_DefaultLaneLength KfALCA_r_ComfortableVRatio KfALCA_r_EgoWidth2LaneWidthRation KfALCA_v_SpeedLaneChangeEnblMax KfALCA_v_SpeedLaneChangeEnblMin KfAlCA_d_CheckOBFUForwardDistMax /end REF_CHARACTERISTIC
/end GROUP
/begin GROUP S8_MonitorOBFU "ALCA_subsystem_integrated/ALCA/ALCA_Enabled/ALCA_CheckLCConditions/MonitorOBFU"
 /begin REF_MEASUREMENT VfALCA_ObstacleCenter_x VfALCA_ObstacleCenter_y VfALCA_ObstacleHeading VfALCA_ObstacleID VfALCA_ObstacleLength VfALCA_ObstacleNearest_x VfALCA_ObstacleNearest_y VfALCA_ObstacleWidth VfALCA_v_Obstacle_Vx VfALCA_v_Obstacle_Vy /end REF_MEASUREMENT
/end GROUP
/begin GROUP S10_ALCA_Init_global4 "ALCA_subsystem_integrated/ALCA/ALCA_Enabled/ALCA_DtrmnALCAState/ALCA_Init_global4" /begin REF_CHARACTERISTIC KbALCA_EnblInterrupt /end REF_CHARACTERISTIC /end GROUP
/begin GROUP S12_ALCA_Dtrm_dcsn_info "ALCA_subsystem_integrated/ALCA/ALCA_Enabled/ALCA_InputDataProcess/ALCA_Dtrm_dcsn_info"
 /begin REF_CHARACTERISTIC KbALCA_ChanggLaneCancelReqOvrd KbALCA_ChanggLaneReqOvrd KbALCA_EnblInterrupt KbALCA_EnblOvrdReqFromECSN KeALCA_ChangeLaneReqSideOvrd /end REF_CHARACTERISTIC
 /begin REF_MEASUREMENT VbALCA_LC_CancelReq VbALCA_LC_CancelReqFromDCSN VbALCA_LC_Req VbALCA_LC_ReqFromDCSN VeALCA_ReqSide VeALCA_ReqSideFromDCSN /end REF_MEASUREMENT
/end GROUP
/begin GROUP S12_ALCA_FaultDetection "ALCA_subsystem_integrated/ALCA/ALCA_Enabled/ALCA_InputDataProcess/ALCA_FaultDetection" /begin REF_CHARACTERISTIC KfALCA_t_TimeNReceivedThrsh /end REF_CHARACTERISTIC /begin REF_MEASUREMENT VfALCA_FaultInit /end REF_MEASUREMENT /end GROUP
/begin GROUP S12_ALCA_Init_global2 "ALCA_subsystem_integrated/ALCA/ALCA_Enabled/ALCA_InputDataProcess/ALCA_Init_global2" /begin REF_CHARACTERISTIC KbALCA_EnblCheckMPFUFusionStatus /end REF_CHARACTERISTIC /end GROUP
/begin GROUP S12_ALCA_adc_path_prediction "ALCA_subsystem_integrated/ALCA/ALCA_Enabled/ALCA_InputDataProcess/ALCA_adc_path_prediction"
 /begin REF_CHARACTERISTIC KfALCA_d_EgoVehWheelBase KfALCA_r_CoeffStrwhl2Radius KfALCA_r_EgoVehStrwhl2FrtwhlRatio /end REF_CHARACTERISTIC
/end GROUP
/begin GROUP LKAS_subsystem_integrated "LKAS_subsystem_integrated" ROOT /begin SUB_GROUP Root_LKAS_subsystem_integrated /end SUB_GROUP /end GROUP
/begin GROUP Root_LKAS_subsystem_integrated "LKAS_subsystem_integrated/LKAS_subsystem_integrated" /begin SUB_GROUP S3_ControlLayer S3_InputFusion /end SUB_GROUP /end GROUP
/begin GROUP S3_ControlLayer "LKAS_subsystem_integrated/LKAS_subsystem_integrated/ControlLayer"
 /begin SUB_GROUP S4_CreateCtrlValue S4_InterventionAbort S4_InterventionCompletion S4_InterventionManager S4_OutputManager S4_SuppressionManager S4_TriggeringSLKA /end SUB_GROUP
/end GROUP
/begin GROUP S3_InputFusion "LKAS_subsystem_integrated/LKAS_subsystem_integrated/InputFusion" /begin SUB_GROUP S5_LaneMarkerHandler S5_TrajectoryCalculation /end SUB_GROUP /end GROUP
/begin GROUP S4_CreateCtrlValue "LKAS_subsystem_integrated/LKAS_subsystem_integrated/ControlLayer/CreateCtrlValue"
 /begin SUB_GROUP S6_CtrlValueCreation S6_InputSelection S6_OffstAndVlatController S6_PathFreeze S6_SteerAngleRequest /end SUB_GROUP
/end GROUP
/begin GROUP S4_InterventionAbort "LKAS_subsystem_integrated/LKAS_subsystem_integrated/ControlLayer/InterventionAbort" /begin SUB_GROUP S8_AbortForTimeOut S8_AbortsLKA S8_DtrmnAbortDly /end SUB_GROUP /end GROUP
/begin GROUP S4_InterventionCompletion "LKAS_subsystem_integrated/LKAS_subsystem_integrated/ControlLayer/InterventionCompletion"
 /begin SUB_GROUP S9_CheckInsidePath S9_CheckVlat S9_ChecksLKACmpl S9_DtrmnPositToPath /end SUB_GROUP
/end GROUP
/begin GROUP S4_InterventionManager "LKAS_subsystem_integrated/LKAS_subsystem_integrated/ControlLayer/InterventionManager" /begin SUB_GROUP S10_FunctionActivityArbitration_ /end SUB_GROUP
 /begin REF_MEASUREMENT VeLKAS_CtrlRef_sLKA VeLKAS_IntvMgrSt_sLKA VeLKAS_IntvSide_sLKA VeLKAS_IntvTyp_sLKA VeLKAS_OnStateSt_sLKA VeLKAS_SystemSt_sLKA /end REF_MEASUREMENT
/end GROUP
/begin GROUP S4_OutputManager "LKAS_subsystem_integrated/LKAS_subsystem_integrated/ControlLayer/OutputManager" /begin SUB_GROUP S11_CreateLKADataBus /end SUB_GROUP /end GROUP
/begin GROUP S4_SuppressionManager "LKAS_subsystem_integrated/LKAS_subsystem_integrated/ControlLayer/SuppressionManager" /begin SUB_GROUP S12_sLKASuppression /end SUB_GROUP /end GROUP
/begin GROUP S4_TriggeringSLKA "LKAS_subsystem_integrated/LKAS_subsystem_integrated/ControlLayer/TriggeringSLKA"
 /begin SUB_GROUP S13_CheckPathAcceleration S13_CheckTracking S13_CheckTrajectoryInTrigZone S13_CheckVlatTowardIntvSide S13_CheckVlatWithinThreshold S13_IncreaseRobustness S13_LDW_Triggering /end SUB_GROUP
 /begin REF_CHARACTERISTIC KbLKAS_TriggerLDWSwitch /end REF_CHARACTERISTIC
 /begin REF_MEASUREMENT VbLKAS_IsTrajectoryFound /end REF_MEASUREMENT
/end GROUP
/begin GROUP S5_LaneMarkerHandler "LKAS_subsystem_integrated/LKAS_subsystem_integrated/InputFusion/LaneMarkerHandler" /begin SUB_GROUP S170_SeneorFusion S170_UpdateInternalOutput S170__ /end SUB_GROUP /end GROUP
/begin GROUP S5_TrajectoryCalculation "LKAS_subsystem_integrated/LKAS_subsystem_integrated/InputFusion/TrajectoryCalculation"
 /begin SUB_GROUP S171_CurveDetection S171_PathGeneration S171_RoadEnableEvaluation S171_VehicleStates /end SUB_GROUP
/end GROUP
/begin GROUP S6_CtrlValueCreation "LKAS_subsystem_integrated/LKAS_subsystem_integrated/ControlLayer/CreateCtrlValue/CtrlValueCreation" /begin SUB_GROUP S15_CtrlValueCreation /end SUB_GROUP /end GROUP
/begin GROUP S6_InputSelection "LKAS_subsystem_integrated/LKAS_subsystem_integrated/ControlLayer/CreateCtrlValue/InputSelection" /begin SUB_GROUP S16_OffstAndVlatCalc /end SUB_GROUP /end GROUP
/begin GROUP S6_OffstAndVlatController "LKAS_subsystem_integrated/LKAS_subsystem_integrated/ControlLayer/CreateCtrlValue/OffstAndVlatController"
 /begin REF_CHARACTERISTIC KbLKAS_TargetSwitch_Temp KfLKAS_d_OffstCtrlr_DeadZone KfLKAS_r_PGainForVlat KfLKAS_v_VlatCtrlr_DeadZone KtLKAS_r_OffstCtrlDiffGain KtLKAS_r_OffstCtrlPropGain /end REF_CHARACTERISTIC
 /begin REF_MEASUREMENT VfLKAS_Alat_Desired VfLKAS_DesiredDistToEdge VfLKAS_OffstError VfLKAS_Offst_ErrorDiff VfLKAS_TargetA VfLKAS_TargetV VfLKAS_VlatError VfLKAS_Vlat_Desired VfLKAS_Vlat_ErrorDiff VfLKAS_YawRateDesired /end REF_MEASUREMENT
/end GROUP
/begin GROUP S6_PathFreeze "LKAS_subsystem_integrated/LKAS_subsystem_integrated/ControlLayer/CreateCtrlValue/PathFreeze"
 /begin SUB_GROUP S18_FreezeCurrent_1 S18_FreezeCurrent_10 S18_FreezeCurrent_2 S18_FreezeCurrent_3 S18_FreezeCurrent_4 S18_FreezeCurrent_5 /end SUB_GROUP
/end GROUP
/begin GROUP S6_SteerAngleRequest "LKAS_subsystem_integrated/LKAS_subsystem_integrated/ControlLayer/CreateCtrlValue/SteerAngleRequest"
 /begin REF_CHARACTERISTIC KfLKAS_Ang_SteerOffset KfLKAS_Ang_StrAngLwrLimit KfLKAS_Ang_StrAngUprLimit KfLKAS_C_CfForLatCtrl KfLKAS_C_CrForLatCtrl KfLKAS_d_LfForLatCtrl KfLKAS_d_LrForLatCtrl KfLKAS_k_StrAngFiltr KfLKAS_m_MForLatCtrl KfLKAS_r_StrRatioForLatCtrl /end REF_CHARACTERISTIC
 /begin REF_MEASUREMENT VfLKAS_SteerAngleRequest VfLKAS_SteerAngleRequest_Saturated VfLKAS_StrAngFilted /end REF_MEASUREMENT
/end GROUP
/begin GROUP S8_AbortForTimeOut "LKAS_subsystem_integrated/LKAS_subsystem_integrated/ControlLayer/InterventionAbort/AbortForTimeOut" /begin REF_CHARACTERISTIC KfLKAS_t_MaxIntvTime /end REF_CHARACTERISTIC /end GROUP
/begin GROUP S8_AbortsLKA "LKAS_subsystem_integrated/LKAS_subsystem_integrated/ControlLayer/InterventionAbort/AbortsLKA" /begin SUB_GROUP S76_Subsystem /end SUB_GROUP /begin REF_CHARACTERISTIC KbLKAS_AbortSwitch_Temp /end REF_CHARACTERISTIC /begin REF_MEASUREMENT VbLKAS_IsAbortIntv /end REF_MEASUREMENT /end GROUP
/begin GROUP S8_DtrmnAbortDly "LKAS_subsystem_integrated/LKAS_subsystem_integrated/ControlLayer/InterventionAbort/DtrmnAbortDly" /begin SUB_GROUP S77_OffDelayBlock /end SUB_GROUP /begin REF_CHARACTERISTIC KcLKAS_CntSample KfLKAS_t_TimeDlyAbort /end REF_CHARACTERISTIC /end GROUP
/begin GROUP S9_CheckInsidePath "LKAS_subsystem_integrated/LKAS_subsystem_integrated/ControlLayer/InterventionCompletion/CheckInsidePath" /begin REF_MEASUREMENT VbLKAS_IsInsidePath /end REF_MEASUREMENT /end GROUP
/begin GROUP S9_CheckVlat "LKAS_subsystem_integrated/LKAS_subsystem_integrated/ControlLayer/InterventionCompletion/CheckVlat" /begin SUB_GROUP S87_CheckVlatTowardsLaneCenter S87_CheckVmaxReached /end SUB_GROUP /end GROUP
/begin GROUP S9_ChecksLKACmpl "LKAS_subsystem_integrated/LKAS_subsystem_integrated/ControlLayer/InterventionCompletion/ChecksLKACmpl" /begin SUB_GROUP S88_Robustness /end SUB_GROUP
 /begin REF_CHARACTERISTIC KbLKAS_UseInsidePathForCmpl_Temp KbLKAS_UseVmaxForCmpl_Temp /end REF_CHARACTERISTIC
/end GROUP
/begin GROUP S9_DtrmnPositToPath "LKAS_subsystem_integrated/LKAS_subsystem_integrated/ControlLayer/InterventionCompletion/DtrmnPositToPath" /begin REF_CHARACTERISTIC KbLKAS_NotUseOffstForCmpl_Temp /end REF_CHARACTERISTIC /end GROUP
/begin GROUP S10_FunctionActivityArbitration_ "LKAS_subsystem_integrated/LKAS_subsystem_integrated/ControlLayer/InterventionManager/FunctionActivityArbitration " /begin SUB_GROUP S103_InterventionTime /end SUB_GROUP /end GROUP
/begin GROUP S11_CreateLKADataBus "LKAS_subsystem_integrated/LKAS_subsystem_integrated/ControlLayer/OutputManager/CreateLKADataBus" /begin REF_MEASUREMENT VbLKAS_Intv_Request /end REF_MEASUREMENT /end GROUP
/begin GROUP S12_sLKASuppression "LKAS_subsystem_integrated/LKAS_subsystem_integrated/ControlLayer/SuppressionManager/sLKASuppression" /begin REF_CHARACTERISTIC KbLKAS_SuppSwitch_Temp /end REF_CHARACTERISTIC
 /begin REF_MEASUREMENT VbLKAS_DlyAftAbort VbLKAS_InnerCurvLe VbLKAS_InnerCurvRi VbLKAS_IsSuppLe VbLKAS_IsSuppRi VbLKAS_LeftChangeLane VbLKAS_NotQualDrpLeft VbLKAS_NotQualDrpRight VbLKAS_RightChangeLane /end REF_MEASUREMENT
/end GROUP
/begin GROUP S13_CheckPathAcceleration "LKAS_subsystem_integrated/LKAS_subsystem_integrated/ControlLayer/TriggeringSLKA/CheckPathAcceleration" /begin REF_CHARACTERISTIC KfLKAS_a_AMaxInPathToTrig_sLKA /end REF_CHARACTERISTIC /begin REF_MEASUREMENT VbLKAS_IsPathAccPlausible /end REF_MEASUREMENT /end GROUP
/begin GROUP S13_CheckTracking "LKAS_subsystem_integrated/LKAS_subsystem_integrated/ControlLayer/TriggeringSLKA/CheckTracking" /begin REF_MEASUREMENT VbLKAS_IsTrackingIntvSide /end REF_MEASUREMENT /end GROUP
/begin GROUP S13_CheckTrajectoryInTrigZone "LKAS_subsystem_integrated/LKAS_subsystem_integrated/ControlLayer/TriggeringSLKA/CheckTrajectoryInTrigZone" /begin REF_CHARACTERISTIC KfLKAS_j_MaxTrigJerk_sLKA KfLKAS_t_TMaxNeeded_sLKA /end REF_CHARACTERISTIC /begin REF_MEASUREMENT VbLKAS_IsTrajInTrigZone /end REF_MEASUREMENT /end GROUP
/begin GROUP S13_CheckVlatTowardIntvSide "LKAS_subsystem_integrated/LKAS_subsystem_integrated/ControlLayer/TriggeringSLKA/CheckVlatTowardIntvSide" /begin REF_MEASUREMENT VbLKAS_IsVlatTowardsIntvSide /end REF_MEASUREMENT /end GROUP
/begin GROUP S13_CheckVlatWithinThreshold "LKAS_subsystem_integrated/LKAS_subsystem_integrated/ControlLayer/TriggeringSLKA/CheckVlatWithinThreshold" /begin REF_CHARACTERISTIC KfLKAS_v_VMaxToTrigZeroPath_sLKA /end REF_CHARACTERISTIC /begin REF_MEASUREMENT VbLKAS_IsVlatOkForZeroPath /end REF_MEASUREMENT /end GROUP
/begin GROUP S13_IncreaseRobustness "LKAS_subsystem_integrated/LKAS_subsystem_integrated/ControlLayer/TriggeringSLKA/IncreaseRobustness" /begin SUB_GROUP S122_OnDelayBlock3 /end SUB_GROUP /begin REF_CHARACTERISTIC KcLKAS_CntSample KfLKAS_t_TDelayForAct_sLKA /end REF_CHARACTERISTIC /end GROUP
/begin GROUP S13_LDW_Triggering "LKAS_subsystem_integrated/LKAS_subsystem_integrated/ControlLayer/TriggeringSLKA/LDW_Triggering" /begin SUB_GROUP S123_Road_Enable_Estimator S123_TriggerManager /end SUB_GROUP /begin REF_MEASUREMENT VbLKAS_IsLDWSTriggered /end REF_MEASUREMENT /end GROUP
/begin GROUP S170__ "LKAS_subsystem_integrated/LKAS_subsystem_integrated/InputFusion/LaneMarkerHandler/ " /begin REF_CHARACTERISTIC KfLKAS_d_VehicleWheelBase KfLKAS_d_VehicleWidth /end REF_CHARACTERISTIC /end GROUP
/begin GROUP S170_SeneorFusion "LKAS_subsystem_integrated/LKAS_subsystem_integrated/InputFusion/LaneMarkerHandler/SeneorFusion"
 /begin SUB_GROUP S173_LaneMarkerHandler S173_Road_Signals S173_VehicleSelfSignalsHandler /end SUB_GROUP
/end GROUP
/begin GROUP S170_UpdateInternalOutput "LKAS_subsystem_integrated/LKAS_subsystem_integrated/InputFusion/LaneMarkerHandler/UpdateInternalOutput"
 /begin REF_MEASUREMENT VbLKAS_IsIntvCompleted_sLKA_IntOut VeLKAS_CtrlRef_sLKA_IntOut VeLKAS_IntvSide_sLKA_IntOut VeLKAS_IntvTyp_sLKA_IntOut VfLKAS_T_AftIntvStart_IntOut /end REF_MEASUREMENT
/end GROUP
/begin GROUP S171_CurveDetection "LKAS_subsystem_integrated/LKAS_subsystem_integrated/InputFusion/TrajectoryCalculation/CurveDetection" /begin SUB_GROUP S236_RELAY_INIT_3 S236_RELAY_INIT_4 /end SUB_GROUP /begin REF_CHARACTERISTIC KfLKAS_c_CurveSuppOff KfLKAS_c_CurveSuppOn /end REF_CHARACTERISTIC /end GROUP
/begin GROUP S171_PathGeneration "LKAS_subsystem_integrated/LKAS_subsystem_integrated/InputFusion/TrajectoryCalculation/PathGeneration"
 /begin SUB_GROUP S237_NoOperation1 S237_NoOperation2 S237_NoOperation3 S237_NoOperation4 S237_PathGeneration_sLKA /end SUB_GROUP
/end GROUP
/begin GROUP S171_RoadEnableEvaluation "LKAS_subsystem_integrated/LKAS_subsystem_integrated/InputFusion/TrajectoryCalculation/RoadEnableEvaluation" /begin SUB_GROUP S238_RoadEnableEvaluationSLKA /end SUB_GROUP /end GROUP
/begin GROUP S171_VehicleStates "LKAS_subsystem_integrated/LKAS_subsystem_integrated/InputFusion/TrajectoryCalculation/VehicleStates"
 /begin SUB_GROUP S239_DetermineRelativeALat S239_DetermineV_Long S239_SelectControlReference S239_SelectReference /end SUB_GROUP
 /begin REF_CHARACTERISTIC KfLKAS_d_ExtraMargin /end REF_CHARACTERISTIC
 /begin REF_MEASUREMENT VfLKAS_L_ExtraMargin_sLKA /end REF_MEASUREMENT
/end GROUP
/begin GROUP S15_CtrlValueCreation "LKAS_subsystem_integrated/LKAS_subsystem_integrated/ControlLayer/CreateCtrlValue/CtrlValueCreation/CtrlValueCreation"
 /begin SUB_GROUP S21_FreezeCurrent_1 S21_FreezeCurrent_5 S21_JerkCalc S21_TargetDistCalc_1 S21_TargetDistCalc_2 /end SUB_GROUP
 /begin REF_MEASUREMENT VbLKAS_Trigger_Traj_1 VbLKAS_Trigger_Traj_2 VfLKAS_TargetDist /end REF_MEASUREMENT
/end GROUP
/begin GROUP S16_OffstAndVlatCalc "LKAS_subsystem_integrated/LKAS_subsystem_integrated/ControlLayer/CreateCtrlValue/InputSelection/OffstAndVlatCalc" /begin REF_MEASUREMENT VfLKAS_Offst_Actual /end REF_MEASUREMENT /end GROUP
/begin GROUP S18_FreezeCurrent_1 "LKAS_subsystem_integrated/LKAS_subsystem_integrated/ControlLayer/CreateCtrlValue/PathFreeze/FreezeCurrent_1" /begin REF_MEASUREMENT VfLKAS_A0Freezed_sLKA /end REF_MEASUREMENT /end GROUP
/begin GROUP S18_FreezeCurrent_10 "LKAS_subsystem_integrated/LKAS_subsystem_integrated/ControlLayer/CreateCtrlValue/PathFreeze/FreezeCurrent_10" /begin REF_MEASUREMENT VfLKAS_Offst_start /end REF_MEASUREMENT /end GROUP
/begin GROUP S18_FreezeCurrent_2 "LKAS_subsystem_integrated/LKAS_subsystem_integrated/ControlLayer/CreateCtrlValue/PathFreeze/FreezeCurrent_2" /begin REF_MEASUREMENT VfLKAS_AmFreezed_sLKA /end REF_MEASUREMENT /end GROUP
/begin GROUP S18_FreezeCurrent_3 "LKAS_subsystem_integrated/LKAS_subsystem_integrated/ControlLayer/CreateCtrlValue/PathFreeze/FreezeCurrent_3" /begin REF_MEASUREMENT VfLKAS_AeFreezed_sLKA /end REF_MEASUREMENT /end GROUP
/begin GROUP S18_FreezeCurrent_4 "LKAS_subsystem_integrated/LKAS_subsystem_integrated/ControlLayer/CreateCtrlValue/PathFreeze/FreezeCurrent_4" /begin REF_MEASUREMENT VfLKAS_dtFreezed_sLKA /end REF_MEASUREMENT /end GROUP
/begin GROUP S18_FreezeCurrent_5 "LKAS_subsystem_integrated/LKAS_subsystem_integrated/ControlLayer/CreateCtrlValue/PathFreeze/FreezeCurrent_5" /begin REF_MEASUREMENT VfLKAS_V0Freezed_sLKA /end REF_MEASUREMENT /end GROUP
/begin GROUP S76_Subsystem "LKAS_subsystem_integrated/LKAS_subsystem_integrated/ControlLayer/InterventionAbort/AbortsLKA/Subsystem" /begin REF_MEASUREMENT VfLKAS_AbortID /end REF_MEASUREMENT /end GROUP
/begin GROUP S77_OffDelayBlock "LKAS_subsystem_integrated/LKAS_subsystem_integrated/ControlLayer/InterventionAbort/DtrmnAbortDly/OffDelayBlock" /begin REF_MEASUREMENT VbLKAS_IsDelayAftAbort /end REF_MEASUREMENT /end GROUP
/begin GROUP S87_CheckVlatTowardsLaneCenter "LKAS_subsystem_integrated/LKAS_subsystem_integrated/ControlLayer/InterventionCompletion/CheckVlat/CheckVlatTowardsLaneCenter" /begin REF_CHARACTERISTIC KfLKAS_v_VlatMinForCmpl /end REF_CHARACTERISTIC /begin REF_MEASUREMENT VbLKAS_IsVlatTowardsLaneCenter /end REF_MEASUREMENT /end GROUP
/begin GROUP S87_CheckVmaxReached "LKAS_subsystem_integrated/LKAS_subsystem_integrated/ControlLayer/InterventionCompletion/CheckVlat/CheckVmaxReached" /begin REF_CHARACTERISTIC KfLKAS_v_VlatMaxForCmpl /end REF_CHARACTERISTIC /begin REF_MEASUREMENT VbLKAS_IsVmaxReached /end REF_MEASUREMENT /end GROUP
/begin GROUP S88_Robustness "LKAS_subsystem_integrated/LKAS_subsystem_integrated/ControlLayer/InterventionCompletion/ChecksLKACmpl/Robustness" /begin SUB_GROUP S94_OnDelayBlock3 /end SUB_GROUP /begin REF_CHARACTERISTIC KcLKAS_CntSample KfLKAS_t_TDelayForCmpl_sLKA /end REF_CHARACTERISTIC /end GROUP
/begin GROUP S103_InterventionTime "LKAS_subsystem_integrated/LKAS_subsystem_integrated/ControlLayer/InterventionManager/FunctionActivityArbitration /InterventionTime" /begin SUB_GROUP S106_Subsystem /end SUB_GROUP /end GROUP
/begin GROUP S122_OnDelayBlock3 "LKAS_subsystem_integrated/LKAS_subsystem_integrated/ControlLayer/TriggeringSLKA/IncreaseRobustness/OnDelayBlock3" /begin REF_MEASUREMENT VbLKAS_IsActivated_sLKA /end REF_MEASUREMENT /end GROUP
/begin GROUP S123_Road_Enable_Estimator "LKAS_subsystem_integrated/LKAS_subsystem_integrated/ControlLayer/TriggeringSLKA/LDW_Triggering/Road_Enable_Estimator" /begin SUB_GROUP S132_Subsystem S132_Subsystem1 /end SUB_GROUP /end GROUP
/begin GROUP S123_TriggerManager "LKAS_subsystem_integrated/LKAS_subsystem_integrated/ControlLayer/TriggeringSLKA/LDW_Triggering/TriggerManager"
 /begin SUB_GROUP S133_DtrmnActLe S133_DtrmnActRi S133_LanePositionConstraint S133_VehicleToBdlnCalc /end SUB_GROUP
/end GROUP
/begin GROUP S173_LaneMarkerHandler "LKAS_subsystem_integrated/LKAS_subsystem_integrated/InputFusion/LaneMarkerHandler/SeneorFusion/LaneMarkerHandler"
 /begin SUB_GROUP S176_Check_Quality S176_LeftLaneMarker S176_RightLaneMarker /end SUB_GROUP
/end GROUP
/begin GROUP S173_Road_Signals "LKAS_subsystem_integrated/LKAS_subsystem_integrated/InputFusion/LaneMarkerHandler/SeneorFusion/Road Signals" /begin SUB_GROUP S177_DetermineLaneWidth S177_DetermineRoadCurvature /end SUB_GROUP /end GROUP
/begin GROUP S173_VehicleSelfSignalsHandler "LKAS_subsystem_integrated/LKAS_subsystem_integrated/InputFusion/LaneMarkerHandler/SeneorFusion/VehicleSelfSignalsHandler"
 /begin SUB_GROUP S178_NoOperation1 S178_NoOperation2 S178_NoOperation3 S178_NoOperation7 /end SUB_GROUP
/end GROUP
/begin GROUP S236_RELAY_INIT_3 "LKAS_subsystem_integrated/LKAS_subsystem_integrated/InputFusion/TrajectoryCalculation/CurveDetection/RELAY_INIT_3" /begin REF_MEASUREMENT VbLKAS_InnerCurvLe_sLKA /end REF_MEASUREMENT /end GROUP
/begin GROUP S236_RELAY_INIT_4 "LKAS_subsystem_integrated/LKAS_subsystem_integrated/InputFusion/TrajectoryCalculation/CurveDetection/RELAY_INIT_4" /begin REF_MEASUREMENT VbLKAS_InnerCurvRi_sLKA /end REF_MEASUREMENT /end GROUP
/begin GROUP S237_NoOperation1 "LKAS_subsystem_integrated/LKAS_subsystem_integrated/InputFusion/TrajectoryCalculation/PathGeneration/NoOperation1" /begin REF_MEASUREMENT VfLKAS_dt_sLKA /end REF_MEASUREMENT /end GROUP
/begin GROUP S237_NoOperation2 "LKAS_subsystem_integrated/LKAS_subsystem_integrated/InputFusion/TrajectoryCalculation/PathGeneration/NoOperation2" /begin REF_MEASUREMENT VfLKAS_A0_sLKA /end REF_MEASUREMENT /end GROUP
/begin GROUP S237_NoOperation3 "LKAS_subsystem_integrated/LKAS_subsystem_integrated/InputFusion/TrajectoryCalculation/PathGeneration/NoOperation3" /begin REF_MEASUREMENT VfLKAS_Am_sLKA /end REF_MEASUREMENT /end GROUP
/begin GROUP S237_NoOperation4 "LKAS_subsystem_integrated/LKAS_subsystem_integrated/InputFusion/TrajectoryCalculation/PathGeneration/NoOperation4" /begin REF_MEASUREMENT VfLKAS_Ae_sLKA /end REF_MEASUREMENT /end GROUP
/begin GROUP S237_PathGeneration_sLKA "LKAS_subsystem_integrated/LKAS_subsystem_integrated/InputFusion/TrajectoryCalculation/PathGeneration/PathGeneration_sLKA"
 /begin SUB_GROUP S258_BoundaryValues_sLKA S258_ITCWithAdditionalConditionForValidPath_sLKA S258_determine_path_sLKA /end SUB_GROUP
/end GROUP
/begin GROUP S238_RoadEnableEvaluationSLKA "LKAS_subsystem_integrated/LKAS_subsystem_integrated/InputFusion/TrajectoryCalculation/RoadEnableEvaluation/RoadEnableEvaluationSLKA" /begin SUB_GROUP S363_LaneWidthEnable S363_OnDelayBlock S363_OnDelayBlock1 /end SUB_GROUP /begin REF_CHARACTERISTIC KfLKAS_CallFreq KfLKAS_t_RoadEnblOKHoldLow /end REF_CHARACTERISTIC /begin REF_MEASUREMENT VbLKAS__RoadEnbl /end REF_MEASUREMENT /end GROUP
/begin GROUP S239_DetermineRelativeALat "LKAS_subsystem_integrated/LKAS_subsystem_integrated/InputFusion/TrajectoryCalculation/VehicleStates/DetermineRelativeALat" /begin REF_CHARACTERISTIC KbLKAS_A0Trigger_Temp KfLKAS_a_SarnOfRelALatForPahCalcn /end REF_CHARACTERISTIC
 /begin REF_MEASUREMENT VfLKAS_A_ALatRelLaneMkrLe VfLKAS_A_ALatRelLaneMkrRi VfLKAS_A_ALatRelLaneMkr_sLKA /end REF_MEASUREMENT
/end GROUP
/begin GROUP S239_DetermineV_Long "LKAS_subsystem_integrated/LKAS_subsystem_integrated/InputFusion/TrajectoryCalculation/VehicleStates/DetermineV_Long" /begin REF_MEASUREMENT VfLKAS_Vlong_sLKA /end REF_MEASUREMENT /end GROUP
/begin GROUP S239_SelectControlReference "LKAS_subsystem_integrated/LKAS_subsystem_integrated/InputFusion/TrajectoryCalculation/VehicleStates/SelectControlReference" /begin REF_MEASUREMENT VeLKAS_CtrlRefReq_sLKA /end REF_MEASUREMENT /end GROUP
/begin GROUP S239_SelectReference "LKAS_subsystem_integrated/LKAS_subsystem_integrated/InputFusion/TrajectoryCalculation/VehicleStates/SelectReference" /begin SUB_GROUP S386_DetermineInterventionSideRequest /end SUB_GROUP /begin REF_MEASUREMENT VfLKAS_L_DistToCross_sLKA VfLKAS_Vlat_sLKA /end REF_MEASUREMENT /end GROUP
/begin GROUP S21_FreezeCurrent_1 "LKAS_subsystem_integrated/LKAS_subsystem_integrated/ControlLayer/CreateCtrlValue/CtrlValueCreation/CtrlValueCreation/FreezeCurrent_1" /begin REF_MEASUREMENT VfLKAS_TargetDist_Freezed2 /end REF_MEASUREMENT /end GROUP
/begin GROUP S21_FreezeCurrent_5 "LKAS_subsystem_integrated/LKAS_subsystem_integrated/ControlLayer/CreateCtrlValue/CtrlValueCreation/CtrlValueCreation/FreezeCurrent_5" /begin REF_MEASUREMENT VfLKAS_TargetDist_Freezed1 /end REF_MEASUREMENT /end GROUP
/begin GROUP S21_JerkCalc "LKAS_subsystem_integrated/LKAS_subsystem_integrated/ControlLayer/CreateCtrlValue/CtrlValueCreation/CtrlValueCreation/JerkCalc" /begin REF_MEASUREMENT VfLKAS_Jerk1 VfLKAS_Jerk2 /end REF_MEASUREMENT /end GROUP
/begin GROUP S21_TargetDistCalc_1 "LKAS_subsystem_integrated/LKAS_subsystem_integrated/ControlLayer/CreateCtrlValue/CtrlValueCreation/CtrlValueCreation/TargetDistCalc_1"
 /begin REF_MEASUREMENT VfLKAS_TargetA_1 VfLKAS_TargetDist_1 VfLKAS_TargetV_1 VfLKAS_V0Increment /end REF_MEASUREMENT
/end GROUP
/begin GROUP S21_TargetDistCalc_2 "LKAS_subsystem_integrated/LKAS_subsystem_integrated/ControlLayer/CreateCtrlValue/CtrlValueCreation/CtrlValueCreation/TargetDistCalc_2" /begin REF_MEASUREMENT VfLKAS_TargetA_2 VfLKAS_TargetDist_2 VfLKAS_TargetV_2 /end REF_MEASUREMENT /end GROUP
/begin GROUP S94_OnDelayBlock3 "LKAS_subsystem_integrated/LKAS_subsystem_integrated/ControlLayer/InterventionCompletion/ChecksLKACmpl/Robustness/OnDelayBlock3" /begin REF_MEASUREMENT VbLKAS_IsIntvCompleted /end REF_MEASUREMENT /end GROUP
/begin GROUP S106_Subsystem "LKAS_subsystem_integrated/LKAS_subsystem_integrated/ControlLayer/InterventionManager/FunctionActivityArbitration /InterventionTime/Subsystem" /begin REF_MEASUREMENT VfLKAS_T_AftIntvStart /end REF_MEASUREMENT /end GROUP
/begin GROUP S132_Subsystem "LKAS_subsystem_integrated/LKAS_subsystem_integrated/ControlLayer/TriggeringSLKA/LDW_Triggering/Road_Enable_Estimator/Subsystem" /begin REF_CHARACTERISTIC KcLKAS_CntSample KfLKAS_r_QlyVld KfLKAS_t_LnMkrMissThrsh /end REF_CHARACTERISTIC /end GROUP
/begin GROUP S132_Subsystem1 "LKAS_subsystem_integrated/LKAS_subsystem_integrated/ControlLayer/TriggeringSLKA/LDW_Triggering/Road_Enable_Estimator/Subsystem1" /begin REF_CHARACTERISTIC KcLKAS_CntSample KfLKAS_r_QlyVld KfLKAS_t_LnMkrMissThrsh /end REF_CHARACTERISTIC /end GROUP
/begin GROUP S133_DtrmnActLe "LKAS_subsystem_integrated/LKAS_subsystem_integrated/ControlLayer/TriggeringSLKA/LDW_Triggering/TriggerManager/DtrmnActLe" /begin REF_CHARACTERISTIC KfLKAS_t_TLCThrsh /end REF_CHARACTERISTIC /end GROUP
/begin GROUP S133_DtrmnActRi "LKAS_subsystem_integrated/LKAS_subsystem_integrated/ControlLayer/TriggeringSLKA/LDW_Triggering/TriggerManager/DtrmnActRi" /begin REF_CHARACTERISTIC KfLKAS_t_TLCThrsh /end REF_CHARACTERISTIC /end GROUP
/begin GROUP S133_LanePositionConstraint "LKAS_subsystem_integrated/LKAS_subsystem_integrated/ControlLayer/TriggeringSLKA/LDW_Triggering/TriggerManager/LanePositionConstraint" /begin SUB_GROUP S143_DtrmnIsOnLeLine S143_DtrmnIsOnRiLine /end SUB_GROUP /end GROUP
/begin GROUP S133_VehicleToBdlnCalc "LKAS_subsystem_integrated/LKAS_subsystem_integrated/ControlLayer/TriggeringSLKA/LDW_Triggering/TriggerManager/VehicleToBdlnCalc"
 /begin REF_CHARACTERISTIC KfLKAS_Ang_BkToCnrAng KfLKAS_c_CurvUprBnd KfLKAS_d_BkToFrtCnrDist KfLKAS_d_EdgBuff KfLKAS_r_CurvBuffCoe /end REF_CHARACTERISTIC
/end GROUP
/begin GROUP S176_Check_Quality "LKAS_subsystem_integrated/LKAS_subsystem_integrated/InputFusion/LaneMarkerHandler/SeneorFusion/LaneMarkerHandler/Check Quality" /begin REF_CHARACTERISTIC KfLKAS_r_QlyVld /end REF_CHARACTERISTIC
 /begin REF_MEASUREMENT VbLKAS_QlyValidLe VbLKAS_QlyValidRi VfLKAS_QlyLe VfLKAS_QlyRi /end REF_MEASUREMENT
/end GROUP
/begin GROUP S176_LeftLaneMarker "LKAS_subsystem_integrated/LKAS_subsystem_integrated/InputFusion/LaneMarkerHandler/SeneorFusion/LaneMarkerHandler/LeftLaneMarker"
 /begin SUB_GROUP S180_LeftCurvStepDetection S180_LeftOffstStepDetection S180_LeftVLatStepDetection /end SUB_GROUP
 /begin REF_MEASUREMENT VeLKAS_LineLeftOk VfLAKS_LeC0 VfLAKS_LeC1 VfLKAS_L_DisToCrossLeft VfLKAS_L_OffstLeft VfLKAS_LeC2 VfLKAS_LeLength VfLKAS_V_Latleft /end REF_MEASUREMENT
/end GROUP
/begin GROUP S176_RightLaneMarker "LKAS_subsystem_integrated/LKAS_subsystem_integrated/InputFusion/LaneMarkerHandler/SeneorFusion/LaneMarkerHandler/RightLaneMarker"
 /begin SUB_GROUP S181_LeftVLatStepDetection S181_RightCurvStepDetection S181_RightOffstStepDetection /end SUB_GROUP
 /begin REF_MEASUREMENT VeLKAS_LineRightOK VfLKAS_Heading VfLKAS_L_DistToCrossRight VfLKAS_OffstRi_sLKA VfLKAS_RiC0 VfLKAS_RiC1 VfLKAS_RiC2 VfLKAS_Ri_Length VfLKAS_VLatRight /end REF_MEASUREMENT
/end GROUP
/begin GROUP S177_DetermineLaneWidth "LKAS_subsystem_integrated/LKAS_subsystem_integrated/InputFusion/LaneMarkerHandler/SeneorFusion/Road Signals/DetermineLaneWidth" /begin REF_MEASUREMENT VfLKAS_LaneWidth /end REF_MEASUREMENT /end GROUP
/begin GROUP S177_DetermineRoadCurvature "LKAS_subsystem_integrated/LKAS_subsystem_integrated/InputFusion/LaneMarkerHandler/SeneorFusion/Road Signals/DetermineRoadCurvature" /begin REF_MEASUREMENT VfLKAS_Cr_Road /end REF_MEASUREMENT /end GROUP
/begin GROUP S178_NoOperation1 "LKAS_subsystem_integrated/LKAS_subsystem_integrated/InputFusion/LaneMarkerHandler/SeneorFusion/VehicleSelfSignalsHandler/NoOperation1" /begin REF_MEASUREMENT VfLKAS_Velocity_x /end REF_MEASUREMENT /end GROUP
/begin GROUP S178_NoOperation2 "LKAS_subsystem_integrated/LKAS_subsystem_integrated/InputFusion/LaneMarkerHandler/SeneorFusion/VehicleSelfSignalsHandler/NoOperation2" /begin REF_MEASUREMENT VfLKAS_yaw_rate_utm /end REF_MEASUREMENT /end GROUP
/begin GROUP S178_NoOperation3 "LKAS_subsystem_integrated/LKAS_subsystem_integrated/InputFusion/LaneMarkerHandler/SeneorFusion/VehicleSelfSignalsHandler/NoOperation3" /begin REF_MEASUREMENT VfLKAS_Acceleration_x /end REF_MEASUREMENT /end GROUP
/begin GROUP S178_NoOperation7 "LKAS_subsystem_integrated/LKAS_subsystem_integrated/InputFusion/LaneMarkerHandler/SeneorFusion/VehicleSelfSignalsHandler/NoOperation7" /begin REF_MEASUREMENT VfLKAS_Acce_y /end REF_MEASUREMENT /end GROUP
/begin GROUP S258_BoundaryValues_sLKA "LKAS_subsystem_integrated/LKAS_subsystem_integrated/InputFusion/TrajectoryCalculation/PathGeneration/PathGeneration_sLKA/BoundaryValues_sLKA"
 /begin SUB_GROUP S259_DetermineEndOffst S259_Determine_alat_0 S259_Determine_vlat_0 S259_LimitWhenCloseToMarker /end SUB_GROUP
/end GROUP
/begin GROUP S258_ITCWithAdditionalConditionForValidPath_sLKA "LKAS_subsystem_integrated/LKAS_subsystem_integrated/InputFusion/TrajectoryCalculation/PathGeneration/PathGeneration_sLKA/ITCWithAdditionalConditionForValidPath_sLKA" /begin SUB_GROUP S260_DetermineSingleSidedTrajectoryWithModTraj /end SUB_GROUP /begin REF_CHARACTERISTIC KfLKAS_d_PosVal /end REF_CHARACTERISTIC /end GROUP
/begin GROUP S258_determine_path_sLKA "LKAS_subsystem_integrated/LKAS_subsystem_integrated/InputFusion/TrajectoryCalculation/PathGeneration/PathGeneration_sLKA/determine_path_sLKA" /begin REF_MEASUREMENT VfLKAS_TimeNeeded_sLKA /end REF_MEASUREMENT /end GROUP
/begin GROUP S363_LaneWidthEnable "LKAS_subsystem_integrated/LKAS_subsystem_integrated/InputFusion/TrajectoryCalculation/RoadEnableEvaluation/RoadEnableEvaluationSLKA/LaneWidthEnable" /begin SUB_GROUP S366_SR_FF_INIT_1 /end SUB_GROUP
 /begin REF_CHARACTERISTIC KfLKAS_d_MaxEnblLaneWidth KfLKAS_d_MinDisLaneWidthMargin KfLKAS_d_MinEnblLaneWidthMargin /end REF_CHARACTERISTIC
/end GROUP
/begin GROUP S363_OnDelayBlock "LKAS_subsystem_integrated/LKAS_subsystem_integrated/InputFusion/TrajectoryCalculation/RoadEnableEvaluation/RoadEnableEvaluationSLKA/OnDelayBlock" /begin REF_MEASUREMENT VbLKAS_RoadEnblLe /end REF_MEASUREMENT /end GROUP
/begin GROUP S363_OnDelayBlock1 "LKAS_subsystem_integrated/LKAS_subsystem_integrated/InputFusion/TrajectoryCalculation/RoadEnableEvaluation/RoadEnableEvaluationSLKA/OnDelayBlock1" /begin REF_MEASUREMENT VbLKAS_RoadEnblRi /end REF_MEASUREMENT /end GROUP
/begin GROUP S386_DetermineInterventionSideRequest "LKAS_subsystem_integrated/LKAS_subsystem_integrated/InputFusion/TrajectoryCalculation/VehicleStates/SelectReference/DetermineInterventionSideRequest" /begin REF_MEASUREMENT VeLKAS_IntvSideReq_sLKA /end REF_MEASUREMENT /end GROUP
/begin GROUP S143_DtrmnIsOnLeLine "LKAS_subsystem_integrated/LKAS_subsystem_integrated/ControlLayer/TriggeringSLKA/LDW_Triggering/TriggerManager/LanePositionConstraint/DtrmnIsOnLeLine"
 /begin REF_CHARACTERISTIC KfLKAS_d_WarnLineLvlOne KfLKAS_d_WarnLineLvlThree KfLKAS_r_WarnLineLvlTwo /end REF_CHARACTERISTIC
/end GROUP
/begin GROUP S143_DtrmnIsOnRiLine "LKAS_subsystem_integrated/LKAS_subsystem_integrated/ControlLayer/TriggeringSLKA/LDW_Triggering/TriggerManager/LanePositionConstraint/DtrmnIsOnRiLine"
 /begin REF_CHARACTERISTIC KfLKAS_d_WarnLineLvlOne KfLKAS_d_WarnLineLvlThree KfLKAS_r_WarnLineLvlTwo /end REF_CHARACTERISTIC
/end GROUP
/begin GROUP S180_LeftCurvStepDetection "LKAS_subsystem_integrated/LKAS_subsystem_integrated/InputFusion/LaneMarkerHandler/SeneorFusion/LaneMarkerHandler/LeftLaneMarker/LeftCurvStepDetection" /begin SUB_GROUP S187_CheckForStep /end SUB_GROUP /begin REF_CHARACTERISTIC KfLKAS_c_MaxCurvStep /end REF_CHARACTERISTIC /end GROUP
/begin GROUP S180_LeftOffstStepDetection "LKAS_subsystem_integrated/LKAS_subsystem_integrated/InputFusion/LaneMarkerHandler/SeneorFusion/LaneMarkerHandler/LeftLaneMarker/LeftOffstStepDetection" /begin SUB_GROUP S188_CheckForStep /end SUB_GROUP /begin REF_CHARACTERISTIC KfLKAS_d_MaxOffstStep /end REF_CHARACTERISTIC /end GROUP
/begin GROUP S180_LeftVLatStepDetection "LKAS_subsystem_integrated/LKAS_subsystem_integrated/InputFusion/LaneMarkerHandler/SeneorFusion/LaneMarkerHandler/LeftLaneMarker/LeftVLatStepDetection" /begin SUB_GROUP S189_CheckForStep /end SUB_GROUP /begin REF_CHARACTERISTIC KfLKAS_v_MaxStepForVLat /end REF_CHARACTERISTIC /end GROUP
/begin GROUP S181_LeftVLatStepDetection "LKAS_subsystem_integrated/LKAS_subsystem_integrated/InputFusion/LaneMarkerHandler/SeneorFusion/LaneMarkerHandler/RightLaneMarker/LeftVLatStepDetection" /begin SUB_GROUP S203_CheckForStep /end SUB_GROUP /begin REF_CHARACTERISTIC KfLKAS_v_MaxStepForVLat /end REF_CHARACTERISTIC /end GROUP
/begin GROUP S181_RightCurvStepDetection "LKAS_subsystem_integrated/LKAS_subsystem_integrated/InputFusion/LaneMarkerHandler/SeneorFusion/LaneMarkerHandler/RightLaneMarker/RightCurvStepDetection" /begin SUB_GROUP S212_CheckForStep /end SUB_GROUP /begin REF_CHARACTERISTIC KfLKAS_c_MaxCurvStep /end REF_CHARACTERISTIC /end GROUP
/begin GROUP S181_RightOffstStepDetection "LKAS_subsystem_integrated/LKAS_subsystem_integrated/InputFusion/LaneMarkerHandler/SeneorFusion/LaneMarkerHandler/RightLaneMarker/RightOffstStepDetection" /begin SUB_GROUP S213_CheckForStep /end SUB_GROUP /begin REF_CHARACTERISTIC KfLKAS_d_MaxOffstStep /end REF_CHARACTERISTIC /end GROUP
/begin GROUP S259_DetermineEndOffst "LKAS_subsystem_integrated/LKAS_subsystem_integrated/InputFusion/TrajectoryCalculation/PathGeneration/PathGeneration_sLKA/BoundaryValues_sLKA/DetermineEndOffst" /begin REF_CHARACTERISTIC KfLKAS_d_OffsAtMinDeltaPos /end REF_CHARACTERISTIC /begin REF_MEASUREMENT VfLKAS_end_offst_sLKA /end REF_MEASUREMENT /end GROUP
/begin GROUP S259_Determine_alat_0 "LKAS_subsystem_integrated/LKAS_subsystem_integrated/InputFusion/TrajectoryCalculation/PathGeneration/PathGeneration_sLKA/BoundaryValues_sLKA/Determine_alat_0" /begin REF_MEASUREMENT VfLKAS_alat_0 /end REF_MEASUREMENT /end GROUP
/begin GROUP S259_Determine_vlat_0 "LKAS_subsystem_integrated/LKAS_subsystem_integrated/InputFusion/TrajectoryCalculation/PathGeneration/PathGeneration_sLKA/BoundaryValues_sLKA/Determine_vlat_0" /begin REF_MEASUREMENT VfLKAS_vlat_0 /end REF_MEASUREMENT /end GROUP
/begin GROUP S259_LimitWhenCloseToMarker "LKAS_subsystem_integrated/LKAS_subsystem_integrated/InputFusion/TrajectoryCalculation/PathGeneration/PathGeneration_sLKA/BoundaryValues_sLKA/LimitWhenCloseToMarker" /begin REF_CHARACTERISTIC KfLKAS_d_MinDeltaPosFirst KfLKAS_d_MinDeltaPosSec /end REF_CHARACTERISTIC /begin REF_MEASUREMENT VbLKAS_zero_trajectory_found VfLKAS_delta_pos_sLKA /end REF_MEASUREMENT /end GROUP
/begin GROUP S260_DetermineSingleSidedTrajectoryWithModTraj "LKAS_subsystem_integrated/LKAS_subsystem_integrated/InputFusion/TrajectoryCalculation/PathGeneration/PathGeneration_sLKA/ITCWithAdditionalConditionForValidPath_sLKA/DetermineSingleSidedTrajectoryWithModTraj" /begin SUB_GROUP S269_CalculateAm S269_CalculateDt S269_CalculateTrajectory /end SUB_GROUP /end GROUP
/begin GROUP S366_SR_FF_INIT_1 "LKAS_subsystem_integrated/LKAS_subsystem_integrated/InputFusion/TrajectoryCalculation/RoadEnableEvaluation/RoadEnableEvaluationSLKA/LaneWidthEnable/SR_FF_INIT_1" /begin REF_MEASUREMENT VbLKAS_LaneWidthEnbl /end REF_MEASUREMENT /end GROUP
/begin GROUP S187_CheckForStep "LKAS_subsystem_integrated/LKAS_subsystem_integrated/InputFusion/LaneMarkerHandler/SeneorFusion/LaneMarkerHandler/LeftLaneMarker/LeftCurvStepDetection/CheckForStep" /begin REF_MEASUREMENT VbLKAS_LeftCurvStep /end REF_MEASUREMENT /end GROUP
/begin GROUP S188_CheckForStep "LKAS_subsystem_integrated/LKAS_subsystem_integrated/InputFusion/LaneMarkerHandler/SeneorFusion/LaneMarkerHandler/LeftLaneMarker/LeftOffstStepDetection/CheckForStep" /begin REF_MEASUREMENT VbLKAS_LeftOffstStep /end REF_MEASUREMENT /end GROUP
/begin GROUP S189_CheckForStep "LKAS_subsystem_integrated/LKAS_subsystem_integrated/InputFusion/LaneMarkerHandler/SeneorFusion/LaneMarkerHandler/LeftLaneMarker/LeftVLatStepDetection/CheckForStep" /begin REF_MEASUREMENT VbLKAS_LeftVLatStep /end REF_MEASUREMENT /end GROUP
/begin GROUP S203_CheckForStep "LKAS_subsystem_integrated/LKAS_subsystem_integrated/InputFusion/LaneMarkerHandler/SeneorFusion/LaneMarkerHandler/RightLaneMarker/LeftVLatStepDetection/CheckForStep" /begin REF_MEASUREMENT VbLKAS_RightVlatStep /end REF_MEASUREMENT /end GROUP
/begin GROUP S212_CheckForStep "LKAS_subsystem_integrated/LKAS_subsystem_integrated/InputFusion/LaneMarkerHandler/SeneorFusion/LaneMarkerHandler/RightLaneMarker/RightCurvStepDetection/CheckForStep" /begin REF_MEASUREMENT VbLKAS_RightCurvStep /end REF_MEASUREMENT /end GROUP
/begin GROUP S213_CheckForStep "LKAS_subsystem_integrated/LKAS_subsystem_integrated/InputFusion/LaneMarkerHandler/SeneorFusion/LaneMarkerHandler/RightLaneMarker/RightOffstStepDetection/CheckForStep" /begin REF_MEASUREMENT VbLKAS_RightOffstStep /end REF_MEASUREMENT /end GROUP
/begin GROUP S269_CalculateAm "LKAS_subsystem_integrated/LKAS_subsystem_integrated/InputFusion/TrajectoryCalculation/PathGeneration/PathGeneration_sLKA/ITCWithAdditionalConditionForValidPath_sLKA/DetermineSingleSidedTrajectoryWithModTraj/CalculateAm" /begin SUB_GROUP S274_get_roots /end SUB_GROUP /end GROUP
/begin GROUP S269_CalculateDt "LKAS_subsystem_integrated/LKAS_subsystem_integrated/InputFusion/TrajectoryCalculation/PathGeneration/PathGeneration_sLKA/ITCWithAdditionalConditionForValidPath_sLKA/DetermineSingleSidedTrajectoryWithModTraj/CalculateDt" /begin REF_MEASUREMENT VfLKAS_dt1 VfLKAS_dt2 /end REF_MEASUREMENT /end GROUP
/begin GROUP S269_CalculateTrajectory "LKAS_subsystem_integrated/LKAS_subsystem_integrated/InputFusion/TrajectoryCalculation/PathGeneration/PathGeneration_sLKA/ITCWithAdditionalConditionForValidPath_sLKA/DetermineSingleSidedTrajectoryWithModTraj/CalculateTrajectory" /begin SUB_GROUP S276_IfSolutionFoundForAm /end SUB_GROUP
 /begin REF_MEASUREMENT VbLKAS_TrajectoryFound_sLKA VfLKAS_JerkNeeded_sLkA VfLKAS_LatAccNeeded_sLKA /end REF_MEASUREMENT
/end GROUP
/begin GROUP S274_get_roots "LKAS_subsystem_integrated/LKAS_subsystem_integrated/InputFusion/TrajectoryCalculation/PathGeneration/PathGeneration_sLKA/ITCWithAdditionalConditionForValidPath_sLKA/DetermineSingleSidedTrajectoryWithModTraj/CalculateAm/get_roots" /begin SUB_GROUP S279_QuadraticEquationSolver /end SUB_GROUP /end GROUP
/begin GROUP S276_IfSolutionFoundForAm "LKAS_subsystem_integrated/LKAS_subsystem_integrated/InputFusion/TrajectoryCalculation/PathGeneration/PathGeneration_sLKA/ITCWithAdditionalConditionForValidPath_sLKA/DetermineSingleSidedTrajectoryWithModTraj/CalculateTrajectory/IfSolutionFoundForAm"
 /begin SUB_GROUP S304_CalculateTrajectoryForFirstAmRoot S304_CalculateTrajectoryForSecondAmRoot /end SUB_GROUP
/end GROUP
/begin GROUP S279_QuadraticEquationSolver "LKAS_subsystem_integrated/LKAS_subsystem_integrated/InputFusion/TrajectoryCalculation/PathGeneration/PathGeneration_sLKA/ITCWithAdditionalConditionForValidPath_sLKA/DetermineSingleSidedTrajectoryWithModTraj/CalculateAm/get_roots/QuadraticEquationSolver" /begin REF_MEASUREMENT VbLKAS_SolutionFoundForAm VfLKAS_Am1 VfLKAS_Am2 /end REF_MEASUREMENT /end GROUP
/begin GROUP S304_CalculateTrajectoryForFirstAmRoot "LKAS_subsystem_integrated/LKAS_subsystem_integrated/InputFusion/TrajectoryCalculation/PathGeneration/PathGeneration_sLKA/ITCWithAdditionalConditionForValidPath_sLKA/DetermineSingleSidedTrajectoryWithModTraj/CalculateTrajectory/IfSolutionFoundForAm/CalculateTrajectoryForFirstAmRoot" /begin SUB_GROUP S306_calc_end_pos S306_calc_end_vlat /end SUB_GROUP
 /begin REF_MEASUREMENT VbLKAS_FirstEndPositionOK VbLKAS_FirstEndVLatOK VbLKAS_TrajectoryFoundAm1 /end REF_MEASUREMENT
/end GROUP
/begin GROUP S304_CalculateTrajectoryForSecondAmRoot "LKAS_subsystem_integrated/LKAS_subsystem_integrated/InputFusion/TrajectoryCalculation/PathGeneration/PathGeneration_sLKA/ITCWithAdditionalConditionForValidPath_sLKA/DetermineSingleSidedTrajectoryWithModTraj/CalculateTrajectory/IfSolutionFoundForAm/CalculateTrajectoryForSecondAmRoot" /begin SUB_GROUP S307_calc_end_pos S307_calc_end_vlat /end SUB_GROUP
 /begin REF_MEASUREMENT VbLKAS_SecEndPositionOK VbLKAS_SecEndVLatOK VbLKAS_TrajectoryFoundAm2 /end REF_MEASUREMENT
/end GROUP
/begin GROUP S306_calc_end_pos "LKAS_subsystem_integrated/LKAS_subsystem_integrated/InputFusion/TrajectoryCalculation/PathGeneration/PathGeneration_sLKA/ITCWithAdditionalConditionForValidPath_sLKA/DetermineSingleSidedTrajectoryWithModTraj/CalculateTrajectory/IfSolutionFoundForAm/CalculateTrajectoryForFirstAmRoot/calc_end_pos" /begin REF_MEASUREMENT VfLKAS_FirstEndPos /end REF_MEASUREMENT /end GROUP
/begin GROUP S306_calc_end_vlat "LKAS_subsystem_integrated/LKAS_subsystem_integrated/InputFusion/TrajectoryCalculation/PathGeneration/PathGeneration_sLKA/ITCWithAdditionalConditionForValidPath_sLKA/DetermineSingleSidedTrajectoryWithModTraj/CalculateTrajectory/IfSolutionFoundForAm/CalculateTrajectoryForFirstAmRoot/calc_end_vlat" /begin REF_MEASUREMENT VfLKAS_FirstEndVlat /end REF_MEASUREMENT /end GROUP
/begin GROUP S307_calc_end_pos "LKAS_subsystem_integrated/LKAS_subsystem_integrated/InputFusion/TrajectoryCalculation/PathGeneration/PathGeneration_sLKA/ITCWithAdditionalConditionForValidPath_sLKA/DetermineSingleSidedTrajectoryWithModTraj/CalculateTrajectory/IfSolutionFoundForAm/CalculateTrajectoryForSecondAmRoot/calc_end_pos" /begin REF_MEASUREMENT VfLKAS_SecEndPos /end REF_MEASUREMENT /end GROUP
/begin GROUP S307_calc_end_vlat "LKAS_subsystem_integrated/LKAS_subsystem_integrated/InputFusion/TrajectoryCalculation/PathGeneration/PathGeneration_sLKA/ITCWithAdditionalConditionForValidPath_sLKA/DetermineSingleSidedTrajectoryWithModTraj/CalculateTrajectory/IfSolutionFoundForAm/CalculateTrajectoryForSecondAmRoot/calc_end_vlat" /begin REF_MEASUREMENT VfLKAS_SecEndVlat /end REF_MEASUREMENT /end GROUP
/begin GROUP bsw_critical_variable "bsw_critical_variable" ROOT /begin SUB_GROUP BSW_Thruput_Measure /end SUB_GROUP /end GROUP
/begin GROUP BSW_Thruput_Measure "BSW_Thruput_Measure" /begin REF_MEASUREMENT ADCtrl_Thruput_MS os_core0_tick_cnt /end REF_MEASUREMENT /end GROUP
/begin GROUP UDP_COMM_Err_Info "UDP_COMM_Err_Info"
 /begin REF_MEASUREMENT Com_stRxUDPFrm17001 diag_communication_error_codes diag_sensor_error_codes diag_module_error_codes /end REF_MEASUREMENT
/end GROUP
/end MODULE
/end PROJECT
