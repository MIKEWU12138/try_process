ASAP2_VERSION 1 60
/begin PROJECT hj_adcu "_default_ProjectLongIdentifier"
/begin HEADER "_default_HeaderComment" PROJECT_NO _default_ProjectNr /end HEADER
/begin MODULE _default_ModuleName "_default_ModuleLongIdentifier"
/begin MOD_COMMON "_default_ModCommonComment" DEPOSIT ABSOLUTE BYTE_ORDER MSB_LAST ALIGNMENT_BYTE 1 ALIGNMENT_WORD 2 ALIGNMENT_LONG 4 ALIGNMENT_FLOAT32_IEEE 4 ALIGNMENT_FLOAT64_IEEE 4 /end MOD_COMMON
/begin MOD_COMMON "Mod Common Comment Here" BYTE_ORDER MSB_LAST /end MOD_COMMON
/begin RECORD_LAYOUT Scalar_BOOLEAN FNC_VALUES 1 UBYTE COLUMN_DIR DIRECT /end RECORD_LAYOUT
/begin RECORD_LAYOUT Scalar_UBYTE FNC_VALUES 1 UBYTE COLUMN_DIR DIRECT /end RECORD_LAYOUT
/begin RECORD_LAYOUT Scalar_FLOAT32_IEEE FNC_VALUES 1 FLOAT32_IEEE COLUMN_DIR DIRECT /end RECORD_LAYOUT
/begin RECORD_LAYOUT Lookup1D_X_BYTE AXIS_PTS_X 1 SBYTE INDEX_INCR DIRECT /end RECORD_LAYOUT
/begin RECORD_LAYOUT Lookup1D_UBYTE FNC_VALUES 1 UBYTE COLUMN_DIR DIRECT /end RECORD_LAYOUT
/begin RECORD_LAYOUT Lookup1D_X_UBYTE AXIS_PTS_X 1 UBYTE INDEX_INCR DIRECT /end RECORD_LAYOUT
/begin RECORD_LAYOUT Lookup1D_UWORD FNC_VALUES 1 UWORD COLUMN_DIR DIRECT /end RECORD_LAYOUT
/begin RECORD_LAYOUT Lookup1D_X_UWORD AXIS_PTS_X 1 UWORD INDEX_INCR DIRECT /end RECORD_LAYOUT
/begin RECORD_LAYOUT Lookup1D_WORD FNC_VALUES 1 SWORD COLUMN_DIR DIRECT /end RECORD_LAYOUT
/begin RECORD_LAYOUT Lookup1D_X_WORD AXIS_PTS_X 1 SWORD INDEX_INCR DIRECT /end RECORD_LAYOUT
/begin RECORD_LAYOUT Lookup1D_FLOAT32_IEEE FNC_VALUES 1 FLOAT32_IEEE COLUMN_DIR DIRECT /end RECORD_LAYOUT
/begin RECORD_LAYOUT Lookup1D_X_FLOAT32_IEEE AXIS_PTS_X 1 FLOAT32_IEEE INDEX_INCR DIRECT /end RECORD_LAYOUT
/begin CHARACTERISTIC KtAEBS_FCWL1ActiveTTCThrshld "" CURVE 0x7010168c /* @ECU_Address@KtAEBS_FCWL1ActiveTTCThrshld@ */ Lookup1D_FLOAT32_IEEE 0 AEBS_subsystem_integrated_CM_single -3.4E+38 3.4E+38
 /begin AXIS_DESCR COM_AXIS NO_INPUT_QUANTITY AEBS_subsystem_integrated_CM_single 13 -3.4E+38 3.4E+38 AXIS_PTS_REF KaAEBS_AXIS_DeltaSpeed_Vip /end AXIS_DESCR
/end CHARACTERISTIC
/begin CHARACTERISTIC KtAEBS_FCWL2ActiveTTCThrshld "" CURVE 0x70101658 /* @ECU_Address@KtAEBS_FCWL2ActiveTTCThrshld@ */ Lookup1D_FLOAT32_IEEE 0 AEBS_subsystem_integrated_CM_single -3.4E+38 3.4E+38
 /begin AXIS_DESCR COM_AXIS NO_INPUT_QUANTITY AEBS_subsystem_integrated_CM_single 13 -3.4E+38 3.4E+38 AXIS_PTS_REF KaAEBS_AXIS_DeltaSpeed_Vip /end AXIS_DESCR
/end CHARACTERISTIC
/begin CHARACTERISTIC KtAEBS_FCWL3ActiveTTCThrshld "" CURVE 0x70101624 /* @ECU_Address@KtAEBS_FCWL3ActiveTTCThrshld@ */ Lookup1D_FLOAT32_IEEE 0 AEBS_subsystem_integrated_CM_single -3.4E+38 3.4E+38
 /begin AXIS_DESCR COM_AXIS NO_INPUT_QUANTITY AEBS_subsystem_integrated_CM_single 13 -3.4E+38 3.4E+38 AXIS_PTS_REF KaAEBS_AXIS_DeltaSpeed_Vip /end AXIS_DESCR
/end CHARACTERISTIC
/begin CHARACTERISTIC KtAEBS_a_BrakeValueLimit "" CURVE 0x70101374 /* @ECU_Address@KtAEBS_a_BrakeValueLimit@ */ Lookup1D_FLOAT32_IEEE 0 AEBS_subsystem_integrated_CM_single -3.4E+38 3.4E+38
 /begin AXIS_DESCR COM_AXIS NO_INPUT_QUANTITY AEBS_subsystem_integrated_CM_single 10 -3.4E+38 3.4E+38 AXIS_PTS_REF KaAEBS_AXIS_Veh_Curvature_vec /end AXIS_DESCR
/end CHARACTERISTIC
/begin CHARACTERISTIC KtAEBS_PrtlBrkActiveTTCThrshld_VRU "" CURVE 0x7010139c /* @ECU_Address@KtAEBS_PrtlBrkActiveTTCThrshld_VRU@ */ Lookup1D_FLOAT32_IEEE 0 AEBS_subsystem_integrated_CM_single -3.4E+38 3.4E+38
 /begin AXIS_DESCR COM_AXIS NO_INPUT_QUANTITY AEBS_subsystem_integrated_CM_single 13 -3.4E+38 3.4E+38 AXIS_PTS_REF KaAEBS_AXIS_DeltaSpeed_Vip /end AXIS_DESCR
/end CHARACTERISTIC
/begin CHARACTERISTIC KtAEBS_PrtlBrkActiveTTCThrshld "" CURVE 0x701013d0 /* @ECU_Address@KtAEBS_PrtlBrkActiveTTCThrshld@ */ Lookup1D_FLOAT32_IEEE 0 AEBS_subsystem_integrated_CM_single -3.4E+38 3.4E+38
 /begin AXIS_DESCR COM_AXIS NO_INPUT_QUANTITY AEBS_subsystem_integrated_CM_single 13 -3.4E+38 3.4E+38 AXIS_PTS_REF KaAEBS_AXIS_DeltaSpeed_Vip /end AXIS_DESCR
/end CHARACTERISTIC
/begin CHARACTERISTIC KtAEBS_PreBrkActiveTTCThrshld_VRU "" CURVE 0x70101404 /* @ECU_Address@KtAEBS_PreBrkActiveTTCThrshld_VRU@ */ Lookup1D_FLOAT32_IEEE 0 AEBS_subsystem_integrated_CM_single -3.4E+38 3.4E+38
 /begin AXIS_DESCR COM_AXIS NO_INPUT_QUANTITY AEBS_subsystem_integrated_CM_single 13 -3.4E+38 3.4E+38 AXIS_PTS_REF KaAEBS_AXIS_DeltaSpeed_Vip /end AXIS_DESCR
/end CHARACTERISTIC
/begin CHARACTERISTIC KtAEBS_PreBrkActiveTTCThrshld "" CURVE 0x70101438 /* @ECU_Address@KtAEBS_PreBrkActiveTTCThrshld@ */ Lookup1D_FLOAT32_IEEE 0 AEBS_subsystem_integrated_CM_single -3.4E+38 3.4E+38
 /begin AXIS_DESCR COM_AXIS NO_INPUT_QUANTITY AEBS_subsystem_integrated_CM_single 13 -3.4E+38 3.4E+38 AXIS_PTS_REF KaAEBS_AXIS_DeltaSpeed_Vip /end AXIS_DESCR
/end CHARACTERISTIC
/begin CHARACTERISTIC KtAEBS_veh_acc_inhibit_AEB_thrhd "" CURVE 0x70101350 /* @ECU_Address@KtAEBS_veh_acc_inhibit_AEB_thrhd@ */ Lookup1D_FLOAT32_IEEE 0 AEBS_subsystem_integrated_CM_single -3.4E+38 3.4E+38
 /begin AXIS_DESCR COM_AXIS VfAEBS_veh_speed_used AEBS_subsystem_integrated_CM_single 9 -3.4E+38 3.4E+38 AXIS_PTS_REF KaAEBS_AXIS_Veh_Speed_vec /end AXIS_DESCR
/end CHARACTERISTIC
/begin CHARACTERISTIC KtAEBS_LateralBuffer_Bicycle "" CURVE 0x701015f8 /* @ECU_Address@KtAEBS_LateralBuffer_Bicycle@ */ Lookup1D_FLOAT32_IEEE 0 AEBS_subsystem_integrated_CM_single -3.4E+38 3.4E+38
 /begin AXIS_DESCR COM_AXIS NO_INPUT_QUANTITY AEBS_subsystem_integrated_CM_single 11 -3.4E+38 3.4E+38 AXIS_PTS_REF KaAEBS_AXIS_NearestPointX_vec /end AXIS_DESCR
/end CHARACTERISTIC
/begin CHARACTERISTIC KtAEBS_LateralBuffer_Motor "" CURVE 0x701015cc /* @ECU_Address@KtAEBS_LateralBuffer_Motor@ */ Lookup1D_FLOAT32_IEEE 0 AEBS_subsystem_integrated_CM_single -3.4E+38 3.4E+38
 /begin AXIS_DESCR COM_AXIS NO_INPUT_QUANTITY AEBS_subsystem_integrated_CM_single 11 -3.4E+38 3.4E+38 AXIS_PTS_REF KaAEBS_AXIS_NearestPointX_vec /end AXIS_DESCR
/end CHARACTERISTIC
/begin CHARACTERISTIC KtAEBS_LateralBuffer_Other "" CURVE 0x701015a0 /* @ECU_Address@KtAEBS_LateralBuffer_Other@ */ Lookup1D_FLOAT32_IEEE 0 AEBS_subsystem_integrated_CM_single -3.4E+38 3.4E+38
 /begin AXIS_DESCR COM_AXIS NO_INPUT_QUANTITY AEBS_subsystem_integrated_CM_single 11 -3.4E+38 3.4E+38 AXIS_PTS_REF KaAEBS_AXIS_NearestPointX_vec /end AXIS_DESCR
/end CHARACTERISTIC
/begin CHARACTERISTIC KtAEBS_LateralBuffer_Pedstrn "" CURVE 0x70101574 /* @ECU_Address@KtAEBS_LateralBuffer_Pedstrn@ */ Lookup1D_FLOAT32_IEEE 0 AEBS_subsystem_integrated_CM_single -3.4E+38 3.4E+38
 /begin AXIS_DESCR COM_AXIS NO_INPUT_QUANTITY AEBS_subsystem_integrated_CM_single 11 -3.4E+38 3.4E+38 AXIS_PTS_REF KaAEBS_AXIS_NearestPointX_vec /end AXIS_DESCR
/end CHARACTERISTIC
/begin CHARACTERISTIC KtAEBS_LateralBuffer_Vehicle "" CURVE 0x70101548 /* @ECU_Address@KtAEBS_LateralBuffer_Vehicle@ */ Lookup1D_FLOAT32_IEEE 0 AEBS_subsystem_integrated_CM_single -3.4E+38 3.4E+38
 /begin AXIS_DESCR COM_AXIS NO_INPUT_QUANTITY AEBS_subsystem_integrated_CM_single 11 -3.4E+38 3.4E+38 AXIS_PTS_REF KaAEBS_AXIS_NearestPointX_vec /end AXIS_DESCR
/end CHARACTERISTIC
/begin CHARACTERISTIC KtAEBS_LongBuffer_Bicycle "" CURVE 0x7010151c /* @ECU_Address@KtAEBS_LongBuffer_Bicycle@ */ Lookup1D_FLOAT32_IEEE 0 AEBS_subsystem_integrated_CM_single -3.4E+38 3.4E+38
 /begin AXIS_DESCR COM_AXIS NO_INPUT_QUANTITY AEBS_subsystem_integrated_CM_single 11 -3.4E+38 3.4E+38 AXIS_PTS_REF KaAEBS_AXIS_NearestPointY_vec /end AXIS_DESCR
/end CHARACTERISTIC
/begin CHARACTERISTIC KtAEBS_LongBuffer_Motor "" CURVE 0x701014f0 /* @ECU_Address@KtAEBS_LongBuffer_Motor@ */ Lookup1D_FLOAT32_IEEE 0 AEBS_subsystem_integrated_CM_single -3.4E+38 3.4E+38
 /begin AXIS_DESCR COM_AXIS NO_INPUT_QUANTITY AEBS_subsystem_integrated_CM_single 11 -3.4E+38 3.4E+38 AXIS_PTS_REF KaAEBS_AXIS_NearestPointY_vec /end AXIS_DESCR
/end CHARACTERISTIC
/begin CHARACTERISTIC KtAEBS_LongBuffer_Other "" CURVE 0x701014c4 /* @ECU_Address@KtAEBS_LongBuffer_Other@ */ Lookup1D_FLOAT32_IEEE 0 AEBS_subsystem_integrated_CM_single -3.4E+38 3.4E+38
 /begin AXIS_DESCR COM_AXIS NO_INPUT_QUANTITY AEBS_subsystem_integrated_CM_single 11 -3.4E+38 3.4E+38 AXIS_PTS_REF KaAEBS_AXIS_NearestPointY_vec /end AXIS_DESCR
/end CHARACTERISTIC
/begin CHARACTERISTIC KtAEBS_LongBuffer_Pedstrn "" CURVE 0x70101498 /* @ECU_Address@KtAEBS_LongBuffer_Pedstrn@ */ Lookup1D_FLOAT32_IEEE 0 AEBS_subsystem_integrated_CM_single -3.4E+38 3.4E+38
 /begin AXIS_DESCR COM_AXIS NO_INPUT_QUANTITY AEBS_subsystem_integrated_CM_single 11 -3.4E+38 3.4E+38 AXIS_PTS_REF KaAEBS_AXIS_NearestPointY_vec /end AXIS_DESCR
/end CHARACTERISTIC
/begin CHARACTERISTIC KtAEBS_LongBuffer_Vehicle "" CURVE 0x7010146c /* @ECU_Address@KtAEBS_LongBuffer_Vehicle@ */ Lookup1D_FLOAT32_IEEE 0 AEBS_subsystem_integrated_CM_single -3.4E+38 3.4E+38
 /begin AXIS_DESCR COM_AXIS NO_INPUT_QUANTITY AEBS_subsystem_integrated_CM_single 11 -3.4E+38 3.4E+38 AXIS_PTS_REF KaAEBS_AXIS_NearestPointY_vec /end AXIS_DESCR
/end CHARACTERISTIC
/begin CHARACTERISTIC KfAEBS_Change_LateralPosThrsh "Object change lateral position threshold" VALUE 0x70101868 /* @ECU_Address@KfAEBS_Change_LateralPosThrsh@ */ Scalar_FLOAT32_IEEE 0 AEBS_subsystem_integrated_CM_single -3.4E+38 3.4E+38 /end CHARACTERISTIC
/begin CHARACTERISTIC KfAEBS_Change_LonglPosThrsh "Object change longitudinal position threshold" VALUE 0x70101864 /* @ECU_Address@KfAEBS_Change_LonglPosThrsh@ */ Scalar_FLOAT32_IEEE 0 AEBS_subsystem_integrated_CM_single -3.4E+38 3.4E+38 /end CHARACTERISTIC
/begin CHARACTERISTIC KfAEBS_SpdMinOvrdAccrResetInCllsnRednByBrkg "" VALUE 0x70101838 /* @ECU_Address@KfAEBS_SpdMinOvrdAccrResetInCllsnRednByBrkg@ */ Scalar_FLOAT32_IEEE 0 AEBS_subsystem_integrated_CM_single -3.4E+38 3.4E+38 /end CHARACTERISTIC
/begin CHARACTERISTIC KfAEBS_SteerRate_Limit_hi "" VALUE 0x70101834 /* @ECU_Address@KfAEBS_SteerRate_Limit_hi@ */ Scalar_FLOAT32_IEEE 0 AEBS_subsystem_integrated_CM_single -3.4E+38 3.4E+38 /end CHARACTERISTIC
/begin CHARACTERISTIC KfAEBS_SteerRate_Limit_lo "" VALUE 0x70101830 /* @ECU_Address@KfAEBS_SteerRate_Limit_lo@ */ Scalar_FLOAT32_IEEE 0 AEBS_subsystem_integrated_CM_single -3.4E+38 3.4E+38 /end CHARACTERISTIC
/begin CHARACTERISTIC KfAEBS_StrAngRte_inhbt_AEB_trshd "" VALUE 0x7010182c /* @ECU_Address@KfAEBS_StrAngRte_inhbt_AEB_trshd@ */ Scalar_FLOAT32_IEEE 0 AEBS_subsystem_integrated_CM_single_rad_s -3.4E+38 3.4E+38 /end CHARACTERISTIC
/begin CHARACTERISTIC KfAEBS_VehAcc_inhbt_FCW_thrshld "" VALUE 0x70101828 /* @ECU_Address@KfAEBS_VehAcc_inhbt_FCW_thrshld@ */ Scalar_FLOAT32_IEEE 0 AEBS_subsystem_integrated_CM_single -3.4E+38 3.4E+38 /end CHARACTERISTIC
/begin CHARACTERISTIC KfAEBS_VeloRectThrsdByBrkg "" VALUE 0x701017f8 /* @ECU_Address@KfAEBS_VeloRectThrsdByBrkg@ */ Scalar_FLOAT32_IEEE 0 AEBS_subsystem_integrated_CM_single -3.4E+38 3.4E+38 /end CHARACTERISTIC
/begin CHARACTERISTIC KfAEBS_YawRate_Limit_hi "" VALUE 0x701017f4 /* @ECU_Address@KfAEBS_YawRate_Limit_hi@ */ Scalar_FLOAT32_IEEE 0 AEBS_subsystem_integrated_CM_single -3.4E+38 3.4E+38 /end CHARACTERISTIC
/begin CHARACTERISTIC KfAEBS_YawRate_Limit_lo "" VALUE 0x701017f0 /* @ECU_Address@KfAEBS_YawRate_Limit_lo@ */ Scalar_FLOAT32_IEEE 0 AEBS_subsystem_integrated_CM_single -3.4E+38 3.4E+38 /end CHARACTERISTIC
/begin CHARACTERISTIC KfAEBS_a_AreqRampRate "" VALUE 0x701017e4 /* @ECU_Address@KfAEBS_a_AreqRampRate@ */ Scalar_FLOAT32_IEEE 0 AEBS_subsystem_integrated_CM_single -3.4E+38 3.4E+38 /end CHARACTERISTIC
/begin CHARACTERISTIC KfAEBS_a_Areq_FullBrkActThrsd "Acceleration request full brake active threshold" VALUE 0x701017e0 /* @ECU_Address@KfAEBS_a_Areq_FullBrkActThrsd@ */ Scalar_FLOAT32_IEEE 0 AEBS_subsystem_integrated_CM_single -3.4E+38 3.4E+38 /end CHARACTERISTIC
/begin CHARACTERISTIC KfAEBS_a_Areq_FullBrkDeactThrsd "Acceleration request full brake dactive threshold(Full brake 
      can be deactived only in a short period)" VALUE 0x701017dc /* @ECU_Address@KfAEBS_a_Areq_FullBrkDeactThrsd@ */ Scalar_FLOAT32_IEEE 0 AEBS_subsystem_integrated_CM_single -3.4E+38 3.4E+38 /end CHARACTERISTIC
/begin CHARACTERISTIC KfAEBS_a_Areq_ObjChangThrsd "When the object is changed, only when the new object's acceleration request
      is samller than a threshold, then, the AEB/FCW can be deactived." VALUE 0x701017d8 /* @ECU_Address@KfAEBS_a_Areq_ObjChangThrsd@ */ Scalar_FLOAT32_IEEE 0 AEBS_subsystem_integrated_CM_single -3.4E+38 3.4E+38 /end CHARACTERISTIC
/begin CHARACTERISTIC KfAEBS_a_Areq_PartialBrkActThrsd "Acceleration request partial brake active threshold" VALUE 0x701017d4 /* @ECU_Address@KfAEBS_a_Areq_PartialBrkActThrsd@ */ Scalar_FLOAT32_IEEE 0 AEBS_subsystem_integrated_CM_single -3.4E+38 3.4E+38 /end CHARACTERISTIC
/begin CHARACTERISTIC KfAEBS_a_Areq_PartialBrkDeactThrsd "Acceleration request partial brake deactive threshold" VALUE 0x701017d0 /* @ECU_Address@KfAEBS_a_Areq_PartialBrkDeactThrsd@ */ Scalar_FLOAT32_IEEE 0 AEBS_subsystem_integrated_CM_single -3.4E+38 3.4E+38 /end CHARACTERISTIC
/begin CHARACTERISTIC KfAEBS_a_BrakeInit "In passensor protected stage,acceleration send at initial step" VALUE 0x701017c8 /* @ECU_Address@KfAEBS_a_BrakeInit@ */ Scalar_FLOAT32_IEEE 0 AEBS_subsystem_integrated_CM_single -3.4E+38 3.4E+38 /end CHARACTERISTIC
/begin CHARACTERISTIC KfAEBS_a_BrakeMax "In passensor protected stage,acceleration send maximum" VALUE 0x701017c4 /* @ECU_Address@KfAEBS_a_BrakeMax@ */ Scalar_FLOAT32_IEEE 0 AEBS_subsystem_integrated_CM_single -3.4E+38 3.4E+38 /end CHARACTERISTIC
/begin CHARACTERISTIC KfAEBS_a_Buffer "Acceleration send buffer in distance safe" VALUE 0x701017c0 /* @ECU_Address@KfAEBS_a_Buffer@ */ Scalar_FLOAT32_IEEE 0 AEBS_subsystem_integrated_CM_single -3.4E+38 3.4E+38 /end CHARACTERISTIC
/begin CHARACTERISTIC KfAEBS_a_FullBrakeHi "Maximum decceleration send in full brake(ex. -5)" VALUE 0x701017bc /* @ECU_Address@KfAEBS_a_FullBrakeHi@ */ Scalar_FLOAT32_IEEE 0 AEBS_subsystem_integrated_CM_single -3.4E+38 3.4E+38 /end CHARACTERISTIC
/begin CHARACTERISTIC KfAEBS_a_FullBrakeLo "Minimum decceleration send in full brake(ex. -2.5)" VALUE 0x701017b8 /* @ECU_Address@KfAEBS_a_FullBrakeLo@ */ Scalar_FLOAT32_IEEE 0 AEBS_subsystem_integrated_CM_single -3.4E+38 3.4E+38 /end CHARACTERISTIC
/begin CHARACTERISTIC KfAEBS_a_ObjUrgentBrake_Thrsh "" VALUE 0x701017b4 /* @ECU_Address@KfAEBS_a_ObjUrgentBrake_Thrsh@ */ Scalar_FLOAT32_IEEE 0 AEBS_subsystem_integrated_CM_single -3.4E+38 3.4E+38 /end CHARACTERISTIC
/begin CHARACTERISTIC KfAEBS_a_PartialBrakeHi "Maximum decceleration send in partial brake(ex. -4)" VALUE 0x701017b0 /* @ECU_Address@KfAEBS_a_PartialBrakeHi@ */ Scalar_FLOAT32_IEEE 0 AEBS_subsystem_integrated_CM_single -3.4E+38 3.4E+38 /end CHARACTERISTIC
/begin CHARACTERISTIC KfAEBS_a_PartialBrakeLo "Minimum decceleration send in partial brake(ex. -2)" VALUE 0x701017ac /* @ECU_Address@KfAEBS_a_PartialBrakeLo@ */ Scalar_FLOAT32_IEEE 0 AEBS_subsystem_integrated_CM_single -3.4E+38 3.4E+38 /end CHARACTERISTIC
/begin CHARACTERISTIC KfAEBS_d_Dis_Safe "Distance safe, when vehicle is stopped, the distance to obj" VALUE 0x70101798 /* @ECU_Address@KfAEBS_d_Dis_Safe@ */ Scalar_FLOAT32_IEEE 0 AEBS_subsystem_integrated_CM_single -3.4E+38 3.4E+38 /end CHARACTERISTIC
/begin CHARACTERISTIC KfAEBS_d_Dis_Safe_VRU "" VALUE 0x70101794 /* @ECU_Address@KfAEBS_d_Dis_Safe_VRU@ */ Scalar_FLOAT32_IEEE 0 AEBS_subsystem_integrated_CM_single -3.4E+38 3.4E+38 /end CHARACTERISTIC
/begin CHARACTERISTIC KfAEBS_d_lateral_max_lostClose "" VALUE 0x70101790 /* @ECU_Address@KfAEBS_d_lateral_max_lostClose@ */ Scalar_FLOAT32_IEEE 0 AEBS_subsystem_integrated_CM_single -3.4E+38 3.4E+38 /end CHARACTERISTIC
/begin CHARACTERISTIC KfAEBS_d_lateral_min_lostClose "" VALUE 0x7010178c /* @ECU_Address@KfAEBS_d_lateral_min_lostClose@ */ Scalar_FLOAT32_IEEE 0 AEBS_subsystem_integrated_CM_single -3.4E+38 3.4E+38 /end CHARACTERISTIC
/begin CHARACTERISTIC KfAEBS_d_long_max_lostClose "" VALUE 0x70101788 /* @ECU_Address@KfAEBS_d_long_max_lostClose@ */ Scalar_FLOAT32_IEEE 0 AEBS_subsystem_integrated_CM_single -3.4E+38 3.4E+38 /end CHARACTERISTIC
/begin CHARACTERISTIC KfAEBS_d_long_min_lostClose "" VALUE 0x70101784 /* @ECU_Address@KfAEBS_d_long_min_lostClose@ */ Scalar_FLOAT32_IEEE 0 AEBS_subsystem_integrated_CM_single -3.4E+38 3.4E+38 /end CHARACTERISTIC
/begin CHARACTERISTIC KfAEBS_t_Speed_DebounceTime "Speed debounce time, used to estimate whether the vheicle is standstill" VALUE 0x70101778 /* @ECU_Address@KfAEBS_t_Speed_DebounceTime@ */ Scalar_FLOAT32_IEEE 0 AEBS_subsystem_integrated_CM_single -3.4E+38 3.4E+38 /end CHARACTERISTIC
/begin CHARACTERISTIC KfAEBS_t_TTC_DeactiveThrsh "TTC Deactive Thrsh" VALUE 0x70101774 /* @ECU_Address@KfAEBS_t_TTC_DeactiveThrsh@ */ Scalar_FLOAT32_IEEE 0 AEBS_subsystem_integrated_CM_single -3.4E+38 3.4E+38 /end CHARACTERISTIC
/begin CHARACTERISTIC KfAEBS_t_TTC_FCWLevel1DeactThrsd "TTC_FCW Level1 Deact Thrsd" VALUE 0x70101770 /* @ECU_Address@KfAEBS_t_TTC_FCWLevel1DeactThrsd@ */ Scalar_FLOAT32_IEEE 0 AEBS_subsystem_integrated_CM_single -3.4E+38 3.4E+38 /end CHARACTERISTIC
/begin CHARACTERISTIC KfAEBS_t_TTC_FCWLevel2DeactThrsd "TTC FCW Level2 Deact Thrsd" VALUE 0x7010176c /* @ECU_Address@KfAEBS_t_TTC_FCWLevel2DeactThrsd@ */ Scalar_FLOAT32_IEEE 0 AEBS_subsystem_integrated_CM_single -3.4E+38 3.4E+38 /end CHARACTERISTIC
/begin CHARACTERISTIC KfAEBS_t_TTC_FCWLevel3DeactThrsd "TTC FCW Level3 Deact Thrsd" VALUE 0x70101768 /* @ECU_Address@KfAEBS_t_TTC_FCWLevel3DeactThrsd@ */ Scalar_FLOAT32_IEEE 0 AEBS_subsystem_integrated_CM_single -3.4E+38 3.4E+38 /end CHARACTERISTIC
/begin CHARACTERISTIC KfAEBS_t_TTC_ObjChangThrsd "" VALUE 0x70101764 /* @ECU_Address@KfAEBS_t_TTC_ObjChangThrsd@ */ Scalar_FLOAT32_IEEE 0 AEBS_subsystem_integrated_CM_single -3.4E+38 3.4E+38 /end CHARACTERISTIC
/begin CHARACTERISTIC KfAEBS_t_TTC_PartialBrkDeactiveThrsd "TTC Partial Brk Deactive Thrsd" VALUE 0x70101760 /* @ECU_Address@KfAEBS_t_TTC_PartialBrkDeactiveThrsd@ */ Scalar_FLOAT32_IEEE 0 AEBS_subsystem_integrated_CM_single -3.4E+38 3.4E+38 /end CHARACTERISTIC
/begin CHARACTERISTIC KfAEBS_t_TTC_PreBrkDeactThrsd "KfAEBS TTC PreBrk Deact Thrsd" VALUE 0x7010175c /* @ECU_Address@KfAEBS_t_TTC_PreBrkDeactThrsd@ */ Scalar_FLOAT32_IEEE 0 AEBS_subsystem_integrated_CM_single -3.4E+38 3.4E+38 /end CHARACTERISTIC
/begin CHARACTERISTIC KfAEBS_t_TimeBrakeThrsd "" VALUE 0x70101754 /* @ECU_Address@KfAEBS_t_TimeBrakeThrsd@ */ Scalar_FLOAT32_IEEE 0 AEBS_subsystem_integrated_CM_single -3.4E+38 3.4E+38 /end CHARACTERISTIC
/begin CHARACTERISTIC KfAEBS_t_TimePreBrkThrsd "" VALUE 0x7010174c /* @ECU_Address@KfAEBS_t_TimePreBrkThrsd@ */ Scalar_FLOAT32_IEEE 0 AEBS_subsystem_integrated_CM_single -3.4E+38 3.4E+38 /end CHARACTERISTIC
/begin CHARACTERISTIC KfAEBS_t_Time_BrakeDelay "Time Brake Delay" VALUE 0x70101744 /* @ECU_Address@KfAEBS_t_Time_BrakeDelay@ */ Scalar_FLOAT32_IEEE 0 AEBS_subsystem_integrated_CM_single -3.4E+38 3.4E+38 /end CHARACTERISTIC
/begin CHARACTERISTIC KfAEBS_t_Time_BrakeInit "Time Brake Init" VALUE 0x70101740 /* @ECU_Address@KfAEBS_t_Time_BrakeInit@ */ Scalar_FLOAT32_IEEE 0 AEBS_subsystem_integrated_CM_single -3.4E+38 3.4E+38 /end CHARACTERISTIC
/begin CHARACTERISTIC KfAEBS_t_Time_BrakeRamp "Time Brake Ramp" VALUE 0x7010173c /* @ECU_Address@KfAEBS_t_Time_BrakeRamp@ */ Scalar_FLOAT32_IEEE 0 AEBS_subsystem_integrated_CM_single -3.4E+38 3.4E+38 /end CHARACTERISTIC
/begin CHARACTERISTIC KfAEBS_t_Time_HasNoVIPDelay "Time Has No VIP Delay" VALUE 0x70101738 /* @ECU_Address@KfAEBS_t_Time_HasNoVIPDelay@ */ Scalar_FLOAT32_IEEE 0 AEBS_subsystem_integrated_CM_single -3.4E+38 3.4E+38 /end CHARACTERISTIC
/begin CHARACTERISTIC KfAEBS_t_Time_ObjUrgentBrk "" VALUE 0x70101730 /* @ECU_Address@KfAEBS_t_Time_ObjUrgentBrk@ */ Scalar_FLOAT32_IEEE 0 AEBS_subsystem_integrated_CM_single -3.4E+38 3.4E+38 /end CHARACTERISTIC
/begin CHARACTERISTIC KfAEBS_t_Time_ResetTimeBrkThrsd "" VALUE 0x7010172c /* @ECU_Address@KfAEBS_t_Time_ResetTimeBrkThrsd@ */ Scalar_FLOAT32_IEEE 0 AEBS_subsystem_integrated_CM_single -3.4E+38 3.4E+38 /end CHARACTERISTIC
/begin CHARACTERISTIC KfAEBS_t_Time_ResetVeloRdctThrsd "" VALUE 0x70101728 /* @ECU_Address@KfAEBS_t_Time_ResetVeloRdctThrsd@ */ Scalar_FLOAT32_IEEE 0 AEBS_subsystem_integrated_CM_single -3.4E+38 3.4E+38 /end CHARACTERISTIC
/begin CHARACTERISTIC KfAEBS_t_Time_TTCHLInhibitAEB "" VALUE 0x70101724 /* @ECU_Address@KfAEBS_t_Time_TTCHLInhibitAEB@ */ Scalar_FLOAT32_IEEE 0 AEBS_subsystem_integrated_CM_single -3.4E+38 3.4E+38 /end CHARACTERISTIC
/begin CHARACTERISTIC KfAEBS_t_Time_TwiceAEBActive "" VALUE 0x70101720 /* @ECU_Address@KfAEBS_t_Time_TwiceAEBActive@ */ Scalar_FLOAT32_IEEE 0 AEBS_subsystem_integrated_CM_single -3.4E+38 3.4E+38 /end CHARACTERISTIC
/begin CHARACTERISTIC KfAEBS_t_Time_TwiceFCWActive "" VALUE 0x7010171c /* @ECU_Address@KfAEBS_t_Time_TwiceFCWActive@ */ Scalar_FLOAT32_IEEE 0 AEBS_subsystem_integrated_CM_single -3.4E+38 3.4E+38 /end CHARACTERISTIC
/begin CHARACTERISTIC KfAEBS_t_Time_TwicePreBrkActive "" VALUE 0x70101718 /* @ECU_Address@KfAEBS_t_Time_TwicePreBrkActive@ */ Scalar_FLOAT32_IEEE 0 AEBS_subsystem_integrated_CM_single -3.4E+38 3.4E+38 /end CHARACTERISTIC
/begin CHARACTERISTIC KfAEBS_t_VipCloseLostTimeOut "" VALUE 0x70101714 /* @ECU_Address@KfAEBS_t_VipCloseLostTimeOut@ */ Scalar_FLOAT32_IEEE 0 AEBS_subsystem_integrated_CM_single -3.4E+38 3.4E+38 /end CHARACTERISTIC
/begin CHARACTERISTIC KfAEBS_t_fb_active_delay_turn "" VALUE 0x70101710 /* @ECU_Address@KfAEBS_t_fb_active_delay_turn@ */ Scalar_FLOAT32_IEEE 0 AEBS_subsystem_integrated_CM_single -3.4E+38 3.4E+38 /end CHARACTERISTIC
/begin CHARACTERISTIC KfAEBS_t_pb_active_delay_turn "" VALUE 0x7010170c /* @ECU_Address@KfAEBS_t_pb_active_delay_turn@ */ Scalar_FLOAT32_IEEE 0 AEBS_subsystem_integrated_CM_single -3.4E+38 3.4E+38 /end CHARACTERISTIC
/begin CHARACTERISTIC KfAEBS_v_ObjUrgentBrk_speed_Thrsh "" VALUE 0x70101704 /* @ECU_Address@KfAEBS_v_ObjUrgentBrk_speed_Thrsh@ */ Scalar_FLOAT32_IEEE 0 AEBS_subsystem_integrated_CM_single -3.4E+38 3.4E+38 /end CHARACTERISTIC
/begin CHARACTERISTIC KfAEBS_v_SpdCollisionInhibitAEB "" VALUE 0x70101700 /* @ECU_Address@KfAEBS_v_SpdCollisionInhibitAEB@ */ Scalar_FLOAT32_IEEE 0 AEBS_subsystem_integrated_CM_single -3.4E+38 3.4E+38 /end CHARACTERISTIC
/begin CHARACTERISTIC KfAEBS_v_Speed_DeltaStStThrsh "delta speed, used to estimate whether the vheicle is standstill" VALUE 0x701016f4 /* @ECU_Address@KfAEBS_v_Speed_DeltaStStThrsh@ */ Scalar_FLOAT32_IEEE 0 AEBS_subsystem_integrated_CM_single -3.4E+38 3.4E+38 /end CHARACTERISTIC
/begin CHARACTERISTIC KfAEBS_v_Speed_High_InhibitAEB "" VALUE 0x701016ec /* @ECU_Address@KfAEBS_v_Speed_High_InhibitAEB@ */ Scalar_FLOAT32_IEEE 0 AEBS_subsystem_integrated_CM_single -3.4E+38 3.4E+38 /end CHARACTERISTIC
/begin CHARACTERISTIC KfAEBS_v_Speed_MaxInhibitAEB "The speed to active AEB" VALUE 0x701016e8 /* @ECU_Address@KfAEBS_v_Speed_MaxInhibitAEB@ */ Scalar_FLOAT32_IEEE 0 AEBS_subsystem_integrated_CM_single -3.4E+38 3.4E+38 /end CHARACTERISTIC
/begin CHARACTERISTIC KfAEBS_v_Speed_StandStillThrsh "Speed, used to estimate whether the vheicle is standstill" VALUE 0x701016dc /* @ECU_Address@KfAEBS_v_Speed_StandStillThrsh@ */ Scalar_FLOAT32_IEEE 0 AEBS_subsystem_integrated_CM_single -3.4E+38 3.4E+38 /end CHARACTERISTIC
/begin CHARACTERISTIC KfAEBS_v_VipStationaryThrshld "" VALUE 0x701016d8 /* @ECU_Address@KfAEBS_v_VipStationaryThrshld@ */ Scalar_FLOAT32_IEEE 0 AEBS_subsystem_integrated_CM_single -3.4E+38 3.4E+38 /end CHARACTERISTIC
/begin CHARACTERISTIC KfAEBS_v_deltaSpeed_InhibitAEB "" VALUE 0x701016d4 /* @ECU_Address@KfAEBS_v_deltaSpeed_InhibitAEB@ */ Scalar_FLOAT32_IEEE 0 AEBS_subsystem_integrated_CM_single -3.4E+38 3.4E+38 /end CHARACTERISTIC
/begin CHARACTERISTIC KfAEBS_v_isInHighSpeed_HighThrshd "" VALUE 0x701016d0 /* @ECU_Address@KfAEBS_v_isInHighSpeed_HighThrshd@ */ Scalar_FLOAT32_IEEE 0 AEBS_subsystem_integrated_CM_single -3.4E+38 3.4E+38 /end CHARACTERISTIC
/begin CHARACTERISTIC KfAEBS_v_isInHighSpeed_LowThrshd "" VALUE 0x701016cc /* @ECU_Address@KfAEBS_v_isInHighSpeed_LowThrshd@ */ Scalar_FLOAT32_IEEE 0 AEBS_subsystem_integrated_CM_single -3.4E+38 3.4E+38 /end CHARACTERISTIC
/begin CHARACTERISTIC KfAEBS_v_speed_max_lostClose "" VALUE 0x701016c4 /* @ECU_Address@KfAEBS_v_speed_max_lostClose@ */ Scalar_FLOAT32_IEEE 0 AEBS_subsystem_integrated_CM_single -3.4E+38 3.4E+38 /end CHARACTERISTIC
/begin CHARACTERISTIC KfAEBS_v_speed_min_lostClose "" VALUE 0x701016c0 /* @ECU_Address@KfAEBS_v_speed_min_lostClose@ */ Scalar_FLOAT32_IEEE 0 AEBS_subsystem_integrated_CM_single -3.4E+38 3.4E+38 /end CHARACTERISTIC
/begin CHARACTERISTIC KfAEBS_AccPdl_InhbtDeact_thrshld "" VALUE 0x70101326 /* @ECU_Address@KfAEBS_AccPdl_InhbtDeact_thrshld@ */ Scalar_UBYTE 0 AEBS_subsystem_integrated_CM_uint8 0 255 /end CHARACTERISTIC
/begin CHARACTERISTIC KfAEBS_Confdnc_FullBrkActThrsd "" VALUE 0x70101324 /* @ECU_Address@KfAEBS_Confdnc_FullBrkActThrsd@ */ Scalar_UBYTE 0 AEBS_subsystem_integrated_CM_uint8 0 255 /end CHARACTERISTIC
/begin CHARACTERISTIC KfAEBS_Confdnc_PartialBrkActThrsd "" VALUE 0x70101323 /* @ECU_Address@KfAEBS_Confdnc_PartialBrkActThrsd@ */ Scalar_UBYTE 0 AEBS_subsystem_integrated_CM_uint8 0 255 /end CHARACTERISTIC
/begin CHARACTERISTIC KfAEBS_Confidnc_Deact_thrshld "" VALUE 0x70101322 /* @ECU_Address@KfAEBS_Confidnc_Deact_thrshld@ */ Scalar_UBYTE 0 AEBS_subsystem_integrated_CM_uint8 0 255 /end CHARACTERISTIC
/begin CHARACTERISTIC KfAEBS_Gear_Value_R "Gear_Value_R" VALUE 0x7010131d /* @ECU_Address@KfAEBS_Gear_Value_R@ */ Scalar_UBYTE 0 AEBS_subsystem_integrated_CM_uint8 0 255 /end CHARACTERISTIC
/begin CHARACTERISTIC KfAEBS_LoPosValInCllsnRednByBrkg "" VALUE 0x7010131c /* @ECU_Address@KfAEBS_LoPosValInCllsnRednByBrkg@ */ Scalar_UBYTE 0 AEBS_subsystem_integrated_CM_uint8 0 255 /end CHARACTERISTIC
/begin CHARACTERISTIC KbAEBS_Enable_VRU_Calibration "" VALUE 0x7010130e /* @ECU_Address@KbAEBS_Enable_VRU_Calibration@ */ Scalar_BOOLEAN 0 AEBS_subsystem_integrated_CM_boolean 0 1 /end CHARACTERISTIC
/begin CHARACTERISTIC KbAEBS_enable_PreBrake "" VALUE 0x70101307 /* @ECU_Address@KbAEBS_enable_PreBrake@ */ Scalar_BOOLEAN 0 AEBS_subsystem_integrated_CM_boolean 0 1 /end CHARACTERISTIC
/begin CHARACTERISTIC KbAEBS_use_steerAngle "" VALUE 0x70101306 /* @ECU_Address@KbAEBS_use_steerAngle@ */ Scalar_BOOLEAN 0 AEBS_subsystem_integrated_CM_boolean 0 1 /end CHARACTERISTIC
/begin CHARACTERISTIC KfARBT_autohold_timeout "Unit in second" VALUE 0x70101f50 /* @ECU_Address@KfARBT_autohold_timeout@ */ Scalar_FLOAT32_IEEE 0 ARBT_subsystem_integrated_CM_single_s -3.4E+38 3.4E+38 /end CHARACTERISTIC
/begin CHARACTERISTIC KfARBT_brake_req_lon_a_lowerlimit "Lower limit for brake longitudinal acceleration request output (in m/s2)" VALUE 0x70101f4c /* @ECU_Address@KfARBT_brake_req_lon_a_lowerlimit@ */ Scalar_FLOAT32_IEEE 0 ARBT_subsystem_integrated_CM_single_m_s2 -3.4E+38 3.4E+38 /end CHARACTERISTIC
/begin CHARACTERISTIC KfARBT_brake_req_lon_a_upperlimit "Upper limit for brake longitudinal acceleration request output (in m/s2)" VALUE 0x70101f48 /* @ECU_Address@KfARBT_brake_req_lon_a_upperlimit@ */ Scalar_FLOAT32_IEEE 0 ARBT_subsystem_integrated_CM_single_m_s2 -3.4E+38 3.4E+38 /end CHARACTERISTIC
/begin CHARACTERISTIC KfARBT_brk_ped_pos_thrsh_rec_trig "Threshold of actual brake pedal position to determine if driver is taking a hard brake" VALUE 0x70101f44 /* @ECU_Address@KfARBT_brk_ped_pos_thrsh_rec_trig@ */ Scalar_FLOAT32_IEEE 0 ARBT_subsystem_integrated_CM_single__ 0.0 100.0 /end CHARACTERISTIC
/begin CHARACTERISTIC KfARBT_lon_a_thrsh_rec_trig "Threshold of longitudinal acceleration to determine if the driver is taking a hard brake" VALUE 0x70101f40 /* @ECU_Address@KfARBT_lon_a_thrsh_rec_trig@ */ Scalar_FLOAT32_IEEE 0 ARBT_subsystem_integrated_CM_single_m_s2 -10.0 0.0 /end CHARACTERISTIC
/begin CHARACTERISTIC KfARBT_power_req_lon_a_lowerlimit "Lower limit for power longitudinal acceleration request output (in m/s2)" VALUE 0x70101f3c /* @ECU_Address@KfARBT_power_req_lon_a_lowerlimit@ */ Scalar_FLOAT32_IEEE 0 ARBT_subsystem_integrated_CM_single_m_s2 -3.4E+38 3.4E+38 /end CHARACTERISTIC
/begin CHARACTERISTIC KfARBT_power_req_lon_a_upperlimit "Lower limit for power longitudinal acceleration request output (in m/s2)" VALUE 0x70101f38 /* @ECU_Address@KfARBT_power_req_lon_a_upperlimit@ */ Scalar_FLOAT32_IEEE 0 ARBT_subsystem_integrated_CM_single_m_s2 -3.4E+38 3.4E+38 /end CHARACTERISTIC
/begin CHARACTERISTIC KfARBT_steer_req_strwhl_angle_lowerlimit "Lower limit for steer wheel angle output (in degrees)" VALUE 0x70101f34 /* @ECU_Address@KfARBT_steer_req_strwhl_angle_lowerlimit@ */ Scalar_FLOAT32_IEEE 0 ARBT_subsystem_integrated_CM_single_deg -3.4E+38 3.4E+38 /end CHARACTERISTIC
/begin CHARACTERISTIC KfARBT_steer_req_strwhl_angle_upperlimit "Upper limit for steer wheel angle output (in degrees)" VALUE 0x70101f30 /* @ECU_Address@KfARBT_steer_req_strwhl_angle_upperlimit@ */ Scalar_FLOAT32_IEEE 0 ARBT_subsystem_integrated_CM_single_deg -3.4E+38 3.4E+38 /end CHARACTERISTIC
/begin CHARACTERISTIC KfARBT_t_false_aeb_time_gap_thrsh "Time difference allowed for AEB to be triggered earlier than the start of driver hard braking
      
      Unit in ms
      " VALUE 0x70101f2c /* @ECU_Address@KfARBT_t_false_aeb_time_gap_thrsh@ */ Scalar_FLOAT32_IEEE 0 ARBT_subsystem_integrated_CM_single_ms -3.4E+38 3.4E+38 /end CHARACTERISTIC
/begin CHARACTERISTIC KfARBT_t_hard_brake_debounce_time "Unit in ms. The debounce time to enter hard braking state" VALUE 0x70101f28 /* @ECU_Address@KfARBT_t_hard_brake_debounce_time@ */ Scalar_FLOAT32_IEEE 0 ARBT_subsystem_integrated_CM_single_ms 0.0 3.4E+38 /end CHARACTERISTIC
/begin CHARACTERISTIC KfARBT_t_hard_brake_time_out "Unit in second, time out for hard braking state" VALUE 0x70101f24 /* @ECU_Address@KfARBT_t_hard_brake_time_out@ */ Scalar_FLOAT32_IEEE 0 ARBT_subsystem_integrated_CM_single_sec 0.0 3.4E+38 /end CHARACTERISTIC
/begin CHARACTERISTIC KfARBT_t_missed_aeb_time_gap_thrsh "Time difference allowed for AEB to be triggered later than the start of driver hard braking
      
      Unit in ms
      
      " VALUE 0x70101f20 /* @ECU_Address@KfARBT_t_missed_aeb_time_gap_thrsh@ */ Scalar_FLOAT32_IEEE 0 ARBT_subsystem_integrated_CM_single_ms -3.4E+38 3.4E+38 /end CHARACTERISTIC
/begin CHARACTERISTIC KfARBT_t_speed_debounce_time "" VALUE 0x70101f1c /* @ECU_Address@KfARBT_t_speed_debounce_time@ */ Scalar_FLOAT32_IEEE 0 ARBT_subsystem_integrated_CM_single -3.4E+38 3.4E+38 /end CHARACTERISTIC
/begin CHARACTERISTIC KfARBT_v_moving_speed_thrsh "" VALUE 0x70101f18 /* @ECU_Address@KfARBT_v_moving_speed_thrsh@ */ Scalar_FLOAT32_IEEE 0 ARBT_subsystem_integrated_CM_single_m_s 0.1 1.0 /end CHARACTERISTIC
/begin CHARACTERISTIC KfARBT_v_standstill_speed_thrsh "" VALUE 0x70101f14 /* @ECU_Address@KfARBT_v_standstill_speed_thrsh@ */ Scalar_FLOAT32_IEEE 0 ARBT_subsystem_integrated_CM_single_m_s 0.1 1.0 /end CHARACTERISTIC
/begin CHARACTERISTIC KbARBT_power_req_mode_man_ctrl_temp "" VALUE 0x70101f13 /* @ECU_Address@KbARBT_power_req_mode_man_ctrl_temp@ */ Scalar_UBYTE 0 ARBT_subsystem_integrated_CM_uint8 0 255 /end CHARACTERISTIC
/begin CHARACTERISTIC KbARBT_SLEW_autohold_active "" VALUE 0x70101f12 /* @ECU_Address@KbARBT_SLEW_autohold_active@ */ Scalar_BOOLEAN 0 ARBT_subsystem_integrated_CM_boolean 0 1 /end CHARACTERISTIC
/begin CHARACTERISTIC KbARBT_SLEW_gear_ctrl_accel_req "" VALUE 0x70101f11 /* @ECU_Address@KbARBT_SLEW_gear_ctrl_accel_req@ */ Scalar_BOOLEAN 0 ARBT_subsystem_integrated_CM_boolean 0 1 /end CHARACTERISTIC
/begin CHARACTERISTIC KbARBT_gear_pos_fedbck_valid "Validity flag of gear position feedback signal.
      
      For project vehicle without gear position feedback, this calibration shall be set to 0" VALUE 0x70101f10 /* @ECU_Address@KbARBT_gear_pos_fedbck_valid@ */ Scalar_BOOLEAN 0 ARBT_subsystem_integrated_CM_boolean 0 1 /end CHARACTERISTIC
/begin CHARACTERISTIC KcCOMM_BrakePedalMax "" VALUE 0x701020b8 /* @ECU_Address@KcCOMM_BrakePedalMax@ */ Scalar_FLOAT32_IEEE 0 COMM_subsystem_integrated_CM_single -3.4E+38 3.4E+38 /end CHARACTERISTIC
/begin CHARACTERISTIC KcCOMM_BrakePedalMin "" VALUE 0x701020b4 /* @ECU_Address@KcCOMM_BrakePedalMin@ */ Scalar_FLOAT32_IEEE 0 COMM_subsystem_integrated_CM_single -3.4E+38 3.4E+38 /end CHARACTERISTIC
/begin CHARACTERISTIC KcCOMM_FirstGearRatio "Gear ratio in 1st gear." VALUE 0x701020b0 /* @ECU_Address@KcCOMM_FirstGearRatio@ */ Scalar_FLOAT32_IEEE 0 COMM_subsystem_integrated_CM_single -3.4E+38 3.4E+38 /end CHARACTERISTIC
/begin CHARACTERISTIC KcCOMM_GasPedalMax "" VALUE 0x701020ac /* @ECU_Address@KcCOMM_GasPedalMax@ */ Scalar_FLOAT32_IEEE 0 COMM_subsystem_integrated_CM_single -3.4E+38 3.4E+38 /end CHARACTERISTIC
/begin CHARACTERISTIC KcCOMM_GasPedalMaxEPB "" VALUE 0x701020a8 /* @ECU_Address@KcCOMM_GasPedalMaxEPB@ */ Scalar_FLOAT32_IEEE 0 COMM_subsystem_integrated_CM_single -3.4E+38 3.4E+38 /end CHARACTERISTIC
/begin CHARACTERISTIC KcCOMM_GasPedalMin "" VALUE 0x701020a4 /* @ECU_Address@KcCOMM_GasPedalMin@ */ Scalar_FLOAT32_IEEE 0 COMM_subsystem_integrated_CM_single -3.4E+38 3.4E+38 /end CHARACTERISTIC
/begin CHARACTERISTIC KcCOMM_GasPedalMinEPB "" VALUE 0x701020a0 /* @ECU_Address@KcCOMM_GasPedalMinEPB@ */ Scalar_FLOAT32_IEEE 0 COMM_subsystem_integrated_CM_single -3.4E+38 3.4E+38 /end CHARACTERISTIC
/begin CHARACTERISTIC KcCOMM_GasPedalRampEPB "" VALUE 0x7010209c /* @ECU_Address@KcCOMM_GasPedalRampEPB@ */ Scalar_FLOAT32_IEEE 0 COMM_subsystem_integrated_CM_single -3.4E+38 3.4E+38 /end CHARACTERISTIC
/begin CHARACTERISTIC KcCOMM_Test_Checksum_0x150 "" VALUE 0x70102098 /* @ECU_Address@KcCOMM_Test_Checksum_0x150@ */ Scalar_FLOAT32_IEEE 0 COMM_subsystem_integrated_CM_single -3.4E+38 3.4E+38 /end CHARACTERISTIC
/begin CHARACTERISTIC KcCOMM_Test_Checksum_0x151 "" VALUE 0x70102094 /* @ECU_Address@KcCOMM_Test_Checksum_0x151@ */ Scalar_FLOAT32_IEEE 0 COMM_subsystem_integrated_CM_single -3.4E+38 3.4E+38 /end CHARACTERISTIC
/begin CHARACTERISTIC KcCOMM_Test_Cmd_AccPelPosAct "" VALUE 0x70102090 /* @ECU_Address@KcCOMM_Test_Cmd_AccPelPosAct@ */ Scalar_FLOAT32_IEEE 0 COMM_subsystem_integrated_CM_single -3.4E+38 3.4E+38 /end CHARACTERISTIC
/begin CHARACTERISTIC KcCOMM_Test_Cmd_AccPelPosActInv "" VALUE 0x7010208c /* @ECU_Address@KcCOMM_Test_Cmd_AccPelPosActInv@ */ Scalar_FLOAT32_IEEE 0 COMM_subsystem_integrated_CM_single -3.4E+38 3.4E+38 /end CHARACTERISTIC
/begin CHARACTERISTIC KcCOMM_Test_Cmd_BrkPelPosAct "" VALUE 0x70102088 /* @ECU_Address@KcCOMM_Test_Cmd_BrkPelPosAct@ */ Scalar_FLOAT32_IEEE 0 COMM_subsystem_integrated_CM_single -3.4E+38 3.4E+38 /end CHARACTERISTIC
/begin CHARACTERISTIC KcCOMM_Test_Cmd_BrkPelPosActInv "" VALUE 0x70102084 /* @ECU_Address@KcCOMM_Test_Cmd_BrkPelPosActInv@ */ Scalar_FLOAT32_IEEE 0 COMM_subsystem_integrated_CM_single -3.4E+38 3.4E+38 /end CHARACTERISTIC
/begin CHARACTERISTIC KcCOMM_Test_Cmd_Checksum "" VALUE 0x70102080 /* @ECU_Address@KcCOMM_Test_Cmd_Checksum@ */ Scalar_FLOAT32_IEEE 0 COMM_subsystem_integrated_CM_single -3.4E+38 3.4E+38 /end CHARACTERISTIC
/begin CHARACTERISTIC KcCOMM_Test_Cmd_RCnt "" VALUE 0x7010207c /* @ECU_Address@KcCOMM_Test_Cmd_RCnt@ */ Scalar_FLOAT32_IEEE 0 COMM_subsystem_integrated_CM_single -3.4E+38 3.4E+38 /end CHARACTERISTIC
/begin CHARACTERISTIC KcCOMM_Test_Cmd_StrAngle "" VALUE 0x70102078 /* @ECU_Address@KcCOMM_Test_Cmd_StrAngle@ */ Scalar_FLOAT32_IEEE 0 COMM_subsystem_integrated_CM_single -3.4E+38 3.4E+38 /end CHARACTERISTIC
/begin CHARACTERISTIC KcCOMM_Test_Cmd_StrAngleLimit "" VALUE 0x70102074 /* @ECU_Address@KcCOMM_Test_Cmd_StrAngleLimit@ */ Scalar_FLOAT32_IEEE 0 COMM_subsystem_integrated_CM_single -3.4E+38 3.4E+38 /end CHARACTERISTIC
/begin CHARACTERISTIC KcCOMM_Test_Cmd_StrAngleSpd "" VALUE 0x70102070 /* @ECU_Address@KcCOMM_Test_Cmd_StrAngleSpd@ */ Scalar_FLOAT32_IEEE 0 COMM_subsystem_integrated_CM_single -3.4E+38 3.4E+38 /end CHARACTERISTIC
/begin CHARACTERISTIC KcCOMM_Test_Cmd_VCUCnt "" VALUE 0x7010206c /* @ECU_Address@KcCOMM_Test_Cmd_VCUCnt@ */ Scalar_FLOAT32_IEEE 0 COMM_subsystem_integrated_CM_single -3.4E+38 3.4E+38 /end CHARACTERISTIC
/begin CHARACTERISTIC KcCOMM_Test_Decs_Acc_Value "" VALUE 0x70102068 /* @ECU_Address@KcCOMM_Test_Decs_Acc_Value@ */ Scalar_FLOAT32_IEEE 0 COMM_subsystem_integrated_CM_single -3.4E+38 3.4E+38 /end CHARACTERISTIC
/begin CHARACTERISTIC KcCOMM_Test_Decs_Breake_Value "" VALUE 0x70102064 /* @ECU_Address@KcCOMM_Test_Decs_Breake_Value@ */ Scalar_FLOAT32_IEEE 0 COMM_subsystem_integrated_CM_single -3.4E+38 3.4E+38 /end CHARACTERISTIC
/begin CHARACTERISTIC KcCOMM_Test_RCnt_0x150 "" VALUE 0x70102060 /* @ECU_Address@KcCOMM_Test_RCnt_0x150@ */ Scalar_FLOAT32_IEEE 0 COMM_subsystem_integrated_CM_single -3.4E+38 3.4E+38 /end CHARACTERISTIC
/begin CHARACTERISTIC KcCOMM_Test_RCnt_0x151 "" VALUE 0x7010205c /* @ECU_Address@KcCOMM_Test_RCnt_0x151@ */ Scalar_FLOAT32_IEEE 0 COMM_subsystem_integrated_CM_single -3.4E+38 3.4E+38 /end CHARACTERISTIC
/begin CHARACTERISTIC KcCOMM_Test_Tar_Torq "" VALUE 0x70102058 /* @ECU_Address@KcCOMM_Test_Tar_Torq@ */ Scalar_FLOAT32_IEEE 0 COMM_subsystem_integrated_CM_single -3.4E+38 3.4E+38 /end CHARACTERISTIC
/begin CHARACTERISTIC KcCOMM_Test_Tar_vehiclespd "" VALUE 0x70102054 /* @ECU_Address@KcCOMM_Test_Tar_vehiclespd@ */ Scalar_FLOAT32_IEEE 0 COMM_subsystem_integrated_CM_single -3.4E+38 3.4E+38 /end CHARACTERISTIC
/begin CHARACTERISTIC KcCOMM_Test_acceleration_fb "" VALUE 0x70102050 /* @ECU_Address@KcCOMM_Test_acceleration_fb@ */ Scalar_FLOAT32_IEEE 0 COMM_subsystem_integrated_CM_single -3.4E+38 3.4E+38 /end CHARACTERISTIC
/begin CHARACTERISTIC KcCOMM_Test_cmd_VCUChecksum "" VALUE 0x7010204c /* @ECU_Address@KcCOMM_Test_cmd_VCUChecksum@ */ Scalar_FLOAT32_IEEE 0 COMM_subsystem_integrated_CM_single -3.4E+38 3.4E+38 /end CHARACTERISTIC
/begin CHARACTERISTIC KcCOMM_Test_yaw_rate_fb "" VALUE 0x70102048 /* @ECU_Address@KcCOMM_Test_yaw_rate_fb@ */ Scalar_FLOAT32_IEEE 0 COMM_subsystem_integrated_CM_single -3.4E+38 3.4E+38 /end CHARACTERISTIC
/begin CHARACTERISTIC KfACCS_d_VEH_WheelDiameter "This is whell diameter" VALUE 0x70102044 /* @ECU_Address@KfACCS_d_VEH_WheelDiameter@ */ Scalar_FLOAT32_IEEE 0 COMM_subsystem_integrated_CM_single_mm 0.0 2000.0 /end CHARACTERISTIC
/begin CHARACTERISTIC KfCOMM_Ang_VEH_AngOrigin2FrontWheel "This is the angle between origin to front axle and origin to front wheel" VALUE 0x70102040 /* @ECU_Address@KfCOMM_Ang_VEH_AngOrigin2FrontWheel@ */ Scalar_FLOAT32_IEEE 0 COMM_subsystem_integrated_CM_single_rad -3.14 3.14 /end CHARACTERISTIC
/begin CHARACTERISTIC KfCOMM_VEH_Mass "Vehicle mass" VALUE 0x7010203c /* @ECU_Address@KfCOMM_VEH_Mass@ */ Scalar_FLOAT32_IEEE 0 COMM_subsystem_integrated_CM_single_kg 0.0 100000.0 /end CHARACTERISTIC
/begin CHARACTERISTIC KfCOMM_VEH_StiffnessFront "This is cornering stiffness of front wheel" VALUE 0x70102038 /* @ECU_Address@KfCOMM_VEH_StiffnessFront@ */ Scalar_FLOAT32_IEEE 0 COMM_subsystem_integrated_CM_single_N_deg 0.0 100000.0 /end CHARACTERISTIC
/begin CHARACTERISTIC KfCOMM_VEH_StiffnessRear "This is cornering stiffness of rear wheel" VALUE 0x70102034 /* @ECU_Address@KfCOMM_VEH_StiffnessRear@ */ Scalar_FLOAT32_IEEE 0 COMM_subsystem_integrated_CM_single_N_deg 0.0 1.0E+6 /end CHARACTERISTIC
/begin CHARACTERISTIC KfCOMM_VEH_YawInertia_Z "Moment of inertia of the whole vehicle around z axis" VALUE 0x70102030 /* @ECU_Address@KfCOMM_VEH_YawInertia_Z@ */ Scalar_FLOAT32_IEEE 0 COMM_subsystem_integrated_CM_single_kg_m2 0.0 100000.0 /end CHARACTERISTIC
/begin CHARACTERISTIC KfCOMM_a_VCULongAccOffset "Offset to override Longitudinal Acceleration." VALUE 0x7010202c /* @ECU_Address@KfCOMM_a_VCULongAccOffset@ */ Scalar_FLOAT32_IEEE 0 COMM_subsystem_integrated_CM_single -3.4E+38 3.4E+38 /end CHARACTERISTIC
/begin CHARACTERISTIC KfCOMM_d_VEH_DisCentorid2Front "This is the distance between Cetroid and Front surface" VALUE 0x70102028 /* @ECU_Address@KfCOMM_d_VEH_DisCentorid2Front@ */ Scalar_FLOAT32_IEEE 0 COMM_subsystem_integrated_CM_single_mm 0.0 10000.0 /end CHARACTERISTIC
/begin CHARACTERISTIC KfCOMM_d_VEH_DisFront2Rear "This is distance between two axes" VALUE 0x70102024 /* @ECU_Address@KfCOMM_d_VEH_DisFront2Rear@ */ Scalar_FLOAT32_IEEE 0 COMM_subsystem_integrated_CM_single_mm 0.0 10000.0 /end CHARACTERISTIC
/begin CHARACTERISTIC KfCOMM_d_VEH_DisLeft2Right "This is the distance between left wheel and right wheel" VALUE 0x70102020 /* @ECU_Address@KfCOMM_d_VEH_DisLeft2Right@ */ Scalar_FLOAT32_IEEE 0 COMM_subsystem_integrated_CM_single_mm 0.0 5000.0 /end CHARACTERISTIC
/begin CHARACTERISTIC KfCOMM_d_VEH_DisOrigin2End "This is the distance between the cordinate origin and the rear surface" VALUE 0x7010201c /* @ECU_Address@KfCOMM_d_VEH_DisOrigin2End@ */ Scalar_FLOAT32_IEEE 0 COMM_subsystem_integrated_CM_single_mm 0.0 10000.0 /end CHARACTERISTIC
/begin CHARACTERISTIC KfCOMM_d_VEH_DisOrigin2FrontWheel "" VALUE 0x70102018 /* @ECU_Address@KfCOMM_d_VEH_DisOrigin2FrontWheel@ */ Scalar_FLOAT32_IEEE 0 COMM_subsystem_integrated_CM_single_mm 0.0 10000.0 /end CHARACTERISTIC
/begin CHARACTERISTIC KfCOMM_d_VEH_DisOrigin2Head "This is the distance between the coordinate origin and the front surface" VALUE 0x70102014 /* @ECU_Address@KfCOMM_d_VEH_DisOrigin2Head@ */ Scalar_FLOAT32_IEEE 0 COMM_subsystem_integrated_CM_single_mm 0.0 10000.0 /end CHARACTERISTIC
/begin CHARACTERISTIC KfCOMM_d_VEH_DisOrigin2RearAxle "This is the distance between the cordinate origin and the rear axle" VALUE 0x70102010 /* @ECU_Address@KfCOMM_d_VEH_DisOrigin2RearAxle@ */ Scalar_FLOAT32_IEEE 0 COMM_subsystem_integrated_CM_single_mm 0.0 10000.0 /end CHARACTERISTIC
/begin CHARACTERISTIC KfCOMM_d_VEH_Length "This is vehicle length" VALUE 0x7010200c /* @ECU_Address@KfCOMM_d_VEH_Length@ */ Scalar_FLOAT32_IEEE 0 COMM_subsystem_integrated_CM_single_mm 0.0 20000.0 /end CHARACTERISTIC
/begin CHARACTERISTIC KfCOMM_d_VEH_MinTurnRadius "Minimum turning radius" VALUE 0x70102008 /* @ECU_Address@KfCOMM_d_VEH_MinTurnRadius@ */ Scalar_FLOAT32_IEEE 0 COMM_subsystem_integrated_CM_single_m 0.0 30.0 /end CHARACTERISTIC
/begin CHARACTERISTIC KfCOMM_d_VEH_Width "Vehicle's width" VALUE 0x70102004 /* @ECU_Address@KfCOMM_d_VEH_Width@ */ Scalar_FLOAT32_IEEE 0 COMM_subsystem_integrated_CM_single_mm 0.0 5000.0 /end CHARACTERISTIC
/begin CHARACTERISTIC KfCOMM_r_VCULongAccSlope "Slope to override Longitudinal Acceleration." VALUE 0x70102000 /* @ECU_Address@KfCOMM_r_VCULongAccSlope@ */ Scalar_FLOAT32_IEEE 0 COMM_subsystem_integrated_CM_single -3.4E+38 3.4E+38 /end CHARACTERISTIC
/begin CHARACTERISTIC KcCOMM_Test_Cmd_ATOModEnable "" VALUE 0x70101ffe /* @ECU_Address@KcCOMM_Test_Cmd_ATOModEnable@ */ Scalar_UBYTE 0 COMM_subsystem_integrated_CM_uint8 0 255 /end CHARACTERISTIC
/begin CHARACTERISTIC KcCOMM_Test_Cmd_AccPelEnable "" VALUE 0x70101ffd /* @ECU_Address@KcCOMM_Test_Cmd_AccPelEnable@ */ Scalar_UBYTE 0 COMM_subsystem_integrated_CM_uint8 0 255 /end CHARACTERISTIC
/begin CHARACTERISTIC KcCOMM_Test_Cmd_BrkPelEnable "" VALUE 0x70101ffc /* @ECU_Address@KcCOMM_Test_Cmd_BrkPelEnable@ */ Scalar_UBYTE 0 COMM_subsystem_integrated_CM_uint8 0 255 /end CHARACTERISTIC
/begin CHARACTERISTIC KcCOMM_Test_Cmd_ICPDTC "" VALUE 0x70101ffb /* @ECU_Address@KcCOMM_Test_Cmd_ICPDTC@ */ Scalar_UBYTE 0 COMM_subsystem_integrated_CM_uint8 0 255 /end CHARACTERISTIC
/begin CHARACTERISTIC KcCOMM_Test_Cmd_TgtSft "" VALUE 0x70101ffa /* @ECU_Address@KcCOMM_Test_Cmd_TgtSft@ */ Scalar_UBYTE 0 COMM_subsystem_integrated_CM_uint8 0 255 /end CHARACTERISTIC
/begin CHARACTERISTIC KcCOMM_Test_Cmd_TgtSftEnable "" VALUE 0x70101ff9 /* @ECU_Address@KcCOMM_Test_Cmd_TgtSftEnable@ */ Scalar_UBYTE 0 COMM_subsystem_integrated_CM_uint8 0 255 /end CHARACTERISTIC
/begin CHARACTERISTIC KcCOMM_Test_Decs_Acc_Mod "" VALUE 0x70101ff8 /* @ECU_Address@KcCOMM_Test_Decs_Acc_Mod@ */ Scalar_UBYTE 0 COMM_subsystem_integrated_CM_uint8 0 255 /end CHARACTERISTIC
/begin CHARACTERISTIC KcCOMM_Test_Decs_Acc_Req "" VALUE 0x70101ff7 /* @ECU_Address@KcCOMM_Test_Decs_Acc_Req@ */ Scalar_UBYTE 0 COMM_subsystem_integrated_CM_uint8 0 255 /end CHARACTERISTIC
/begin CHARACTERISTIC KcCOMM_Test_Over_Speed "SLEW value for Over Speed." VALUE 0x70101ff6 /* @ECU_Address@KcCOMM_Test_Over_Speed@ */ Scalar_UBYTE 0 COMM_subsystem_integrated_CM_uint8 0 255 /end CHARACTERISTIC
/begin CHARACTERISTIC KcCOMM_Test_SlowDown_Indication "SLEW value for SpeedUp_Indication." VALUE 0x70101ff5 /* @ECU_Address@KcCOMM_Test_SlowDown_Indication@ */ Scalar_UBYTE 0 COMM_subsystem_integrated_CM_uint8 0 255 /end CHARACTERISTIC
/begin CHARACTERISTIC KcCOMM_Test_SpeedUp_Indication "SLEW value for SpeedUp_Indication." VALUE 0x70101ff4 /* @ECU_Address@KcCOMM_Test_SpeedUp_Indication@ */ Scalar_UBYTE 0 COMM_subsystem_integrated_CM_uint8 0 255 /end CHARACTERISTIC
/begin CHARACTERISTIC KcCOMM_Test_Stop_Request "" VALUE 0x70101ff3 /* @ECU_Address@KcCOMM_Test_Stop_Request@ */ Scalar_UBYTE 0 COMM_subsystem_integrated_CM_uint8 0 255 /end CHARACTERISTIC
/begin CHARACTERISTIC KcCOMM_Test_XBR_EBI_Mode "" VALUE 0x70101ff2 /* @ECU_Address@KcCOMM_Test_XBR_EBI_Mode@ */ Scalar_UBYTE 0 COMM_subsystem_integrated_CM_uint8 0 255 /end CHARACTERISTIC
/begin CHARACTERISTIC KcCOMM_Test_XBR_Priority "" VALUE 0x70101ff1 /* @ECU_Address@KcCOMM_Test_XBR_Priority@ */ Scalar_UBYTE 0 COMM_subsystem_integrated_CM_uint8 0 255 /end CHARACTERISTIC
/begin CHARACTERISTIC KcCOMM_Test_driveoff_Req "" VALUE 0x70101ff0 /* @ECU_Address@KcCOMM_Test_driveoff_Req@ */ Scalar_UBYTE 0 COMM_subsystem_integrated_CM_uint8 0 255 /end CHARACTERISTIC
/begin CHARACTERISTIC KcCOMM_Test_mode "" VALUE 0x70101fef /* @ECU_Address@KcCOMM_Test_mode@ */ Scalar_UBYTE 0 COMM_subsystem_integrated_CM_uint8 0 255 /end CHARACTERISTIC
/begin CHARACTERISTIC KcCOMM_TorqCtrlPriority_Active "The priority of the Torque Override Control Mode send to VCU in ADV active state.
      0 - Highest priority.
      1 - High priority.
      2 - Medium priority.
      3 - Low priority." VALUE 0x70101fee /* @ECU_Address@KcCOMM_TorqCtrlPriority_Active@ */ Scalar_UBYTE 0 COMM_subsystem_integrated_CM_uint8 0 255 /end CHARACTERISTIC
/begin CHARACTERISTIC KcCOMM_TorqCtrlPriority_Default "The priority of the Torque Override Control Mode send to VCU in default state.
      0 - Highest priority.
      1 - High priority.
      2 - Medium priority.
      3 - Low priority." VALUE 0x70101fed /* @ECU_Address@KcCOMM_TorqCtrlPriority_Default@ */ Scalar_UBYTE 0 COMM_subsystem_integrated_CM_uint8 0 255 /end CHARACTERISTIC
/begin CHARACTERISTIC KcCOMM_VehicleCANbusConfig "Vehicle Platform and CAN Bus Configuration.
      1 - JAC#1;
      2 - JAC#2 or iVISTA;
      3 - ICPV;
      4 - GLB;
      5 - FAW;
      6 - HZBus;
      7 - USdemo." VALUE 0x70101fec /* @ECU_Address@KcCOMM_VehicleCANbusConfig@ */ Scalar_UBYTE 0 COMM_subsystem_integrated_CM_uint8 0 255 /end CHARACTERISTIC
/begin CHARACTERISTIC KeCOMM_NewCANTest_Type "Vehicle Platform and CAN Bus Configuration.
      1 - JAC#1;
      2 - JAC#2 or iVISTA;
      3 - ICPV;
      4 - GLB;
      5 - FAW;
      6 - HZBus;
      7 - USdemo." VALUE 0x70101feb /* @ECU_Address@KeCOMM_NewCANTest_Type@ */ Scalar_UBYTE 0 COMM_subsystem_integrated_CM_uint8 0 255 /end CHARACTERISTIC
/begin CHARACTERISTIC KeCOMM_Test_Cmd_ParkingCtrlValue "" VALUE 0x70101fea /* @ECU_Address@KeCOMM_Test_Cmd_ParkingCtrlValue@ */ Scalar_UBYTE 0 COMM_subsystem_integrated_CM_uint8 0 255 /end CHARACTERISTIC
/begin CHARACTERISTIC KbCOMM_NewCANTest "" VALUE 0x70101fe9 /* @ECU_Address@KbCOMM_NewCANTest@ */ Scalar_BOOLEAN 0 COMM_subsystem_integrated_CM_boolean 0 1 /end CHARACTERISTIC
/begin CHARACTERISTIC KbCOMM_Test_BckFogLamp_Req "" VALUE 0x70101fe8 /* @ECU_Address@KbCOMM_Test_BckFogLamp_Req@ */ Scalar_BOOLEAN 0 COMM_subsystem_integrated_CM_boolean 0 1 /end CHARACTERISTIC
/begin CHARACTERISTIC KbCOMM_Test_BrakePrechargeRequest "Test mode value for brake boost precharge request." VALUE 0x70101fe7 /* @ECU_Address@KbCOMM_Test_BrakePrechargeRequest@ */ Scalar_BOOLEAN 0 COMM_subsystem_integrated_CM_boolean 0 1 /end CHARACTERISTIC
/begin CHARACTERISTIC KbCOMM_Test_BrakePriorityMode "Test mode for brake request priority mode." VALUE 0x70101fe6 /* @ECU_Address@KbCOMM_Test_BrakePriorityMode@ */ Scalar_BOOLEAN 0 COMM_subsystem_integrated_CM_boolean 0 1 /end CHARACTERISTIC
/begin CHARACTERISTIC KbCOMM_Test_Cmd_AccPelEnable "" VALUE 0x70101fe5 /* @ECU_Address@KbCOMM_Test_Cmd_AccPelEnable@ */ Scalar_BOOLEAN 0 COMM_subsystem_integrated_CM_boolean 0 1 /end CHARACTERISTIC
/begin CHARACTERISTIC KbCOMM_Test_Cmd_BrakeLightReq "" VALUE 0x70101fe4 /* @ECU_Address@KbCOMM_Test_Cmd_BrakeLightReq@ */ Scalar_BOOLEAN 0 COMM_subsystem_integrated_CM_boolean 0 1 /end CHARACTERISTIC
/begin CHARACTERISTIC KbCOMM_Test_Cmd_BrkPelEnable "" VALUE 0x70101fe3 /* @ECU_Address@KbCOMM_Test_Cmd_BrkPelEnable@ */ Scalar_BOOLEAN 0 COMM_subsystem_integrated_CM_boolean 0 1 /end CHARACTERISTIC
/begin CHARACTERISTIC KbCOMM_Test_Cmd_EPSDir "" VALUE 0x70101fe2 /* @ECU_Address@KbCOMM_Test_Cmd_EPSDir@ */ Scalar_BOOLEAN 0 COMM_subsystem_integrated_CM_boolean 0 1 /end CHARACTERISTIC
/begin CHARACTERISTIC KbCOMM_Test_Cmd_ParkingCtrlEnable "" VALUE 0x70101fe1 /* @ECU_Address@KbCOMM_Test_Cmd_ParkingCtrlEnable@ */ Scalar_BOOLEAN 0 COMM_subsystem_integrated_CM_boolean 0 1 /end CHARACTERISTIC
/begin CHARACTERISTIC KbCOMM_Test_Cmd_TgtSftEnable "" VALUE 0x70101fe0 /* @ECU_Address@KbCOMM_Test_Cmd_TgtSftEnable@ */ Scalar_BOOLEAN 0 COMM_subsystem_integrated_CM_boolean 0 1 /end CHARACTERISTIC
/begin CHARACTERISTIC KbCOMM_Test_Decs_DippedBeam_Req "" VALUE 0x70101fdf /* @ECU_Address@KbCOMM_Test_Decs_DippedBeam_Req@ */ Scalar_BOOLEAN 0 COMM_subsystem_integrated_CM_boolean 0 1 /end CHARACTERISTIC
/begin CHARACTERISTIC KbCOMM_Test_Decs_HighBeam_Req "" VALUE 0x70101fde /* @ECU_Address@KbCOMM_Test_Decs_HighBeam_Req@ */ Scalar_BOOLEAN 0 COMM_subsystem_integrated_CM_boolean 0 1 /end CHARACTERISTIC
/begin CHARACTERISTIC KbCOMM_Test_Decs_LftLmp_Req "" VALUE 0x70101fdd /* @ECU_Address@KbCOMM_Test_Decs_LftLmp_Req@ */ Scalar_BOOLEAN 0 COMM_subsystem_integrated_CM_boolean 0 1 /end CHARACTERISTIC
/begin CHARACTERISTIC KbCOMM_Test_Decs_Light_Req "" VALUE 0x70101fdc /* @ECU_Address@KbCOMM_Test_Decs_Light_Req@ */ Scalar_BOOLEAN 0 COMM_subsystem_integrated_CM_boolean 0 1 /end CHARACTERISTIC
/begin CHARACTERISTIC KbCOMM_Test_Decs_RihtLmp_Req "" VALUE 0x70101fdb /* @ECU_Address@KbCOMM_Test_Decs_RihtLmp_Req@ */ Scalar_BOOLEAN 0 COMM_subsystem_integrated_CM_boolean 0 1 /end CHARACTERISTIC
/begin CHARACTERISTIC KbCOMM_Test_Decs_iBCM_Req "" VALUE 0x70101fda /* @ECU_Address@KbCOMM_Test_Decs_iBCM_Req@ */ Scalar_BOOLEAN 0 COMM_subsystem_integrated_CM_boolean 0 1 /end CHARACTERISTIC
/begin CHARACTERISTIC KbCOMM_Test_FrontFogLamp_Req "" VALUE 0x70101fd9 /* @ECU_Address@KbCOMM_Test_FrontFogLamp_Req@ */ Scalar_BOOLEAN 0 COMM_subsystem_integrated_CM_boolean 0 1 /end CHARACTERISTIC
/begin CHARACTERISTIC KbCOMM_Test_Horn_Req "" VALUE 0x70101fd8 /* @ECU_Address@KbCOMM_Test_Horn_Req@ */ Scalar_BOOLEAN 0 COMM_subsystem_integrated_CM_boolean 0 1 /end CHARACTERISTIC
/begin CHARACTERISTIC KbCOMM_Test_HummerSts "" VALUE 0x70101fd7 /* @ECU_Address@KbCOMM_Test_HummerSts@ */ Scalar_BOOLEAN 0 COMM_subsystem_integrated_CM_boolean 0 1 /end CHARACTERISTIC
/begin CHARACTERISTIC KbCOMM_Test_Over_Speed "SLEW value for Over Speed." VALUE 0x70101fd6 /* @ECU_Address@KbCOMM_Test_Over_Speed@ */ Scalar_BOOLEAN 0 COMM_subsystem_integrated_CM_boolean 0 1 /end CHARACTERISTIC
/begin CHARACTERISTIC KbCOMM_Test_SlowDown_Indication "SLEW value for SpeedUp_Indication." VALUE 0x70101fd5 /* @ECU_Address@KbCOMM_Test_SlowDown_Indication@ */ Scalar_BOOLEAN 0 COMM_subsystem_integrated_CM_boolean 0 1 /end CHARACTERISTIC
/begin CHARACTERISTIC KbCOMM_Test_SpeedUp_Indication "SLEW value for SpeedUp_Indication." VALUE 0x70101fd4 /* @ECU_Address@KbCOMM_Test_SpeedUp_Indication@ */ Scalar_BOOLEAN 0 COMM_subsystem_integrated_CM_boolean 0 1 /end CHARACTERISTIC
/begin CHARACTERISTIC KbCOMM_Test_Stop_Request "" VALUE 0x70101fd3 /* @ECU_Address@KbCOMM_Test_Stop_Request@ */ Scalar_BOOLEAN 0 COMM_subsystem_integrated_CM_boolean 0 1 /end CHARACTERISTIC
/begin CHARACTERISTIC KbCOMM_Test_WarnLight_Req "" VALUE 0x70101fd2 /* @ECU_Address@KbCOMM_Test_WarnLight_Req@ */ Scalar_BOOLEAN 0 COMM_subsystem_integrated_CM_boolean 0 1 /end CHARACTERISTIC
/begin CHARACTERISTIC KbCOMM_Test_driveoff_Req "" VALUE 0x70101fd1 /* @ECU_Address@KbCOMM_Test_driveoff_Req@ */ Scalar_BOOLEAN 0 COMM_subsystem_integrated_CM_boolean 0 1 /end CHARACTERISTIC
/begin CHARACTERISTIC KbCOMM_VEH_UseNewConfig "This calibartion can change to a new vehicle configure which can be calibrated" VALUE 0x70101fd0 /* @ECU_Address@KbCOMM_VEH_UseNewConfig@ */ Scalar_BOOLEAN 0 COMM_subsystem_integrated_CM_boolean 0.0 1.0 /end CHARACTERISTIC
/begin CHARACTERISTIC KcCOMM_Test_Cmd_EPSXBW_En "" VALUE 0x70101fcf /* @ECU_Address@KcCOMM_Test_Cmd_EPSXBW_En@ */ Scalar_BOOLEAN 0 COMM_subsystem_integrated_CM_boolean 0 1 /end CHARACTERISTIC
/begin CHARACTERISTIC KcCOMM_Test_Cmd_EPSXBW_En_ovr "" VALUE 0x70101fce /* @ECU_Address@KcCOMM_Test_Cmd_EPSXBW_En_ovr@ */ Scalar_BOOLEAN 0 COMM_subsystem_integrated_CM_boolean 0 1 /end CHARACTERISTIC
/begin CHARACTERISTIC KcCOMM_Test_Cmd_StrAngle_ovr "" VALUE 0x70101fcd /* @ECU_Address@KcCOMM_Test_Cmd_StrAngle_ovr@ */ Scalar_BOOLEAN 0 COMM_subsystem_integrated_CM_boolean 0 1 /end CHARACTERISTIC
/begin CHARACTERISTIC KcCOMM_Test_Decs_Acc_Req_ovr "" VALUE 0x70101fcc /* @ECU_Address@KcCOMM_Test_Decs_Acc_Req_ovr@ */ Scalar_BOOLEAN 0 COMM_subsystem_integrated_CM_boolean 0 1 /end CHARACTERISTIC
/begin CHARACTERISTIC KcCOMM_Test_Decs_Acc_Value_ovr "" VALUE 0x70101fcb /* @ECU_Address@KcCOMM_Test_Decs_Acc_Value_ovr@ */ Scalar_BOOLEAN 0 COMM_subsystem_integrated_CM_boolean 0 1 /end CHARACTERISTIC
/begin CHARACTERISTIC KcCOMM_Test_Decs_Breake_Req "" VALUE 0x70101fca /* @ECU_Address@KcCOMM_Test_Decs_Breake_Req@ */ Scalar_BOOLEAN 0 COMM_subsystem_integrated_CM_boolean 0 1 /end CHARACTERISTIC
/begin CHARACTERISTIC KcCOMM_Test_Decs_Breake_Req_ovr "" VALUE 0x70101fc9 /* @ECU_Address@KcCOMM_Test_Decs_Breake_Req_ovr@ */ Scalar_BOOLEAN 0 COMM_subsystem_integrated_CM_boolean 0 1 /end CHARACTERISTIC
/begin CHARACTERISTIC KcCOMM_Test_Decs_Breake_Value_ovr "" VALUE 0x70101fc8 /* @ECU_Address@KcCOMM_Test_Decs_Breake_Value_ovr@ */ Scalar_BOOLEAN 0 COMM_subsystem_integrated_CM_boolean 0 1 /end CHARACTERISTIC
/begin CHARACTERISTIC KfDCSN_t_adm_temp_steering_ovrd_delay "when override conditions are met, the time to delay before exit." VALUE 0xb0001060 /* @ECU_Address@KfDCSN_t_adm_temp_steering_ovrd_delay@ */ Scalar_FLOAT32_IEEE 0 DCSN_subsystem_integrated_CM_single_s -3.4E+38 3.4E+38 /end CHARACTERISTIC
/begin CHARACTERISTIC KfDCSN_t_adm_temp_steering_resume_delay "When resume conditions are met, the time before re-engaged." VALUE 0xb000105c /* @ECU_Address@KfDCSN_t_adm_temp_steering_resume_delay@ */ Scalar_FLOAT32_IEEE 0 DCSN_subsystem_integrated_CM_single_s -3.4E+38 3.4E+38 /end CHARACTERISTIC
/begin CHARACTERISTIC KfDCSN_t_autodrive_max_wait_time "the maximal wait time before the vehicle response to our activating request" VALUE 0xb0001050 /* @ECU_Address@KfDCSN_t_autodrive_max_wait_time@ */ Scalar_FLOAT32_IEEE 0 DCSN_subsystem_integrated_CM_single_s -3.4E+38 3.4E+38 /end CHARACTERISTIC
/begin CHARACTERISTIC KfDCSN_t_max_eps_inhibit_power "The maximal allowed delay time to inhibit power control if EPS cannot response to CMD" VALUE 0xb000104c /* @ECU_Address@KfDCSN_t_max_eps_inhibit_power@ */ Scalar_FLOAT32_IEEE 0 DCSN_subsystem_integrated_CM_single_s 0.0 30.0 /end CHARACTERISTIC
/begin CHARACTERISTIC KfDCSN_t_max_time_fault_warning "allowed reaction time after fault warning and before triggering emergency stop" VALUE 0xb0001048 /* @ECU_Address@KfDCSN_t_max_time_fault_warning@ */ Scalar_FLOAT32_IEEE 0 DCSN_subsystem_integrated_CM_single_s -3.4E+38 3.4E+38 /end CHARACTERISTIC
/begin CHARACTERISTIC KfDCSN_t_max_time_to_takeover "allowed reaction time after both lane markers are missed but before autodrive exit" VALUE 0xb0001044 /* @ECU_Address@KfDCSN_t_max_time_to_takeover@ */ Scalar_FLOAT32_IEEE 0 DCSN_subsystem_integrated_CM_single_s -3.4E+38 3.4E+38 /end CHARACTERISTIC
/begin CHARACTERISTIC KfDCSN_v_adm_temp_veh_setspeed "Current vehicle acc set speed. 
      Not connect with ACCS yet" VALUE 0xb000102c /* @ECU_Address@KfDCSN_v_adm_temp_veh_setspeed@ */ Scalar_FLOAT32_IEEE 0 DCSN_subsystem_integrated_CM_single_m_s -3.4E+38 3.4E+38 /end CHARACTERISTIC
/begin CHARACTERISTIC KcDCSN_t_usr_activate_cmd_send_count "send count of usr_activate_action, valid when KbDCSN_use_vehicle_activate_switch = true
      unit: seconds" VALUE 0xb0000f5e /* @ECU_Address@KcDCSN_t_usr_activate_cmd_send_count@ */ Scalar_UBYTE 0 DCSN_subsystem_integrated_CM_uint8 0 255 /end CHARACTERISTIC
/begin CHARACTERISTIC KeDCSN_adm_main_mode_man_value "manual override of adm_main_mode output as uint8:
      
      0 = ADM_OFF
      1 = ADM_STANDBY
      2 = ADM_READY
      3 = ADM_ACTIVE
      4 = ADM_STEER_OVRD
      5 = ADM_TAKEOVER_WARNING
      6 = ADM_FAULT_WARNING76 = ADM_FAULT_REACTION
      8 = ADM_FAULT_DETECTED" VALUE 0x7000424d /* @ECU_Address@KeDCSN_adm_main_mode_man_value@ */ Scalar_UBYTE 0 DCSN_subsystem_integrated_CM_uint8 0 255 /end CHARACTERISTIC
/begin CHARACTERISTIC KeDCSN_adm_temp_diag_system_fault "System faults
      0 = no fault
      1,2 = warning faults
      3,4,5 = exit faults" VALUE 0x7000424c /* @ECU_Address@KeDCSN_adm_temp_diag_system_fault@ */ Scalar_UBYTE 0 DCSN_subsystem_integrated_CM_uint8 0 255 /end CHARACTERISTIC
/begin CHARACTERISTIC KeDCSN_usr_cmd_autodrive_activate_man "0 = Deactivate
      1 = Activate
      2 = Hold" VALUE 0x70004244 /* @ECU_Address@KeDCSN_usr_cmd_autodrive_activate_man@ */ Scalar_UBYTE 0 DCSN_subsystem_integrated_CM_uint8 0 255 /end CHARACTERISTIC
/begin CHARACTERISTIC KbDCSN_SLEW_initialization_finished "0 = use initialization finished judgement logic
      1 = initialization finished" VALUE 0x70004241 /* @ECU_Address@KbDCSN_SLEW_initialization_finished@ */ Scalar_BOOLEAN 0 DCSN_subsystem_integrated_CM_boolean 0 1 /end CHARACTERISTIC
/begin CHARACTERISTIC KbDCSN_accs_resume_man_enbl "0 = manual accs resume override disabled
      1 = manual accs resume override enabled" VALUE 0x7000423f /* @ECU_Address@KbDCSN_accs_resume_man_enbl@ */ Scalar_BOOLEAN 0 DCSN_subsystem_integrated_CM_boolean 0 1 /end CHARACTERISTIC
/begin CHARACTERISTIC KbDCSN_accs_resume_man_value "manual change lane switch, valid only when KbDCSN_accs_resume_man_enbl = true
      Pulse signal when reverse." VALUE 0x7000423e /* @ECU_Address@KbDCSN_accs_resume_man_value@ */ Scalar_BOOLEAN 0 DCSN_subsystem_integrated_CM_boolean 0 1 /end CHARACTERISTIC
/begin CHARACTERISTIC KbDCSN_adm_main_mode_man_ctrl "0 = manual override disabled
      1 = manual override enabled" VALUE 0x7000423b /* @ECU_Address@KbDCSN_adm_main_mode_man_ctrl@ */ Scalar_BOOLEAN 0 DCSN_subsystem_integrated_CM_boolean 0 1 /end CHARACTERISTIC
/begin CHARACTERISTIC KbDCSN_adm_temp_stop_finished "0 = not finished
      1 = finished" VALUE 0xb0000f5b /* @ECU_Address@KbDCSN_adm_temp_stop_finished@ */ Scalar_BOOLEAN 0 DCSN_subsystem_integrated_CM_boolean 0 1 /end CHARACTERISTIC
/begin CHARACTERISTIC KbDCSN_adm_temp_usr_cmd_autodrive_enabled "0 = not enabled
      1 = enabled" VALUE 0xb0000f5a /* @ECU_Address@KbDCSN_adm_temp_usr_cmd_autodrive_enabled@ */ Scalar_BOOLEAN 0 DCSN_subsystem_integrated_CM_boolean 0 1 /end CHARACTERISTIC
/begin CHARACTERISTIC KbDCSN_aeb_usr_switch "AEB feature user switch" VALUE 0x70004239 /* @ECU_Address@KbDCSN_aeb_usr_switch@ */ Scalar_BOOLEAN 0 DCSN_subsystem_integrated_CM_boolean 0 1 /end CHARACTERISTIC
/begin CHARACTERISTIC KbDCSN_alca_usr_switch "ALCA feature user switch" VALUE 0xb0000f59 /* @ECU_Address@KbDCSN_alca_usr_switch@ */ Scalar_BOOLEAN 0 DCSN_subsystem_integrated_CM_boolean 0 1 /end CHARACTERISTIC
/begin CHARACTERISTIC KbDCSN_bsd_usr_switch "BSD feature user switch" VALUE 0xb0000f58 /* @ECU_Address@KbDCSN_bsd_usr_switch@ */ Scalar_BOOLEAN 0 DCSN_subsystem_integrated_CM_boolean 0 1 /end CHARACTERISTIC
/begin CHARACTERISTIC KbDCSN_dow_usr_switch "DOW feature user switch" VALUE 0xb0000f56 /* @ECU_Address@KbDCSN_dow_usr_switch@ */ Scalar_BOOLEAN 0 DCSN_subsystem_integrated_CM_boolean 0 1 /end CHARACTERISTIC
/begin CHARACTERISTIC KbDCSN_fcta_usr_switch "FCTA feature user switch" VALUE 0xb0000f55 /* @ECU_Address@KbDCSN_fcta_usr_switch@ */ Scalar_BOOLEAN 0 DCSN_subsystem_integrated_CM_boolean 0 1 /end CHARACTERISTIC
/begin CHARACTERISTIC KbDCSN_fcw_usr_switch "FCW feature user switch" VALUE 0xb0000f54 /* @ECU_Address@KbDCSN_fcw_usr_switch@ */ Scalar_BOOLEAN 0 DCSN_subsystem_integrated_CM_boolean 0 1 /end CHARACTERISTIC
/begin CHARACTERISTIC KbDCSN_inhibit_power_for_eps_enable "0 = disable power inhibit when EPS is out of control
      1 = enable power inhibit when EPS is out of control" VALUE 0xb0000f53 /* @ECU_Address@KbDCSN_inhibit_power_for_eps_enable@ */ Scalar_BOOLEAN 0 DCSN_subsystem_integrated_CM_boolean 0 1 /end CHARACTERISTIC
/begin CHARACTERISTIC KbDCSN_lca_usr_switch "LCA feature user switch" VALUE 0xb0000f52 /* @ECU_Address@KbDCSN_lca_usr_switch@ */ Scalar_BOOLEAN 0 DCSN_subsystem_integrated_CM_boolean 0 1 /end CHARACTERISTIC
/begin CHARACTERISTIC KbDCSN_lcc_usr_switch "LCC feature user switch" VALUE 0xb0000f51 /* @ECU_Address@KbDCSN_lcc_usr_switch@ */ Scalar_BOOLEAN 0 DCSN_subsystem_integrated_CM_boolean 0 1 /end CHARACTERISTIC
/begin CHARACTERISTIC KbDCSN_lcw_usr_switch "LCW feature user switch" VALUE 0xb0000f50 /* @ECU_Address@KbDCSN_lcw_usr_switch@ */ Scalar_BOOLEAN 0 DCSN_subsystem_integrated_CM_boolean 0 1 /end CHARACTERISTIC
/begin CHARACTERISTIC KbDCSN_ldw_usr_switch "LDW feature user switch" VALUE 0x70004222 /* @ECU_Address@KbDCSN_ldw_usr_switch@ */ Scalar_BOOLEAN 0 DCSN_subsystem_integrated_CM_boolean 0 1 /end CHARACTERISTIC
/begin CHARACTERISTIC KbDCSN_lka_usr_switch "LKA feature user switch" VALUE 0x70004220 /* @ECU_Address@KbDCSN_lka_usr_switch@ */ Scalar_BOOLEAN 0 DCSN_subsystem_integrated_CM_boolean 0 1 /end CHARACTERISTIC
/begin CHARACTERISTIC KbDCSN_rcta_usr_switch "RCTA feature user switch" VALUE 0xb0000f4e /* @ECU_Address@KbDCSN_rcta_usr_switch@ */ Scalar_BOOLEAN 0 DCSN_subsystem_integrated_CM_boolean 0 1 /end CHARACTERISTIC
/begin CHARACTERISTIC KbDCSN_use_EgmoLinearSpeed "0 = Use vehicle CAN velocity
      1 = Use egmo linear velocity" VALUE 0xb0000f4b /* @ECU_Address@KbDCSN_use_EgmoLinearSpeed@ */ Scalar_BOOLEAN 0 DCSN_subsystem_integrated_CM_boolean 0 1 /end CHARACTERISTIC
/begin CHARACTERISTIC KbDCSN_use_EgmoReadyFlag "0 = use calibration to output EGMO ready flag
      1 = use EGMO ready flag" VALUE 0x70004214 /* @ECU_Address@KbDCSN_use_EgmoReadyFlag@ */ Scalar_BOOLEAN 0 DCSN_subsystem_integrated_CM_boolean 0 1 /end CHARACTERISTIC
/begin CHARACTERISTIC KbDCSN_use_MpfuReadyFlag "0 = use calibration to output MPFU ready flag
      1 = use MPFU ready flag" VALUE 0x70004213 /* @ECU_Address@KbDCSN_use_MpfuReadyFlag@ */ Scalar_BOOLEAN 0 DCSN_subsystem_integrated_CM_boolean 0 1 /end CHARACTERISTIC
/begin CHARACTERISTIC KbDCSN_use_SLEW_override_logic "0 = disable override logic in SLEW
      1 = enable override logic in SLEW
      " VALUE 0xb0000f4a /* @ECU_Address@KbDCSN_use_SLEW_override_logic@ */ Scalar_BOOLEAN 0 DCSN_subsystem_integrated_CM_boolean 0 1 /end CHARACTERISTIC
/begin CHARACTERISTIC KbDCSN_use_SLEW_switch_control_mode "0 = Use normal control mode logic
      1 = Use driver switch as control mode activated" VALUE 0x70004212 /* @ECU_Address@KbDCSN_use_SLEW_switch_control_mode@ */ Scalar_BOOLEAN 0 DCSN_subsystem_integrated_CM_boolean 0 1 /end CHARACTERISTIC
/begin CHARACTERISTIC KbDCSN_use_faw_l4_logic "0 = use jac l3 logic
      1 = use faw l4 logic" VALUE 0x70004210 /* @ECU_Address@KbDCSN_use_faw_l4_logic@ */ Scalar_BOOLEAN 0 DCSN_subsystem_integrated_CM_boolean 0 1 /end CHARACTERISTIC
/begin CHARACTERISTIC KbDCSN_use_vehicle_activate_switch "0 = use calibration activate switch
      1 = use vehicle activate switch" VALUE 0xb0000f48 /* @ECU_Address@KbDCSN_use_vehicle_activate_switch@ */ Scalar_BOOLEAN 0 DCSN_subsystem_integrated_CM_boolean 0 1 /end CHARACTERISTIC
/begin AXIS_PTS KaAEBS_AXIS_Veh_Speed_vec "" 0x70101870 /* @ECU_Address@KaAEBS_AXIS_Veh_Speed_vec@ */ VfAEBS_veh_speed_used Lookup1D_X_FLOAT32_IEEE 0 AEBS_subsystem_integrated_CM_single 9 -3.4E+38 3.4E+38 /end AXIS_PTS
/begin AXIS_PTS KaAEBS_AXIS_DeltaSpeed_Vip "" 0x70101914 /* @ECU_Address@KaAEBS_AXIS_DeltaSpeed_Vip@ */ NO_INPUT_QUANTITY Lookup1D_X_FLOAT32_IEEE 0 AEBS_subsystem_integrated_CM_single 13 -3.4E+38 3.4E+38 /end AXIS_PTS
/begin AXIS_PTS KaAEBS_AXIS_Veh_Curvature_vec "" 0x70101894 /* @ECU_Address@KaAEBS_AXIS_Veh_Curvature_vec@ */ NO_INPUT_QUANTITY Lookup1D_X_FLOAT32_IEEE 0 AEBS_subsystem_integrated_CM_single 10 -3.4E+38 3.4E+38 /end AXIS_PTS
/begin AXIS_PTS KaAEBS_AXIS_NearestPointX_vec "" 0x701018e8 /* @ECU_Address@KaAEBS_AXIS_NearestPointX_vec@ */ NO_INPUT_QUANTITY Lookup1D_X_FLOAT32_IEEE 0 AEBS_subsystem_integrated_CM_single 11 -3.4E+38 3.4E+38 /end AXIS_PTS
/begin AXIS_PTS KaAEBS_AXIS_NearestPointY_vec "" 0x701018bc /* @ECU_Address@KaAEBS_AXIS_NearestPointY_vec@ */ NO_INPUT_QUANTITY Lookup1D_X_FLOAT32_IEEE 0 AEBS_subsystem_integrated_CM_single 11 -3.4E+38 3.4E+38 /end AXIS_PTS
/begin MEASUREMENT VfAEBS_Pre_BrakeActiveTTCThreshold "" FLOAT32_IEEE AEBS_subsystem_integrated_CM_single 0 0 -3.4E+38 3.4E+38 ECU_ADDRESS 0xb0002978 /* @ECU_Address@VfAEBS_Pre_BrakeActiveTTCThreshold@ */ /end MEASUREMENT
/begin MEASUREMENT VfAEBS_Partial_BrakeActiveTTCThreshold "" FLOAT32_IEEE AEBS_subsystem_integrated_CM_single 0 0 -3.4E+38 3.4E+38 ECU_ADDRESS 0xb0002974 /* @ECU_Address@VfAEBS_Partial_BrakeActiveTTCThreshold@ */ /end MEASUREMENT
/begin MEASUREMENT VfAEBS_v_obj_absolute_speed "" FLOAT32_IEEE AEBS_subsystem_integrated_CM_single 0 0 -3.4E+38 3.4E+38 ECU_ADDRESS 0xb0002970 /* @ECU_Address@VfAEBS_v_obj_absolute_speed@ */ /end MEASUREMENT
/begin MEASUREMENT VfAEBS_a_obj_absolute_acc "" FLOAT32_IEEE AEBS_subsystem_integrated_CM_single 0 0 -3.4E+38 3.4E+38 ECU_ADDRESS 0xb000296c /* @ECU_Address@VfAEBS_a_obj_absolute_acc@ */ /end MEASUREMENT
/begin MEASUREMENT VfAEBS_areq_withoutDelay_UrgentBrk "" FLOAT32_IEEE AEBS_subsystem_integrated_CM_single 0 0 -3.4E+38 3.4E+38 ECU_ADDRESS 0xb0002968 /* @ECU_Address@VfAEBS_areq_withoutDelay_UrgentBrk@ */ /end MEASUREMENT
/begin MEASUREMENT VfAEBS_areq_withoutDelay "" FLOAT32_IEEE AEBS_subsystem_integrated_CM_single 0 0 -3.4E+38 3.4E+38 ECU_ADDRESS 0xb0002964 /* @ECU_Address@VfAEBS_areq_withoutDelay@ */ /end MEASUREMENT
/begin MEASUREMENT VfAEBS_dis_delay "" FLOAT32_IEEE AEBS_subsystem_integrated_CM_single 0 0 -3.4E+38 3.4E+38 ECU_ADDRESS 0xb0002960 /* @ECU_Address@VfAEBS_dis_delay@ */ /end MEASUREMENT
/begin MEASUREMENT VfAEBS_dis_safe_used "" FLOAT32_IEEE AEBS_subsystem_integrated_CM_single 0 0 -3.4E+38 3.4E+38 ECU_ADDRESS 0xb000295c /* @ECU_Address@VfAEBS_dis_safe_used@ */ /end MEASUREMENT
/begin MEASUREMENT VfAEBS_areq "" FLOAT32_IEEE AEBS_subsystem_integrated_CM_single 0 0 -3.4E+38 3.4E+38 ECU_ADDRESS 0xb0002958 /* @ECU_Address@VfAEBS_areq@ */ /end MEASUREMENT
/begin MEASUREMENT VfAEBS_AEB_acceleration_af_filter "" FLOAT32_IEEE AEBS_subsystem_integrated_CM_single 0 0 -3.4E+38 3.4E+38 ECU_ADDRESS 0xb0002954 /* @ECU_Address@VfAEBS_AEB_acceleration_af_filter@ */ /end MEASUREMENT
/begin MEASUREMENT VfAEBS_AEB_acceleration_bf_limit "" FLOAT32_IEEE AEBS_subsystem_integrated_CM_single 0 0 -3.4E+38 3.4E+38 ECU_ADDRESS 0xb0002950 /* @ECU_Address@VfAEBS_AEB_acceleration_bf_limit@ */ /end MEASUREMENT
/begin MEASUREMENT VfAEBS_AEB_accReq_beforeSend "" FLOAT32_IEEE AEBS_subsystem_integrated_CM_single 0 0 -3.4E+38 3.4E+38 ECU_ADDRESS 0xb000294c /* @ECU_Address@VfAEBS_AEB_accReq_beforeSend@ */ /end MEASUREMENT
/begin MEASUREMENT VfAEBS_FCW_enabled "" UBYTE AEBS_subsystem_integrated_CM_boolean 0 0 0 1 ECU_ADDRESS 0xb00028a7 /* @ECU_Address@VfAEBS_FCW_enabled@ */ /end MEASUREMENT
/begin MEASUREMENT VbAEBS_FCW_inhbt_AccPedPos "" UBYTE AEBS_subsystem_integrated_CM_boolean 0 0 0 1 ECU_ADDRESS 0xb00028a6 /* @ECU_Address@VbAEBS_FCW_inhbt_AccPedPos@ */ /end MEASUREMENT
/begin MEASUREMENT VbAEBS_FCW_inhbt_VehAcc "" UBYTE AEBS_subsystem_integrated_CM_boolean 0 0 0 1 ECU_ADDRESS 0xb00028a5 /* @ECU_Address@VbAEBS_FCW_inhbt_VehAcc@ */ /end MEASUREMENT
/begin MEASUREMENT VbAEBS_FCW_inhbt_DeactTime "" UBYTE AEBS_subsystem_integrated_CM_boolean 0 0 0 1 ECU_ADDRESS 0xb00028a4 /* @ECU_Address@VbAEBS_FCW_inhbt_DeactTime@ */ /end MEASUREMENT
/begin MEASUREMENT VbAEBS_FCW_inhibit "" UBYTE AEBS_subsystem_integrated_CM_boolean 0 0 0 1 ECU_ADDRESS 0xb00028a3 /* @ECU_Address@VbAEBS_FCW_inhibit@ */ /end MEASUREMENT
/begin MEASUREMENT VfAEBS_FCWLev1_active "" UBYTE AEBS_subsystem_integrated_CM_boolean 0 0 0 1 ECU_ADDRESS 0xb00028a2 /* @ECU_Address@VfAEBS_FCWLev1_active@ */ /end MEASUREMENT
/begin MEASUREMENT VfAEBS_FCWLev1_dactive "" UBYTE AEBS_subsystem_integrated_CM_boolean 0 0 0 1 ECU_ADDRESS 0xb00028a1 /* @ECU_Address@VfAEBS_FCWLev1_dactive@ */ /end MEASUREMENT
/begin MEASUREMENT VfAEBS_FCWLev2_active "" UBYTE AEBS_subsystem_integrated_CM_boolean 0 0 0 1 ECU_ADDRESS 0xb00028a0 /* @ECU_Address@VfAEBS_FCWLev2_active@ */ /end MEASUREMENT
/begin MEASUREMENT VfAEBS_FCWLev2_dactive "" UBYTE AEBS_subsystem_integrated_CM_boolean 0 0 0 1 ECU_ADDRESS 0xb000289f /* @ECU_Address@VfAEBS_FCWLev2_dactive@ */ /end MEASUREMENT
/begin MEASUREMENT VfAEBS_FCWLev3_active "" UBYTE AEBS_subsystem_integrated_CM_boolean 0 0 0 1 ECU_ADDRESS 0xb000289e /* @ECU_Address@VfAEBS_FCWLev3_active@ */ /end MEASUREMENT
/begin MEASUREMENT VfAEBS_FCWLev3_dactive "" UBYTE AEBS_subsystem_integrated_CM_boolean 0 0 0 1 ECU_ADDRESS 0xb000289d /* @ECU_Address@VfAEBS_FCWLev3_dactive@ */ /end MEASUREMENT
/begin MEASUREMENT VfAEBS_FCW_disabled "" UBYTE AEBS_subsystem_integrated_CM_boolean 0 0 0 1 ECU_ADDRESS 0xb000289c /* @ECU_Address@VfAEBS_FCW_disabled@ */ /end MEASUREMENT
/begin MEASUREMENT VfAEBS_FCW_deacitve "" UBYTE AEBS_subsystem_integrated_CM_boolean 0 0 0 1 ECU_ADDRESS 0xb000289b /* @ECU_Address@VfAEBS_FCW_deacitve@ */ /end MEASUREMENT
/begin MEASUREMENT VfAEBS_Obj_IsVRU "" UBYTE AEBS_subsystem_integrated_CM_boolean 0 0 0 1 ECU_ADDRESS 0xb0002899 /* @ECU_Address@VfAEBS_Obj_IsVRU@ */ /end MEASUREMENT
/begin MEASUREMENT VfAEBS_use_VRU_Calibration "" UBYTE AEBS_subsystem_integrated_CM_boolean 0 0 0 1 ECU_ADDRESS 0xb0002898 /* @ECU_Address@VfAEBS_use_VRU_Calibration@ */ /end MEASUREMENT
/begin MEASUREMENT VfAEBS_LowSpeed_InhibitAEB "" UBYTE AEBS_subsystem_integrated_CM_boolean 0 0 0 1 ECU_ADDRESS 0xb0002897 /* @ECU_Address@VfAEBS_LowSpeed_InhibitAEB@ */ /end MEASUREMENT
/begin MEASUREMENT VfAEBS_HighSpeed_InhibitAEB "" UBYTE AEBS_subsystem_integrated_CM_boolean 0 0 0 1 ECU_ADDRESS 0xb0002896 /* @ECU_Address@VfAEBS_HighSpeed_InhibitAEB@ */ /end MEASUREMENT
/begin MEASUREMENT VfAEBS_VehDeltaSpeed_InhibitAEB "" UBYTE AEBS_subsystem_integrated_CM_boolean 0 0 0 1 ECU_ADDRESS 0xb0002895 /* @ECU_Address@VfAEBS_VehDeltaSpeed_InhibitAEB@ */ /end MEASUREMENT
/begin MEASUREMENT VfAEBS_Speed_InhibitAEB "" UBYTE AEBS_subsystem_integrated_CM_boolean 0 0 0 1 ECU_ADDRESS 0xb0002894 /* @ECU_Address@VfAEBS_Speed_InhibitAEB@ */ /end MEASUREMENT
/begin MEASUREMENT VfAEBS_Gear_InhibitAEB "" UBYTE AEBS_subsystem_integrated_CM_boolean 0 0 0 1 ECU_ADDRESS 0xb0002893 /* @ECU_Address@VfAEBS_Gear_InhibitAEB@ */ /end MEASUREMENT
/begin MEASUREMENT VbAEBS_AEB_inhbt_DeactTime "" UBYTE AEBS_subsystem_integrated_CM_boolean 0 0 0 1 ECU_ADDRESS 0xb0002892 /* @ECU_Address@VbAEBS_AEB_inhbt_DeactTime@ */ /end MEASUREMENT
/begin MEASUREMENT VbAEBS_AEB_inhbt_AccPdl "" UBYTE AEBS_subsystem_integrated_CM_boolean 0 0 0 1 ECU_ADDRESS 0xb0002891 /* @ECU_Address@VbAEBS_AEB_inhbt_AccPdl@ */ /end MEASUREMENT
/begin MEASUREMENT VbAEBS_AEB_inhbt_StrAngRte "" UBYTE AEBS_subsystem_integrated_CM_boolean 0 0 0 1 ECU_ADDRESS 0xb0002890 /* @ECU_Address@VbAEBS_AEB_inhbt_StrAngRte@ */ /end MEASUREMENT
/begin MEASUREMENT VbAEBS_AEB_inhbt_veh_acc "" UBYTE AEBS_subsystem_integrated_CM_boolean 0 0 0 1 ECU_ADDRESS 0xb000288f /* @ECU_Address@VbAEBS_AEB_inhbt_veh_acc@ */ /end MEASUREMENT
/begin MEASUREMENT VfAEBS_AEB_inhibit "" UBYTE AEBS_subsystem_integrated_CM_boolean 0 0 0 1 ECU_ADDRESS 0xb000288e /* @ECU_Address@VfAEBS_AEB_inhibit@ */ /end MEASUREMENT
/begin MEASUREMENT VbAEBS_PreBrk_inhbt_deactTime "" UBYTE AEBS_subsystem_integrated_CM_boolean 0 0 0 1 ECU_ADDRESS 0xb000288d /* @ECU_Address@VbAEBS_PreBrk_inhbt_deactTime@ */ /end MEASUREMENT
/begin MEASUREMENT VbAEBS_preBrake_inhibit "" UBYTE AEBS_subsystem_integrated_CM_boolean 0 0 0 1 ECU_ADDRESS 0xb000288c /* @ECU_Address@VbAEBS_preBrake_inhibit@ */ /end MEASUREMENT
/begin MEASUREMENT VfAEBS_preBrake_active "" UBYTE AEBS_subsystem_integrated_CM_boolean 0 0 0 1 ECU_ADDRESS 0xb000288b /* @ECU_Address@VfAEBS_preBrake_active@ */ /end MEASUREMENT
/begin MEASUREMENT VfAEBS_partialBrk_active "" UBYTE AEBS_subsystem_integrated_CM_boolean 0 0 0 1 ECU_ADDRESS 0xb000288a /* @ECU_Address@VfAEBS_partialBrk_active@ */ /end MEASUREMENT
/begin MEASUREMENT VfAEBS_fullBrk_active "" UBYTE AEBS_subsystem_integrated_CM_boolean 0 0 0 1 ECU_ADDRESS 0xb0002889 /* @ECU_Address@VfAEBS_fullBrk_active@ */ /end MEASUREMENT
/begin MEASUREMENT VbAEBS_Deactive_R_NoVIP "" UBYTE AEBS_subsystem_integrated_CM_boolean 0 0 0 1 ECU_ADDRESS 0xb0002888 /* @ECU_Address@VbAEBS_Deactive_R_NoVIP@ */ /end MEASUREMENT
/begin MEASUREMENT VbAEBS_vipCloseLost "" UBYTE AEBS_subsystem_integrated_CM_boolean 0 0 0 1 ECU_ADDRESS 0xb0002887 /* @ECU_Address@VbAEBS_vipCloseLost@ */ /end MEASUREMENT
/begin MEASUREMENT VbAEBS_vipStationary "" UBYTE AEBS_subsystem_integrated_CM_boolean 0 0 0 1 ECU_ADDRESS 0xb0002886 /* @ECU_Address@VbAEBS_vipStationary@ */ /end MEASUREMENT
/begin MEASUREMENT VbAEBS_Deactive_R_VIPChanged "" UBYTE AEBS_subsystem_integrated_CM_boolean 0 0 0 1 ECU_ADDRESS 0xb0002885 /* @ECU_Address@VbAEBS_Deactive_R_VIPChanged@ */ /end MEASUREMENT
/begin MEASUREMENT VfAEBS_DeniedDueToSpdRed "" UBYTE AEBS_subsystem_integrated_CM_boolean 0 0 0 1 ECU_ADDRESS 0xb0002884 /* @ECU_Address@VfAEBS_DeniedDueToSpdRed@ */ /end MEASUREMENT
/begin MEASUREMENT VfAEBS_DeniedDueToTimeBrake "" UBYTE AEBS_subsystem_integrated_CM_boolean 0 0 0 1 ECU_ADDRESS 0xb0002883 /* @ECU_Address@VfAEBS_DeniedDueToTimeBrake@ */ /end MEASUREMENT
/begin MEASUREMENT VbAEBS_Deactive_R_Confdnc "" UBYTE AEBS_subsystem_integrated_CM_boolean 0 0 0 1 ECU_ADDRESS 0xb0002882 /* @ECU_Address@VbAEBS_Deactive_R_Confdnc@ */ /end MEASUREMENT
/begin MEASUREMENT VbAEBS_deactive_preBrk_timeOut "" UBYTE AEBS_subsystem_integrated_CM_boolean 0 0 0 1 ECU_ADDRESS 0xb0002881 /* @ECU_Address@VbAEBS_deactive_preBrk_timeOut@ */ /end MEASUREMENT
/begin MEASUREMENT VfAEBS_AEB_enabled "" UBYTE AEBS_subsystem_integrated_CM_boolean 0 0 0 1 ECU_ADDRESS 0xb0002880 /* @ECU_Address@VfAEBS_AEB_enabled@ */ /end MEASUREMENT
/begin MEASUREMENT VfAEBS_preBrake_dactive "" UBYTE AEBS_subsystem_integrated_CM_boolean 0 0 0 1 ECU_ADDRESS 0xb000287f /* @ECU_Address@VfAEBS_preBrake_dactive@ */ /end MEASUREMENT
/begin MEASUREMENT VfAEBS_partialBrk_dactive "" UBYTE AEBS_subsystem_integrated_CM_boolean 0 0 0 1 ECU_ADDRESS 0xb000287e /* @ECU_Address@VfAEBS_partialBrk_dactive@ */ /end MEASUREMENT
/begin MEASUREMENT VfAEBS_fullBrk_dactive "" UBYTE AEBS_subsystem_integrated_CM_boolean 0 0 0 1 ECU_ADDRESS 0xb000287d /* @ECU_Address@VfAEBS_fullBrk_dactive@ */ /end MEASUREMENT
/begin MEASUREMENT VfAEBS_AEB_disabled "" UBYTE AEBS_subsystem_integrated_CM_boolean 0 0 0 1 ECU_ADDRESS 0xb000287c /* @ECU_Address@VfAEBS_AEB_disabled@ */ /end MEASUREMENT
/begin MEASUREMENT VfAEBS_veh_standstill "" UBYTE AEBS_subsystem_integrated_CM_boolean 0 0 0 1 ECU_ADDRESS 0xb000287b /* @ECU_Address@VfAEBS_veh_standstill@ */ /end MEASUREMENT
/begin MEASUREMENT VfAEBS_Vehicle_isInHighSpeed "" UBYTE AEBS_subsystem_integrated_CM_boolean 0 0 0 1 ECU_ADDRESS 0xb000287a /* @ECU_Address@VfAEBS_Vehicle_isInHighSpeed@ */ /end MEASUREMENT
/begin MEASUREMENT VfAEBS_AEB_deactive "" UBYTE AEBS_subsystem_integrated_CM_boolean 0 0 0 1 ECU_ADDRESS 0xb0002879 /* @ECU_Address@VfAEBS_AEB_deactive@ */ /end MEASUREMENT
/begin MEASUREMENT VbAEBS_Deactive_R_HighTTC "" UBYTE AEBS_subsystem_integrated_CM_boolean 0 0 0 1 ECU_ADDRESS 0xb0002878 /* @ECU_Address@VbAEBS_Deactive_R_HighTTC@ */ /end MEASUREMENT
/begin MEASUREMENT VfARBT_steer_req_strwhl_angle "final steer angle req (as deg) after arbitration and saturation" FLOAT32_IEEE ARBT_subsystem_integrated_CM_single_deg 0 0 -3.4E+38 3.4E+38 ECU_ADDRESS 0xb0002f94 /* @ECU_Address@VfARBT_steer_req_strwhl_angle@ */ /end MEASUREMENT
/begin MEASUREMENT VfARBT_steer_req_strwhl_angle_raw "raw steer angle request after arbitration before saturation" FLOAT32_IEEE ARBT_subsystem_integrated_CM_single_deg 0 0 -3.4E+38 3.4E+38 ECU_ADDRESS 0xb0002f90 /* @ECU_Address@VfARBT_steer_req_strwhl_angle_raw@ */ /end MEASUREMENT
/begin MEASUREMENT VfARBT_steer_req_strwhl_torque "" FLOAT32_IEEE ARBT_subsystem_integrated_CM_single_Nm 0 0 -3.4E+38 3.4E+38 ECU_ADDRESS 0xb0002f8c /* @ECU_Address@VfARBT_steer_req_strwhl_torque@ */ /end MEASUREMENT
/begin MEASUREMENT VfARBT_power_req_lon_a_raw "raw power request after arbitration before saturation" FLOAT32_IEEE ARBT_subsystem_integrated_CM_single_m_s2 0 0 -3.4E+38 3.4E+38 ECU_ADDRESS 0xb0002f88 /* @ECU_Address@VfARBT_power_req_lon_a_raw@ */ /end MEASUREMENT
/begin MEASUREMENT VfARBT_power_req_lon_a "final power req (as m/s2) after arbitration and saturation" FLOAT32_IEEE ARBT_subsystem_integrated_CM_single_m_s2 0 0 -3.4E+38 3.4E+38 ECU_ADDRESS 0xb0002f84 /* @ECU_Address@VfARBT_power_req_lon_a@ */ /end MEASUREMENT
/begin MEASUREMENT VfARBT_power_req_torque "" FLOAT32_IEEE ARBT_subsystem_integrated_CM_single 0 0 -3.4E+38 3.4E+38 ECU_ADDRESS 0xb0002f80 /* @ECU_Address@VfARBT_power_req_torque@ */ /end MEASUREMENT
/begin MEASUREMENT VfARBT_brake_req_lon_a_raw "raw brake request after arbitration before saturation" FLOAT32_IEEE ARBT_subsystem_integrated_CM_single_m_s2 0 0 -3.4E+38 3.4E+38 ECU_ADDRESS 0xb0002f7c /* @ECU_Address@VfARBT_brake_req_lon_a_raw@ */ /end MEASUREMENT
/begin MEASUREMENT VfARBT_brake_req_lon_a "final brake req (as m/s2) after arbitration and saturation" FLOAT32_IEEE ARBT_subsystem_integrated_CM_single_m_s2 0 0 -3.4E+38 3.4E+38 ECU_ADDRESS 0xb0002f78 /* @ECU_Address@VfARBT_brake_req_lon_a@ */ /end MEASUREMENT
/begin MEASUREMENT VfARBT_steer_req_mode "0 = acceleration mode
      1 = torque mode" UBYTE ARBT_subsystem_integrated_CM_uint8 0 0 0 255 ECU_ADDRESS 0xb0002f74 /* @ECU_Address@VfARBT_steer_req_mode@ */ /end MEASUREMENT
/begin MEASUREMENT VfARBT_power_req_mode "0 = steering wheel angle
      1 = steering wheel torque" UBYTE ARBT_subsystem_integrated_CM_uint8 0 0 0 255 ECU_ADDRESS 0xb0002f73 /* @ECU_Address@VfARBT_power_req_mode@ */ /end MEASUREMENT
/begin MEASUREMENT VfARBT_gear_pos_req "Gear Pos Definition
      0->N
      1->D
      13->R
      14->P
      15->Invalid" UBYTE ARBT_subsystem_integrated_CM_uint8 0 0 0 255 ECU_ADDRESS 0xb0002f72 /* @ECU_Address@VfARBT_gear_pos_req@ */ /end MEASUREMENT
/begin MEASUREMENT VfARBT_gear_ctrl_state "" UBYTE ARBT_subsystem_integrated_CM_uint8 0 0 0 255 ECU_ADDRESS 0xb0002f71 /* @ECU_Address@VfARBT_gear_ctrl_state@ */ /end MEASUREMENT
/begin MEASUREMENT VbARBT_EPB_ctrl_mode "" UBYTE ARBT_subsystem_integrated_CM_uint8 0 0 0 255 ECU_ADDRESS 0xb0002f70 /* @ECU_Address@VbARBT_EPB_ctrl_mode@ */ /end MEASUREMENT
/begin MEASUREMENT VbARBT_FCW_level_three "" UBYTE ARBT_subsystem_integrated_CM_boolean 0 0 0 1 ECU_ADDRESS 0xb0002f6f /* @ECU_Address@VbARBT_FCW_level_three@ */ /end MEASUREMENT
/begin MEASUREMENT VbARBT_FCW_level_one "" UBYTE ARBT_subsystem_integrated_CM_boolean 0 0 0 1 ECU_ADDRESS 0xb0002f6e /* @ECU_Address@VbARBT_FCW_level_one@ */ /end MEASUREMENT
/begin MEASUREMENT VbARBT_FCW_level_two "" UBYTE ARBT_subsystem_integrated_CM_boolean 0 0 0 1 ECU_ADDRESS 0xb0002f6d /* @ECU_Address@VbARBT_FCW_level_two@ */ /end MEASUREMENT
/begin MEASUREMENT VbARBT_LDW_left "" UBYTE ARBT_subsystem_integrated_CM_boolean 0 0 0 1 ECU_ADDRESS 0xb0002f6c /* @ECU_Address@VbARBT_LDW_left@ */ /end MEASUREMENT
/begin MEASUREMENT VbARBT_BSD_left_low_raw "" UBYTE ARBT_subsystem_integrated_CM_boolean 0 0 0 1 ECU_ADDRESS 0xb0002f6b /* @ECU_Address@VbARBT_BSD_left_low_raw@ */ /end MEASUREMENT
/begin MEASUREMENT VbARBT_BSD_right_low_raw "" UBYTE ARBT_subsystem_integrated_CM_boolean 0 0 0 1 ECU_ADDRESS 0xb0002f6a /* @ECU_Address@VbARBT_BSD_right_low_raw@ */ /end MEASUREMENT
/begin MEASUREMENT VbARBT_LCA_left_low_raw "" UBYTE ARBT_subsystem_integrated_CM_boolean 0 0 0 1 ECU_ADDRESS 0xb0002f69 /* @ECU_Address@VbARBT_LCA_left_low_raw@ */ /end MEASUREMENT
/begin MEASUREMENT VbARBT_LCA_right_low_raw "" UBYTE ARBT_subsystem_integrated_CM_boolean 0 0 0 1 ECU_ADDRESS 0xb0002f68 /* @ECU_Address@VbARBT_LCA_right_low_raw@ */ /end MEASUREMENT
/begin MEASUREMENT VbARBT_warn_lcw_left_req "" UBYTE ARBT_subsystem_integrated_CM_boolean 0 0 0 1 ECU_ADDRESS 0xb0002f67 /* @ECU_Address@VbARBT_warn_lcw_left_req@ */ /end MEASUREMENT
/begin MEASUREMENT VbARBT_LDW_right "" UBYTE ARBT_subsystem_integrated_CM_boolean 0 0 0 1 ECU_ADDRESS 0xb0002f66 /* @ECU_Address@VbARBT_LDW_right@ */ /end MEASUREMENT
/begin MEASUREMENT VbARBT_BSD_left_high_raw "" UBYTE ARBT_subsystem_integrated_CM_boolean 0 0 0 1 ECU_ADDRESS 0xb0002f65 /* @ECU_Address@VbARBT_BSD_left_high_raw@ */ /end MEASUREMENT
/begin MEASUREMENT VbARBT_LCA_left_high_raw "" UBYTE ARBT_subsystem_integrated_CM_boolean 0 0 0 1 ECU_ADDRESS 0xb0002f64 /* @ECU_Address@VbARBT_LCA_left_high_raw@ */ /end MEASUREMENT
/begin MEASUREMENT VbARBT_BSD_right_high_raw "" UBYTE ARBT_subsystem_integrated_CM_boolean 0 0 0 1 ECU_ADDRESS 0xb0002f63 /* @ECU_Address@VbARBT_BSD_right_high_raw@ */ /end MEASUREMENT
/begin MEASUREMENT VbARBT_LCA_right_high_raw "" UBYTE ARBT_subsystem_integrated_CM_boolean 0 0 0 1 ECU_ADDRESS 0xb0002f62 /* @ECU_Address@VbARBT_LCA_right_high_raw@ */ /end MEASUREMENT
/begin MEASUREMENT VbARBT_FCW_level_four "" UBYTE ARBT_subsystem_integrated_CM_boolean 0 0 0 1 ECU_ADDRESS 0xb0002f61 /* @ECU_Address@VbARBT_FCW_level_four@ */ /end MEASUREMENT
/begin MEASUREMENT VbARBT_FCW_level_five "" UBYTE ARBT_subsystem_integrated_CM_boolean 0 0 0 1 ECU_ADDRESS 0xb0002f60 /* @ECU_Address@VbARBT_FCW_level_five@ */ /end MEASUREMENT
/begin MEASUREMENT VbARBT_warn_lcw_right_req "" UBYTE ARBT_subsystem_integrated_CM_boolean 0 0 0 1 ECU_ADDRESS 0xb0002f5f /* @ECU_Address@VbARBT_warn_lcw_right_req@ */ /end MEASUREMENT
/begin MEASUREMENT VbARBT_steer_ctrl_enbl_to_comm "" UBYTE ARBT_subsystem_integrated_CM_boolean 0 0 0 1 ECU_ADDRESS 0xb0002f5e /* @ECU_Address@VbARBT_steer_ctrl_enbl_to_comm@ */ /end MEASUREMENT
/begin MEASUREMENT VbARBT_aeb_triggered_flag "Flag of whether AEB is triggered" UBYTE ARBT_subsystem_integrated_CM_boolean 0 0 0 1 ECU_ADDRESS 0xb0002f5d /* @ECU_Address@VbARBT_aeb_triggered_flag@ */ /end MEASUREMENT
/begin MEASUREMENT VbARBT_missed_aeb_flag "Flag of whether a missed aeb event is detected" UBYTE ARBT_subsystem_integrated_CM_boolean 0 0 0 1 ECU_ADDRESS 0xb0002f5c /* @ECU_Address@VbARBT_missed_aeb_flag@ */ /end MEASUREMENT
/begin MEASUREMENT VbARBT_false_aeb_flag "Flag of whether a false AEB event is detected
      " UBYTE ARBT_subsystem_integrated_CM_boolean 0 0 0 1 ECU_ADDRESS 0xb0002f5b /* @ECU_Address@VbARBT_false_aeb_flag@ */ /end MEASUREMENT
/begin MEASUREMENT VbARBT_driver_hard_brake_flag "Flag of whether driver is taking a hard brake" UBYTE ARBT_subsystem_integrated_CM_boolean 0 0 0 1 ECU_ADDRESS 0xb0002f5a /* @ECU_Address@VbARBT_driver_hard_brake_flag@ */ /end MEASUREMENT
/begin MEASUREMENT VbARBT_power_ctrl_enbl_to_comm "" UBYTE ARBT_subsystem_integrated_CM_boolean 0 0 0 1 ECU_ADDRESS 0xb0002f59 /* @ECU_Address@VbARBT_power_ctrl_enbl_to_comm@ */ /end MEASUREMENT
/begin MEASUREMENT VbARBT_brake_ctrl_enbl_to_comm "" UBYTE ARBT_subsystem_integrated_CM_boolean 0 0 0 1 ECU_ADDRESS 0xb0002f58 /* @ECU_Address@VbARBT_brake_ctrl_enbl_to_comm@ */ /end MEASUREMENT
/begin MEASUREMENT VbARBT_EPB_ctrl_enbl_to_comm "" UBYTE ARBT_subsystem_integrated_CM_boolean 0 0 0 1 ECU_ADDRESS 0xb0002f57 /* @ECU_Address@VbARBT_EPB_ctrl_enbl_to_comm@ */ /end MEASUREMENT
/begin MEASUREMENT VbARBT_vehicle_standstill "" UBYTE ARBT_subsystem_integrated_CM_boolean 0 0 0 1 ECU_ADDRESS 0xb0002f56 /* @ECU_Address@VbARBT_vehicle_standstill@ */ /end MEASUREMENT
/begin MEASUREMENT VbARBT_EPB_switch_request "1 = clamping request
      0 = release request" UBYTE ARBT_subsystem_integrated_CM_boolean 0 0 0 1 ECU_ADDRESS 0xb0002f55 /* @ECU_Address@VbARBT_EPB_switch_request@ */ /end MEASUREMENT
/begin MEASUREMENT VbARBT_gear_ctrl_enbl_to_comm "" UBYTE ARBT_subsystem_integrated_CM_boolean 0 0 0 1 ECU_ADDRESS 0xb0002f54 /* @ECU_Address@VbARBT_gear_ctrl_enbl_to_comm@ */ /end MEASUREMENT
/begin MEASUREMENT VbARBT_auto_hold_req "" UBYTE ARBT_subsystem_integrated_CM_boolean 0 0 0 1 ECU_ADDRESS 0xb0002f53 /* @ECU_Address@VbARBT_auto_hold_req@ */ /end MEASUREMENT
/begin MEASUREMENT VeARBT_steer_arbt_winner "" UBYTE ARBT_subsystem_integrated_CM_EnumARBT_arbitration_winner 0 0 0 6 ECU_ADDRESS 0xb0002f52 /* @ECU_Address@VeARBT_steer_arbt_winner@ */ /end MEASUREMENT
/begin MEASUREMENT VeARBT_power_arbt_winner "" UBYTE ARBT_subsystem_integrated_CM_EnumARBT_arbitration_winner 0 0 0 6 ECU_ADDRESS 0xb0002f51 /* @ECU_Address@VeARBT_power_arbt_winner@ */ /end MEASUREMENT
/begin MEASUREMENT VeARBT_brake_arbt_winner "" UBYTE ARBT_subsystem_integrated_CM_EnumARBT_arbitration_winner 0 0 0 6 ECU_ADDRESS 0xb0002f50 /* @ECU_Address@VeARBT_brake_arbt_winner@ */ /end MEASUREMENT
/begin MEASUREMENT VbHWIO_DriverModeComd "" UBYTE COMM_subsystem_integrated_CM_boolean 0 0 0 1 ECU_ADDRESS 0xb0004dda /* @ECU_Address@VbHWIO_DriverModeComd@ */ /end MEASUREMENT
/begin MEASUREMENT VbHWIO_LeftTurningLightState "" UBYTE COMM_subsystem_integrated_CM_boolean 0 0 0 1 ECU_ADDRESS 0xb0004dd9 /* @ECU_Address@VbHWIO_LeftTurningLightState@ */ /end MEASUREMENT
/begin MEASUREMENT VbHWIO_RightTurningLightState "" UBYTE COMM_subsystem_integrated_CM_boolean 0 0 0 1 ECU_ADDRESS 0xb0004dd8 /* @ECU_Address@VbHWIO_RightTurningLightState@ */ /end MEASUREMENT
/begin MEASUREMENT VfCOMM_Decs_Breake_Value "" FLOAT32_IEEE COMM_subsystem_integrated_CM_single 0 0 -3.4E+38 3.4E+38 ECU_ADDRESS 0xb0004b18 /* @ECU_Address@VfCOMM_Decs_Breake_Value@ */ /end MEASUREMENT
/begin MEASUREMENT VfCOMM_Decs_Acc_Value "" FLOAT32_IEEE COMM_subsystem_integrated_CM_single 0 0 -3.4E+38 3.4E+38 ECU_ADDRESS 0xb0004b14 /* @ECU_Address@VfCOMM_Decs_Acc_Value@ */ /end MEASUREMENT
/begin MEASUREMENT VfCOMM_Decs_SteeringAngle "" FLOAT32_IEEE COMM_subsystem_integrated_CM_single 0 0 -3.4E+38 3.4E+38 ECU_ADDRESS 0xb0004b10 /* @ECU_Address@VfCOMM_Decs_SteeringAngle@ */ /end MEASUREMENT
/begin MEASUREMENT VcCOMM_EPB_control_enable "EPB control enable flag." FLOAT32_IEEE COMM_subsystem_integrated_CM_single 0 0 -3.4E+38 3.4E+38 ECU_ADDRESS 0xb0004b0c /* @ECU_Address@VcCOMM_EPB_control_enable@ */ /end MEASUREMENT
/begin MEASUREMENT VcCOMM_EPB_switch_request "EPB Switch request. 0 = Release, 1 = Clamp." FLOAT32_IEEE COMM_subsystem_integrated_CM_single 0 0 -3.4E+38 3.4E+38 ECU_ADDRESS 0xb0004b08 /* @ECU_Address@VcCOMM_EPB_switch_request@ */ /end MEASUREMENT
/begin MEASUREMENT VfCOMM_req_pct_torque_raw "Power requested torque in percentage." FLOAT32_IEEE COMM_subsystem_integrated_CM_single 0 0 -3.4E+38 3.4E+38 ECU_ADDRESS 0xb0004b04 /* @ECU_Address@VfCOMM_req_pct_torque_raw@ */ /end MEASUREMENT
/begin MEASUREMENT VfCOMM_ADCU_BrakeDecelValue "" FLOAT32_IEEE COMM_subsystem_integrated_CM_single 0 0 -3.4E+38 3.4E+38 ECU_ADDRESS 0xb0004b00 /* @ECU_Address@VfCOMM_ADCU_BrakeDecelValue@ */ /end MEASUREMENT
/begin MEASUREMENT VfCOMM_ADCU_PowerAccelValue "" FLOAT32_IEEE COMM_subsystem_integrated_CM_single 0 0 -3.4E+38 3.4E+38 ECU_ADDRESS 0xb0004afc /* @ECU_Address@VfCOMM_ADCU_PowerAccelValue@ */ /end MEASUREMENT
/begin MEASUREMENT VfCOMM_ADCU_SteeringAngleValue "" FLOAT32_IEEE COMM_subsystem_integrated_CM_single 0 0 -3.4E+38 3.4E+38 ECU_ADDRESS 0xb0004af8 /* @ECU_Address@VfCOMM_ADCU_SteeringAngleValue@ */ /end MEASUREMENT
/begin MEASUREMENT VfCOMM_ADCU_TargetVehicleSpeed "" FLOAT32_IEEE COMM_subsystem_integrated_CM_single 0 0 -3.4E+38 3.4E+38 ECU_ADDRESS 0xb0004af4 /* @ECU_Address@VfCOMM_ADCU_TargetVehicleSpeed@ */ /end MEASUREMENT
/begin MEASUREMENT VfCOMM_ADCU_PowerTorqueValue "" FLOAT32_IEEE COMM_subsystem_integrated_CM_single 0 0 -3.4E+38 3.4E+38 ECU_ADDRESS 0xb0004af0 /* @ECU_Address@VfCOMM_ADCU_PowerTorqueValue@ */ /end MEASUREMENT
/begin MEASUREMENT VfCOMM_ADCU_BrakePressureValue "" FLOAT32_IEEE COMM_subsystem_integrated_CM_single 0 0 -3.4E+38 3.4E+38 ECU_ADDRESS 0xb0004aec /* @ECU_Address@VfCOMM_ADCU_BrakePressureValue@ */ /end MEASUREMENT
/begin MEASUREMENT VfCOMM_max_gas_pedal_EPB "" FLOAT32_IEEE COMM_subsystem_integrated_CM_single 0 0 -3.4E+38 3.4E+38 ECU_ADDRESS 0xb0004ae8 /* @ECU_Address@VfCOMM_max_gas_pedal_EPB@ */ /end MEASUREMENT
/begin MEASUREMENT VcCOMM_max_gas_pedal_EPB "" FLOAT32_IEEE COMM_subsystem_integrated_CM_single 0 0 -3.4E+38 3.4E+38 ECU_ADDRESS 0xb0004ae4 /* @ECU_Address@VcCOMM_max_gas_pedal_EPB@ */ /end MEASUREMENT
/begin MEASUREMENT VfCOMM_EPS_SteeringTorqueAct "" FLOAT32_IEEE COMM_subsystem_integrated_CM_single 0 0 -3.4E+38 3.4E+38 ECU_ADDRESS 0xb0004ae0 /* @ECU_Address@VfCOMM_EPS_SteeringTorqueAct@ */ /end MEASUREMENT
/begin MEASUREMENT VfCOMM_VCU_LongitudinalAcc "" FLOAT32_IEEE COMM_subsystem_integrated_CM_single 0 0 -3.4E+38 3.4E+38 ECU_ADDRESS 0xb0004adc /* @ECU_Address@VfCOMM_VCU_LongitudinalAcc@ */ /end MEASUREMENT
/begin MEASUREMENT VfCOMM_VCU_BrkPedPos "Brake pedal position." FLOAT32_IEEE COMM_subsystem_integrated_CM_single 0 0 -3.4E+38 3.4E+38 ECU_ADDRESS 0xb0004ad8 /* @ECU_Address@VfCOMM_VCU_BrkPedPos@ */ /end MEASUREMENT
/begin MEASUREMENT VfCOMM_VCU_YawRate "Yaw Rate." FLOAT32_IEEE COMM_subsystem_integrated_CM_single 0 0 -3.4E+38 3.4E+38 ECU_ADDRESS 0xb0004ad4 /* @ECU_Address@VfCOMM_VCU_YawRate@ */ /end MEASUREMENT
/begin MEASUREMENT VfCOMM_VCU_LateralAcc "Lateral acceleration (m/s~2)." FLOAT32_IEEE COMM_subsystem_integrated_CM_single 0 0 -3.4E+38 3.4E+38 ECU_ADDRESS 0xb0004ad0 /* @ECU_Address@VfCOMM_VCU_LateralAcc@ */ /end MEASUREMENT
/begin MEASUREMENT VfCOMM_VCU_ESCWhlRRSpd "Rear right wheel speed (kph)." FLOAT32_IEEE COMM_subsystem_integrated_CM_single 0 0 -3.4E+38 3.4E+38 ECU_ADDRESS 0xb0004acc /* @ECU_Address@VfCOMM_VCU_ESCWhlRRSpd@ */ /end MEASUREMENT
/begin MEASUREMENT VfCOMM_VCU_ESCWhlRLSpd "Rear left wheel speed (kph)." FLOAT32_IEEE COMM_subsystem_integrated_CM_single 0 0 -3.4E+38 3.4E+38 ECU_ADDRESS 0xb0004ac8 /* @ECU_Address@VfCOMM_VCU_ESCWhlRLSpd@ */ /end MEASUREMENT
/begin MEASUREMENT VfCOMM_VCU_ESCWhlFRSpd "Front right wheel speed (kph)." FLOAT32_IEEE COMM_subsystem_integrated_CM_single 0 0 -3.4E+38 3.4E+38 ECU_ADDRESS 0xb0004ac4 /* @ECU_Address@VfCOMM_VCU_ESCWhlFRSpd@ */ /end MEASUREMENT
/begin MEASUREMENT VfCOMM_VCU_ESCWhlFLSpd "Front left wheel speed (kph)." FLOAT32_IEEE COMM_subsystem_integrated_CM_single 0 0 -3.4E+38 3.4E+38 ECU_ADDRESS 0xb0004ac0 /* @ECU_Address@VfCOMM_VCU_ESCWhlFLSpd@ */ /end MEASUREMENT
/begin MEASUREMENT VfCOMM_Actual_Gear_Ratio "" FLOAT32_IEEE COMM_subsystem_integrated_CM_single 0 0 -3.4E+38 3.4E+38 ECU_ADDRESS 0xb0004abc /* @ECU_Address@VfCOMM_Actual_Gear_Ratio@ */ /end MEASUREMENT
/begin MEASUREMENT VfCOMM_Decs_FedBck_StrAngle "" FLOAT32_IEEE COMM_subsystem_integrated_CM_single 0 0 -3.4E+38 3.4E+38 ECU_ADDRESS 0xb0004ab8 /* @ECU_Address@VfCOMM_Decs_FedBck_StrAngle@ */ /end MEASUREMENT
/begin MEASUREMENT VfCOMM_Decs_FedBck_VehSpd "" FLOAT32_IEEE COMM_subsystem_integrated_CM_single 0 0 -3.4E+38 3.4E+38 ECU_ADDRESS 0xb0004ab4 /* @ECU_Address@VfCOMM_Decs_FedBck_VehSpd@ */ /end MEASUREMENT
/begin MEASUREMENT VfCOMM_AccPedl "" FLOAT32_IEEE COMM_subsystem_integrated_CM_single 0 0 -3.4E+38 3.4E+38 ECU_ADDRESS 0xb0004ab0 /* @ECU_Address@VfCOMM_AccPedl@ */ /end MEASUREMENT
/begin MEASUREMENT VfCOMM_TCU_ActualGearRatio "" FLOAT32_IEEE COMM_subsystem_integrated_CM_single 0 0 -3.4E+38 3.4E+38 ECU_ADDRESS 0xb0004aac /* @ECU_Address@VfCOMM_TCU_ActualGearRatio@ */ /end MEASUREMENT
/begin MEASUREMENT VfCOMM_VDC_YawRate "" FLOAT32_IEEE COMM_subsystem_integrated_CM_single 0 0 -3.4E+38 3.4E+38 ECU_ADDRESS 0xb0004aa8 /* @ECU_Address@VfCOMM_VDC_YawRate@ */ /end MEASUREMENT
/begin MEASUREMENT VfCOMM_VDC_VehicleSpeed "" FLOAT32_IEEE COMM_subsystem_integrated_CM_single 0 0 -3.4E+38 3.4E+38 ECU_ADDRESS 0xb0004aa4 /* @ECU_Address@VfCOMM_VDC_VehicleSpeed@ */ /end MEASUREMENT
/begin MEASUREMENT VfCOMM_VDC_WheelSpeed_RR1 "" FLOAT32_IEEE COMM_subsystem_integrated_CM_single 0 0 -3.4E+38 3.4E+38 ECU_ADDRESS 0xb0004aa0 /* @ECU_Address@VfCOMM_VDC_WheelSpeed_RR1@ */ /end MEASUREMENT
/begin MEASUREMENT VfCOMM_VDC_LongAcceleration "" FLOAT32_IEEE COMM_subsystem_integrated_CM_single 0 0 -3.4E+38 3.4E+38 ECU_ADDRESS 0xb0004a9c /* @ECU_Address@VfCOMM_VDC_LongAcceleration@ */ /end MEASUREMENT
/begin MEASUREMENT VfCOMM_VDC_LateralAcceleration "" FLOAT32_IEEE COMM_subsystem_integrated_CM_single 0 0 -3.4E+38 3.4E+38 ECU_ADDRESS 0xb0004a98 /* @ECU_Address@VfCOMM_VDC_LateralAcceleration@ */ /end MEASUREMENT
/begin MEASUREMENT VfCOMM_VDC_WheelSpeed_RR2 "" FLOAT32_IEEE COMM_subsystem_integrated_CM_single 0 0 -3.4E+38 3.4E+38 ECU_ADDRESS 0xb0004a94 /* @ECU_Address@VfCOMM_VDC_WheelSpeed_RR2@ */ /end MEASUREMENT
/begin MEASUREMENT VfCOMM_VDC_WheelSpeed_RL1 "" FLOAT32_IEEE COMM_subsystem_integrated_CM_single 0 0 -3.4E+38 3.4E+38 ECU_ADDRESS 0xb0004a90 /* @ECU_Address@VfCOMM_VDC_WheelSpeed_RL1@ */ /end MEASUREMENT
/begin MEASUREMENT VfCOMM_VDC_WheelSpeed_RL2 "" FLOAT32_IEEE COMM_subsystem_integrated_CM_single 0 0 -3.4E+38 3.4E+38 ECU_ADDRESS 0xb0004a8c /* @ECU_Address@VfCOMM_VDC_WheelSpeed_RL2@ */ /end MEASUREMENT
/begin MEASUREMENT VfCOMM_EPS_TargetSteeringAngleEcho "" FLOAT32_IEEE COMM_subsystem_integrated_CM_single 0 0 -3.4E+38 3.4E+38 ECU_ADDRESS 0xb0004a88 /* @ECU_Address@VfCOMM_EPS_TargetSteeringAngleEcho@ */ /end MEASUREMENT
/begin MEASUREMENT VfCOMM_EPS_ActualSteeringAngle "" FLOAT32_IEEE COMM_subsystem_integrated_CM_single 0 0 -3.4E+38 3.4E+38 ECU_ADDRESS 0xb0004a84 /* @ECU_Address@VfCOMM_EPS_ActualSteeringAngle@ */ /end MEASUREMENT
/begin MEASUREMENT VfCOMM_EPS_SteeringAngleRate "" FLOAT32_IEEE COMM_subsystem_integrated_CM_single 0 0 -3.4E+38 3.4E+38 ECU_ADDRESS 0xb0004a80 /* @ECU_Address@VfCOMM_EPS_SteeringAngleRate@ */ /end MEASUREMENT
/begin MEASUREMENT VfCOMM_VDC_WheelSpeed_FR "" FLOAT32_IEEE COMM_subsystem_integrated_CM_single 0 0 -3.4E+38 3.4E+38 ECU_ADDRESS 0xb0004a7c /* @ECU_Address@VfCOMM_VDC_WheelSpeed_FR@ */ /end MEASUREMENT
/begin MEASUREMENT VfCOMM_VDC_WheelSpeed_FL "" FLOAT32_IEEE COMM_subsystem_integrated_CM_single 0 0 -3.4E+38 3.4E+38 ECU_ADDRESS 0xb0004a78 /* @ECU_Address@VfCOMM_VDC_WheelSpeed_FL@ */ /end MEASUREMENT
/begin MEASUREMENT VfCOMM_VCU_VirtualAccelPedalPosition "" FLOAT32_IEEE COMM_subsystem_integrated_CM_single 0 0 -3.4E+38 3.4E+38 ECU_ADDRESS 0xb0004a74 /* @ECU_Address@VfCOMM_VCU_VirtualAccelPedalPosition@ */ /end MEASUREMENT
/begin MEASUREMENT VfCOMM_EMS_EngineSpeed "" FLOAT32_IEEE COMM_subsystem_integrated_CM_single 0 0 -3.4E+38 3.4E+38 ECU_ADDRESS 0xb0004a70 /* @ECU_Address@VfCOMM_EMS_EngineSpeed@ */ /end MEASUREMENT
/begin MEASUREMENT VfCOMM_PCU_DriverDemandTorque "" FLOAT32_IEEE COMM_subsystem_integrated_CM_single 0 0 -3.4E+38 3.4E+38 ECU_ADDRESS 0xb0004a6c /* @ECU_Address@VfCOMM_PCU_DriverDemandTorque@ */ /end MEASUREMENT
/begin MEASUREMENT VfCOMM_PCU_ActualEngineTorque "" FLOAT32_IEEE COMM_subsystem_integrated_CM_single 0 0 -3.4E+38 3.4E+38 ECU_ADDRESS 0xb0004a68 /* @ECU_Address@VfCOMM_PCU_ActualEngineTorque@ */ /end MEASUREMENT
/begin MEASUREMENT VfCOMM_EMS_CatalystTankLevel "" FLOAT32_IEEE COMM_subsystem_integrated_CM_single 0 0 -3.4E+38 3.4E+38 ECU_ADDRESS 0xb0004a64 /* @ECU_Address@VfCOMM_EMS_CatalystTankLevel@ */ /end MEASUREMENT
/begin MEASUREMENT VfCOMM_VCU_ActualAccelPedalPosition "" FLOAT32_IEEE COMM_subsystem_integrated_CM_single 0 0 -3.4E+38 3.4E+38 ECU_ADDRESS 0xb0004a60 /* @ECU_Address@VfCOMM_VCU_ActualAccelPedalPosition@ */ /end MEASUREMENT
/begin MEASUREMENT VfCOMM_VCU_TargetAccelPedalPostionEcho "" FLOAT32_IEEE COMM_subsystem_integrated_CM_single 0 0 -3.4E+38 3.4E+38 ECU_ADDRESS 0xb0004a5c /* @ECU_Address@VfCOMM_VCU_TargetAccelPedalPostionEcho@ */ /end MEASUREMENT
/begin MEASUREMENT VfCOMM_PCU_BatterySOC "" FLOAT32_IEEE COMM_subsystem_integrated_CM_single 0 0 -3.4E+38 3.4E+38 ECU_ADDRESS 0xb0004a58 /* @ECU_Address@VfCOMM_PCU_BatterySOC@ */ /end MEASUREMENT
/begin MEASUREMENT VfCOMM_PCU_MotorSpeed "" FLOAT32_IEEE COMM_subsystem_integrated_CM_single 0 0 -3.4E+38 3.4E+38 ECU_ADDRESS 0xb0004a54 /* @ECU_Address@VfCOMM_PCU_MotorSpeed@ */ /end MEASUREMENT
/begin MEASUREMENT VfCOMM_PCU_MotorActualTorque "" FLOAT32_IEEE COMM_subsystem_integrated_CM_single 0 0 -3.4E+38 3.4E+38 ECU_ADDRESS 0xb0004a50 /* @ECU_Address@VfCOMM_PCU_MotorActualTorque@ */ /end MEASUREMENT
/begin MEASUREMENT VfCOMM_PCU_EngineTorqueLoss "" FLOAT32_IEEE COMM_subsystem_integrated_CM_single 0 0 -3.4E+38 3.4E+38 ECU_ADDRESS 0xb0004a4c /* @ECU_Address@VfCOMM_PCU_EngineTorqueLoss@ */ /end MEASUREMENT
/begin MEASUREMENT VfCOMM_EPS_SteeringWheelTorque "" FLOAT32_IEEE COMM_subsystem_integrated_CM_single 0 0 -3.4E+38 3.4E+38 ECU_ADDRESS 0xb0004a48 /* @ECU_Address@VfCOMM_EPS_SteeringWheelTorque@ */ /end MEASUREMENT
/begin MEASUREMENT VfCOMM_VCU_TargetBrakePedalEcho "" FLOAT32_IEEE COMM_subsystem_integrated_CM_single 0 0 -3.4E+38 3.4E+38 ECU_ADDRESS 0xb0004a44 /* @ECU_Address@VfCOMM_VCU_TargetBrakePedalEcho@ */ /end MEASUREMENT
/begin MEASUREMENT VfCOMM_VCU_ActualBrakePedalPosition "" FLOAT32_IEEE COMM_subsystem_integrated_CM_single 0 0 -3.4E+38 3.4E+38 ECU_ADDRESS 0xb0004a40 /* @ECU_Address@VfCOMM_VCU_ActualBrakePedalPosition@ */ /end MEASUREMENT
/begin MEASUREMENT VfCOMM_ESP_MasterCylinderPress "" FLOAT32_IEEE COMM_subsystem_integrated_CM_single 0 0 -3.4E+38 3.4E+38 ECU_ADDRESS 0xb0004a3c /* @ECU_Address@VfCOMM_ESP_MasterCylinderPress@ */ /end MEASUREMENT
/begin MEASUREMENT VfCOMM_VDC_WheelEncoderCounter_RL "" ULONG COMM_subsystem_integrated_CM_uint32 0 0 0 4294967295 ECU_ADDRESS 0xb0004a38 /* @ECU_Address@VfCOMM_VDC_WheelEncoderCounter_RL@ */ /end MEASUREMENT
/begin MEASUREMENT VfCOMM_VDC_WheelEncoderCounter_RR "" ULONG COMM_subsystem_integrated_CM_uint32 0 0 0 4294967295 ECU_ADDRESS 0xb0004a34 /* @ECU_Address@VfCOMM_VDC_WheelEncoderCounter_RR@ */ /end MEASUREMENT
/begin MEASUREMENT VfCOMM_req_pct_torque_final "" SWORD COMM_subsystem_integrated_CM_int16 0 0 -32768 32767 ECU_ADDRESS 0xb0004a32 /* @ECU_Address@VfCOMM_req_pct_torque_final@ */ /end MEASUREMENT
/begin MEASUREMENT VfCOMM_EMS_EngineCoolantTemperature "" SWORD COMM_subsystem_integrated_CM_int16 0 0 -32768 32767 ECU_ADDRESS 0xb0004a30 /* @ECU_Address@VfCOMM_EMS_EngineCoolantTemperature@ */ /end MEASUREMENT
/begin MEASUREMENT VcCOMM_Auto_To_Manual_Tips "" UWORD COMM_subsystem_integrated_CM_uint16 0 0 0 65535 ECU_ADDRESS 0xb0004a2e /* @ECU_Address@VcCOMM_Auto_To_Manual_Tips@ */ /end MEASUREMENT
/begin MEASUREMENT VfCOMM_EMS_EngineOilPressure "" UWORD COMM_subsystem_integrated_CM_uint16 0 0 0 65535 ECU_ADDRESS 0xb0004a2c /* @ECU_Address@VfCOMM_EMS_EngineOilPressure@ */ /end MEASUREMENT
/begin MEASUREMENT VeCOMM_VCU_AutoToManualTips "" UWORD COMM_subsystem_integrated_CM_uint16 0 0 0 65535 ECU_ADDRESS 0xb0004a2a /* @ECU_Address@VeCOMM_VCU_AutoToManualTips@ */ /end MEASUREMENT
/begin MEASUREMENT VfCOMM_ESP_BrakeAirTankPressure "" UWORD COMM_subsystem_integrated_CM_uint16 0 0 0 65535 ECU_ADDRESS 0xb0004a28 /* @ECU_Address@VfCOMM_ESP_BrakeAirTankPressure@ */ /end MEASUREMENT
/begin MEASUREMENT VcCOMM_Decs_Control_mod "" UBYTE COMM_subsystem_integrated_CM_uint8 0 0 0 255 ECU_ADDRESS 0xb0004a27 /* @ECU_Address@VcCOMM_Decs_Control_mod@ */ /end MEASUREMENT
/begin MEASUREMENT VcCOMM_Decs_Gear_Value "" UBYTE COMM_subsystem_integrated_CM_uint8 0 0 0 255 ECU_ADDRESS 0xb0004a26 /* @ECU_Address@VcCOMM_Decs_Gear_Value@ */ /end MEASUREMENT
/begin MEASUREMENT VcCOMM_Decs_Gear_Req "" UBYTE COMM_subsystem_integrated_CM_uint8 0 0 0 255 ECU_ADDRESS 0xb0004a25 /* @ECU_Address@VcCOMM_Decs_Gear_Req@ */ /end MEASUREMENT
/begin MEASUREMENT VcCOMM_Decs_Breake_Req "" UBYTE COMM_subsystem_integrated_CM_uint8 0 0 0 255 ECU_ADDRESS 0xb0004a24 /* @ECU_Address@VcCOMM_Decs_Breake_Req@ */ /end MEASUREMENT
/begin MEASUREMENT VcCOMM_Decs_Acc_Req "" UBYTE COMM_subsystem_integrated_CM_uint8 0 0 0 255 ECU_ADDRESS 0xb0004a23 /* @ECU_Address@VcCOMM_Decs_Acc_Req@ */ /end MEASUREMENT
/begin MEASUREMENT VcCOMM_Decs_Steering_Req "" UBYTE COMM_subsystem_integrated_CM_uint8 0 0 0 255 ECU_ADDRESS 0xb0004a22 /* @ECU_Address@VcCOMM_Decs_Steering_Req@ */ /end MEASUREMENT
/begin MEASUREMENT VeCOMM_ADCU_TargetGearValue "" UBYTE COMM_subsystem_integrated_CM_uint8 0 0 0 255 ECU_ADDRESS 0xb0004a21 /* @ECU_Address@VeCOMM_ADCU_TargetGearValue@ */ /end MEASUREMENT
/begin MEASUREMENT VeCOMM_ADCU_ParkingControlValue "" UBYTE COMM_subsystem_integrated_CM_uint8 0 0 0 255 ECU_ADDRESS 0xb0004a20 /* @ECU_Address@VeCOMM_ADCU_ParkingControlValue@ */ /end MEASUREMENT
/begin MEASUREMENT VcCOMM_Decs_FedBck_EPBstate "" UBYTE COMM_subsystem_integrated_CM_uint8 0 0 0 255 ECU_ADDRESS 0xb0004a1f /* @ECU_Address@VcCOMM_Decs_FedBck_EPBstate@ */ /end MEASUREMENT
/begin MEASUREMENT VcCOMM_DriverModeComd "" UBYTE COMM_subsystem_integrated_CM_uint8 0 0 0 255 ECU_ADDRESS 0xb0004a1e /* @ECU_Address@VcCOMM_DriverModeComd@ */ /end MEASUREMENT
/begin MEASUREMENT VcCOMM_Decs_FedBck_KeyState "Ignition Key State." UBYTE COMM_subsystem_integrated_CM_uint8 0 0 0 255 ECU_ADDRESS 0xb0004a1d /* @ECU_Address@VcCOMM_Decs_FedBck_KeyState@ */ /end MEASUREMENT
/begin MEASUREMENT VcCOMM_VCU_DirIndicationLH "Left turning lamp status." UBYTE COMM_subsystem_integrated_CM_uint8 0 0 0 255 ECU_ADDRESS 0xb0004a1c /* @ECU_Address@VcCOMM_VCU_DirIndicationLH@ */ /end MEASUREMENT
/begin MEASUREMENT VcCOMM_VCU_DirIndicationRH "Right turning lamp status." UBYTE COMM_subsystem_integrated_CM_uint8 0 0 0 255 ECU_ADDRESS 0xb0004a1b /* @ECU_Address@VcCOMM_VCU_DirIndicationRH@ */ /end MEASUREMENT
/begin MEASUREMENT VcCOMM_Decs_FedBck_BrkPedSts "" UBYTE COMM_subsystem_integrated_CM_uint8 0 0 0 255 ECU_ADDRESS 0xb0004a1a /* @ECU_Address@VcCOMM_Decs_FedBck_BrkPedSts@ */ /end MEASUREMENT
/begin MEASUREMENT VcCOMM_VCU_HeadLampLowBeam "" UBYTE COMM_subsystem_integrated_CM_uint8 0 0 0 255 ECU_ADDRESS 0xb0004a19 /* @ECU_Address@VcCOMM_VCU_HeadLampLowBeam@ */ /end MEASUREMENT
/begin MEASUREMENT VcCOMM_VCU_HeadLampHighBeam "" UBYTE COMM_subsystem_integrated_CM_uint8 0 0 0 255 ECU_ADDRESS 0xb0004a18 /* @ECU_Address@VcCOMM_VCU_HeadLampHighBeam@ */ /end MEASUREMENT
/begin MEASUREMENT VcCOMM_Decs_FedBck_EPSmod "" UBYTE COMM_subsystem_integrated_CM_uint8 0 0 0 255 ECU_ADDRESS 0xb0004a17 /* @ECU_Address@VcCOMM_Decs_FedBck_EPSmod@ */ /end MEASUREMENT
/begin MEASUREMENT VcCOMM_Decs_FedBck_ESCmod "" UBYTE COMM_subsystem_integrated_CM_uint8 0 0 0 255 ECU_ADDRESS 0xb0004a16 /* @ECU_Address@VcCOMM_Decs_FedBck_ESCmod@ */ /end MEASUREMENT
/begin MEASUREMENT VcCOMM_Decs_FedBck_Drivemod "" UBYTE COMM_subsystem_integrated_CM_uint8 0 0 0 255 ECU_ADDRESS 0xb0004a15 /* @ECU_Address@VcCOMM_Decs_FedBck_Drivemod@ */ /end MEASUREMENT
/begin MEASUREMENT VcCOMM_Decs_FedBck_GearValue "" UBYTE COMM_subsystem_integrated_CM_uint8 0 0 0 255 ECU_ADDRESS 0xb0004a14 /* @ECU_Address@VcCOMM_Decs_FedBck_GearValue@ */ /end MEASUREMENT
/begin MEASUREMENT VeCOMM_TCU_TargetGearPositionEcho "" UBYTE COMM_subsystem_integrated_CM_uint8 0 0 0 255 ECU_ADDRESS 0xb0004a13 /* @ECU_Address@VeCOMM_TCU_TargetGearPositionEcho@ */ /end MEASUREMENT
/begin MEASUREMENT VeCOMM_TCU_ShiftLevelPosition "" UBYTE COMM_subsystem_integrated_CM_uint8 0 0 0 255 ECU_ADDRESS 0xb0004a12 /* @ECU_Address@VeCOMM_TCU_ShiftLevelPosition@ */ /end MEASUREMENT
/begin MEASUREMENT VeCOMM_TCU_ActualGearPosition "" UBYTE COMM_subsystem_integrated_CM_uint8 0 0 0 255 ECU_ADDRESS 0xb0004a11 /* @ECU_Address@VeCOMM_TCU_ActualGearPosition@ */ /end MEASUREMENT
/begin MEASUREMENT VeCOMM_EPS_SteeringModeEcho "" UBYTE COMM_subsystem_integrated_CM_uint8 0 0 0 255 ECU_ADDRESS 0xb0004a10 /* @ECU_Address@VeCOMM_EPS_SteeringModeEcho@ */ /end MEASUREMENT
/begin MEASUREMENT VeCOMM_EMS_StartStopStatus "" UBYTE COMM_subsystem_integrated_CM_uint8 0 0 0 255 ECU_ADDRESS 0xb0004a0f /* @ECU_Address@VeCOMM_EMS_StartStopStatus@ */ /end MEASUREMENT
/begin MEASUREMENT VeCOMM_EMS_EngineState "" UBYTE COMM_subsystem_integrated_CM_uint8 0 0 0 255 ECU_ADDRESS 0xb0004a0e /* @ECU_Address@VeCOMM_EMS_EngineState@ */ /end MEASUREMENT
/begin MEASUREMENT VeCOMM_PCU_PowertrainFaultLevel "" UBYTE COMM_subsystem_integrated_CM_uint8 0 0 0 255 ECU_ADDRESS 0xb0004a0d /* @ECU_Address@VeCOMM_PCU_PowertrainFaultLevel@ */ /end MEASUREMENT
/begin MEASUREMENT VeCOMM_EPS_FaultLevel "" UBYTE COMM_subsystem_integrated_CM_uint8 0 0 0 255 ECU_ADDRESS 0xb0004a0c /* @ECU_Address@VeCOMM_EPS_FaultLevel@ */ /end MEASUREMENT
/begin MEASUREMENT VeCOMM_BCM_CruiseControlStatus "" UBYTE COMM_subsystem_integrated_CM_uint8 0 0 0 255 ECU_ADDRESS 0xb0004a0b /* @ECU_Address@VeCOMM_BCM_CruiseControlStatus@ */ /end MEASUREMENT
/begin MEASUREMENT VeCOMM_BCM_DriveMode "" UBYTE COMM_subsystem_integrated_CM_uint8 0 0 0 255 ECU_ADDRESS 0xb0004a0a /* @ECU_Address@VeCOMM_BCM_DriveMode@ */ /end MEASUREMENT
/begin MEASUREMENT VeCOMM_ESP_SystemFaultStatus "" UBYTE COMM_subsystem_integrated_CM_uint8 0 0 0 255 ECU_ADDRESS 0xb0004a09 /* @ECU_Address@VeCOMM_ESP_SystemFaultStatus@ */ /end MEASUREMENT
/begin MEASUREMENT VeCOMM_EPB_SystemFaultStatus "" UBYTE COMM_subsystem_integrated_CM_uint8 0 0 0 255 ECU_ADDRESS 0xb0004a08 /* @ECU_Address@VeCOMM_EPB_SystemFaultStatus@ */ /end MEASUREMENT
/begin MEASUREMENT VeCOMM_EPB_ActualControlStatus "" UBYTE COMM_subsystem_integrated_CM_uint8 0 0 0 255 ECU_ADDRESS 0xb0004a07 /* @ECU_Address@VeCOMM_EPB_ActualControlStatus@ */ /end MEASUREMENT
/begin MEASUREMENT VbCOMM_Decs_WarnLight_Req "" UBYTE COMM_subsystem_integrated_CM_boolean 0 0 0 1 ECU_ADDRESS 0xb0004a06 /* @ECU_Address@VbCOMM_Decs_WarnLight_Req@ */ /end MEASUREMENT
/begin MEASUREMENT VbCOMM_Decs_RihtLmp_Req "" UBYTE COMM_subsystem_integrated_CM_boolean 0 0 0 1 ECU_ADDRESS 0xb0004a05 /* @ECU_Address@VbCOMM_Decs_RihtLmp_Req@ */ /end MEASUREMENT
/begin MEASUREMENT VbCOMM_Decs_Light_Req "" UBYTE COMM_subsystem_integrated_CM_boolean 0 0 0 1 ECU_ADDRESS 0xb0004a04 /* @ECU_Address@VbCOMM_Decs_Light_Req@ */ /end MEASUREMENT
/begin MEASUREMENT VbCOMM_Decs_LftLmp_Req "" UBYTE COMM_subsystem_integrated_CM_boolean 0 0 0 1 ECU_ADDRESS 0xb0004a03 /* @ECU_Address@VbCOMM_Decs_LftLmp_Req@ */ /end MEASUREMENT
/begin MEASUREMENT VbCOMM_Decs_Horn_Req "" UBYTE COMM_subsystem_integrated_CM_boolean 0 0 0 1 ECU_ADDRESS 0xb0004a02 /* @ECU_Address@VbCOMM_Decs_Horn_Req@ */ /end MEASUREMENT
/begin MEASUREMENT VbCOMM_Decs_HighBeam_Req "" UBYTE COMM_subsystem_integrated_CM_boolean 0 0 0 1 ECU_ADDRESS 0xb0004a01 /* @ECU_Address@VbCOMM_Decs_HighBeam_Req@ */ /end MEASUREMENT
/begin MEASUREMENT VbCOMM_Decs_FrontFogLamp_Req "" UBYTE COMM_subsystem_integrated_CM_boolean 0 0 0 1 ECU_ADDRESS 0xb0004a00 /* @ECU_Address@VbCOMM_Decs_FrontFogLamp_Req@ */ /end MEASUREMENT
/begin MEASUREMENT VbCOMM_Decs_DippedBeam_Req "" UBYTE COMM_subsystem_integrated_CM_boolean 0 0 0 1 ECU_ADDRESS 0xb00049ff /* @ECU_Address@VbCOMM_Decs_DippedBeam_Req@ */ /end MEASUREMENT
/begin MEASUREMENT VbCOMM_Decs_BrkLight_Req "" UBYTE COMM_subsystem_integrated_CM_boolean 0 0 0 1 ECU_ADDRESS 0xb00049fe /* @ECU_Address@VbCOMM_Decs_BrkLight_Req@ */ /end MEASUREMENT
/begin MEASUREMENT VbCOMM_Decs_BckfogLmp_Req "" UBYTE COMM_subsystem_integrated_CM_boolean 0 0 0 1 ECU_ADDRESS 0xb00049fd /* @ECU_Address@VbCOMM_Decs_BckfogLmp_Req@ */ /end MEASUREMENT
/begin MEASUREMENT VbCOMM_Decs_iBCM_Req "" UBYTE COMM_subsystem_integrated_CM_boolean 0 0 0 1 ECU_ADDRESS 0xb00049fc /* @ECU_Address@VbCOMM_Decs_iBCM_Req@ */ /end MEASUREMENT
/begin MEASUREMENT VbCOMM_ADCU_EmergencyLightRequest "" UBYTE COMM_subsystem_integrated_CM_boolean 0 0 0 1 ECU_ADDRESS 0xb00049fb /* @ECU_Address@VbCOMM_ADCU_EmergencyLightRequest@ */ /end MEASUREMENT
/begin MEASUREMENT VbCOMM_ADCU_RightTurningLightRequest "" UBYTE COMM_subsystem_integrated_CM_boolean 0 0 0 1 ECU_ADDRESS 0xb00049fa /* @ECU_Address@VbCOMM_ADCU_RightTurningLightRequest@ */ /end MEASUREMENT
/begin MEASUREMENT VbCOMM_ADCU_PositionLightRequest "" UBYTE COMM_subsystem_integrated_CM_boolean 0 0 0 1 ECU_ADDRESS 0xb00049f9 /* @ECU_Address@VbCOMM_ADCU_PositionLightRequest@ */ /end MEASUREMENT
/begin MEASUREMENT VbCOMM_ADCU_LeftTurningLightRequest "" UBYTE COMM_subsystem_integrated_CM_boolean 0 0 0 1 ECU_ADDRESS 0xb00049f8 /* @ECU_Address@VbCOMM_ADCU_LeftTurningLightRequest@ */ /end MEASUREMENT
/begin MEASUREMENT VbCOMM_ADCU_HornRequest "" UBYTE COMM_subsystem_integrated_CM_boolean 0 0 0 1 ECU_ADDRESS 0xb00049f7 /* @ECU_Address@VbCOMM_ADCU_HornRequest@ */ /end MEASUREMENT
/begin MEASUREMENT VbCOMM_ADCU_HighBeamRequest "" UBYTE COMM_subsystem_integrated_CM_boolean 0 0 0 1 ECU_ADDRESS 0xb00049f6 /* @ECU_Address@VbCOMM_ADCU_HighBeamRequest@ */ /end MEASUREMENT
/begin MEASUREMENT VbCOMM_ADCU_FrontFogLightRequest "" UBYTE COMM_subsystem_integrated_CM_boolean 0 0 0 1 ECU_ADDRESS 0xb00049f5 /* @ECU_Address@VbCOMM_ADCU_FrontFogLightRequest@ */ /end MEASUREMENT
/begin MEASUREMENT VbCOMM_ADCU_LowBeamRequest "" UBYTE COMM_subsystem_integrated_CM_boolean 0 0 0 1 ECU_ADDRESS 0xb00049f4 /* @ECU_Address@VbCOMM_ADCU_LowBeamRequest@ */ /end MEASUREMENT
/begin MEASUREMENT VbCOMM_ADCU_BrakeLightRequest "" UBYTE COMM_subsystem_integrated_CM_boolean 0 0 0 1 ECU_ADDRESS 0xb00049f3 /* @ECU_Address@VbCOMM_ADCU_BrakeLightRequest@ */ /end MEASUREMENT
/begin MEASUREMENT VbCOMM_ADCU_BackFogLghtRequest "" UBYTE COMM_subsystem_integrated_CM_boolean 0 0 0 1 ECU_ADDRESS 0xb00049f2 /* @ECU_Address@VbCOMM_ADCU_BackFogLghtRequest@ */ /end MEASUREMENT
/begin MEASUREMENT VbCOMM_ADCU_AutodriveEnable "" UBYTE COMM_subsystem_integrated_CM_boolean 0 0 0 1 ECU_ADDRESS 0xb00049f1 /* @ECU_Address@VbCOMM_ADCU_AutodriveEnable@ */ /end MEASUREMENT
/begin MEASUREMENT VbCOMM_ADCU_BCMControlEnable "" UBYTE COMM_subsystem_integrated_CM_boolean 0 0 0 1 ECU_ADDRESS 0xb00049f0 /* @ECU_Address@VbCOMM_ADCU_BCMControlEnable@ */ /end MEASUREMENT
/begin MEASUREMENT VbCOMM_ADCU_TargetGearEnable "" UBYTE COMM_subsystem_integrated_CM_boolean 0 0 0 1 ECU_ADDRESS 0xb00049ef /* @ECU_Address@VbCOMM_ADCU_TargetGearEnable@ */ /end MEASUREMENT
/begin MEASUREMENT VbCOMM_ADCU_SteeringAngleEnable "" UBYTE COMM_subsystem_integrated_CM_boolean 0 0 0 1 ECU_ADDRESS 0xb00049ee /* @ECU_Address@VbCOMM_ADCU_SteeringAngleEnable@ */ /end MEASUREMENT
/begin MEASUREMENT VbCOMM_ADCU_ParkingPressureRequest "" UBYTE COMM_subsystem_integrated_CM_boolean 0 0 0 1 ECU_ADDRESS 0xb00049ed /* @ECU_Address@VbCOMM_ADCU_ParkingPressureRequest@ */ /end MEASUREMENT
/begin MEASUREMENT VbCOMM_ADCU_LaunchRequest "" UBYTE COMM_subsystem_integrated_CM_boolean 0 0 0 1 ECU_ADDRESS 0xb00049ec /* @ECU_Address@VbCOMM_ADCU_LaunchRequest@ */ /end MEASUREMENT
/begin MEASUREMENT VbCOMM_ADCU_ParkingControlEnable "" UBYTE COMM_subsystem_integrated_CM_boolean 0 0 0 1 ECU_ADDRESS 0xb00049eb /* @ECU_Address@VbCOMM_ADCU_ParkingControlEnable@ */ /end MEASUREMENT
/begin MEASUREMENT VbCOMM_ADCU_PowerEnable "" UBYTE COMM_subsystem_integrated_CM_boolean 0 0 0 1 ECU_ADDRESS 0xb00049ea /* @ECU_Address@VbCOMM_ADCU_PowerEnable@ */ /end MEASUREMENT
/begin MEASUREMENT VbCOMM_ADCU_BrakeEnable "" UBYTE COMM_subsystem_integrated_CM_boolean 0 0 0 1 ECU_ADDRESS 0xb00049e9 /* @ECU_Address@VbCOMM_ADCU_BrakeEnable@ */ /end MEASUREMENT
/begin MEASUREMENT VbCOMM_ADCU_SpeedDownIndicator "" UBYTE COMM_subsystem_integrated_CM_boolean 0 0 0 1 ECU_ADDRESS 0xb00049e8 /* @ECU_Address@VbCOMM_ADCU_SpeedDownIndicator@ */ /end MEASUREMENT
/begin MEASUREMENT VbCOMM_ADCU_SpeedUpIndicator "" UBYTE COMM_subsystem_integrated_CM_boolean 0 0 0 1 ECU_ADDRESS 0xb00049e7 /* @ECU_Address@VbCOMM_ADCU_SpeedUpIndicator@ */ /end MEASUREMENT
/begin MEASUREMENT VbCOMM_ADCU_OverSpeedWarning "" UBYTE COMM_subsystem_integrated_CM_boolean 0 0 0 1 ECU_ADDRESS 0xb00049e6 /* @ECU_Address@VbCOMM_ADCU_OverSpeedWarning@ */ /end MEASUREMENT
/begin MEASUREMENT VbCOMM_HandsOffWheelDetected "" UBYTE COMM_subsystem_integrated_CM_boolean 0 0 0 1 ECU_ADDRESS 0xb00049e5 /* @ECU_Address@VbCOMM_HandsOffWheelDetected@ */ /end MEASUREMENT
/begin MEASUREMENT VbCOMM_HandsOnWheelDetected "" UBYTE COMM_subsystem_integrated_CM_boolean 0 0 0 1 ECU_ADDRESS 0xb00049e4 /* @ECU_Address@VbCOMM_HandsOnWheelDetected@ */ /end MEASUREMENT
/begin MEASUREMENT VbCOMM_VDC_YawRateValid "" UBYTE COMM_subsystem_integrated_CM_boolean 0 0 0 1 ECU_ADDRESS 0xb00049e3 /* @ECU_Address@VbCOMM_VDC_YawRateValid@ */ /end MEASUREMENT
/begin MEASUREMENT VbCOMM_VDC_LongAccelerationValid "" UBYTE COMM_subsystem_integrated_CM_boolean 0 0 0 1 ECU_ADDRESS 0xb00049e2 /* @ECU_Address@VbCOMM_VDC_LongAccelerationValid@ */ /end MEASUREMENT
/begin MEASUREMENT VbCOMM_EPS_SteeringWheelTorqueValid "" UBYTE COMM_subsystem_integrated_CM_boolean 0 0 0 1 ECU_ADDRESS 0xb00049e1 /* @ECU_Address@VbCOMM_EPS_SteeringWheelTorqueValid@ */ /end MEASUREMENT
/begin MEASUREMENT VbCOMM_VDC_LateralAccelerationValid "" UBYTE COMM_subsystem_integrated_CM_boolean 0 0 0 1 ECU_ADDRESS 0xb00049e0 /* @ECU_Address@VbCOMM_VDC_LateralAccelerationValid@ */ /end MEASUREMENT
/begin MEASUREMENT VbCOMM_EPS_SteeringControlResponse_LDW "" UBYTE COMM_subsystem_integrated_CM_boolean 0 0 0 1 ECU_ADDRESS 0xb00049df /* @ECU_Address@VbCOMM_EPS_SteeringControlResponse_LDW@ */ /end MEASUREMENT
/begin MEASUREMENT VbCOMM_EPS_SteeringControlResponse_LCC "" UBYTE COMM_subsystem_integrated_CM_boolean 0 0 0 1 ECU_ADDRESS 0xb00049de /* @ECU_Address@VbCOMM_EPS_SteeringControlResponse_LCC@ */ /end MEASUREMENT
/begin MEASUREMENT VbCOMM_EPS_SteeringControlResponse "" UBYTE COMM_subsystem_integrated_CM_boolean 0 0 0 1 ECU_ADDRESS 0xb00049dd /* @ECU_Address@VbCOMM_EPS_SteeringControlResponse@ */ /end MEASUREMENT
/begin MEASUREMENT VbCOMM_VDC_WheelSpeed_RR1Valid "" UBYTE COMM_subsystem_integrated_CM_boolean 0 0 0 1 ECU_ADDRESS 0xb00049dc /* @ECU_Address@VbCOMM_VDC_WheelSpeed_RR1Valid@ */ /end MEASUREMENT
/begin MEASUREMENT VbCOMM_VDC_WheelSpeed_RR2Valid "" UBYTE COMM_subsystem_integrated_CM_boolean 0 0 0 1 ECU_ADDRESS 0xb00049db /* @ECU_Address@VbCOMM_VDC_WheelSpeed_RR2Valid@ */ /end MEASUREMENT
/begin MEASUREMENT VbCOMM_VDC_WheelSpeed_RL1Valid "" UBYTE COMM_subsystem_integrated_CM_boolean 0 0 0 1 ECU_ADDRESS 0xb00049da /* @ECU_Address@VbCOMM_VDC_WheelSpeed_RL1Valid@ */ /end MEASUREMENT
/begin MEASUREMENT VbCOMM_VDC_WheelSpeed_FLValid "" UBYTE COMM_subsystem_integrated_CM_boolean 0 0 0 1 ECU_ADDRESS 0xb00049d9 /* @ECU_Address@VbCOMM_VDC_WheelSpeed_FLValid@ */ /end MEASUREMENT
/begin MEASUREMENT VbCOMM_VDC_WheelSpeed_RL2Valid "" UBYTE COMM_subsystem_integrated_CM_boolean 0 0 0 1 ECU_ADDRESS 0xb00049d8 /* @ECU_Address@VbCOMM_VDC_WheelSpeed_RL2Valid@ */ /end MEASUREMENT
/begin MEASUREMENT VbCOMM_VDC_WheelSpeed_FRValid "" UBYTE COMM_subsystem_integrated_CM_boolean 0 0 0 1 ECU_ADDRESS 0xb00049d7 /* @ECU_Address@VbCOMM_VDC_WheelSpeed_FRValid@ */ /end MEASUREMENT
/begin MEASUREMENT VbCOMM_EMS_EngineSpeedValid "" UBYTE COMM_subsystem_integrated_CM_boolean 0 0 0 1 ECU_ADDRESS 0xb00049d6 /* @ECU_Address@VbCOMM_EMS_EngineSpeedValid@ */ /end MEASUREMENT
/begin MEASUREMENT VbCOMM_VCU_VirtualAccelPedalValid "" UBYTE COMM_subsystem_integrated_CM_boolean 0 0 0 1 ECU_ADDRESS 0xb00049d5 /* @ECU_Address@VbCOMM_VCU_VirtualAccelPedalValid@ */ /end MEASUREMENT
/begin MEASUREMENT VbCOMM_VCU_AccelPedalOverride "" UBYTE COMM_subsystem_integrated_CM_boolean 0 0 0 1 ECU_ADDRESS 0xb00049d4 /* @ECU_Address@VbCOMM_VCU_AccelPedalOverride@ */ /end MEASUREMENT
/begin MEASUREMENT VbCOMM_EMS_CoolantLevelLow "" UBYTE COMM_subsystem_integrated_CM_boolean 0 0 0 1 ECU_ADDRESS 0xb00049d3 /* @ECU_Address@VbCOMM_EMS_CoolantLevelLow@ */ /end MEASUREMENT
/begin MEASUREMENT VbCOMM_PCU_PowerControlResponse "" UBYTE COMM_subsystem_integrated_CM_boolean 0 0 0 1 ECU_ADDRESS 0xb00049d2 /* @ECU_Address@VbCOMM_PCU_PowerControlResponse@ */ /end MEASUREMENT
/begin MEASUREMENT VbCOMM_VCU_AccelPedalValid "" UBYTE COMM_subsystem_integrated_CM_boolean 0 0 0 1 ECU_ADDRESS 0xb00049d1 /* @ECU_Address@VbCOMM_VCU_AccelPedalValid@ */ /end MEASUREMENT
/begin MEASUREMENT VbCOMM_EPS_HandsOnWheelDetected "" UBYTE COMM_subsystem_integrated_CM_boolean 0 0 0 1 ECU_ADDRESS 0xb00049d0 /* @ECU_Address@VbCOMM_EPS_HandsOnWheelDetected@ */ /end MEASUREMENT
/begin MEASUREMENT VbCOMM_EPS_HandsOffWheelDetected "" UBYTE COMM_subsystem_integrated_CM_boolean 0 0 0 1 ECU_ADDRESS 0xb00049cf /* @ECU_Address@VbCOMM_EPS_HandsOffWheelDetected@ */ /end MEASUREMENT
/begin MEASUREMENT VbCOMM_VCU_AutodriveMainSwitch "" UBYTE COMM_subsystem_integrated_CM_boolean 0 0 0 1 ECU_ADDRESS 0xb00049ce /* @ECU_Address@VbCOMM_VCU_AutodriveMainSwitch@ */ /end MEASUREMENT
/begin MEASUREMENT VbCOMM_BCM_CruiseSwLimitMain "" UBYTE COMM_subsystem_integrated_CM_boolean 0 0 0 1 ECU_ADDRESS 0xb00049cd /* @ECU_Address@VbCOMM_BCM_CruiseSwLimitMain@ */ /end MEASUREMENT
/begin MEASUREMENT VbCOMM_BCM_DriverSeatBelt "" UBYTE COMM_subsystem_integrated_CM_boolean 0 0 0 1 ECU_ADDRESS 0xb00049cc /* @ECU_Address@VbCOMM_BCM_DriverSeatBelt@ */ /end MEASUREMENT
/begin MEASUREMENT VbCOMM_BCM_DriverSeatBeltValid "" UBYTE COMM_subsystem_integrated_CM_boolean 0 0 0 1 ECU_ADDRESS 0xb00049cb /* @ECU_Address@VbCOMM_BCM_DriverSeatBeltValid@ */ /end MEASUREMENT
/begin MEASUREMENT VbCOMM_BCM_TurningLightEcho "" UBYTE COMM_subsystem_integrated_CM_boolean 0 0 0 1 ECU_ADDRESS 0xb00049ca /* @ECU_Address@VbCOMM_BCM_TurningLightEcho@ */ /end MEASUREMENT
/begin MEASUREMENT VbCOMM_BCM_LowBeamSwitch "" UBYTE COMM_subsystem_integrated_CM_boolean 0 0 0 1 ECU_ADDRESS 0xb00049c9 /* @ECU_Address@VbCOMM_BCM_LowBeamSwitch@ */ /end MEASUREMENT
/begin MEASUREMENT VbCOMM_BCM_HighBeamSwitch "" UBYTE COMM_subsystem_integrated_CM_boolean 0 0 0 1 ECU_ADDRESS 0xb00049c8 /* @ECU_Address@VbCOMM_BCM_HighBeamSwitch@ */ /end MEASUREMENT
/begin MEASUREMENT VbCOMM_BCM_BrakeLightStatus "" UBYTE COMM_subsystem_integrated_CM_boolean 0 0 0 1 ECU_ADDRESS 0xb00049c7 /* @ECU_Address@VbCOMM_BCM_BrakeLightStatus@ */ /end MEASUREMENT
/begin MEASUREMENT VbCOMM_BCM_LeftTurningLightState "" UBYTE COMM_subsystem_integrated_CM_boolean 0 0 0 1 ECU_ADDRESS 0xb00049c6 /* @ECU_Address@VbCOMM_BCM_LeftTurningLightState@ */ /end MEASUREMENT
/begin MEASUREMENT VbCOMM_BCM_RightTurningLightState "" UBYTE COMM_subsystem_integrated_CM_boolean 0 0 0 1 ECU_ADDRESS 0xb00049c5 /* @ECU_Address@VbCOMM_BCM_RightTurningLightState@ */ /end MEASUREMENT
/begin MEASUREMENT VbCOMM_VCU_AutodriveActiveStatus "" UBYTE COMM_subsystem_integrated_CM_boolean 0 0 0 1 ECU_ADDRESS 0xb00049c4 /* @ECU_Address@VbCOMM_VCU_AutodriveActiveStatus@ */ /end MEASUREMENT
/begin MEASUREMENT VbCOMM_BCM_IgnitionKeyState "" UBYTE COMM_subsystem_integrated_CM_boolean 0 0 0 1 ECU_ADDRESS 0xb00049c3 /* @ECU_Address@VbCOMM_BCM_IgnitionKeyState@ */ /end MEASUREMENT
/begin MEASUREMENT VbCOMM_BCM_DriverDoorStatus "" UBYTE COMM_subsystem_integrated_CM_boolean 0 0 0 1 ECU_ADDRESS 0xb00049c2 /* @ECU_Address@VbCOMM_BCM_DriverDoorStatus@ */ /end MEASUREMENT
/begin MEASUREMENT VbCOMM_BCM_PassengerDoorStatus "" UBYTE COMM_subsystem_integrated_CM_boolean 0 0 0 1 ECU_ADDRESS 0xb00049c1 /* @ECU_Address@VbCOMM_BCM_PassengerDoorStatus@ */ /end MEASUREMENT
/begin MEASUREMENT VbCOMM_BCM_FrontHoodStatus "" UBYTE COMM_subsystem_integrated_CM_boolean 0 0 0 1 ECU_ADDRESS 0xb00049c0 /* @ECU_Address@VbCOMM_BCM_FrontHoodStatus@ */ /end MEASUREMENT
/begin MEASUREMENT VbCOMM_BCM_RearRightDoorStatus "" UBYTE COMM_subsystem_integrated_CM_boolean 0 0 0 1 ECU_ADDRESS 0xb00049bf /* @ECU_Address@VbCOMM_BCM_RearRightDoorStatus@ */ /end MEASUREMENT
/begin MEASUREMENT VbCOMM_BCM_RearLeftDoorStatus "" UBYTE COMM_subsystem_integrated_CM_boolean 0 0 0 1 ECU_ADDRESS 0xb00049be /* @ECU_Address@VbCOMM_BCM_RearLeftDoorStatus@ */ /end MEASUREMENT
/begin MEASUREMENT VbCOMM_BCM_BackTrunkStatus "" UBYTE COMM_subsystem_integrated_CM_boolean 0 0 0 1 ECU_ADDRESS 0xb00049bd /* @ECU_Address@VbCOMM_BCM_BackTrunkStatus@ */ /end MEASUREMENT
/begin MEASUREMENT VbCOMM_BCM_WiperSwitch "" UBYTE COMM_subsystem_integrated_CM_boolean 0 0 0 1 ECU_ADDRESS 0xb00049bc /* @ECU_Address@VbCOMM_BCM_WiperSwitch@ */ /end MEASUREMENT
/begin MEASUREMENT VbCOMM_BCM_ControlResponse "" UBYTE COMM_subsystem_integrated_CM_boolean 0 0 0 1 ECU_ADDRESS 0xb00049bb /* @ECU_Address@VbCOMM_BCM_ControlResponse@ */ /end MEASUREMENT
/begin MEASUREMENT VbCOMM_BCM_CruiseSwValid "" UBYTE COMM_subsystem_integrated_CM_boolean 0 0 0 1 ECU_ADDRESS 0xb00049ba /* @ECU_Address@VbCOMM_BCM_CruiseSwValid@ */ /end MEASUREMENT
/begin MEASUREMENT VbCOMM_BCM_CruiseSwResume "" UBYTE COMM_subsystem_integrated_CM_boolean 0 0 0 1 ECU_ADDRESS 0xb00049b9 /* @ECU_Address@VbCOMM_BCM_CruiseSwResume@ */ /end MEASUREMENT
/begin MEASUREMENT VbCOMM_BCM_CruiseSwSet "" UBYTE COMM_subsystem_integrated_CM_boolean 0 0 0 1 ECU_ADDRESS 0xb00049b8 /* @ECU_Address@VbCOMM_BCM_CruiseSwSet@ */ /end MEASUREMENT
/begin MEASUREMENT VbCOMM_BCM_CruiseSwTimeGapPlus "" UBYTE COMM_subsystem_integrated_CM_boolean 0 0 0 1 ECU_ADDRESS 0xb00049b7 /* @ECU_Address@VbCOMM_BCM_CruiseSwTimeGapPlus@ */ /end MEASUREMENT
/begin MEASUREMENT VbCOMM_BCM_CruiseSwTimeGapMinus "" UBYTE COMM_subsystem_integrated_CM_boolean 0 0 0 1 ECU_ADDRESS 0xb00049b6 /* @ECU_Address@VbCOMM_BCM_CruiseSwTimeGapMinus@ */ /end MEASUREMENT
/begin MEASUREMENT VbCOMM_BCM_CruiseSwMain "" UBYTE COMM_subsystem_integrated_CM_boolean 0 0 0 1 ECU_ADDRESS 0xb00049b5 /* @ECU_Address@VbCOMM_BCM_CruiseSwMain@ */ /end MEASUREMENT
/begin MEASUREMENT VbCOMM_ESP_TCSActive "" UBYTE COMM_subsystem_integrated_CM_boolean 0 0 0 1 ECU_ADDRESS 0xb00049b4 /* @ECU_Address@VbCOMM_ESP_TCSActive@ */ /end MEASUREMENT
/begin MEASUREMENT VbCOMM_ESP_ABSActive "" UBYTE COMM_subsystem_integrated_CM_boolean 0 0 0 1 ECU_ADDRESS 0xb00049b3 /* @ECU_Address@VbCOMM_ESP_ABSActive@ */ /end MEASUREMENT
/begin MEASUREMENT VbCOMM_EPB_AutoholdStatus "" UBYTE COMM_subsystem_integrated_CM_boolean 0 0 0 1 ECU_ADDRESS 0xb00049b2 /* @ECU_Address@VbCOMM_EPB_AutoholdStatus@ */ /end MEASUREMENT
/begin MEASUREMENT VbCOMM_EPB_ParkingControlResponse "" UBYTE COMM_subsystem_integrated_CM_boolean 0 0 0 1 ECU_ADDRESS 0xb00049b1 /* @ECU_Address@VbCOMM_EPB_ParkingControlResponse@ */ /end MEASUREMENT
/begin MEASUREMENT VbCOMM_EPB_SwitchStatus "" UBYTE COMM_subsystem_integrated_CM_boolean 0 0 0 1 ECU_ADDRESS 0xb00049b0 /* @ECU_Address@VbCOMM_EPB_SwitchStatus@ */ /end MEASUREMENT
/begin MEASUREMENT VbCOMM_VCU_BrakePedalValid "" UBYTE COMM_subsystem_integrated_CM_boolean 0 0 0 1 ECU_ADDRESS 0xb00049af /* @ECU_Address@VbCOMM_VCU_BrakePedalValid@ */ /end MEASUREMENT
/begin MEASUREMENT VbCOMM_ESP_BrakeControlResponse "" UBYTE COMM_subsystem_integrated_CM_boolean 0 0 0 1 ECU_ADDRESS 0xb00049ae /* @ECU_Address@VbCOMM_ESP_BrakeControlResponse@ */ /end MEASUREMENT
/begin MEASUREMENT VbCOMM_VCU_ActualBrakePedalSwitch "" UBYTE COMM_subsystem_integrated_CM_boolean 0 0 0 1 ECU_ADDRESS 0xb00049ad /* @ECU_Address@VbCOMM_VCU_ActualBrakePedalSwitch@ */ /end MEASUREMENT
/begin MEASUREMENT VbCOMM_ESP_MasterCylinderPressValid "" UBYTE COMM_subsystem_integrated_CM_boolean 0 0 0 1 ECU_ADDRESS 0xb00049ac /* @ECU_Address@VbCOMM_ESP_MasterCylinderPressValid@ */ /end MEASUREMENT
/begin MEASUREMENT VeDCSN_usr_cmd_autodrive_activate "usr activate cmd
      0 = deactivate
      1 = activate
      2 = hold" UBYTE DCSN_subsystem_integrated_CM_uint8 0 0 0 255 ECU_ADDRESS 0x700042b6 /* @ECU_Address@VeDCSN_usr_cmd_autodrive_activate@ */ /end MEASUREMENT
/begin MEASUREMENT VbDCSN_power_control_inhibit "0 = power control not inhibit
      1 = power control inhibit" UBYTE DCSN_subsystem_integrated_CM_boolean 0 0 0 1 ECU_ADDRESS 0x70004291 /* @ECU_Address@VbDCSN_power_control_inhibit@ */ /end MEASUREMENT
/begin MEASUREMENT VbDCSN_initialization_finished "Initialization process is finished.
      Including vehicle and controller." UBYTE DCSN_subsystem_integrated_CM_boolean 0 0 0 1 ECU_ADDRESS 0x7000427d /* @ECU_Address@VbDCSN_initialization_finished@ */ /end MEASUREMENT
/begin MEASUREMENT VbDCSN_ACC_ready_to_engage "ACCS subsystem ready" UBYTE DCSN_subsystem_integrated_CM_boolean 0 0 0 1 ECU_ADDRESS 0x7000427c /* @ECU_Address@VbDCSN_ACC_ready_to_engage@ */ /end MEASUREMENT
/begin MEASUREMENT VbDCSN_accs_resume "0 = no accs resume request
      1 = accs resume request" UBYTE DCSN_subsystem_integrated_CM_boolean 0 0 0 1 ECU_ADDRESS 0x70004278 /* @ECU_Address@VbDCSN_accs_resume@ */ /end MEASUREMENT
/begin MEASUREMENT VbDCSN_adm_steering_override "0 = not override
      1 = override" UBYTE DCSN_subsystem_integrated_CM_boolean 0 0 0 1 ECU_ADDRESS 0x70004277 /* @ECU_Address@VbDCSN_adm_steering_override@ */ /end MEASUREMENT
/begin MEASUREMENT VbDCSN_adm_steering_resume "0 = not resume
      1 = resume" UBYTE DCSN_subsystem_integrated_CM_boolean 0 0 0 1 ECU_ADDRESS 0x70004276 /* @ECU_Address@VbDCSN_adm_steering_resume@ */ /end MEASUREMENT
/begin MEASUREMENT VeDCSN_adm_main_mode "0 = ADM_OFF
      1 = ADM_STANDBY
      2 = ADM_READY
      3 = ADM_ACTIVE
      4 = ADM_STEER_OVRD
      5 = ADM_TAKEOVER_WARNING
      6 = ADM_FAULT_WARNING
      7 = ADM_FAULT_REACTION
      8 = ADM_FAULT_DETECTED" UBYTE DCSN_subsystem_integrated_CM_EnumDCSN_adm_main_mode 0 0 0 8 ECU_ADDRESS 0x70004272 /* @ECU_Address@VeDCSN_adm_main_mode@ */ /end MEASUREMENT
/begin MEASUREMENT VeDCSN_hmi_msg_display "0 = NO_MSG
      1 = ACTIVE
      2 = OVRD
      3 = TAKOVER_REQ
      4 = FAULT" UBYTE DCSN_subsystem_integrated_CM_EnumDCSN_adm_hmi_msg_display 0 0 0 4 ECU_ADDRESS 0x70004271 /* @ECU_Address@VeDCSN_hmi_msg_display@ */ /end MEASUREMENT
/begin MEASUREMENT VeDCSN_hmi_icon_display "0 = NO_ICON
      1 = GREY_SOLID
      2 = GREEN_SOLID
      3 = BLUE_SOLID
      4 = RED_FLASH_SLOW
      5 = RED_FLASH_FAST
      6 = RED_SOLID" UBYTE DCSN_subsystem_integrated_CM_EnumDCSN_adm_hmi_icon_display 0 0 0 6 ECU_ADDRESS 0x70004270 /* @ECU_Address@VeDCSN_hmi_icon_display@ */ /end MEASUREMENT
/begin COMPU_METHOD AEBS_subsystem_integrated_CM_single "Q = V" RAT_FUNC "%8.6" "" COEFFS 0 1 0 0 0 1 /end COMPU_METHOD
/begin COMPU_METHOD AEBS_subsystem_integrated_CM_single_rad_s "Q = V" RAT_FUNC "%8.6" "rad/s" COEFFS 0 1 0 0 0 1 /end COMPU_METHOD
/begin COMPU_METHOD AEBS_subsystem_integrated_CM_uint8 "Q = V" RAT_FUNC "%3.0" "" COEFFS 0 1 0 0 0 1 /end COMPU_METHOD
/begin COMPU_METHOD AEBS_subsystem_integrated_CM_boolean "Q = V" RAT_FUNC "%1.0" "" COEFFS 0 1 0 0 0 1 /end COMPU_METHOD
/begin COMPU_METHOD ARBT_subsystem_integrated_CM_single_s "Q = V" RAT_FUNC "%8.6" "s" COEFFS 0 1 0 0 0 1 /end COMPU_METHOD
/begin COMPU_METHOD ARBT_subsystem_integrated_CM_single_m_s2 "Q = V" RAT_FUNC "%8.6" "m/s2" COEFFS 0 1 0 0 0 1 /end COMPU_METHOD
/begin COMPU_METHOD ARBT_subsystem_integrated_CM_single__ "Q = V" RAT_FUNC "%8.6" "%" COEFFS 0 1 0 0 0 1 /end COMPU_METHOD
/begin COMPU_METHOD ARBT_subsystem_integrated_CM_single_deg "Q = V" RAT_FUNC "%8.6" "deg" COEFFS 0 1 0 0 0 1 /end COMPU_METHOD
/begin COMPU_METHOD ARBT_subsystem_integrated_CM_single_ms "Q = V" RAT_FUNC "%8.6" "ms" COEFFS 0 1 0 0 0 1 /end COMPU_METHOD
/begin COMPU_METHOD ARBT_subsystem_integrated_CM_single_sec "Q = V" RAT_FUNC "%8.6" "sec" COEFFS 0 1 0 0 0 1 /end COMPU_METHOD
/begin COMPU_METHOD ARBT_subsystem_integrated_CM_single "Q = V" RAT_FUNC "%8.6" "" COEFFS 0 1 0 0 0 1 /end COMPU_METHOD
/begin COMPU_METHOD ARBT_subsystem_integrated_CM_single_m_s "Q = V" RAT_FUNC "%8.6" "m/s" COEFFS 0 1 0 0 0 1 /end COMPU_METHOD
/begin COMPU_METHOD ARBT_subsystem_integrated_CM_uint8 "Q = V" RAT_FUNC "%3.0" "" COEFFS 0 1 0 0 0 1 /end COMPU_METHOD
/begin COMPU_METHOD ARBT_subsystem_integrated_CM_boolean "Q = V" RAT_FUNC "%1.0" "" COEFFS 0 1 0 0 0 1 /end COMPU_METHOD
/begin COMPU_METHOD ARBT_subsystem_integrated_CM_single_Nm "Q = V" RAT_FUNC "%8.6" "Nm" COEFFS 0 1 0 0 0 1 /end COMPU_METHOD
/begin COMPU_METHOD ARBT_subsystem_integrated_CM_EnumARBT_arbitration_winner "Enumerated data type: EnumARBT_arbitration_winner" TAB_VERB "%0.6" "" COMPU_TAB_REF VTAB_FOR_ARBT_subsystem_integrated_CM_EnumARBT_arbitration_winner /end COMPU_METHOD
/begin COMPU_METHOD COMM_subsystem_integrated_CM_single "Q = V" RAT_FUNC "%8.6" "" COEFFS 0 1 0 0 0 1 /end COMPU_METHOD
/begin COMPU_METHOD COMM_subsystem_integrated_CM_single_mm "Q = V" RAT_FUNC "%8.6" "mm" COEFFS 0 1 0 0 0 1 /end COMPU_METHOD
/begin COMPU_METHOD COMM_subsystem_integrated_CM_single_rad "Q = V" RAT_FUNC "%8.6" "rad" COEFFS 0 1 0 0 0 1 /end COMPU_METHOD
/begin COMPU_METHOD COMM_subsystem_integrated_CM_single_kg "Q = V" RAT_FUNC "%8.6" "kg" COEFFS 0 1 0 0 0 1 /end COMPU_METHOD
/begin COMPU_METHOD COMM_subsystem_integrated_CM_single_N_deg "Q = V" RAT_FUNC "%8.6" "N/deg" COEFFS 0 1 0 0 0 1 /end COMPU_METHOD
/begin COMPU_METHOD COMM_subsystem_integrated_CM_single_kg_m2 "Q = V" RAT_FUNC "%8.6" "kg*m2" COEFFS 0 1 0 0 0 1 /end COMPU_METHOD
/begin COMPU_METHOD COMM_subsystem_integrated_CM_single_m "Q = V" RAT_FUNC "%8.6" "m" COEFFS 0 1 0 0 0 1 /end COMPU_METHOD
/begin COMPU_METHOD COMM_subsystem_integrated_CM_uint8 "Q = V" RAT_FUNC "%3.0" "" COEFFS 0 1 0 0 0 1 /end COMPU_METHOD
/begin COMPU_METHOD COMM_subsystem_integrated_CM_boolean "Q = V" RAT_FUNC "%1.0" "" COEFFS 0 1 0 0 0 1 /end COMPU_METHOD
/begin COMPU_METHOD COMM_subsystem_integrated_CM_uint32 "Q = V" RAT_FUNC "%10.0" "" COEFFS 0 1 0 0 0 1 /end COMPU_METHOD
/begin COMPU_METHOD COMM_subsystem_integrated_CM_int16 "Q = V" RAT_FUNC "%5.0" "" COEFFS 0 1 0 0 0 1 /end COMPU_METHOD
/begin COMPU_METHOD COMM_subsystem_integrated_CM_uint16 "Q = V" RAT_FUNC "%5.0" "" COEFFS 0 1 0 0 0 1 /end COMPU_METHOD
/begin COMPU_METHOD DCSN_subsystem_integrated_CM_single_m_s "Q = V" RAT_FUNC "%8.6" "m/s" COEFFS 0 1 0 0 0 1 /end COMPU_METHOD
/begin COMPU_METHOD DCSN_subsystem_integrated_CM_single_s "Q = V" RAT_FUNC "%8.6" "s" COEFFS 0 1 0 0 0 1 /end COMPU_METHOD
/begin COMPU_METHOD DCSN_subsystem_integrated_CM_uint8 "Q = V" RAT_FUNC "%3.0" "" COEFFS 0 1 0 0 0 1 /end COMPU_METHOD
/begin COMPU_METHOD DCSN_subsystem_integrated_CM_boolean "Q = V" RAT_FUNC "%1.0" "" COEFFS 0 1 0 0 0 1 /end COMPU_METHOD
/begin COMPU_METHOD DCSN_subsystem_integrated_CM_EnumDCSN_adm_main_mode "Enumerated data type: EnumDCSN_adm_main_mode" TAB_VERB "%0.6" "" COMPU_TAB_REF VTAB_FOR_DCSN_subsystem_integrated_CM_EnumDCSN_adm_main_mode /end COMPU_METHOD
/begin COMPU_METHOD DCSN_subsystem_integrated_CM_EnumDCSN_adm_hmi_msg_display "Enumerated data type: EnumDCSN_adm_hmi_msg_display" TAB_VERB "%0.6" "" COMPU_TAB_REF VTAB_FOR_DCSN_subsystem_integrated_CM_EnumDCSN_adm_hmi_msg_display /end COMPU_METHOD
/begin COMPU_METHOD DCSN_subsystem_integrated_CM_EnumDCSN_adm_hmi_icon_display "Enumerated data type: EnumDCSN_adm_hmi_icon_display" TAB_VERB "%0.6" "" COMPU_TAB_REF VTAB_FOR_DCSN_subsystem_integrated_CM_EnumDCSN_adm_hmi_icon_display /end COMPU_METHOD
/begin COMPU_VTAB VTAB_FOR_ARBT_subsystem_integrated_CM_EnumARBT_arbitration_winner "Enumerated data type: EnumARBT_arbitration_winner" TAB_VERB 7 0 "ARBT_NO_REQ" 1 "AEB" 2 "ACC" 3 "LCC" 4 "LKA" 5 "BRAKE_OVRD" 6 "RSVD2" /end COMPU_VTAB
/begin COMPU_VTAB VTAB_FOR_DCSN_subsystem_integrated_CM_EnumDCSN_adm_main_mode "Enumerated data type: EnumDCSN_adm_main_mode" TAB_VERB 9 0 "ADM_OFF" 1 "ADM_STANDBY" 2 "ADM_READY" 3 "ADM_ACTIVE" 4 "ADM_STEER_OVRD" 5 "ADM_TAKEOVER_WARNING" 6 "ADM_FAULT_WARNING" 7 "ADM_FAULT_REACTION" 8 "ADM_FAULT_DETECTED" /end COMPU_VTAB
/begin COMPU_VTAB VTAB_FOR_DCSN_subsystem_integrated_CM_EnumDCSN_adm_hmi_msg_display "Enumerated data type: EnumDCSN_adm_hmi_msg_display" TAB_VERB 5 0 "NO_MSG" 1 "ACTIVE" 2 "OVRD" 3 "TAKEOVER_REQ" 4 "FAULT" /end COMPU_VTAB
/begin COMPU_VTAB VTAB_FOR_DCSN_subsystem_integrated_CM_EnumDCSN_adm_hmi_icon_display "Enumerated data type: EnumDCSN_adm_hmi_icon_display" TAB_VERB 7 0 "NO_ICON" 1 "GREY_SOLID" 2 "GREEN_SOLID" 3 "BLUE_SOLID" 4 "RED_FLASH_SLOW" 5 "RED_FLASH_FAST" 6 "RED_SOLID" /end COMPU_VTAB
/begin GROUP S10_DetermineFCWStatus "AEBS_subsystem_integrated/AEBS/AEBS_Enabled/FCW_Determination/DetermineFCWStatus" /begin SUB_GROUP S184_CheckAEBS_SystemOverride /end SUB_GROUP /end GROUP
/begin GROUP S10_ThreatEvaluation "AEBS_subsystem_integrated/AEBS/AEBS_Enabled/FCW_Determination/ThreatEvaluation"
 /begin SUB_GROUP S186_Deactive S186_Dtrn_vehicleStandStill S186_Enable_Evaluation S186_FCW_level1_Threat S186_FCW_level2_Threat S186_FCW_level3_Threat S186_inhibit /end SUB_GROUP
/end GROUP
/begin GROUP S39_CalcAEBSAcceleration "AEBS_subsystem_integrated/AEBS/AEBS_Enabled/AEB_Determination/DetermineAEBStatus/CalcAEBSAcceleration"
 /begin SUB_GROUP S42_AccelReqFilter S42_AccelerationLimit S42_ClacCurrTime S42_First_Order_Low_Pass_Filter /end SUB_GROUP
 /begin REF_CHARACTERISTIC KfAEBS_a_BrakeInit KfAEBS_a_BrakeMax KfAEBS_a_FullBrakeHi KfAEBS_a_FullBrakeLo KfAEBS_a_PartialBrakeHi KfAEBS_a_PartialBrakeLo KfAEBS_t_Time_BrakeInit KfAEBS_t_Time_BrakeRamp /end REF_CHARACTERISTIC
/end GROUP
/begin GROUP S39_CheckAEBS_SystemOverride "AEBS_subsystem_integrated/AEBS/AEBS_Enabled/AEB_Determination/DetermineAEBStatus/CheckAEBS_SystemOverride"
 /begin REF_CHARACTERISTIC KfAEBS_LoPosValInCllsnRednByBrkg KfAEBS_SpdMinOvrdAccrResetInCllsnRednByBrkg /end REF_CHARACTERISTIC
/end GROUP
/begin GROUP S40_CalcObsAreq "AEBS_subsystem_integrated/AEBS/AEBS_Enabled/AEB_Determination/DtrmnThreatEvaluation/CalcObsAreq" /begin SUB_GROUP S68_Subsystem2 /end SUB_GROUP
 /begin REF_CHARACTERISTIC KfAEBS_a_FullBrakeHi KfAEBS_a_ObjUrgentBrake_Thrsh KfAEBS_d_Dis_Safe KfAEBS_d_Dis_Safe_VRU KfAEBS_t_Time_BrakeDelay KfAEBS_t_Time_ObjUrgentBrk KfAEBS_v_ObjUrgentBrk_speed_Thrsh /end REF_CHARACTERISTIC
 /begin REF_MEASUREMENT VfAEBS_a_obj_absolute_acc VfAEBS_areq VfAEBS_areq_withoutDelay VfAEBS_areq_withoutDelay_UrgentBrk VfAEBS_dis_delay VfAEBS_dis_safe_used VfAEBS_v_obj_absolute_speed /end REF_MEASUREMENT
/end GROUP
/begin GROUP S40_Deactive "AEBS_subsystem_integrated/AEBS/AEBS_Enabled/AEB_Determination/DtrmnThreatEvaluation/Deactive"
 /begin SUB_GROUP S69_HighTTCDeactive S69_RisingEdgeDelay S69_SpeedReductionMonitoring S69_Subsystem S69_VIPChange_Deactive S69_VIP_lost_close S69_preBrakeTimeOutDetection /end SUB_GROUP
 /begin REF_CHARACTERISTIC KfAEBS_AccPdl_InhbtDeact_thrshld KfAEBS_Confidnc_Deact_thrshld /end REF_CHARACTERISTIC
 /begin REF_MEASUREMENT VbAEBS_Deactive_R_Confdnc VbAEBS_Deactive_R_NoVIP /end REF_MEASUREMENT
/end GROUP
/begin GROUP S40_Dtrn_VUR_and_VRU_Protection "AEBS_subsystem_integrated/AEBS/AEBS_Enabled/AEB_Determination/DtrmnThreatEvaluation/Dtrn_VUR_and_VRU_Protection" /begin SUB_GROUP S70_Dtrn_VRU_obstacle S70_Dtrn_VehicleSpeedState /end SUB_GROUP /begin REF_CHARACTERISTIC KbAEBS_Enable_VRU_Calibration /end REF_CHARACTERISTIC /begin REF_MEASUREMENT VfAEBS_use_VRU_Calibration /end REF_MEASUREMENT /end GROUP
/begin GROUP S40_Dtrn_vehicleStandStill "AEBS_subsystem_integrated/AEBS/AEBS_Enabled/AEB_Determination/DtrmnThreatEvaluation/Dtrn_vehicleStandStill"
 /begin REF_CHARACTERISTIC KfAEBS_t_Speed_DebounceTime KfAEBS_v_Speed_DeltaStStThrsh KfAEBS_v_Speed_StandStillThrsh /end REF_CHARACTERISTIC
 /begin REF_MEASUREMENT VfAEBS_veh_standstill /end REF_MEASUREMENT
/end GROUP
/begin GROUP S40_Enable_Evaluation "AEBS_subsystem_integrated/AEBS/AEBS_Enabled/AEB_Determination/DtrmnThreatEvaluation/Enable Evaluation" /begin REF_MEASUREMENT VfAEBS_AEB_disabled VfAEBS_AEB_enabled /end REF_MEASUREMENT /end GROUP
/begin GROUP S40_FullBrakeThreat "AEBS_subsystem_integrated/AEBS/AEBS_Enabled/AEB_Determination/DtrmnThreatEvaluation/FullBrakeThreat" /begin SUB_GROUP S73_Subsystem S73_Subsystem1 /end SUB_GROUP
 /begin REF_CHARACTERISTIC KfAEBS_Confdnc_FullBrkActThrsd KfAEBS_a_Areq_FullBrkActThrsd KfAEBS_a_Areq_FullBrkDeactThrsd /end REF_CHARACTERISTIC
 /begin REF_MEASUREMENT VfAEBS_fullBrk_active VfAEBS_fullBrk_dactive /end REF_MEASUREMENT
/end GROUP
/begin GROUP S40_PartialBrakeThreat "AEBS_subsystem_integrated/AEBS/AEBS_Enabled/AEB_Determination/DtrmnThreatEvaluation/PartialBrakeThreat" /begin SUB_GROUP S74_Dtrn_TTC_Threshold S74_Subsystem S74_Subsystem1 /end SUB_GROUP
 /begin REF_CHARACTERISTIC KfAEBS_Confdnc_PartialBrkActThrsd KfAEBS_a_Areq_PartialBrkActThrsd KfAEBS_a_Areq_PartialBrkDeactThrsd KfAEBS_t_TTC_PartialBrkDeactiveThrsd /end REF_CHARACTERISTIC
 /begin REF_MEASUREMENT VfAEBS_partialBrk_active VfAEBS_partialBrk_dactive /end REF_MEASUREMENT
/end GROUP
/begin GROUP S40_Prebrake_Threat "AEBS_subsystem_integrated/AEBS/AEBS_Enabled/AEB_Determination/DtrmnThreatEvaluation/Prebrake Threat" /begin SUB_GROUP S75_Dtrn_TTC_Threshold /end SUB_GROUP /begin REF_CHARACTERISTIC KfAEBS_t_TTC_PreBrkDeactThrsd /end REF_CHARACTERISTIC /begin REF_MEASUREMENT VfAEBS_preBrake_active VfAEBS_preBrake_dactive /end REF_MEASUREMENT /end GROUP
/begin GROUP S40_inhibit "AEBS_subsystem_integrated/AEBS/AEBS_Enabled/AEB_Determination/DtrmnThreatEvaluation/inhibit"
 /begin SUB_GROUP S76_Deactive_time_inhibit S76_Deactive_time_inhibit1 S76_Steer_angle_rate_inhibit S76_speed_inhibit S76_veh_acceleration_inhibit /end SUB_GROUP
 /begin REF_CHARACTERISTIC KbAEBS_enable_PreBrake KfAEBS_AccPdl_InhbtDeact_thrshld KfAEBS_Gear_Value_R /end REF_CHARACTERISTIC
 /begin REF_MEASUREMENT VbAEBS_AEB_inhbt_AccPdl VbAEBS_preBrake_inhibit VfAEBS_AEB_inhibit VfAEBS_Gear_InhibitAEB /end REF_MEASUREMENT
/end GROUP
/begin GROUP S154_Calc_Lateral_long_buffer "AEBS_subsystem_integrated/AEBS/AEBS_Enabled/AEB_FCWVIPTargetSelection/Calc_obs_lateral_long_buffer/Calc_Lateral_long_buffer"
 /begin SUB_GROUP S158_Calc_lateral_buffer S158_Calc_long_buffer S158_ObsIgnore /end SUB_GROUP
/end GROUP
/begin GROUP S184_CheckAEBS_SystemOverride "AEBS_subsystem_integrated/AEBS/AEBS_Enabled/FCW_Determination/DetermineFCWStatus/CheckAEBS_SystemOverride"
 /begin REF_CHARACTERISTIC KfAEBS_LoPosValInCllsnRednByBrkg KfAEBS_SpdMinOvrdAccrResetInCllsnRednByBrkg /end REF_CHARACTERISTIC
/end GROUP
/begin GROUP S186_Deactive "AEBS_subsystem_integrated/AEBS/AEBS_Enabled/FCW_Determination/ThreatEvaluation/Deactive" /begin SUB_GROUP S195_ObjDataChangeDetection S195_RaisingEdgeDelay1 /end SUB_GROUP
 /begin REF_CHARACTERISTIC KfAEBS_t_TTC_DeactiveThrsh KfAEBS_t_TTC_ObjChangThrsd KfAEBS_t_Time_HasNoVIPDelay KfAEBS_t_Time_TTCHLInhibitAEB /end REF_CHARACTERISTIC
/end GROUP
/begin GROUP S186_Dtrn_vehicleStandStill "AEBS_subsystem_integrated/AEBS/AEBS_Enabled/FCW_Determination/ThreatEvaluation/Dtrn_vehicleStandStill"
 /begin REF_CHARACTERISTIC KfAEBS_t_Speed_DebounceTime KfAEBS_v_Speed_DeltaStStThrsh KfAEBS_v_Speed_StandStillThrsh /end REF_CHARACTERISTIC
/end GROUP
/begin GROUP S186_Enable_Evaluation "AEBS_subsystem_integrated/AEBS/AEBS_Enabled/FCW_Determination/ThreatEvaluation/Enable Evaluation" /begin REF_MEASUREMENT VfAEBS_FCW_disabled VfAEBS_FCW_enabled /end REF_MEASUREMENT /end GROUP
/begin GROUP S186_FCW_level1_Threat "AEBS_subsystem_integrated/AEBS/AEBS_Enabled/FCW_Determination/ThreatEvaluation/FCW_level1 Threat"
 /begin REF_CHARACTERISTIC KfAEBS_t_TTC_FCWLevel1DeactThrsd KtAEBS_FCWL1ActiveTTCThrshld /end REF_CHARACTERISTIC
 /begin REF_MEASUREMENT VfAEBS_FCWLev1_active VfAEBS_FCWLev1_dactive /end REF_MEASUREMENT
/end GROUP
/begin GROUP S186_FCW_level2_Threat "AEBS_subsystem_integrated/AEBS/AEBS_Enabled/FCW_Determination/ThreatEvaluation/FCW_level2 Threat"
 /begin REF_CHARACTERISTIC KfAEBS_t_TTC_FCWLevel2DeactThrsd KtAEBS_FCWL2ActiveTTCThrshld /end REF_CHARACTERISTIC
 /begin REF_MEASUREMENT VfAEBS_FCWLev2_active VfAEBS_FCWLev2_dactive /end REF_MEASUREMENT
/end GROUP
/begin GROUP S186_FCW_level3_Threat "AEBS_subsystem_integrated/AEBS/AEBS_Enabled/FCW_Determination/ThreatEvaluation/FCW_level3 Threat"
 /begin REF_CHARACTERISTIC KfAEBS_t_TTC_FCWLevel3DeactThrsd KtAEBS_FCWL3ActiveTTCThrshld /end REF_CHARACTERISTIC
 /begin REF_MEASUREMENT VfAEBS_FCWLev3_active VfAEBS_FCWLev3_dactive /end REF_MEASUREMENT
/end GROUP
/begin GROUP S186_inhibit "AEBS_subsystem_integrated/AEBS/AEBS_Enabled/FCW_Determination/ThreatEvaluation/inhibit" /begin SUB_GROUP S201_Deactive_time_inhibit /end SUB_GROUP
 /begin REF_CHARACTERISTIC KfAEBS_AccPdl_InhbtDeact_thrshld KfAEBS_Gear_Value_R KfAEBS_VehAcc_inhbt_FCW_thrshld /end REF_CHARACTERISTIC
 /begin REF_MEASUREMENT VbAEBS_FCW_inhbt_AccPedPos VbAEBS_FCW_inhbt_VehAcc VbAEBS_FCW_inhibit /end REF_MEASUREMENT
/end GROUP
/begin GROUP S42_AccelReqFilter "AEBS_subsystem_integrated/AEBS/AEBS_Enabled/AEB_Determination/DetermineAEBStatus/CalcAEBSAcceleration/AccelReqFilter" /begin REF_CHARACTERISTIC KfAEBS_a_AreqRampRate /end REF_CHARACTERISTIC /begin REF_MEASUREMENT VfAEBS_AEB_acceleration_bf_limit /end REF_MEASUREMENT /end GROUP
/begin GROUP S42_AccelerationLimit "AEBS_subsystem_integrated/AEBS/AEBS_Enabled/AEB_Determination/DetermineAEBStatus/CalcAEBSAcceleration/AccelerationLimit" /begin REF_CHARACTERISTIC KtAEBS_a_BrakeValueLimit /end REF_CHARACTERISTIC /begin REF_MEASUREMENT VfAEBS_AEB_accReq_beforeSend /end REF_MEASUREMENT /end GROUP
/begin GROUP S42_First_Order_Low_Pass_Filter "AEBS_subsystem_integrated/AEBS/AEBS_Enabled/AEB_Determination/DetermineAEBStatus/CalcAEBSAcceleration/First Order Low Pass Filter" /begin REF_MEASUREMENT VfAEBS_AEB_acceleration_af_filter /end REF_MEASUREMENT /end GROUP
/begin GROUP S68_Subsystem2 "AEBS_subsystem_integrated/AEBS/AEBS_Enabled/AEB_Determination/DtrmnThreatEvaluation/CalcObsAreq/Subsystem2" /begin SUB_GROUP S78_Subsystem1 /end SUB_GROUP /begin REF_CHARACTERISTIC KfAEBS_a_FullBrakeHi /end REF_CHARACTERISTIC /end GROUP
/begin GROUP S69_HighTTCDeactive "AEBS_subsystem_integrated/AEBS/AEBS_Enabled/AEB_Determination/DtrmnThreatEvaluation/Deactive/HighTTCDeactive" /begin SUB_GROUP S82_RaisingEdgeDelay2 /end SUB_GROUP /begin REF_CHARACTERISTIC KfAEBS_t_TTC_DeactiveThrsh KfAEBS_t_Time_TTCHLInhibitAEB /end REF_CHARACTERISTIC /end GROUP
/begin GROUP S69_RisingEdgeDelay "AEBS_subsystem_integrated/AEBS/AEBS_Enabled/AEB_Determination/DtrmnThreatEvaluation/Deactive/RisingEdgeDelay" /begin SUB_GROUP S83_RaisingEdgeDelay /end SUB_GROUP /begin REF_CHARACTERISTIC KfAEBS_t_Time_HasNoVIPDelay /end REF_CHARACTERISTIC /end GROUP
/begin GROUP S69_SpeedReductionMonitoring "AEBS_subsystem_integrated/AEBS/AEBS_Enabled/AEB_Determination/DtrmnThreatEvaluation/Deactive/SpeedReductionMonitoring" /begin SUB_GROUP S84_SpeedReductionASILACheck /end SUB_GROUP /begin REF_CHARACTERISTIC KfAEBS_VeloRectThrsdByBrkg KfAEBS_t_TimeBrakeThrsd /end REF_CHARACTERISTIC /begin REF_MEASUREMENT VfAEBS_DeniedDueToSpdRed VfAEBS_DeniedDueToTimeBrake /end REF_MEASUREMENT /end GROUP
/begin GROUP S69_Subsystem "AEBS_subsystem_integrated/AEBS/AEBS_Enabled/AEB_Determination/DtrmnThreatEvaluation/Deactive/Subsystem" /begin REF_CHARACTERISTIC KfAEBS_v_VipStationaryThrshld /end REF_CHARACTERISTIC /begin REF_MEASUREMENT VbAEBS_vipStationary /end REF_MEASUREMENT /end GROUP
/begin GROUP S69_VIPChange_Deactive "AEBS_subsystem_integrated/AEBS/AEBS_Enabled/AEB_Determination/DtrmnThreatEvaluation/Deactive/VIPChange_Deactive" /begin SUB_GROUP S86_ObjDataChangeDetection /end SUB_GROUP /begin REF_CHARACTERISTIC KfAEBS_a_Areq_ObjChangThrsd /end REF_CHARACTERISTIC /begin REF_MEASUREMENT VbAEBS_Deactive_R_VIPChanged /end REF_MEASUREMENT /end GROUP
/begin GROUP S69_VIP_lost_close "AEBS_subsystem_integrated/AEBS/AEBS_Enabled/AEB_Determination/DtrmnThreatEvaluation/Deactive/VIP_lost_close" /begin SUB_GROUP S87_vipCloseLostTimeOut /end SUB_GROUP
 /begin REF_CHARACTERISTIC KfAEBS_d_lateral_max_lostClose KfAEBS_d_lateral_min_lostClose KfAEBS_d_long_max_lostClose KfAEBS_d_long_min_lostClose KfAEBS_v_speed_max_lostClose KfAEBS_v_speed_min_lostClose /end REF_CHARACTERISTIC
 /begin REF_MEASUREMENT VbAEBS_vipCloseLost /end REF_MEASUREMENT
/end GROUP
/begin GROUP S69_preBrakeTimeOutDetection "AEBS_subsystem_integrated/AEBS/AEBS_Enabled/AEB_Determination/DtrmnThreatEvaluation/Deactive/preBrakeTimeOutDetection" /begin REF_CHARACTERISTIC KfAEBS_t_TimePreBrkThrsd /end REF_CHARACTERISTIC /begin REF_MEASUREMENT VbAEBS_deactive_preBrk_timeOut /end REF_MEASUREMENT /end GROUP
/begin GROUP S70_Dtrn_VRU_obstacle "AEBS_subsystem_integrated/AEBS/AEBS_Enabled/AEB_Determination/DtrmnThreatEvaluation/Dtrn_VUR_and_VRU_Protection/Dtrn_VRU_obstacle" /begin REF_MEASUREMENT VfAEBS_Obj_IsVRU /end REF_MEASUREMENT /end GROUP
/begin GROUP S70_Dtrn_VehicleSpeedState "AEBS_subsystem_integrated/AEBS/AEBS_Enabled/AEB_Determination/DtrmnThreatEvaluation/Dtrn_VUR_and_VRU_Protection/Dtrn_VehicleSpeedState"
 /begin REF_CHARACTERISTIC KfAEBS_v_isInHighSpeed_HighThrshd KfAEBS_v_isInHighSpeed_LowThrshd /end REF_CHARACTERISTIC
 /begin REF_MEASUREMENT VfAEBS_Vehicle_isInHighSpeed /end REF_MEASUREMENT
/end GROUP
/begin GROUP S73_Subsystem "AEBS_subsystem_integrated/AEBS/AEBS_Enabled/AEB_Determination/DtrmnThreatEvaluation/FullBrakeThreat/Subsystem"
 /begin REF_CHARACTERISTIC KbAEBS_use_steerAngle KfAEBS_SteerRate_Limit_hi KfAEBS_SteerRate_Limit_lo KfAEBS_YawRate_Limit_hi KfAEBS_YawRate_Limit_lo /end REF_CHARACTERISTIC
/end GROUP
/begin GROUP S73_Subsystem1 "AEBS_subsystem_integrated/AEBS/AEBS_Enabled/AEB_Determination/DtrmnThreatEvaluation/FullBrakeThreat/Subsystem1" /begin REF_CHARACTERISTIC KfAEBS_t_fb_active_delay_turn /end REF_CHARACTERISTIC /end GROUP
/begin GROUP S74_Dtrn_TTC_Threshold "AEBS_subsystem_integrated/AEBS/AEBS_Enabled/AEB_Determination/DtrmnThreatEvaluation/PartialBrakeThreat/Dtrn_TTC_Threshold"
 /begin REF_CHARACTERISTIC KtAEBS_PrtlBrkActiveTTCThrshld KtAEBS_PrtlBrkActiveTTCThrshld_VRU /end REF_CHARACTERISTIC
 /begin REF_MEASUREMENT VfAEBS_Partial_BrakeActiveTTCThreshold /end REF_MEASUREMENT
/end GROUP
/begin GROUP S74_Subsystem "AEBS_subsystem_integrated/AEBS/AEBS_Enabled/AEB_Determination/DtrmnThreatEvaluation/PartialBrakeThreat/Subsystem"
 /begin REF_CHARACTERISTIC KbAEBS_use_steerAngle KfAEBS_SteerRate_Limit_hi KfAEBS_SteerRate_Limit_lo KfAEBS_YawRate_Limit_hi KfAEBS_YawRate_Limit_lo /end REF_CHARACTERISTIC
/end GROUP
/begin GROUP S74_Subsystem1 "AEBS_subsystem_integrated/AEBS/AEBS_Enabled/AEB_Determination/DtrmnThreatEvaluation/PartialBrakeThreat/Subsystem1" /begin REF_CHARACTERISTIC KfAEBS_t_pb_active_delay_turn /end REF_CHARACTERISTIC /end GROUP
/begin GROUP S75_Dtrn_TTC_Threshold "AEBS_subsystem_integrated/AEBS/AEBS_Enabled/AEB_Determination/DtrmnThreatEvaluation/Prebrake Threat/Dtrn_TTC_Threshold"
 /begin REF_CHARACTERISTIC KtAEBS_PreBrkActiveTTCThrshld KtAEBS_PreBrkActiveTTCThrshld_VRU /end REF_CHARACTERISTIC
 /begin REF_MEASUREMENT VfAEBS_Pre_BrakeActiveTTCThreshold /end REF_MEASUREMENT
/end GROUP
/begin GROUP S76_Deactive_time_inhibit "AEBS_subsystem_integrated/AEBS/AEBS_Enabled/AEB_Determination/DtrmnThreatEvaluation/inhibit/Deactive_time_inhibit" /begin REF_CHARACTERISTIC KfAEBS_t_Time_TwiceAEBActive /end REF_CHARACTERISTIC /begin REF_MEASUREMENT VbAEBS_AEB_inhbt_DeactTime /end REF_MEASUREMENT /end GROUP
/begin GROUP S76_Deactive_time_inhibit1 "AEBS_subsystem_integrated/AEBS/AEBS_Enabled/AEB_Determination/DtrmnThreatEvaluation/inhibit/Deactive_time_inhibit1" /begin REF_CHARACTERISTIC KfAEBS_t_Time_TwicePreBrkActive /end REF_CHARACTERISTIC /begin REF_MEASUREMENT VbAEBS_PreBrk_inhbt_deactTime /end REF_MEASUREMENT /end GROUP
/begin GROUP S76_Steer_angle_rate_inhibit "AEBS_subsystem_integrated/AEBS/AEBS_Enabled/AEB_Determination/DtrmnThreatEvaluation/inhibit/Steer_angle_rate_inhibit" /begin REF_CHARACTERISTIC KfAEBS_StrAngRte_inhbt_AEB_trshd /end REF_CHARACTERISTIC /begin REF_MEASUREMENT VbAEBS_AEB_inhbt_StrAngRte /end REF_MEASUREMENT /end GROUP
/begin GROUP S76_speed_inhibit "AEBS_subsystem_integrated/AEBS/AEBS_Enabled/AEB_Determination/DtrmnThreatEvaluation/inhibit/speed_inhibit"
 /begin REF_CHARACTERISTIC KfAEBS_t_Time_TTCHLInhibitAEB KfAEBS_v_SpdCollisionInhibitAEB KfAEBS_v_Speed_High_InhibitAEB KfAEBS_v_Speed_MaxInhibitAEB KfAEBS_v_deltaSpeed_InhibitAEB /end REF_CHARACTERISTIC
 /begin REF_MEASUREMENT VfAEBS_HighSpeed_InhibitAEB VfAEBS_LowSpeed_InhibitAEB VfAEBS_Speed_InhibitAEB VfAEBS_VehDeltaSpeed_InhibitAEB /end REF_MEASUREMENT
/end GROUP
/begin GROUP S76_veh_acceleration_inhibit "AEBS_subsystem_integrated/AEBS/AEBS_Enabled/AEB_Determination/DtrmnThreatEvaluation/inhibit/veh_acceleration_inhibit" /begin REF_CHARACTERISTIC KtAEBS_veh_acc_inhibit_AEB_thrhd /end REF_CHARACTERISTIC /begin REF_MEASUREMENT VbAEBS_AEB_inhbt_veh_acc /end REF_MEASUREMENT /end GROUP
/begin GROUP S158_Calc_lateral_buffer "AEBS_subsystem_integrated/AEBS/AEBS_Enabled/AEB_FCWVIPTargetSelection/Calc_obs_lateral_long_buffer/Calc_Lateral_long_buffer/Calc_lateral_buffer"
 /begin SUB_GROUP S159_Bicycle S159_Motorcycle S159_Other S159_Pedestrain S159_VehicleBusTruck /end SUB_GROUP
/end GROUP
/begin GROUP S158_Calc_long_buffer "AEBS_subsystem_integrated/AEBS/AEBS_Enabled/AEB_FCWVIPTargetSelection/Calc_obs_lateral_long_buffer/Calc_Lateral_long_buffer/Calc_long_buffer"
 /begin SUB_GROUP S160_Bicycle S160_Motorcycle S160_Other S160_Pedestrain S160_VehicleBusTruck /end SUB_GROUP
/end GROUP
/begin GROUP S195_ObjDataChangeDetection "AEBS_subsystem_integrated/AEBS/AEBS_Enabled/FCW_Determination/ThreatEvaluation/Deactive/ObjDataChangeDetection" /begin REF_CHARACTERISTIC KfAEBS_Change_LateralPosThrsh KfAEBS_Change_LonglPosThrsh /end REF_CHARACTERISTIC /end GROUP
/begin GROUP S195_RaisingEdgeDelay1 "AEBS_subsystem_integrated/AEBS/AEBS_Enabled/FCW_Determination/ThreatEvaluation/Deactive/RaisingEdgeDelay1" /begin REF_MEASUREMENT VfAEBS_FCW_deacitve /end REF_MEASUREMENT /end GROUP
/begin GROUP S201_Deactive_time_inhibit "AEBS_subsystem_integrated/AEBS/AEBS_Enabled/FCW_Determination/ThreatEvaluation/inhibit/Deactive_time_inhibit" /begin REF_CHARACTERISTIC KfAEBS_t_Time_TwiceFCWActive /end REF_CHARACTERISTIC /begin REF_MEASUREMENT VbAEBS_FCW_inhbt_DeactTime /end REF_MEASUREMENT /end GROUP
/begin GROUP S78_Subsystem1 "AEBS_subsystem_integrated/AEBS/AEBS_Enabled/AEB_Determination/DtrmnThreatEvaluation/CalcObsAreq/Subsystem2/Subsystem1" /begin REF_CHARACTERISTIC KfAEBS_a_Buffer /end REF_CHARACTERISTIC /end GROUP
/begin GROUP S82_RaisingEdgeDelay2 "AEBS_subsystem_integrated/AEBS/AEBS_Enabled/AEB_Determination/DtrmnThreatEvaluation/Deactive/HighTTCDeactive/RaisingEdgeDelay2" /begin REF_MEASUREMENT VbAEBS_Deactive_R_HighTTC /end REF_MEASUREMENT /end GROUP
/begin GROUP S83_RaisingEdgeDelay "AEBS_subsystem_integrated/AEBS/AEBS_Enabled/AEB_Determination/DtrmnThreatEvaluation/Deactive/RisingEdgeDelay/RaisingEdgeDelay" /begin REF_MEASUREMENT VfAEBS_AEB_deactive /end REF_MEASUREMENT /end GROUP
/begin GROUP S84_SpeedReductionASILACheck "AEBS_subsystem_integrated/AEBS/AEBS_Enabled/AEB_Determination/DtrmnThreatEvaluation/Deactive/SpeedReductionMonitoring/SpeedReductionASILACheck"
 /begin REF_CHARACTERISTIC KfAEBS_t_Time_ResetTimeBrkThrsd KfAEBS_t_Time_ResetVeloRdctThrsd /end REF_CHARACTERISTIC
/end GROUP
/begin GROUP S86_ObjDataChangeDetection "AEBS_subsystem_integrated/AEBS/AEBS_Enabled/AEB_Determination/DtrmnThreatEvaluation/Deactive/VIPChange_Deactive/ObjDataChangeDetection" /begin REF_CHARACTERISTIC KfAEBS_Change_LateralPosThrsh KfAEBS_Change_LonglPosThrsh /end REF_CHARACTERISTIC /end GROUP
/begin GROUP S87_vipCloseLostTimeOut "AEBS_subsystem_integrated/AEBS/AEBS_Enabled/AEB_Determination/DtrmnThreatEvaluation/Deactive/VIP_lost_close/vipCloseLostTimeOut" /begin REF_CHARACTERISTIC KfAEBS_t_VipCloseLostTimeOut /end REF_CHARACTERISTIC /end GROUP
/begin GROUP S159_Bicycle "AEBS_subsystem_integrated/AEBS/AEBS_Enabled/AEB_FCWVIPTargetSelection/Calc_obs_lateral_long_buffer/Calc_Lateral_long_buffer/Calc_lateral_buffer/Bicycle" /begin REF_CHARACTERISTIC KtAEBS_LateralBuffer_Bicycle /end REF_CHARACTERISTIC /end GROUP
/begin GROUP S159_Motorcycle "AEBS_subsystem_integrated/AEBS/AEBS_Enabled/AEB_FCWVIPTargetSelection/Calc_obs_lateral_long_buffer/Calc_Lateral_long_buffer/Calc_lateral_buffer/Motorcycle" /begin REF_CHARACTERISTIC KtAEBS_LateralBuffer_Motor /end REF_CHARACTERISTIC /end GROUP
/begin GROUP S159_Other "AEBS_subsystem_integrated/AEBS/AEBS_Enabled/AEB_FCWVIPTargetSelection/Calc_obs_lateral_long_buffer/Calc_Lateral_long_buffer/Calc_lateral_buffer/Other" /begin REF_CHARACTERISTIC KtAEBS_LateralBuffer_Other /end REF_CHARACTERISTIC /end GROUP
/begin GROUP S159_Pedestrain "AEBS_subsystem_integrated/AEBS/AEBS_Enabled/AEB_FCWVIPTargetSelection/Calc_obs_lateral_long_buffer/Calc_Lateral_long_buffer/Calc_lateral_buffer/Pedestrain" /begin REF_CHARACTERISTIC KtAEBS_LateralBuffer_Pedstrn /end REF_CHARACTERISTIC /end GROUP
/begin GROUP S159_VehicleBusTruck "AEBS_subsystem_integrated/AEBS/AEBS_Enabled/AEB_FCWVIPTargetSelection/Calc_obs_lateral_long_buffer/Calc_Lateral_long_buffer/Calc_lateral_buffer/VehicleBusTruck" /begin REF_CHARACTERISTIC KtAEBS_LateralBuffer_Vehicle /end REF_CHARACTERISTIC /end GROUP
/begin GROUP S160_Bicycle "AEBS_subsystem_integrated/AEBS/AEBS_Enabled/AEB_FCWVIPTargetSelection/Calc_obs_lateral_long_buffer/Calc_Lateral_long_buffer/Calc_long_buffer/Bicycle" /begin REF_CHARACTERISTIC KtAEBS_LongBuffer_Bicycle /end REF_CHARACTERISTIC /end GROUP
/begin GROUP S160_Motorcycle "AEBS_subsystem_integrated/AEBS/AEBS_Enabled/AEB_FCWVIPTargetSelection/Calc_obs_lateral_long_buffer/Calc_Lateral_long_buffer/Calc_long_buffer/Motorcycle" /begin REF_CHARACTERISTIC KtAEBS_LongBuffer_Motor /end REF_CHARACTERISTIC /end GROUP
/begin GROUP S160_Other "AEBS_subsystem_integrated/AEBS/AEBS_Enabled/AEB_FCWVIPTargetSelection/Calc_obs_lateral_long_buffer/Calc_Lateral_long_buffer/Calc_long_buffer/Other" /begin REF_CHARACTERISTIC KtAEBS_LongBuffer_Other /end REF_CHARACTERISTIC /end GROUP
/begin GROUP S160_Pedestrain "AEBS_subsystem_integrated/AEBS/AEBS_Enabled/AEB_FCWVIPTargetSelection/Calc_obs_lateral_long_buffer/Calc_Lateral_long_buffer/Calc_long_buffer/Pedestrain" /begin REF_CHARACTERISTIC KtAEBS_LongBuffer_Pedstrn /end REF_CHARACTERISTIC /end GROUP
/begin GROUP S160_VehicleBusTruck "AEBS_subsystem_integrated/AEBS/AEBS_Enabled/AEB_FCWVIPTargetSelection/Calc_obs_lateral_long_buffer/Calc_Lateral_long_buffer/Calc_long_buffer/VehicleBusTruck" /begin REF_CHARACTERISTIC KtAEBS_LongBuffer_Vehicle /end REF_CHARACTERISTIC /end GROUP
/begin GROUP ARBT_subsystem_integrated "ARBT_subsystem_integrated" ROOT /begin SUB_GROUP Root_ARBTIntegrated /end SUB_GROUP /end GROUP
/begin GROUP Root_ARBTIntegrated "ARBT_subsystem_integrated/ARBTIntegrated"
 /begin SUB_GROUP S1_AccessoryArbitration S1_BrakeArbitration S1_PowerArbitration S1_RecordTriggerArbitration S1_SteerArbitration S1_WarningArbitration /end SUB_GROUP
/end GROUP
/begin GROUP S1_AccessoryArbitration "ARBT_subsystem_integrated/ARBTIntegrated/AccessoryArbitration"
 /begin SUB_GROUP S3_DtrmnVehStandStill S3_ElectricParkingBrakeControl S3_GearPosControl /end SUB_GROUP
 /begin REF_CHARACTERISTIC KbARBT_SLEW_autohold_active KbARBT_SLEW_gear_ctrl_accel_req KfARBT_autohold_timeout /end REF_CHARACTERISTIC
/end GROUP
/begin GROUP S1_BrakeArbitration "ARBT_subsystem_integrated/ARBTIntegrated/BrakeArbitration"
 /begin REF_CHARACTERISTIC KfARBT_brake_req_lon_a_lowerlimit KfARBT_brake_req_lon_a_upperlimit /end REF_CHARACTERISTIC
 /begin REF_MEASUREMENT VbARBT_brake_ctrl_enbl_to_comm VeARBT_brake_arbt_winner VfARBT_brake_req_lon_a VfARBT_brake_req_lon_a_raw /end REF_MEASUREMENT
/end GROUP
/begin GROUP S1_PowerArbitration "ARBT_subsystem_integrated/ARBTIntegrated/PowerArbitration"
 /begin REF_CHARACTERISTIC KbARBT_power_req_mode_man_ctrl_temp KfARBT_power_req_lon_a_lowerlimit KfARBT_power_req_lon_a_upperlimit /end REF_CHARACTERISTIC
 /begin REF_MEASUREMENT VbARBT_power_ctrl_enbl_to_comm VeARBT_power_arbt_winner VfARBT_power_req_lon_a VfARBT_power_req_lon_a_raw VfARBT_power_req_mode VfARBT_power_req_torque /end REF_MEASUREMENT
/end GROUP
/begin GROUP S1_RecordTriggerArbitration "ARBT_subsystem_integrated/ARBTIntegrated/RecordTriggerArbitration"
 /begin REF_CHARACTERISTIC KfARBT_brk_ped_pos_thrsh_rec_trig KfARBT_lon_a_thrsh_rec_trig KfARBT_t_false_aeb_time_gap_thrsh KfARBT_t_hard_brake_debounce_time KfARBT_t_hard_brake_time_out KfARBT_t_missed_aeb_time_gap_thrsh /end REF_CHARACTERISTIC
 /begin REF_MEASUREMENT VbARBT_aeb_triggered_flag VbARBT_driver_hard_brake_flag VbARBT_false_aeb_flag VbARBT_missed_aeb_flag /end REF_MEASUREMENT
/end GROUP
/begin GROUP S1_SteerArbitration "ARBT_subsystem_integrated/ARBTIntegrated/SteerArbitration"
 /begin REF_CHARACTERISTIC KfARBT_steer_req_strwhl_angle_lowerlimit KfARBT_steer_req_strwhl_angle_upperlimit /end REF_CHARACTERISTIC
 /begin REF_MEASUREMENT VbARBT_steer_ctrl_enbl_to_comm VeARBT_steer_arbt_winner VfARBT_steer_req_mode VfARBT_steer_req_strwhl_angle VfARBT_steer_req_strwhl_angle_raw VfARBT_steer_req_strwhl_torque /end REF_MEASUREMENT
/end GROUP
/begin GROUP S1_WarningArbitration "ARBT_subsystem_integrated/ARBTIntegrated/WarningArbitration"
 /begin REF_MEASUREMENT VbARBT_BSD_left_high_raw VbARBT_BSD_left_low_raw VbARBT_BSD_right_high_raw VbARBT_BSD_right_low_raw VbARBT_FCW_level_five VbARBT_FCW_level_four VbARBT_FCW_level_one VbARBT_FCW_level_three VbARBT_FCW_level_two VbARBT_LCA_left_high_raw VbARBT_LCA_left_low_raw VbARBT_LCA_right_high_raw VbARBT_LCA_right_low_raw VbARBT_LDW_left VbARBT_LDW_right VbARBT_warn_lcw_left_req VbARBT_warn_lcw_right_req /end REF_MEASUREMENT
/end GROUP
/begin GROUP S3_DtrmnVehStandStill "ARBT_subsystem_integrated/ARBTIntegrated/AccessoryArbitration/DtrmnVehStandStill"
 /begin REF_CHARACTERISTIC KfARBT_t_speed_debounce_time KfARBT_v_moving_speed_thrsh KfARBT_v_standstill_speed_thrsh /end REF_CHARACTERISTIC
 /begin REF_MEASUREMENT VbARBT_vehicle_standstill /end REF_MEASUREMENT
/end GROUP
/begin GROUP S3_ElectricParkingBrakeControl "ARBT_subsystem_integrated/ARBTIntegrated/AccessoryArbitration/ElectricParkingBrakeControl" /begin REF_CHARACTERISTIC KbARBT_gear_pos_fedbck_valid /end REF_CHARACTERISTIC
 /begin REF_MEASUREMENT VbARBT_EPB_ctrl_enbl_to_comm VbARBT_EPB_ctrl_mode VbARBT_EPB_switch_request /end REF_MEASUREMENT
/end GROUP
/begin GROUP S3_GearPosControl "ARBT_subsystem_integrated/ARBTIntegrated/AccessoryArbitration/GearPosControl"
 /begin REF_MEASUREMENT VbARBT_auto_hold_req VbARBT_gear_ctrl_enbl_to_comm VfARBT_gear_ctrl_state VfARBT_gear_pos_req /end REF_MEASUREMENT
/end GROUP
/begin GROUP COMM_subsystem_integrated "COMM_subsystem_integrated" ROOT /begin SUB_GROUP Root_Receive Root_Transmit /end SUB_GROUP
 /begin REF_MEASUREMENT VbHWIO_DriverModeComd VbHWIO_LeftTurningLightState VbHWIO_RightTurningLightState /end REF_MEASUREMENT
/end GROUP
/begin GROUP Root_Receive "COMM_subsystem_integrated/Receive" /begin SUB_GROUP S1_Subsystem S1_iEV7S S1_iEV7S_New S1_iVISTA S1_iVISTA_New /end SUB_GROUP
 /begin REF_CHARACTERISTIC KbCOMM_VEH_UseNewConfig KcCOMM_VehicleCANbusConfig KeCOMM_NewCANTest_Type /end REF_CHARACTERISTIC
 /begin REF_MEASUREMENT VbCOMM_BCM_BackTrunkStatus VbCOMM_BCM_BrakeLightStatus VbCOMM_BCM_ControlResponse VbCOMM_BCM_CruiseSwLimitMain VbCOMM_BCM_CruiseSwMain VbCOMM_BCM_CruiseSwResume VbCOMM_BCM_CruiseSwSet VbCOMM_BCM_CruiseSwTimeGapMinus VbCOMM_BCM_CruiseSwTimeGapPlus VbCOMM_BCM_CruiseSwValid VbCOMM_BCM_DriverDoorStatus VbCOMM_BCM_DriverSeatBelt VbCOMM_BCM_DriverSeatBeltValid VbCOMM_BCM_FrontHoodStatus VbCOMM_BCM_HighBeamSwitch VbCOMM_BCM_IgnitionKeyState VbCOMM_BCM_LeftTurningLightState VbCOMM_BCM_LowBeamSwitch VbCOMM_BCM_PassengerDoorStatus VbCOMM_BCM_RearLeftDoorStatus VbCOMM_BCM_RearRightDoorStatus VbCOMM_BCM_RightTurningLightState VbCOMM_BCM_TurningLightEcho VbCOMM_BCM_WiperSwitch VbCOMM_EMS_CoolantLevelLow VbCOMM_EMS_EngineSpeedValid VbCOMM_EPB_AutoholdStatus VbCOMM_EPB_ParkingControlResponse VbCOMM_EPB_SwitchStatus VbCOMM_EPS_HandsOffWheelDetected VbCOMM_EPS_HandsOnWheelDetected VbCOMM_EPS_SteeringControlResponse VbCOMM_EPS_SteeringControlResponse_LCC VbCOMM_EPS_SteeringControlResponse_LDW VbCOMM_EPS_SteeringWheelTorqueValid VbCOMM_ESP_ABSActive VbCOMM_ESP_BrakeControlResponse VbCOMM_ESP_MasterCylinderPressValid VbCOMM_ESP_TCSActive VbCOMM_HandsOffWheelDetected VbCOMM_HandsOnWheelDetected VbCOMM_PCU_PowerControlResponse VbCOMM_VCU_AccelPedalOverride VbCOMM_VCU_AccelPedalValid VbCOMM_VCU_ActualBrakePedalSwitch VbCOMM_VCU_AutodriveActiveStatus VbCOMM_VCU_AutodriveMainSwitch VbCOMM_VCU_BrakePedalValid VbCOMM_VCU_VirtualAccelPedalValid VbCOMM_VDC_LateralAccelerationValid VbCOMM_VDC_LongAccelerationValid VbCOMM_VDC_WheelSpeed_FLValid VbCOMM_VDC_WheelSpeed_FRValid VbCOMM_VDC_WheelSpeed_RL1Valid VbCOMM_VDC_WheelSpeed_RL2Valid VbCOMM_VDC_WheelSpeed_RR1Valid VbCOMM_VDC_WheelSpeed_RR2Valid VbCOMM_VDC_YawRateValid VcCOMM_Auto_To_Manual_Tips VcCOMM_Decs_FedBck_BrkPedSts VcCOMM_Decs_FedBck_Drivemod VcCOMM_Decs_FedBck_EPBstate VcCOMM_Decs_FedBck_EPSmod VcCOMM_Decs_FedBck_ESCmod VcCOMM_Decs_FedBck_GearValue VcCOMM_Decs_FedBck_KeyState VcCOMM_DriverModeComd VcCOMM_VCU_DirIndicationLH VcCOMM_VCU_DirIndicationRH VcCOMM_VCU_HeadLampHighBeam VcCOMM_VCU_HeadLampLowBeam VeCOMM_BCM_CruiseControlStatus VeCOMM_BCM_DriveMode VeCOMM_EMS_EngineState VeCOMM_EMS_StartStopStatus VeCOMM_EPB_ActualControlStatus VeCOMM_EPB_SystemFaultStatus VeCOMM_EPS_FaultLevel VeCOMM_EPS_SteeringModeEcho VeCOMM_ESP_SystemFaultStatus VeCOMM_PCU_PowertrainFaultLevel VeCOMM_TCU_ActualGearPosition VeCOMM_TCU_ShiftLevelPosition VeCOMM_TCU_TargetGearPositionEcho VeCOMM_VCU_AutoToManualTips VfCOMM_AccPedl VfCOMM_Actual_Gear_Ratio VfCOMM_Decs_FedBck_StrAngle VfCOMM_Decs_FedBck_VehSpd VfCOMM_EMS_CatalystTankLevel VfCOMM_EMS_EngineCoolantTemperature VfCOMM_EMS_EngineOilPressure VfCOMM_EMS_EngineSpeed VfCOMM_EPS_ActualSteeringAngle VfCOMM_EPS_SteeringAngleRate VfCOMM_EPS_SteeringTorqueAct VfCOMM_EPS_SteeringWheelTorque VfCOMM_EPS_TargetSteeringAngleEcho VfCOMM_ESP_BrakeAirTankPressure VfCOMM_ESP_MasterCylinderPress VfCOMM_PCU_ActualEngineTorque VfCOMM_PCU_BatterySOC VfCOMM_PCU_DriverDemandTorque VfCOMM_PCU_EngineTorqueLoss VfCOMM_PCU_MotorActualTorque VfCOMM_PCU_MotorSpeed VfCOMM_TCU_ActualGearRatio VfCOMM_VCU_ActualAccelPedalPosition VfCOMM_VCU_ActualBrakePedalPosition VfCOMM_VCU_BrkPedPos VfCOMM_VCU_ESCWhlFLSpd VfCOMM_VCU_ESCWhlFRSpd VfCOMM_VCU_ESCWhlRLSpd VfCOMM_VCU_ESCWhlRRSpd VfCOMM_VCU_LateralAcc VfCOMM_VCU_LongitudinalAcc VfCOMM_VCU_TargetAccelPedalPostionEcho VfCOMM_VCU_TargetBrakePedalEcho VfCOMM_VCU_VirtualAccelPedalPosition VfCOMM_VCU_YawRate VfCOMM_VDC_LateralAcceleration VfCOMM_VDC_LongAcceleration VfCOMM_VDC_VehicleSpeed VfCOMM_VDC_WheelEncoderCounter_RL VfCOMM_VDC_WheelEncoderCounter_RR VfCOMM_VDC_WheelSpeed_FL VfCOMM_VDC_WheelSpeed_FR VfCOMM_VDC_WheelSpeed_RL1 VfCOMM_VDC_WheelSpeed_RL2 VfCOMM_VDC_WheelSpeed_RR1 VfCOMM_VDC_WheelSpeed_RR2 VfCOMM_VDC_YawRate /end REF_MEASUREMENT
/end GROUP
/begin GROUP Root_Transmit "COMM_subsystem_integrated/Transmit"
 /begin SUB_GROUP S2_FAW S2_FAW_New S2_ICPV S2_ICPV_New S2_Test_Mode S2_Test_Mode_New /end SUB_GROUP
 /begin REF_CHARACTERISTIC KbCOMM_NewCANTest KcCOMM_Test_Cmd_EPSXBW_En KcCOMM_Test_Cmd_EPSXBW_En_ovr KcCOMM_Test_Cmd_StrAngle KcCOMM_Test_Cmd_StrAngle_ovr KcCOMM_Test_Decs_Acc_Req KcCOMM_Test_Decs_Acc_Req_ovr KcCOMM_Test_Decs_Acc_Value KcCOMM_Test_Decs_Acc_Value_ovr KcCOMM_Test_Decs_Breake_Req KcCOMM_Test_Decs_Breake_Req_ovr KcCOMM_Test_Decs_Breake_Value KcCOMM_Test_Decs_Breake_Value_ovr KcCOMM_Test_mode KcCOMM_VehicleCANbusConfig KeCOMM_NewCANTest_Type /end REF_CHARACTERISTIC
 /begin REF_MEASUREMENT VbCOMM_ADCU_AutodriveEnable VbCOMM_ADCU_BCMControlEnable VbCOMM_ADCU_BackFogLghtRequest VbCOMM_ADCU_BrakeEnable VbCOMM_ADCU_BrakeLightRequest VbCOMM_ADCU_EmergencyLightRequest VbCOMM_ADCU_FrontFogLightRequest VbCOMM_ADCU_HighBeamRequest VbCOMM_ADCU_HornRequest VbCOMM_ADCU_LaunchRequest VbCOMM_ADCU_LeftTurningLightRequest VbCOMM_ADCU_LowBeamRequest VbCOMM_ADCU_OverSpeedWarning VbCOMM_ADCU_ParkingControlEnable VbCOMM_ADCU_ParkingPressureRequest VbCOMM_ADCU_PositionLightRequest VbCOMM_ADCU_PowerEnable VbCOMM_ADCU_RightTurningLightRequest VbCOMM_ADCU_SpeedDownIndicator VbCOMM_ADCU_SpeedUpIndicator VbCOMM_ADCU_SteeringAngleEnable VbCOMM_ADCU_TargetGearEnable VbCOMM_Decs_BckfogLmp_Req VbCOMM_Decs_BrkLight_Req VbCOMM_Decs_DippedBeam_Req VbCOMM_Decs_FrontFogLamp_Req VbCOMM_Decs_HighBeam_Req VbCOMM_Decs_Horn_Req VbCOMM_Decs_LftLmp_Req VbCOMM_Decs_Light_Req VbCOMM_Decs_RihtLmp_Req VbCOMM_Decs_WarnLight_Req VbCOMM_Decs_iBCM_Req VcCOMM_Decs_Acc_Req VcCOMM_Decs_Breake_Req VcCOMM_Decs_Control_mod VcCOMM_Decs_Gear_Req VcCOMM_Decs_Gear_Value VcCOMM_Decs_Steering_Req VcCOMM_EPB_control_enable VcCOMM_EPB_switch_request VeCOMM_ADCU_ParkingControlValue VeCOMM_ADCU_TargetGearValue VfCOMM_ADCU_BrakeDecelValue VfCOMM_ADCU_BrakePressureValue VfCOMM_ADCU_PowerAccelValue VfCOMM_ADCU_PowerTorqueValue VfCOMM_ADCU_SteeringAngleValue VfCOMM_ADCU_TargetVehicleSpeed VfCOMM_Decs_Acc_Value VfCOMM_Decs_Breake_Value VfCOMM_Decs_SteeringAngle VfCOMM_req_pct_torque_raw /end REF_MEASUREMENT
/end GROUP
/begin GROUP S1_Subsystem "COMM_subsystem_integrated/Receive/Subsystem"
 /begin REF_CHARACTERISTIC KfACCS_d_VEH_WheelDiameter KfCOMM_Ang_VEH_AngOrigin2FrontWheel KfCOMM_VEH_Mass KfCOMM_VEH_StiffnessFront KfCOMM_VEH_StiffnessRear KfCOMM_VEH_YawInertia_Z KfCOMM_d_VEH_DisCentorid2Front KfCOMM_d_VEH_DisFront2Rear KfCOMM_d_VEH_DisLeft2Right KfCOMM_d_VEH_DisOrigin2End KfCOMM_d_VEH_DisOrigin2FrontWheel KfCOMM_d_VEH_DisOrigin2Head KfCOMM_d_VEH_DisOrigin2RearAxle KfCOMM_d_VEH_Length KfCOMM_d_VEH_MinTurnRadius KfCOMM_d_VEH_Width /end REF_CHARACTERISTIC
/end GROUP
/begin GROUP S1_iEV7S "COMM_subsystem_integrated/Receive/iEV7S" /begin REF_CHARACTERISTIC KfCOMM_a_VCULongAccOffset KfCOMM_r_VCULongAccSlope /end REF_CHARACTERISTIC /end GROUP
/begin GROUP S1_iEV7S_New "COMM_subsystem_integrated/Receive/iEV7S_New" /begin REF_CHARACTERISTIC KfCOMM_a_VCULongAccOffset KfCOMM_r_VCULongAccSlope /end REF_CHARACTERISTIC /end GROUP
/begin GROUP S1_iVISTA "COMM_subsystem_integrated/Receive/iVISTA" /begin REF_CHARACTERISTIC KfCOMM_a_VCULongAccOffset KfCOMM_r_VCULongAccSlope /end REF_CHARACTERISTIC /end GROUP
/begin GROUP S1_iVISTA_New "COMM_subsystem_integrated/Receive/iVISTA_New" /begin REF_CHARACTERISTIC KfCOMM_a_VCULongAccOffset KfCOMM_r_VCULongAccSlope /end REF_CHARACTERISTIC /end GROUP
/begin GROUP S2_FAW "COMM_subsystem_integrated/Transmit/FAW" /begin SUB_GROUP S67_Command_Mapping /end SUB_GROUP /begin REF_CHARACTERISTIC KcCOMM_FirstGearRatio /end REF_CHARACTERISTIC /begin REF_MEASUREMENT VfCOMM_req_pct_torque_final /end REF_MEASUREMENT /end GROUP
/begin GROUP S2_FAW_New "COMM_subsystem_integrated/Transmit/FAW New" /begin SUB_GROUP S68_Command_Mapping /end SUB_GROUP /begin REF_CHARACTERISTIC KcCOMM_FirstGearRatio /end REF_CHARACTERISTIC /end GROUP
/begin GROUP S2_ICPV "COMM_subsystem_integrated/Transmit/ICPV" /begin SUB_GROUP S69_EPB_clamped S69_EPB_released S69_EPB_releasing /end SUB_GROUP
 /begin REF_CHARACTERISTIC KcCOMM_BrakePedalMax KcCOMM_BrakePedalMin KcCOMM_GasPedalMax KcCOMM_GasPedalMin /end REF_CHARACTERISTIC
 /begin REF_MEASUREMENT VcCOMM_max_gas_pedal_EPB /end REF_MEASUREMENT
/end GROUP
/begin GROUP S2_ICPV_New "COMM_subsystem_integrated/Transmit/ICPV New" /begin SUB_GROUP S70_EPB_clamped S70_EPB_released S70_EPB_releasing /end SUB_GROUP
 /begin REF_CHARACTERISTIC KcCOMM_BrakePedalMax KcCOMM_BrakePedalMin KcCOMM_GasPedalMax KcCOMM_GasPedalMin /end REF_CHARACTERISTIC
 /begin REF_MEASUREMENT VfCOMM_max_gas_pedal_EPB /end REF_MEASUREMENT
/end GROUP
/begin GROUP S2_Test_Mode "COMM_subsystem_integrated/Transmit/Test_Mode"
 /begin REF_CHARACTERISTIC KbCOMM_Test_BckFogLamp_Req KbCOMM_Test_BrakePrechargeRequest KbCOMM_Test_BrakePriorityMode KbCOMM_Test_Cmd_BrakeLightReq KbCOMM_Test_Cmd_EPSDir KbCOMM_Test_Decs_DippedBeam_Req KbCOMM_Test_Decs_HighBeam_Req KbCOMM_Test_Decs_LftLmp_Req KbCOMM_Test_Decs_Light_Req KbCOMM_Test_Decs_RihtLmp_Req KbCOMM_Test_Decs_iBCM_Req KbCOMM_Test_FrontFogLamp_Req KbCOMM_Test_Horn_Req KbCOMM_Test_HummerSts KbCOMM_Test_WarnLight_Req KcCOMM_Test_Checksum_0x150 KcCOMM_Test_Checksum_0x151 KcCOMM_Test_Cmd_ATOModEnable KcCOMM_Test_Cmd_AccPelEnable KcCOMM_Test_Cmd_AccPelPosAct KcCOMM_Test_Cmd_AccPelPosActInv KcCOMM_Test_Cmd_BrkPelEnable KcCOMM_Test_Cmd_BrkPelPosAct KcCOMM_Test_Cmd_BrkPelPosActInv KcCOMM_Test_Cmd_Checksum KcCOMM_Test_Cmd_EPSXBW_En KcCOMM_Test_Cmd_ICPDTC KcCOMM_Test_Cmd_RCnt KcCOMM_Test_Cmd_StrAngle KcCOMM_Test_Cmd_StrAngleLimit KcCOMM_Test_Cmd_StrAngleSpd KcCOMM_Test_Cmd_TgtSft KcCOMM_Test_Cmd_TgtSftEnable KcCOMM_Test_Cmd_VCUCnt KcCOMM_Test_Decs_Acc_Mod KcCOMM_Test_Decs_Acc_Req KcCOMM_Test_Decs_Acc_Value KcCOMM_Test_Decs_Breake_Req KcCOMM_Test_Decs_Breake_Value KcCOMM_Test_Over_Speed KcCOMM_Test_RCnt_0x150 KcCOMM_Test_RCnt_0x151 KcCOMM_Test_SlowDown_Indication KcCOMM_Test_SpeedUp_Indication KcCOMM_Test_Stop_Request KcCOMM_Test_Tar_Torq KcCOMM_Test_Tar_vehiclespd KcCOMM_Test_XBR_EBI_Mode KcCOMM_Test_XBR_Priority KcCOMM_Test_acceleration_fb KcCOMM_Test_cmd_VCUChecksum KcCOMM_Test_driveoff_Req KcCOMM_Test_yaw_rate_fb /end REF_CHARACTERISTIC
/end GROUP
/begin GROUP S2_Test_Mode_New "COMM_subsystem_integrated/Transmit/Test_Mode_New"
 /begin REF_CHARACTERISTIC KbCOMM_Test_BckFogLamp_Req KbCOMM_Test_BrakePrechargeRequest KbCOMM_Test_Cmd_AccPelEnable KbCOMM_Test_Cmd_BrakeLightReq KbCOMM_Test_Cmd_BrkPelEnable KbCOMM_Test_Cmd_ParkingCtrlEnable KbCOMM_Test_Cmd_TgtSftEnable KbCOMM_Test_Decs_DippedBeam_Req KbCOMM_Test_Decs_HighBeam_Req KbCOMM_Test_Decs_LftLmp_Req KbCOMM_Test_Decs_Light_Req KbCOMM_Test_Decs_RihtLmp_Req KbCOMM_Test_Decs_iBCM_Req KbCOMM_Test_FrontFogLamp_Req KbCOMM_Test_Horn_Req KbCOMM_Test_Over_Speed KbCOMM_Test_SlowDown_Indication KbCOMM_Test_SpeedUp_Indication KbCOMM_Test_Stop_Request KbCOMM_Test_WarnLight_Req KbCOMM_Test_driveoff_Req KcCOMM_Test_Cmd_ATOModEnable KcCOMM_Test_Cmd_AccPelPosAct KcCOMM_Test_Cmd_BrkPelPosAct KcCOMM_Test_Cmd_EPSXBW_En KcCOMM_Test_Cmd_StrAngle KcCOMM_Test_Cmd_StrAngleSpd KcCOMM_Test_Cmd_TgtSft KcCOMM_Test_Decs_Acc_Value KcCOMM_Test_Decs_Breake_Value KcCOMM_Test_Tar_vehiclespd KeCOMM_Test_Cmd_ParkingCtrlValue /end REF_CHARACTERISTIC
/end GROUP
/begin GROUP S67_Command_Mapping "COMM_subsystem_integrated/Transmit/FAW/Command_Mapping" /begin SUB_GROUP S79_T03 /end SUB_GROUP /begin REF_CHARACTERISTIC KbCOMM_Test_Decs_iBCM_Req /end REF_CHARACTERISTIC /end GROUP
/begin GROUP S68_Command_Mapping "COMM_subsystem_integrated/Transmit/FAW New/Command_Mapping" /begin SUB_GROUP S92_T03 /end SUB_GROUP /begin REF_CHARACTERISTIC KbCOMM_Test_Decs_iBCM_Req /end REF_CHARACTERISTIC /end GROUP
/begin GROUP S69_EPB_clamped "COMM_subsystem_integrated/Transmit/ICPV/EPB_clamped" /begin REF_CHARACTERISTIC KcCOMM_GasPedalMinEPB /end REF_CHARACTERISTIC /end GROUP
/begin GROUP S69_EPB_released "COMM_subsystem_integrated/Transmit/ICPV/EPB_released" /begin REF_CHARACTERISTIC KcCOMM_GasPedalMax KcCOMM_GasPedalRampEPB /end REF_CHARACTERISTIC /end GROUP
/begin GROUP S69_EPB_releasing "COMM_subsystem_integrated/Transmit/ICPV/EPB_releasing" /begin REF_CHARACTERISTIC KcCOMM_GasPedalMaxEPB KcCOMM_GasPedalRampEPB /end REF_CHARACTERISTIC /end GROUP
/begin GROUP S70_EPB_clamped "COMM_subsystem_integrated/Transmit/ICPV New/EPB_clamped" /begin REF_CHARACTERISTIC KcCOMM_GasPedalMinEPB /end REF_CHARACTERISTIC /end GROUP
/begin GROUP S70_EPB_released "COMM_subsystem_integrated/Transmit/ICPV New/EPB_released" /begin REF_CHARACTERISTIC KcCOMM_GasPedalMax KcCOMM_GasPedalRampEPB /end REF_CHARACTERISTIC /end GROUP
/begin GROUP S70_EPB_releasing "COMM_subsystem_integrated/Transmit/ICPV New/EPB_releasing" /begin REF_CHARACTERISTIC KcCOMM_GasPedalMaxEPB KcCOMM_GasPedalRampEPB /end REF_CHARACTERISTIC /end GROUP
/begin GROUP S79_T03 "COMM_subsystem_integrated/Transmit/FAW/Command_Mapping/T03"
 /begin REF_CHARACTERISTIC KcCOMM_TorqCtrlPriority_Active KcCOMM_TorqCtrlPriority_Default /end REF_CHARACTERISTIC
/end GROUP
/begin GROUP S92_T03 "COMM_subsystem_integrated/Transmit/FAW New/Command_Mapping/T03"
 /begin REF_CHARACTERISTIC KcCOMM_TorqCtrlPriority_Active KcCOMM_TorqCtrlPriority_Default /end REF_CHARACTERISTIC
/end GROUP
/begin GROUP DCSN_subsystem_integrated "DCSN_subsystem_integrated" ROOT /begin SUB_GROUP Root_DtrmnDCSN_Integrated /end SUB_GROUP /end GROUP
/begin GROUP Root_DtrmnDCSN_Integrated "DCSN_subsystem_integrated/DtrmnDCSN_Integrated"
 /begin SUB_GROUP S1_DtrmnDCSN_ADM S1_DtrmnDCSN_EnablingManager S1_DtrmnDCSN_TrafficDecider /end SUB_GROUP
/end GROUP
/begin GROUP S1_DtrmnDCSN_ADM "DCSN_subsystem_integrated/DtrmnDCSN_Integrated/DtrmnDCSN_ADM"
 /begin SUB_GROUP S3_CheckDCSN_ACCS_mode S3_CheckDCSN_UsrSwitchStatus S3_DtrmnDCSN_ADMMainManager S3_DtrmnDCSN_DRIVIintentionSimu S3_DtrmnDCSN_InitializationManager /end SUB_GROUP
 /begin REF_CHARACTERISTIC KbDCSN_accs_resume_man_enbl KbDCSN_accs_resume_man_value KbDCSN_use_EgmoLinearSpeed KbDCSN_use_EgmoReadyFlag KbDCSN_use_MpfuReadyFlag /end REF_CHARACTERISTIC
 /begin REF_MEASUREMENT VbDCSN_accs_resume /end REF_MEASUREMENT
/end GROUP
/begin GROUP S1_DtrmnDCSN_EnablingManager "DCSN_subsystem_integrated/DtrmnDCSN_Integrated/DtrmnDCSN_EnablingManager"
 /begin SUB_GROUP S4_DtrmnDCSN_ActiveFeatureSwitch S4_DtrmnDCSN_AutoDriveModeManager S4_DtrmnDCSN_EpbCtrlSwitch S4_DtrmnDCSN_GearCtrlSwitch S4_DtrmnDCSN_PowerControlInhibit S4_DtrmnDCSN_SteerCtrlSwitch S4_Dtrmn_EnablingFlagsOSP /end SUB_GROUP
 /begin REF_CHARACTERISTIC KbDCSN_aeb_usr_switch KbDCSN_bsd_usr_switch KbDCSN_dow_usr_switch KbDCSN_fcta_usr_switch KbDCSN_fcw_usr_switch KbDCSN_lca_usr_switch KbDCSN_lcw_usr_switch KbDCSN_ldw_usr_switch KbDCSN_lka_usr_switch KbDCSN_rcta_usr_switch KbDCSN_use_EgmoReadyFlag /end REF_CHARACTERISTIC
/end GROUP
/begin GROUP S1_DtrmnDCSN_TrafficDecider "DCSN_subsystem_integrated/DtrmnDCSN_Integrated/DtrmnDCSN_TrafficDecider"
 /begin SUB_GROUP S5_CalcDCSN_OverSpeedWarning S5_CalcDCSN_SpeedLimit S5_CalcDCSN_StopRequest S5_CheckDCSN_InputDataValidity S5_CvrtDCSN_DataSelector S5_DtrmnDCSN_ChangeLaneReq S5_MngDCSN_TrafficDeciderManager S5_MngDCSN_TrafficDeciderOutputM /end SUB_GROUP
/end GROUP
/begin GROUP S3_CheckDCSN_ACCS_mode "DCSN_subsystem_integrated/DtrmnDCSN_Integrated/DtrmnDCSN_ADM/CheckDCSN_ACCS_mode" /begin REF_MEASUREMENT VbDCSN_ACC_ready_to_engage /end REF_MEASUREMENT /end GROUP
/begin GROUP S3_CheckDCSN_UsrSwitchStatus "DCSN_subsystem_integrated/DtrmnDCSN_Integrated/DtrmnDCSN_ADM/CheckDCSN_UsrSwitchStatus"
 /begin REF_CHARACTERISTIC KbDCSN_use_vehicle_activate_switch KcDCSN_t_usr_activate_cmd_send_count KeDCSN_usr_cmd_autodrive_activate_man /end REF_CHARACTERISTIC
 /begin REF_MEASUREMENT VeDCSN_usr_cmd_autodrive_activate /end REF_MEASUREMENT
/end GROUP
/begin GROUP S3_DtrmnDCSN_ADMMainManager "DCSN_subsystem_integrated/DtrmnDCSN_Integrated/DtrmnDCSN_ADM/DtrmnDCSN_ADMMainManager"
 /begin SUB_GROUP S8_CheckDCSN_StateCheck S8_CheckDCSN_SystemFaultCheck S8_DtrmnDCSN_CondActivation /end SUB_GROUP
 /begin REF_CHARACTERISTIC KbDCSN_adm_main_mode_man_ctrl KbDCSN_adm_temp_stop_finished KbDCSN_adm_temp_usr_cmd_autodrive_enabled KbDCSN_lcc_usr_switch KeDCSN_adm_main_mode_man_value KeDCSN_adm_temp_diag_system_fault KfDCSN_t_max_time_fault_warning KfDCSN_t_max_time_to_takeover KfDCSN_v_adm_temp_veh_setspeed /end REF_CHARACTERISTIC
 /begin REF_MEASUREMENT VeDCSN_adm_main_mode VeDCSN_hmi_icon_display VeDCSN_hmi_msg_display /end REF_MEASUREMENT
/end GROUP
/begin GROUP S3_DtrmnDCSN_DRIVIintentionSimu "DCSN_subsystem_integrated/DtrmnDCSN_Integrated/DtrmnDCSN_ADM/DtrmnDCSN_DRIVIintentionSimu"
 /begin SUB_GROUP S9_DtrmnDCSN_FAWTorqueOverride S9_DtrmnDCSN_TakeOverLogicFAW S9_SteerOvrrideTorque S9_SteerResumeTorque /end SUB_GROUP
 /begin REF_CHARACTERISTIC KfDCSN_t_adm_temp_steering_ovrd_delay KfDCSN_t_adm_temp_steering_resume_delay /end REF_CHARACTERISTIC
 /begin REF_MEASUREMENT VbDCSN_adm_steering_override VbDCSN_adm_steering_resume /end REF_MEASUREMENT
/end GROUP
/begin GROUP S3_DtrmnDCSN_InitializationManager "DCSN_subsystem_integrated/DtrmnDCSN_Integrated/DtrmnDCSN_ADM/DtrmnDCSN_InitializationManager"
 /begin REF_CHARACTERISTIC KbDCSN_SLEW_initialization_finished KbDCSN_use_faw_l4_logic /end REF_CHARACTERISTIC
 /begin REF_MEASUREMENT VbDCSN_initialization_finished /end REF_MEASUREMENT
/end GROUP
/begin GROUP S4_DtrmnDCSN_ActiveFeatureSwitch "DCSN_subsystem_integrated/DtrmnDCSN_Integrated/DtrmnDCSN_EnablingManager/DtrmnDCSN_ActiveFeatureSwitch" /begin REF_CHARACTERISTIC KbDCSN_alca_usr_switch /end REF_CHARACTERISTIC /end GROUP
/begin GROUP S4_DtrmnDCSN_AutoDriveModeManager "DCSN_subsystem_integrated/DtrmnDCSN_Integrated/DtrmnDCSN_EnablingManager/DtrmnDCSN_AutoDriveModeManager"
 /begin SUB_GROUP S53_DtrmnDCSN_ACCSResumeReq S53_DtrmnDCSN_AutodriveActDelay S53_DtrmnDCSN_ReActivateLogicFAW /end SUB_GROUP
 /begin REF_CHARACTERISTIC KbDCSN_use_SLEW_switch_control_mode KfDCSN_t_autodrive_max_wait_time /end REF_CHARACTERISTIC
/end GROUP
/begin GROUP S4_DtrmnDCSN_EpbCtrlSwitch "DCSN_subsystem_integrated/DtrmnDCSN_Integrated/DtrmnDCSN_EnablingManager/DtrmnDCSN_EpbCtrlSwitch" /begin REF_CHARACTERISTIC KbDCSN_use_faw_l4_logic /end REF_CHARACTERISTIC /end GROUP
/begin GROUP S4_DtrmnDCSN_GearCtrlSwitch "DCSN_subsystem_integrated/DtrmnDCSN_Integrated/DtrmnDCSN_EnablingManager/DtrmnDCSN_GearCtrlSwitch" /begin REF_CHARACTERISTIC KbDCSN_use_faw_l4_logic /end REF_CHARACTERISTIC /end GROUP
/begin GROUP S4_DtrmnDCSN_PowerControlInhibit "DCSN_subsystem_integrated/DtrmnDCSN_Integrated/DtrmnDCSN_EnablingManager/DtrmnDCSN_PowerControlInhibit"
 /begin REF_CHARACTERISTIC KbDCSN_inhibit_power_for_eps_enable KfDCSN_t_max_eps_inhibit_power /end REF_CHARACTERISTIC
 /begin REF_MEASUREMENT VbDCSN_power_control_inhibit /end REF_MEASUREMENT
/end GROUP
/begin GROUP S4_DtrmnDCSN_SteerCtrlSwitch "DCSN_subsystem_integrated/DtrmnDCSN_Integrated/DtrmnDCSN_EnablingManager/DtrmnDCSN_SteerCtrlSwitch"
 /begin REF_CHARACTERISTIC KbDCSN_adm_main_mode_man_ctrl KbDCSN_use_SLEW_override_logic /end REF_CHARACTERISTIC
/end GROUP
/begin GROUP S9_DtrmnDCSN_FAWTorqueOverride "DCSN_subsystem_integrated/DtrmnDCSN_Integrated/DtrmnDCSN_ADM/DtrmnDCSN_DRIVIintentionSimu/DtrmnDCSN_FAWTorqueOverride" /begin REF_CHARACTERISTIC KbDCSN_use_faw_l4_logic /end REF_CHARACTERISTIC /end GROUP
/begin GROUP S9_DtrmnDCSN_TakeOverLogicFAW "DCSN_subsystem_integrated/DtrmnDCSN_Integrated/DtrmnDCSN_ADM/DtrmnDCSN_DRIVIintentionSimu/DtrmnDCSN_TakeOverLogicFAW" /begin REF_CHARACTERISTIC KbDCSN_use_faw_l4_logic /end REF_CHARACTERISTIC /end GROUP
/begin GROUP S9_SteerOvrrideTorque "DCSN_subsystem_integrated/DtrmnDCSN_Integrated/DtrmnDCSN_ADM/DtrmnDCSN_DRIVIintentionSimu/SteerOvrrideTorque" /begin REF_CHARACTERISTIC KbDCSN_use_faw_l4_logic /end REF_CHARACTERISTIC /end GROUP
/begin GROUP S9_SteerResumeTorque "DCSN_subsystem_integrated/DtrmnDCSN_Integrated/DtrmnDCSN_ADM/DtrmnDCSN_DRIVIintentionSimu/SteerResumeTorque" /begin REF_CHARACTERISTIC KbDCSN_use_faw_l4_logic /end REF_CHARACTERISTIC /end GROUP
/begin GROUP S53_DtrmnDCSN_ACCSResumeReq "DCSN_subsystem_integrated/DtrmnDCSN_Integrated/DtrmnDCSN_EnablingManager/DtrmnDCSN_AutoDriveModeManager/DtrmnDCSN_ACCSResumeReq" /begin REF_CHARACTERISTIC KbDCSN_use_faw_l4_logic /end REF_CHARACTERISTIC /end GROUP
/begin GROUP S53_DtrmnDCSN_AutodriveActDelay "DCSN_subsystem_integrated/DtrmnDCSN_Integrated/DtrmnDCSN_EnablingManager/DtrmnDCSN_AutoDriveModeManager/DtrmnDCSN_AutodriveActDelay" /begin REF_CHARACTERISTIC KbDCSN_use_faw_l4_logic /end REF_CHARACTERISTIC /end GROUP
/begin GROUP S53_DtrmnDCSN_ReActivateLogicFAW "DCSN_subsystem_integrated/DtrmnDCSN_Integrated/DtrmnDCSN_EnablingManager/DtrmnDCSN_AutoDriveModeManager/DtrmnDCSN_ReActivateLogicFAW" /begin REF_CHARACTERISTIC KbDCSN_use_faw_l4_logic /end REF_CHARACTERISTIC /end GROUP
/begin GROUP S15_CheckDCSN_VehicleActivation "DCSN_subsystem_integrated/DtrmnDCSN_Integrated/DtrmnDCSN_ADM/DtrmnDCSN_ADMMainManager/CheckDCSN_StateCheck/CheckDCSN_ActivationStateCheck/CheckDCSN_VehicleActivation" /begin REF_CHARACTERISTIC KbDCSN_use_faw_l4_logic /end REF_CHARACTERISTIC /end GROUP
/begin GROUP S16_CheckDCSN_VehicleExit "DCSN_subsystem_integrated/DtrmnDCSN_Integrated/DtrmnDCSN_ADM/DtrmnDCSN_ADMMainManager/CheckDCSN_StateCheck/CheckDCSN_ExitStateCheck/CheckDCSN_VehicleExit" /begin REF_CHARACTERISTIC KbDCSN_use_faw_l4_logic /end REF_CHARACTERISTIC /end GROUP
/end MODULE
/end PROJECT
