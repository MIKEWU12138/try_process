ASAP2_VERSION 1 60
/begin PROJECT hj_adcu "_default_ProjectLongIdentifier"
/begin HEADER "_default_HeaderComment" PROJECT_NO _default_ProjectNr /end HEADER
/begin MODULE _default_ModuleName "_default_ModuleLongIdentifier"
/begin MOD_COMMON "_default_ModCommonComment" DEPOSIT ABSOLUTE BYTE_ORDER MSB_LAST ALIGNMENT_BYTE 1 ALIGNMENT_WORD 2 ALIGNMENT_LONG 4 ALIGNMENT_FLOAT32_IEEE 4 ALIGNMENT_FLOAT64_IEEE 4 /end MOD_COMMON
/begin MOD_COMMON "Mod Common Comment Here" BYTE_ORDER MSB_LAST /end MOD_COMMON
/begin RECORD_LAYOUT Scalar_BOOLEAN FNC_VALUES 1 UBYTE COLUMN_DIR DIRECT /end RECORD_LAYOUT
/begin RECORD_LAYOUT Scalar_UBYTE FNC_VALUES 1 UBYTE COLUMN_DIR DIRECT /end RECORD_LAYOUT
/begin RECORD_LAYOUT Scalar_BYTE FNC_VALUES 1 SBYTE COLUMN_DIR DIRECT /end RECORD_LAYOUT
/begin RECORD_LAYOUT Scalar_UWORD FNC_VALUES 1 UWORD COLUMN_DIR DIRECT /end RECORD_LAYOUT
/begin RECORD_LAYOUT Scalar_LONG FNC_VALUES 1 SLONG COLUMN_DIR DIRECT /end RECORD_LAYOUT
/begin RECORD_LAYOUT Scalar_FLOAT32_IEEE FNC_VALUES 1 FLOAT32_IEEE COLUMN_DIR DIRECT /end RECORD_LAYOUT
/begin RECORD_LAYOUT Lookup1D_X_ULONG AXIS_PTS_X 1 ULONG INDEX_INCR DIRECT /end RECORD_LAYOUT
/begin RECORD_LAYOUT Lookup1D_SLONG FNC_VALUES 1 SLONG COLUMN_DIR DIRECT /end RECORD_LAYOUT
/begin RECORD_LAYOUT Lookup1D_X_LONG AXIS_PTS_X 1 SLONG INDEX_INCR DIRECT /end RECORD_LAYOUT
/begin RECORD_LAYOUT Lookup1D_FLOAT32_IEEE FNC_VALUES 1 FLOAT32_IEEE COLUMN_DIR DIRECT /end RECORD_LAYOUT
/begin RECORD_LAYOUT Lookup1D_X_FLOAT32_IEEE AXIS_PTS_X 1 FLOAT32_IEEE INDEX_INCR DIRECT /end RECORD_LAYOUT
/begin RECORD_LAYOUT Lookup1D_FLOAT64_IEEE FNC_VALUES 1 FLOAT64_IEEE COLUMN_DIR DIRECT /end RECORD_LAYOUT
/begin RECORD_LAYOUT Lookup1D_X_FLOAT64_IEEE AXIS_PTS_X 1 FLOAT64_IEEE INDEX_INCR DIRECT /end RECORD_LAYOUT
/begin RECORD_LAYOUT Lookup2D_BOOLEAN FNC_VALUES 1 UBYTE COLUMN_DIR DIRECT /end RECORD_LAYOUT
/begin RECORD_LAYOUT Lookup2D_X_BOOLEAN AXIS_PTS_X 1 UBYTE INDEX_INCR DIRECT /end RECORD_LAYOUT
/begin RECORD_LAYOUT Lookup2D_UBYTE FNC_VALUES 1 UBYTE COLUMN_DIR DIRECT /end RECORD_LAYOUT
/begin RECORD_LAYOUT Lookup2D_FLOAT32_IEEE FNC_VALUES 1 FLOAT32_IEEE COLUMN_DIR DIRECT /end RECORD_LAYOUT
/begin RECORD_LAYOUT Lookup2D_X_FLOAT32_IEEE AXIS_PTS_X 1 FLOAT32_IEEE INDEX_INCR DIRECT /end RECORD_LAYOUT
/begin CHARACTERISTIC KtDCSN_v_speed_limit_curve "Speed limit from curvature value" CURVE 0x70102140 /* @ECU_Address@KtDCSN_v_speed_limit_curve@ */ Lookup1D_FLOAT32_IEEE 0 DCSN_subsystem_integrated_CM_single_m_s 0.0 3.4E+38
 /begin AXIS_DESCR COM_AXIS VfDCSN_largest_curvature_ahead DCSN_subsystem_integrated_CM_single_1_m 14 -3.4E+38 3.4E+38 AXIS_PTS_REF KtDCSN_c_speed_limit_curve_axis /end AXIS_DESCR
/end CHARACTERISTIC
/begin CHARACTERISTIC KtDCSN_t_curvature_ahead_timegap "The look-ahead time gap for speed limit from curvature" CURVE 0x701021a0 /* @ECU_Address@KtDCSN_t_curvature_ahead_timegap@ */ Lookup1D_FLOAT32_IEEE 0 DCSN_subsystem_integrated_CM_single_s -3.4E+38 3.4E+38
 /begin AXIS_DESCR COM_AXIS VfDCSN_vehicle_speed_egmo DCSN_subsystem_integrated_CM_single_m_s 10 -3.4E+38 3.4E+38 AXIS_PTS_REF KtDCSN_v_ahead_timegap_speed_axis /end AXIS_DESCR
/end CHARACTERISTIC
/begin CHARACTERISTIC KfDCSN_M_adm_temp_steering_ovrd_torque "The torque for driver to override." VALUE 0x70102284 /* @ECU_Address@KfDCSN_M_adm_temp_steering_ovrd_torque@ */ Scalar_FLOAT32_IEEE 0 DCSN_subsystem_integrated_CM_single_nm -3.4E+38 3.4E+38 /end CHARACTERISTIC
/begin CHARACTERISTIC KfDCSN_M_adm_temp_steering_resume_torque "The torque for driver to override." VALUE 0x70102280 /* @ECU_Address@KfDCSN_M_adm_temp_steering_resume_torque@ */ Scalar_FLOAT32_IEEE 0 DCSN_subsystem_integrated_CM_single_nm -3.4E+38 3.4E+38 /end CHARACTERISTIC
/begin CHARACTERISTIC KfDCSN_d_Thrsh_request_stop "The maximal distance between vehicle and stop line before sending stop request." VALUE 0x7010227c /* @ECU_Address@KfDCSN_d_Thrsh_request_stop@ */ Scalar_FLOAT32_IEEE 0 DCSN_subsystem_integrated_CM_single_m 0.0 1000.0 /end CHARACTERISTIC
/begin CHARACTERISTIC KfDCSN_d_arc_length_integration_step "The step size of arc length integration when caculating the look ahead distance for curvature." VALUE 0x70102278 /* @ECU_Address@KfDCSN_d_arc_length_integration_step@ */ Scalar_FLOAT32_IEEE 0 DCSN_subsystem_integrated_CM_single_m 0.0 100.0 /end CHARACTERISTIC
/begin CHARACTERISTIC KfDCSN_d_rearaxle_frontbump "The distance between rear axle and front bumper" VALUE 0x70102274 /* @ECU_Address@KfDCSN_d_rearaxle_frontbump@ */ Scalar_FLOAT32_IEEE 0 DCSN_subsystem_integrated_CM_single_m 0.0 100.0 /end CHARACTERISTIC
/begin CHARACTERISTIC KfDCSN_d_speed_limit_distance_man_value "targe speed limit point distance" VALUE 0x70102270 /* @ECU_Address@KfDCSN_d_speed_limit_distance_man_value@ */ Scalar_FLOAT32_IEEE 0 DCSN_subsystem_integrated_CM_single_m -3.4E+38 3.4E+38 /end CHARACTERISTIC
/begin CHARACTERISTIC KfDCSN_d_stop_cleared_Thrsh "The extra distance vehicle has to move before receiving new stop request" VALUE 0x7010226c /* @ECU_Address@KfDCSN_d_stop_cleared_Thrsh@ */ Scalar_FLOAT32_IEEE 0 DCSN_subsystem_integrated_CM_single_m 0.0 100.0 /end CHARACTERISTIC
/begin CHARACTERISTIC KfDCSN_d_stop_close_Thrsh "The threshold whether stop distance is calculated by vehicle speed." VALUE 0x70102268 /* @ECU_Address@KfDCSN_d_stop_close_Thrsh@ */ Scalar_FLOAT32_IEEE 0 DCSN_subsystem_integrated_CM_single_m 0.0 100.0 /end CHARACTERISTIC
/begin CHARACTERISTIC KfDCSN_d_stop_distance_buffer "The buffer between vehicle and stop destination" VALUE 0x70102264 /* @ECU_Address@KfDCSN_d_stop_distance_buffer@ */ Scalar_FLOAT32_IEEE 0 DCSN_subsystem_integrated_CM_single_m 0.0 100.0 /end CHARACTERISTIC
/begin CHARACTERISTIC KfDCSN_d_stop_finished_dis "When ACC finished stop request, the maximal distance between stop point and ego vehicle.
      If the stop distance is larger than the value, the stop request will not be cleared." VALUE 0x70102260 /* @ECU_Address@KfDCSN_d_stop_finished_dis@ */ Scalar_FLOAT32_IEEE 0 DCSN_subsystem_integrated_CM_single_m 0.0 100.0 /end CHARACTERISTIC
/begin CHARACTERISTIC KfDCSN_d_stop_s_distance_man_value "manual stop control distance, valid only when KbDCSN_stop_man_enbl = true" VALUE 0x7010225c /* @ECU_Address@KfDCSN_d_stop_s_distance_man_value@ */ Scalar_FLOAT32_IEEE 0 DCSN_subsystem_integrated_CM_single_m -3.4E+38 3.4E+38 /end CHARACTERISTIC
/begin CHARACTERISTIC KfDCSN_d_stop_unsuccess_Thrsh "The maximal distance from vehicle to stop line if vehicle had passed the stop line. This will regard current stop action as an unsuccessful stop." VALUE 0x70102258 /* @ECU_Address@KfDCSN_d_stop_unsuccess_Thrsh@ */ Scalar_FLOAT32_IEEE 0 DCSN_subsystem_integrated_CM_single_m 0.0 100.0 /end CHARACTERISTIC
/begin CHARACTERISTIC KfDCSN_k_largest_curvature_filter "manual stop control distance, valid only when KbDCSN_stop_man_enbl = true" VALUE 0x70102254 /* @ECU_Address@KfDCSN_k_largest_curvature_filter@ */ Scalar_FLOAT32_IEEE 0 DCSN_subsystem_integrated_CM_single_m -3.4E+38 3.4E+38 /end CHARACTERISTIC
/begin CHARACTERISTIC KfDCSN_t_allowed_time_cond_activate "When driver want to activate autodirve with brake or gas pedal, the max time allowed between pushing activate switch and releasing brake or gas pedal" VALUE 0x70102248 /* @ECU_Address@KfDCSN_t_allowed_time_cond_activate@ */ Scalar_FLOAT32_IEEE 0 DCSN_subsystem_integrated_CM_single_s -3.4E+38 3.4E+38 /end CHARACTERISTIC
/begin CHARACTERISTIC KfDCSN_t_autodrive_control_mode_delay "the time that the system keeps sending activating request" VALUE 0x70102244 /* @ECU_Address@KfDCSN_t_autodrive_control_mode_delay@ */ Scalar_FLOAT32_IEEE 0 DCSN_subsystem_integrated_CM_single_s -3.4E+38 3.4E+38 /end CHARACTERISTIC
/begin CHARACTERISTIC KfDCSN_t_max_wait_cond_activate "When driver want to activate autodirve with brake or gas pedal, the max wait time for adm active" VALUE 0x70102230 /* @ECU_Address@KfDCSN_t_max_wait_cond_activate@ */ Scalar_FLOAT32_IEEE 0 DCSN_subsystem_integrated_CM_single_s -3.4E+38 3.4E+38 /end CHARACTERISTIC
/begin CHARACTERISTIC KfDCSN_t_sample_time "DCSN calculation sample time" VALUE 0x7010222c /* @ECU_Address@KfDCSN_t_sample_time@ */ Scalar_FLOAT32_IEEE 0 DCSN_subsystem_integrated_CM_single_s -3.4E+38 3.4E+38 /end CHARACTERISTIC
/begin CHARACTERISTIC KfDCSN_t_stop_req_hold "When stop is finished, the stop request will be held for seconds. " VALUE 0x70102228 /* @ECU_Address@KfDCSN_t_stop_req_hold@ */ Scalar_FLOAT32_IEEE 0 DCSN_subsystem_integrated_CM_single_s -3.4E+38 3.4E+38 /end CHARACTERISTIC
/begin CHARACTERISTIC KfDCSN_t_usr_change_lane_delay "The time delay between usr command and actual change lane action" VALUE 0x70102224 /* @ECU_Address@KfDCSN_t_usr_change_lane_delay@ */ Scalar_FLOAT32_IEEE 0 DCSN_subsystem_integrated_CM_single_s -3.4E+38 3.4E+38 /end CHARACTERISTIC
/begin CHARACTERISTIC KfDCSN_v_adm_active_extraspeed "When activating ACC control, max allowed delta speed between actual and ACC speed upper limit" VALUE 0x70102220 /* @ECU_Address@KfDCSN_v_adm_active_extraspeed@ */ Scalar_FLOAT32_IEEE 0 DCSN_subsystem_integrated_CM_single_m_s -3.4E+38 3.4E+38 /end CHARACTERISTIC
/begin CHARACTERISTIC KfDCSN_v_autodrive_max_speed "Max speed allowed by Autodrive system
      If vehicle speed is larger than this value, autodrive will be deactivated immediately." VALUE 0x70102218 /* @ECU_Address@KfDCSN_v_autodrive_max_speed@ */ Scalar_FLOAT32_IEEE 0 DCSN_subsystem_integrated_CM_single_m_s -3.4E+38 3.4E+38 /end CHARACTERISTIC
/begin CHARACTERISTIC KfDCSN_v_change_lane_target_speed_man_value "manual change lane target speed, valid only when KbDCSN_change_lane_man_enbl = true" VALUE 0x70102214 /* @ECU_Address@KfDCSN_v_change_lane_target_speed_man_value@ */ Scalar_FLOAT32_IEEE 0 DCSN_subsystem_integrated_CM_single_m_s -3.4E+38 3.4E+38 /end CHARACTERISTIC
/begin CHARACTERISTIC KfDCSN_v_lane_speed_limit_man_value "manual speed limit, valid only when KbDCSN_traffic_speed_limit_enble = true" VALUE 0x7010220c /* @ECU_Address@KfDCSN_v_lane_speed_limit_man_value@ */ Scalar_FLOAT32_IEEE 0 DCSN_subsystem_integrated_CM_single_m_s -3.4E+38 3.4E+38 /end CHARACTERISTIC
/begin CHARACTERISTIC KfDCSN_v_setspeed_thrsh_hi "Max allowed set speed for ACCS" VALUE 0x70102204 /* @ECU_Address@KfDCSN_v_setspeed_thrsh_hi@ */ Scalar_FLOAT32_IEEE 0 DCSN_subsystem_integrated_CM_single_m_s -3.4E+38 3.4E+38 /end CHARACTERISTIC
/begin CHARACTERISTIC KfDCSN_v_target_speed_limit_man_value "target speed in manual mode" VALUE 0x70102200 /* @ECU_Address@KfDCSN_v_target_speed_limit_man_value@ */ Scalar_FLOAT32_IEEE 0 DCSN_subsystem_integrated_CM_single_m_s -3.4E+38 3.4E+38 /end CHARACTERISTIC
/begin CHARACTERISTIC KeDCSN_change_lane_cancel_reason_man_value "0 = LC_CANCEL_NO_REQUEST
      1 = LC_CANCEL_USR_CMD" VALUE 0x70102139 /* @ECU_Address@KeDCSN_change_lane_cancel_reason_man_value@ */ Scalar_UBYTE 0 DCSN_subsystem_integrated_CM_uint8 0 255 /end CHARACTERISTIC
/begin CHARACTERISTIC KeDCSN_change_lane_reason_man_value "0 = LC_NO_REQUEST
      1 = LC_USER_CMD
      2 = LC_NAVIGATION_CMD
      3 = LC_FRONT_OBSTACLE" VALUE 0x70102138 /* @ECU_Address@KeDCSN_change_lane_reason_man_value@ */ Scalar_UBYTE 0 DCSN_subsystem_integrated_CM_uint8 0 255 /end CHARACTERISTIC
/begin CHARACTERISTIC KeDCSN_change_lane_req_side_man_value "manual change lane side, valid only when KbDCSN_change_lane_man_enbl = true
      0 = NA
      1 = LEFT
      2 = RIGHT" VALUE 0x70102137 /* @ECU_Address@KeDCSN_change_lane_req_side_man_value@ */ Scalar_UBYTE 0 DCSN_subsystem_integrated_CM_uint8 0 255 /end CHARACTERISTIC
/begin CHARACTERISTIC KeDCSN_inlane_nudge_reason_man_value "0 = NUDGE_NO_REQUEST
      1 = NUDGE_FRONT_OBSTACLE
      2 = NUDGE_SIDE_OBSTACLE" VALUE 0x70102135 /* @ECU_Address@KeDCSN_inlane_nudge_reason_man_value@ */ Scalar_UBYTE 0 DCSN_subsystem_integrated_CM_uint8 0 255 /end CHARACTERISTIC
/begin CHARACTERISTIC KeDCSN_pull_over_reason_man_value "0 = PULLOVER_NO_REQUEST
      1 = PULLOVER_USER_CMD
      2 = PULLOVER_POLICE
      3 = PULLOVER_SYSTEM_FAULT" VALUE 0x70102134 /* @ECU_Address@KeDCSN_pull_over_reason_man_value@ */ Scalar_UBYTE 0 DCSN_subsystem_integrated_CM_uint8 0 255 /end CHARACTERISTIC
/begin CHARACTERISTIC KeDCSN_speed_limit_reason_man_value "0 = NO_LIMIT
      1 = LIMIT_FOR_EGO_LANE
      2 = LIMIT_FOR_DRIVER_REQ
      3 = LIMIT_FOR_CROSSWALK
      4 = LIMIT_FOR_NUDGE" VALUE 0x70102133 /* @ECU_Address@KeDCSN_speed_limit_reason_man_value@ */ Scalar_UBYTE 0 DCSN_subsystem_integrated_CM_uint8 0 255 /end CHARACTERISTIC
/begin CHARACTERISTIC KeDCSN_stop_reason_man_value "0 = NO_STOP_REQUEST
      1 = STOP_FOR_DESTINATION
      2 = STOP_FOR_TRAFFIC_LIGHT
      3 = STOP_FOR_STOP_SIGN
      4 = STOP_FOR_STOP_LINE
      5 = STOP_FOR_CROSSWALK
      6 = STOP_FOR_KEEP_CLEAR" VALUE 0x70102132 /* @ECU_Address@KeDCSN_stop_reason_man_value@ */ Scalar_UBYTE 0 DCSN_subsystem_integrated_CM_uint8 0 255 /end CHARACTERISTIC
/begin CHARACTERISTIC KfDCSN_Pct_lane_marker_valid_quality "The quality threshold for valid lane marker or edge" VALUE 0x70102130 /* @ECU_Address@KfDCSN_Pct_lane_marker_valid_quality@ */ Scalar_UBYTE 0 DCSN_subsystem_integrated_CM_uint8 0 255 /end CHARACTERISTIC
/begin CHARACTERISTIC KfDCSN_d_inlane_nudge_side_man_value "manual inlane nudge side, valid only when KbDCSN_inlane_nudge_man_enbl = true
      0 = NA
      1 = LEFT
      2 = RIGHT" VALUE 0x7010212f /* @ECU_Address@KfDCSN_d_inlane_nudge_side_man_value@ */ Scalar_UBYTE 0 DCSN_subsystem_integrated_CM_uint8 0 255 /end CHARACTERISTIC
/begin CHARACTERISTIC KbDCSN_adm_BrkPressDeactivateEnabled "0 = cannot activate when BrkPed is pressed
      1 = can activate when BrkPed is pressed" VALUE 0x70102128 /* @ECU_Address@KbDCSN_adm_BrkPressDeactivateEnabled@ */ Scalar_BOOLEAN 0 DCSN_subsystem_integrated_CM_boolean 0 1 /end CHARACTERISTIC
/begin CHARACTERISTIC KbDCSN_change_lane_cancel_request_man_value "manual change lane switch, valid only when KbDCSN_change_lane_man_enbl = true
      0 = no change lane cancel request
      1 = change lane cancel request" VALUE 0x7010211c /* @ECU_Address@KbDCSN_change_lane_cancel_request_man_value@ */ Scalar_BOOLEAN 0 DCSN_subsystem_integrated_CM_boolean 0 1 /end CHARACTERISTIC
/begin CHARACTERISTIC KbDCSN_change_lane_enable "0 = disable change lane request
      1 = enable change lane request" VALUE 0x7010211b /* @ECU_Address@KbDCSN_change_lane_enable@ */ Scalar_BOOLEAN 0 DCSN_subsystem_integrated_CM_boolean 0 1 /end CHARACTERISTIC
/begin CHARACTERISTIC KbDCSN_change_lane_man_enbl "traffic decider
      0 = manual change lane off
      1 = manual change lane on" VALUE 0x7010211a /* @ECU_Address@KbDCSN_change_lane_man_enbl@ */ Scalar_BOOLEAN 0 DCSN_subsystem_integrated_CM_boolean 0 1 /end CHARACTERISTIC
/begin CHARACTERISTIC KbDCSN_change_lane_request_man_value "manual change lane switch, valid only when KbDCSN_change_lane_man_enbl = true
      0 = no change lane request
      1 = change lane request" VALUE 0x70102119 /* @ECU_Address@KbDCSN_change_lane_request_man_value@ */ Scalar_BOOLEAN 0 DCSN_subsystem_integrated_CM_boolean 0 1 /end CHARACTERISTIC
/begin CHARACTERISTIC KbDCSN_inlane_nudge_man_enbl "traffic decider
      0 = manual inlane nudge off
      1 = manual inlane nudge on" VALUE 0x7010210b /* @ECU_Address@KbDCSN_inlane_nudge_man_enbl@ */ Scalar_BOOLEAN 0 DCSN_subsystem_integrated_CM_boolean 0 1 /end CHARACTERISTIC
/begin CHARACTERISTIC KbDCSN_inlane_nudge_request_man_value "manual inlane nudge switch, valid only when KbDCSN_inlane_nudge_request_man_enbl = true
      0 = no inlane nudge request
      1 = inlane nudge request" VALUE 0x7010210a /* @ECU_Address@KbDCSN_inlane_nudge_request_man_value@ */ Scalar_BOOLEAN 0 DCSN_subsystem_integrated_CM_boolean 0 1 /end CHARACTERISTIC
/begin CHARACTERISTIC KbDCSN_overspeed_warning_enable "0 = disable overspeed warning
      1 = enable overspeed warning" VALUE 0x701020ff /* @ECU_Address@KbDCSN_overspeed_warning_enable@ */ Scalar_BOOLEAN 0 DCSN_subsystem_integrated_CM_boolean 0 1 /end CHARACTERISTIC
/begin CHARACTERISTIC KbDCSN_pull_over_man_enbl "traffic decider
      0 = manual pull over off
      1 = manual pull over on" VALUE 0x701020fb /* @ECU_Address@KbDCSN_pull_over_man_enbl@ */ Scalar_BOOLEAN 0 DCSN_subsystem_integrated_CM_boolean 0 1 /end CHARACTERISTIC
/begin CHARACTERISTIC KbDCSN_pull_over_request_man_value "manual pull over switch, valid only when KbDCSN_pull_over_request_man_enbl = true
      0 = no pull over request
      1 = pull over request" VALUE 0x701020fa /* @ECU_Address@KbDCSN_pull_over_request_man_value@ */ Scalar_BOOLEAN 0 DCSN_subsystem_integrated_CM_boolean 0 1 /end CHARACTERISTIC
/begin CHARACTERISTIC KbDCSN_speed_limit_enable "0 = disable speed limit output
      1 = enable speed limit output" VALUE 0x701020f7 /* @ECU_Address@KbDCSN_speed_limit_enable@ */ Scalar_BOOLEAN 0 DCSN_subsystem_integrated_CM_boolean 0 1 /end CHARACTERISTIC
/begin CHARACTERISTIC KbDCSN_speed_limit_man_enbl "traffic decider
      0 = manual speed limit off
      1 = manual speed limit on" VALUE 0x701020f6 /* @ECU_Address@KbDCSN_speed_limit_man_enbl@ */ Scalar_BOOLEAN 0 DCSN_subsystem_integrated_CM_boolean 0 1 /end CHARACTERISTIC
/begin CHARACTERISTIC KbDCSN_stop_man_enbl "traffic decider
      0 = manual stop off
      1 = manual stop on" VALUE 0x701020f3 /* @ECU_Address@KbDCSN_stop_man_enbl@ */ Scalar_BOOLEAN 0 DCSN_subsystem_integrated_CM_boolean 0 1 /end CHARACTERISTIC
/begin CHARACTERISTIC KbDCSN_stop_request_enable "0 = disable stop request output
      1 = enable stop request output" VALUE 0x701020f2 /* @ECU_Address@KbDCSN_stop_request_enable@ */ Scalar_BOOLEAN 0 DCSN_subsystem_integrated_CM_boolean 0 1 /end CHARACTERISTIC
/begin CHARACTERISTIC KbDCSN_stop_request_man_value "manual stop control switch, valid only when KbDCSN_stop_man_enbl = true
      0 = no stop request
      1 = stop request" VALUE 0x701020f1 /* @ECU_Address@KbDCSN_stop_request_man_value@ */ Scalar_BOOLEAN 0 DCSN_subsystem_integrated_CM_boolean 0 1 /end CHARACTERISTIC
/begin CHARACTERISTIC KbDCSN_use_faw_handoff_as_ovrd "0 = use HandOn flag as override flag
      1 = use HandOff flag as override flag" VALUE 0x701020eb /* @ECU_Address@KbDCSN_use_faw_handoff_as_ovrd@ */ Scalar_BOOLEAN 0 DCSN_subsystem_integrated_CM_boolean 0 1 /end CHARACTERISTIC
/begin CHARACTERISTIC KbDCSN_use_faw_handoff_as_resume "0 = use HandOn flag as resume flag
      1 = use HandOff flag as resume flag" VALUE 0x701020ea /* @ECU_Address@KbDCSN_use_faw_handoff_as_resume@ */ Scalar_BOOLEAN 0 DCSN_subsystem_integrated_CM_boolean 0 1 /end CHARACTERISTIC
/begin CHARACTERISTIC KtLCCS_k_LanemarkMergeCoef "Lane marker merging filter coef." CURVE 0x701025bc /* @ECU_Address@KtLCCS_k_LanemarkMergeCoef@ */ Lookup1D_FLOAT32_IEEE 0 LCCS_subsystem_integrated_CM_single 0.001 1.0
 /begin AXIS_DESCR COM_AXIS VfLCCS_left_lanemark_switch_time LCCS_subsystem_integrated_CM_single_s 21 0.0 10.0 AXIS_PTS_REF KtLCCS_AXIS_lanemark_switch_time /end AXIS_DESCR
/end CHARACTERISTIC
/begin CHARACTERISTIC KtLCCS_d_lookahead_distance "Vehicle lookahead distance." MAP 0x70102760 /* @ECU_Address@KtLCCS_d_lookahead_distance@ */ Lookup2D_FLOAT32_IEEE 0 LCCS_subsystem_integrated_CM_single_m -3.4E+38 3.4E+38
 /begin AXIS_DESCR COM_AXIS VfLCCS_linear_velocity LCCS_subsystem_integrated_CM_single 21 -3.4E+38 3.4E+38 AXIS_PTS_REF KtLCCS_AXIS_vehicle_speed /end AXIS_DESCR
 /begin AXIS_DESCR COM_AXIS NO_INPUT_QUANTITY LCCS_subsystem_integrated_CM_single 5 -3.4E+38 3.4E+38 AXIS_PTS_REF KtLCCS_AXIS_route_curvature /end AXIS_DESCR
/end CHARACTERISTIC
/begin CHARACTERISTIC KtLCCS_Ang_steering_angle_reentry_zone "Steering angle delta limit for re-engage control. Unit: degree." CURVE 0x701029ac /* @ECU_Address@KtLCCS_Ang_steering_angle_reentry_zone@ */ Lookup1D_FLOAT32_IEEE 0 LCCS_subsystem_integrated_CM_single -3.4E+38 3.4E+38
 /begin AXIS_DESCR COM_AXIS VfLCCS_linear_velocity LCCS_subsystem_integrated_CM_single 21 -3.4E+38 3.4E+38 AXIS_PTS_REF KtLCCS_AXIS_vehicle_speed /end AXIS_DESCR
/end CHARACTERISTIC
/begin CHARACTERISTIC KtLCCS_heading_err_correction "Correction for heading error." CURVE 0x7010270c /* @ECU_Address@KtLCCS_heading_err_correction@ */ Lookup1D_FLOAT32_IEEE 0 LCCS_subsystem_integrated_CM_single -3.4E+38 3.4E+38
 /begin AXIS_DESCR COM_AXIS NO_INPUT_QUANTITY LCCS_subsystem_integrated_CM_single_rad 21 0.0 0.1 AXIS_PTS_REF KtLCCS_AXIS_heading_error /end AXIS_DESCR
/end CHARACTERISTIC
/begin CHARACTERISTIC KtLCCS_heading_err_gain_scheduler "Gain for heading error scheduler." CURVE 0x701026b8 /* @ECU_Address@KtLCCS_heading_err_gain_scheduler@ */ Lookup1D_FLOAT32_IEEE 0 LCCS_subsystem_integrated_CM_single -3.4E+38 3.4E+38
 /begin AXIS_DESCR COM_AXIS NO_INPUT_QUANTITY LCCS_subsystem_integrated_CM_single 21 -3.4E+38 3.4E+38 AXIS_PTS_REF KtLCCS_AXIS_vehicle_speed /end AXIS_DESCR
/end CHARACTERISTIC
/begin CHARACTERISTIC KtLCCS_heading_err_rate_correction "Correction for heading error rate." CURVE 0x70102664 /* @ECU_Address@KtLCCS_heading_err_rate_correction@ */ Lookup1D_FLOAT32_IEEE 0 LCCS_subsystem_integrated_CM_single -3.4E+38 3.4E+38
 /begin AXIS_DESCR COM_AXIS NO_INPUT_QUANTITY LCCS_subsystem_integrated_CM_single 21 -3.4E+38 3.4E+38 AXIS_PTS_REF KtLCCS_AXIS_vehicle_speed /end AXIS_DESCR
/end CHARACTERISTIC
/begin CHARACTERISTIC KtLCCS_heading_err_rate_gain_scheduler "Gain for heading error scheduler." CURVE 0x70102610 /* @ECU_Address@KtLCCS_heading_err_rate_gain_scheduler@ */ Lookup1D_FLOAT32_IEEE 0 LCCS_subsystem_integrated_CM_single -3.4E+38 3.4E+38
 /begin AXIS_DESCR COM_AXIS NO_INPUT_QUANTITY LCCS_subsystem_integrated_CM_single 21 -3.4E+38 3.4E+38 AXIS_PTS_REF KtLCCS_AXIS_vehicle_speed /end AXIS_DESCR
/end CHARACTERISTIC
/begin CHARACTERISTIC KtLCCS_lateral_err_correction "Correction for lateral error." CURVE 0x70102568 /* @ECU_Address@KtLCCS_lateral_err_correction@ */ Lookup1D_FLOAT32_IEEE 0 LCCS_subsystem_integrated_CM_single -1.0 1.0
 /begin AXIS_DESCR COM_AXIS NO_INPUT_QUANTITY LCCS_subsystem_integrated_CM_single 21 -3.4E+38 3.4E+38 AXIS_PTS_REF KtLCCS_AXIS_vehicle_speed /end AXIS_DESCR
/end CHARACTERISTIC
/begin CHARACTERISTIC KtLCCS_lateral_err_gain_scheduler "Gain for lateral error scheduler." CURVE 0x70102514 /* @ECU_Address@KtLCCS_lateral_err_gain_scheduler@ */ Lookup1D_FLOAT32_IEEE 0 LCCS_subsystem_integrated_CM_single -3.4E+38 3.4E+38
 /begin AXIS_DESCR COM_AXIS NO_INPUT_QUANTITY LCCS_subsystem_integrated_CM_single 21 -3.4E+38 3.4E+38 AXIS_PTS_REF KtLCCS_AXIS_vehicle_speed /end AXIS_DESCR
/end CHARACTERISTIC
/begin CHARACTERISTIC KtLCCS_lateral_err_rate_correction "Correction for lateral error rate." CURVE 0x701024c0 /* @ECU_Address@KtLCCS_lateral_err_rate_correction@ */ Lookup1D_FLOAT32_IEEE 0 LCCS_subsystem_integrated_CM_single -1.0 1.0
 /begin AXIS_DESCR COM_AXIS NO_INPUT_QUANTITY LCCS_subsystem_integrated_CM_single 21 -3.4E+38 3.4E+38 AXIS_PTS_REF KtLCCS_AXIS_vehicle_speed /end AXIS_DESCR
/end CHARACTERISTIC
/begin CHARACTERISTIC KtLCCS_lateral_err_rate_gain_scheduler "Gain for lateral error rate scheduler." CURVE 0x7010246c /* @ECU_Address@KtLCCS_lateral_err_rate_gain_scheduler@ */ Lookup1D_FLOAT32_IEEE 0 LCCS_subsystem_integrated_CM_single -3.4E+38 3.4E+38
 /begin AXIS_DESCR COM_AXIS NO_INPUT_QUANTITY LCCS_subsystem_integrated_CM_single 21 -3.4E+38 3.4E+38 AXIS_PTS_REF KtLCCS_AXIS_vehicle_speed /end AXIS_DESCR
/end CHARACTERISTIC
/begin CHARACTERISTIC KtLCCS_slowpath_steer_I_gain "Gain for slowpath steer I part." CURVE 0x70102418 /* @ECU_Address@KtLCCS_slowpath_steer_I_gain@ */ Lookup1D_FLOAT32_IEEE 0 LCCS_subsystem_integrated_CM_single -3.4E+38 3.4E+38
 /begin AXIS_DESCR COM_AXIS NO_INPUT_QUANTITY LCCS_subsystem_integrated_CM_single 21 -3.4E+38 3.4E+38 AXIS_PTS_REF KtLCCS_AXIS_vehicle_speed /end AXIS_DESCR
/end CHARACTERISTIC
/begin CHARACTERISTIC KtLCCS_slowpath_steer_P_gain "Gain for slowpath steer P part." CURVE 0x701023c4 /* @ECU_Address@KtLCCS_slowpath_steer_P_gain@ */ Lookup1D_FLOAT32_IEEE 0 LCCS_subsystem_integrated_CM_single -3.4E+38 3.4E+38
 /begin AXIS_DESCR COM_AXIS NO_INPUT_QUANTITY LCCS_subsystem_integrated_CM_single 21 -3.4E+38 3.4E+38 AXIS_PTS_REF KtLCCS_AXIS_vehicle_speed /end AXIS_DESCR
/end CHARACTERISTIC
/begin CHARACTERISTIC KtLCCS_t_lateral_oscillation_period "THe control period of lateral oscillation." CURVE 0x70102370 /* @ECU_Address@KtLCCS_t_lateral_oscillation_period@ */ Lookup1D_FLOAT32_IEEE 0 LCCS_subsystem_integrated_CM_single_s 0.0 10.0
 /begin AXIS_DESCR COM_AXIS NO_INPUT_QUANTITY LCCS_subsystem_integrated_CM_single 21 -3.4E+38 3.4E+38 AXIS_PTS_REF KtLCCS_AXIS_vehicle_speed /end AXIS_DESCR
/end CHARACTERISTIC
/begin CHARACTERISTIC KtLCCS_Ang_steering_angle_max "Absolute maximum steering wheel angle. Unit: degree." CURVE 0x70102a00 /* @ECU_Address@KtLCCS_Ang_steering_angle_max@ */ Lookup1D_FLOAT32_IEEE 0 LCCS_subsystem_integrated_CM_single -3.4E+38 3.4E+38
 /begin AXIS_DESCR COM_AXIS VfLCCS_linear_velocity LCCS_subsystem_integrated_CM_single 21 -3.4E+38 3.4E+38 AXIS_PTS_REF KtLCCS_AXIS_vehicle_speed /end AXIS_DESCR
/end CHARACTERISTIC
/begin CHARACTERISTIC KtLCCS_Ang_steering_angle_step "Desired steering wheel angle moving step per second. Unit: degree/s." CURVE 0x70102958 /* @ECU_Address@KtLCCS_Ang_steering_angle_step@ */ Lookup1D_FLOAT32_IEEE 0 LCCS_subsystem_integrated_CM_single -3.4E+38 3.4E+38
 /begin AXIS_DESCR COM_AXIS VfLCCS_linear_velocity LCCS_subsystem_integrated_CM_single 21 -3.4E+38 3.4E+38 AXIS_PTS_REF KtLCCS_AXIS_vehicle_speed /end AXIS_DESCR
/end CHARACTERISTIC
/begin CHARACTERISTIC KtLCCS_Ang_steering_angle_step_engaging "Desired steering wheel angle moving step per second, when engaging steering control. Unit: degree/s." CURVE 0x70102904 /* @ECU_Address@KtLCCS_Ang_steering_angle_step_engaging@ */ Lookup1D_FLOAT32_IEEE 0 LCCS_subsystem_integrated_CM_single -3.4E+38 3.4E+38
 /begin AXIS_DESCR COM_AXIS VfLCCS_linear_velocity LCCS_subsystem_integrated_CM_single 21 -3.4E+38 3.4E+38 AXIS_PTS_REF KtLCCS_AXIS_vehicle_speed /end AXIS_DESCR
/end CHARACTERISTIC
/begin CHARACTERISTIC KfLCCS_Ang_slowpath_steer_limit "Slowpath adjuct limit for front wheel angle. Unit: rad." VALUE 0x70102bdc /* @ECU_Address@KfLCCS_Ang_slowpath_steer_limit@ */ Scalar_FLOAT32_IEEE 0 LCCS_subsystem_integrated_CM_single -3.4E+38 3.4E+38 /end CHARACTERISTIC
/begin CHARACTERISTIC KfLCCS_Ang_steering_center_position "Steering wheel center position. Unit: degree." VALUE 0x70102bd8 /* @ECU_Address@KfLCCS_Ang_steering_center_position@ */ Scalar_FLOAT32_IEEE 0 LCCS_subsystem_integrated_CM_single -3.4E+38 3.4E+38 /end CHARACTERISTIC
/begin CHARACTERISTIC KfLCCS_LanemarkerQualityThrsh "Lane marker quality thresh, below which that lane marker is not utilized.
      " VALUE 0x70102bd4 /* @ECU_Address@KfLCCS_LanemarkerQualityThrsh@ */ Scalar_FLOAT32_IEEE 0 LCCS_subsystem_integrated_CM_single -3.4E+38 3.4E+38 /end CHARACTERISTIC
/begin CHARACTERISTIC KfLCCS_WeightMatrixStates_R "Regulator matrix for LQR solver.
      " VALUE 0x70102bd0 /* @ECU_Address@KfLCCS_WeightMatrixStates_R@ */ Scalar_FLOAT32_IEEE 0 LCCS_subsystem_integrated_CM_single -3.4E+38 3.4E+38 /end CHARACTERISTIC
/begin CHARACTERISTIC KfLCCS_a_max_lat_acc "Max acceptable lateral acceleration. Unit: m/s^2." VALUE 0x70102bcc /* @ECU_Address@KfLCCS_a_max_lat_acc@ */ Scalar_FLOAT32_IEEE 0 LCCS_subsystem_integrated_CM_single -3.4E+38 3.4E+38 /end CHARACTERISTIC
/begin CHARACTERISTIC KfLCCS_cf "Corning stiffness for front wheel.
      " VALUE 0x70102bc8 /* @ECU_Address@KfLCCS_cf@ */ Scalar_FLOAT32_IEEE 0 LCCS_subsystem_integrated_CM_single -3.4E+38 3.4E+38 /end CHARACTERISTIC
/begin CHARACTERISTIC KfLCCS_cr "Corning stiffness for rear wheel.
      " VALUE 0x70102bc4 /* @ECU_Address@KfLCCS_cr@ */ Scalar_FLOAT32_IEEE 0 LCCS_subsystem_integrated_CM_single -3.4E+38 3.4E+38 /end CHARACTERISTIC
/begin CHARACTERISTIC KfLCCS_d_LateralErrorDeadBand "Lateral error deadband for slowpath I term." VALUE 0x70102bc0 /* @ECU_Address@KfLCCS_d_LateralErrorDeadBand@ */ Scalar_FLOAT32_IEEE 0 LCCS_subsystem_integrated_CM_single_m 0.0 0.1 /end CHARACTERISTIC
/begin CHARACTERISTIC KfLCCS_d_NudgeSafetyZone "Inlane nudge safety margin between vehicle body and lane marker.
      " VALUE 0x70102bbc /* @ECU_Address@KfLCCS_d_NudgeSafetyZone@ */ Scalar_FLOAT32_IEEE 0 LCCS_subsystem_integrated_CM_single_m 0.1 1.0 /end CHARACTERISTIC
/begin CHARACTERISTIC KfLCCS_d_RearAxleToCameraOrigin "The distance between rear axle and camera coordinates origin." VALUE 0x70102bb8 /* @ECU_Address@KfLCCS_d_RearAxleToCameraOrigin@ */ Scalar_FLOAT32_IEEE 0 LCCS_subsystem_integrated_CM_single_m 0.0 10.0 /end CHARACTERISTIC
/begin CHARACTERISTIC KfLCCS_d_ValidLaneWidthLimit "" VALUE 0x70102bb4 /* @ECU_Address@KfLCCS_d_ValidLaneWidthLimit@ */ Scalar_FLOAT32_IEEE 0 LCCS_subsystem_integrated_CM_single_m -3.4E+38 3.4E+38 /end CHARACTERISTIC
/begin CHARACTERISTIC KfLCCS_d_VehicleWidth "Vehicle width." VALUE 0x70102bb0 /* @ECU_Address@KfLCCS_d_VehicleWidth@ */ Scalar_FLOAT32_IEEE 0 LCCS_subsystem_integrated_CM_single_m 1.0 3.0 /end CHARACTERISTIC
/begin CHARACTERISTIC KfLCCS_d_lf "Distance between center of mass and front axle.
      " VALUE 0x70102bac /* @ECU_Address@KfLCCS_d_lf@ */ Scalar_FLOAT32_IEEE 0 LCCS_subsystem_integrated_CM_single_m -3.4E+38 3.4E+38 /end CHARACTERISTIC
/begin CHARACTERISTIC KfLCCS_d_lr "Distance between center of mass and rear axle.
      " VALUE 0x70102ba8 /* @ECU_Address@KfLCCS_d_lr@ */ Scalar_FLOAT32_IEEE 0 LCCS_subsystem_integrated_CM_single_m -3.4E+38 3.4E+38 /end CHARACTERISTIC
/begin CHARACTERISTIC KfLCCS_d_min_turn_radius "Minimum turn radius at lowest speed.
      " VALUE 0x70102ba4 /* @ECU_Address@KfLCCS_d_min_turn_radius@ */ Scalar_FLOAT32_IEEE 0 LCCS_subsystem_integrated_CM_single_m -3.4E+38 3.4E+38 /end CHARACTERISTIC
/begin CHARACTERISTIC KfLCCS_d_wheel_base "Wheel base." VALUE 0x70102ba0 /* @ECU_Address@KfLCCS_d_wheel_base@ */ Scalar_FLOAT32_IEEE 0 LCCS_subsystem_integrated_CM_single_m 1.0 10.0 /end CHARACTERISTIC
/begin CHARACTERISTIC KfLCCS_eps "Tolerance for LQR solver.
      " VALUE 0x70102b9c /* @ECU_Address@KfLCCS_eps@ */ Scalar_FLOAT32_IEEE 0 LCCS_subsystem_integrated_CM_single -3.4E+38 3.4E+38 /end CHARACTERISTIC
/begin CHARACTERISTIC KfLCCS_heading_error_rate_limit "High limit for calculated heading error rate.
      " VALUE 0x70102b98 /* @ECU_Address@KfLCCS_heading_error_rate_limit@ */ Scalar_FLOAT32_IEEE 0 LCCS_subsystem_integrated_CM_single -3.4E+38 3.4E+38 /end CHARACTERISTIC
/begin CHARACTERISTIC KfLCCS_iz "Vehicle yaw inertia around -Z- axis.
      " VALUE 0x70102b94 /* @ECU_Address@KfLCCS_iz@ */ Scalar_FLOAT32_IEEE 0 LCCS_subsystem_integrated_CM_single -3.4E+38 3.4E+38 /end CHARACTERISTIC
/begin CHARACTERISTIC KfLCCS_k_LaneWidthFilter "Filter to smooth lane width." VALUE 0x70102b90 /* @ECU_Address@KfLCCS_k_LaneWidthFilter@ */ Scalar_FLOAT32_IEEE 0 LCCS_subsystem_integrated_CM_single 0.0001 1.0 /end CHARACTERISTIC
/begin CHARACTERISTIC KfLCCS_mass "Vehicle mass.
      " VALUE 0x70102b8c /* @ECU_Address@KfLCCS_mass@ */ Scalar_FLOAT32_IEEE 0 LCCS_subsystem_integrated_CM_single_kg -3.4E+38 3.4E+38 /end CHARACTERISTIC
/begin CHARACTERISTIC KfLCCS_r_MaxLateralSpeedPortion "The maximum ratio of lateral speed over vehicle speed." VALUE 0x70102b88 /* @ECU_Address@KfLCCS_r_MaxLateralSpeedPortion@ */ Scalar_FLOAT32_IEEE 0 LCCS_subsystem_integrated_CM_single -3.4E+38 3.4E+38 /end CHARACTERISTIC
/begin CHARACTERISTIC KfLCCS_r_YawRateCorrection "Correction factor for Yaw Rate from CAN bus." VALUE 0x70102b84 /* @ECU_Address@KfLCCS_r_YawRateCorrection@ */ Scalar_FLOAT32_IEEE 0 LCCS_subsystem_integrated_CM_single -1.0 1.0 /end CHARACTERISTIC
/begin CHARACTERISTIC KfLCCS_r_shift_speed_gain "Lateral distance to go multiply by thisgain to calculate lateral shift speed." VALUE 0x70102b80 /* @ECU_Address@KfLCCS_r_shift_speed_gain@ */ Scalar_FLOAT32_IEEE 0 LCCS_subsystem_integrated_CM_single -3.4E+38 3.4E+38 /end CHARACTERISTIC
/begin CHARACTERISTIC KfLCCS_r_steering_rate_forward_gain "Steering wheel turning speed gain when moving to forward direction." VALUE 0x70102b7c /* @ECU_Address@KfLCCS_r_steering_rate_forward_gain@ */ Scalar_FLOAT32_IEEE 0 LCCS_subsystem_integrated_CM_single -3.4E+38 3.4E+38 /end CHARACTERISTIC
/begin CHARACTERISTIC KfLCCS_r_veh_strwhl_2_frtwhl_ratio "The gear ratio between steering wheel angle and front wheel angle." VALUE 0x70102b78 /* @ECU_Address@KfLCCS_r_veh_strwhl_2_frtwhl_ratio@ */ Scalar_FLOAT32_IEEE 0 LCCS_subsystem_integrated_CM_single -3.4E+38 3.4E+38 /end CHARACTERISTIC
/begin CHARACTERISTIC KfLCCS_t_SampleTime "Base control loop time.
      " VALUE 0x70102b74 /* @ECU_Address@KfLCCS_t_SampleTime@ */ Scalar_FLOAT32_IEEE 0 LCCS_subsystem_integrated_CM_single_s 0.01 0.1 /end CHARACTERISTIC
/begin CHARACTERISTIC KfLCCS_t_TimestampAliveThresh "Timestamp alive thresh to check the diff between EGMO and MPFU messages.." VALUE 0x70102b70 /* @ECU_Address@KfLCCS_t_TimestampAliveThresh@ */ Scalar_FLOAT32_IEEE 0 LCCS_subsystem_integrated_CM_single_s -3.4E+38 3.4E+38 /end CHARACTERISTIC
/begin CHARACTERISTIC KfLCCS_t_lateral_movement_delay "When vehicle is moving, and steering control is active, lateral movement will be enabled after this time delay." VALUE 0x70102b6c /* @ECU_Address@KfLCCS_t_lateral_movement_delay@ */ Scalar_FLOAT32_IEEE 0 LCCS_subsystem_integrated_CM_single_s -3.4E+38 3.4E+38 /end CHARACTERISTIC
/begin CHARACTERISTIC KfLCCS_v_shift_speed_high_limit "Lateral shift speed high limit." VALUE 0x70102b68 /* @ECU_Address@KfLCCS_v_shift_speed_high_limit@ */ Scalar_FLOAT32_IEEE 0 LCCS_subsystem_integrated_CM_single_m_s -3.4E+38 3.4E+38 /end CHARACTERISTIC
/begin CHARACTERISTIC KfLCCS_v_shift_speed_low_limit "Lateral shift speed low limit." VALUE 0x70102b64 /* @ECU_Address@KfLCCS_v_shift_speed_low_limit@ */ Scalar_FLOAT32_IEEE 0 LCCS_subsystem_integrated_CM_single_m_s -3.4E+38 3.4E+38 /end CHARACTERISTIC
/begin CHARACTERISTIC KcLCCS_HeadingErrorRateSmooth "This number of heading error samples are used to calculate heading error rate.
      " VALUE 0x7010236c /* @ECU_Address@KcLCCS_HeadingErrorRateSmooth@ */ Scalar_LONG 0 LCCS_subsystem_integrated_CM_int32 1.0 50.0 /end CHARACTERISTIC
/begin CHARACTERISTIC KbLCCS_UsePurePursuit "True: Use lookahead point to calculate target driving direction." VALUE 0x7010236b /* @ECU_Address@KbLCCS_UsePurePursuit@ */ Scalar_BOOLEAN 0 LCCS_subsystem_integrated_CM_boolean 0 1 /end CHARACTERISTIC
/begin CHARACTERISTIC KbLCCS_WheelEncoderReady "Indicator for wheel encoder system ready." VALUE 0x7010236a /* @ECU_Address@KbLCCS_WheelEncoderReady@ */ Scalar_BOOLEAN 0 LCCS_subsystem_integrated_CM_boolean 0 1 /end CHARACTERISTIC
/begin CHARACTERISTIC KbLCCS_inlane_nudge_request_SLEW "Calibration switch to SLEW inlane nudge request." VALUE 0x70102369 /* @ECU_Address@KbLCCS_inlane_nudge_request_SLEW@ */ Scalar_BOOLEAN 0 LCCS_subsystem_integrated_CM_boolean 0 1 /end CHARACTERISTIC
/begin CHARACTERISTIC KbLCCS_inlane_nudge_request_value "Inlane nudge request value in SLEW mode." VALUE 0x70102368 /* @ECU_Address@KbLCCS_inlane_nudge_request_value@ */ Scalar_BOOLEAN 0 LCCS_subsystem_integrated_CM_boolean 0 1 /end CHARACTERISTIC
/begin CHARACTERISTIC KbLCCS_lane_change_request_SLEW "Calibration switch to SLEW lane change request." VALUE 0x70102367 /* @ECU_Address@KbLCCS_lane_change_request_SLEW@ */ Scalar_BOOLEAN 0 LCCS_subsystem_integrated_CM_boolean 0 1 /end CHARACTERISTIC
/begin CHARACTERISTIC KbLCCS_lane_change_request_value "Lane change request value in SLEW mode." VALUE 0x70102366 /* @ECU_Address@KbLCCS_lane_change_request_value@ */ Scalar_BOOLEAN 0 LCCS_subsystem_integrated_CM_boolean 0 1 /end CHARACTERISTIC
/begin CHARACTERISTIC KbLCCS_lane_change_source_ALCA "Lane change request source is ALCA." VALUE 0x70102365 /* @ECU_Address@KbLCCS_lane_change_source_ALCA@ */ Scalar_BOOLEAN 0 LCCS_subsystem_integrated_CM_boolean 0 1 /end CHARACTERISTIC
/begin CHARACTERISTIC KeLCCS_shifting_direction_value "Shifting direction value in SLEW mode." VALUE 0x70102364 /* @ECU_Address@KeLCCS_shifting_direction_value@ */ Scalar_UBYTE 0 LCCS_subsystem_integrated_CM_EnumDCSN_driving_direction 0 2 /end CHARACTERISTIC
/begin CHARACTERISTIC KfLCAS_Ang_DisbleStrAngleThrshMax "" VALUE 0x70102360 /* @ECU_Address@KfLCAS_Ang_DisbleStrAngleThrshMax@ */ Scalar_FLOAT32_IEEE 0 LCAS_subsystem_integrated_CM_single 0.0 12.0 /end CHARACTERISTIC
/begin CHARACTERISTIC KfLCAS_Ang_EnbleStrAngleThrshMax "" VALUE 0x7010235c /* @ECU_Address@KfLCAS_Ang_EnbleStrAngleThrshMax@ */ Scalar_FLOAT32_IEEE 0 LCAS_subsystem_integrated_CM_single 0.0 12.0 /end CHARACTERISTIC
/begin CHARACTERISTIC KfLCAS_c_DisbleCurveThrshMax "" VALUE 0x70102358 /* @ECU_Address@KfLCAS_c_DisbleCurveThrshMax@ */ Scalar_FLOAT32_IEEE 0 LCAS_subsystem_integrated_CM_single 0.001 0.1 /end CHARACTERISTIC
/begin CHARACTERISTIC KfLCAS_c_EnbleCurveThrshMax "" VALUE 0x70102354 /* @ECU_Address@KfLCAS_c_EnbleCurveThrshMax@ */ Scalar_FLOAT32_IEEE 0 LCAS_subsystem_integrated_CM_single 0.001 0.1 /end CHARACTERISTIC
/begin CHARACTERISTIC KfLCAS_d_CVLargerZone_FrontDis "" VALUE 0x70102350 /* @ECU_Address@KfLCAS_d_CVLargerZone_FrontDis@ */ Scalar_FLOAT32_IEEE 0 LCAS_subsystem_integrated_CM_single 0.0 3.0 /end CHARACTERISTIC
/begin CHARACTERISTIC KfLCAS_d_CVLargerZone_NearDis "" VALUE 0x7010234c /* @ECU_Address@KfLCAS_d_CVLargerZone_NearDis@ */ Scalar_FLOAT32_IEEE 0 LCAS_subsystem_integrated_CM_single -0.5 0.5 /end CHARACTERISTIC
/begin CHARACTERISTIC KfLCAS_d_CVZone_FarDis "" VALUE 0x70102348 /* @ECU_Address@KfLCAS_d_CVZone_FarDis@ */ Scalar_FLOAT32_IEEE 0 LCAS_subsystem_integrated_CM_single 3.0 6.0 /end CHARACTERISTIC
/begin CHARACTERISTIC KfLCAS_d_CVZone_FrontDis "" VALUE 0x70102344 /* @ECU_Address@KfLCAS_d_CVZone_FrontDis@ */ Scalar_FLOAT32_IEEE 0 LCAS_subsystem_integrated_CM_single 0.0 3.0 /end CHARACTERISTIC
/begin CHARACTERISTIC KfLCAS_d_CVZone_NearDis "" VALUE 0x70102340 /* @ECU_Address@KfLCAS_d_CVZone_NearDis@ */ Scalar_FLOAT32_IEEE 0 LCAS_subsystem_integrated_CM_single -0.5 0.5 /end CHARACTERISTIC
/begin CHARACTERISTIC KfLCAS_d_VehCenterFront "" VALUE 0x7010233c /* @ECU_Address@KfLCAS_d_VehCenterFront@ */ Scalar_FLOAT32_IEEE 0 LCAS_subsystem_integrated_CM_single 0.0 4.0 /end CHARACTERISTIC
/begin CHARACTERISTIC KfLCAS_d_VehCenterRear "" VALUE 0x70102338 /* @ECU_Address@KfLCAS_d_VehCenterRear@ */ Scalar_FLOAT32_IEEE 0 LCAS_subsystem_integrated_CM_single 0.0 4.0 /end CHARACTERISTIC
/begin CHARACTERISTIC KfLCAS_d_VehLenth "" VALUE 0x70102334 /* @ECU_Address@KfLCAS_d_VehLenth@ */ Scalar_FLOAT32_IEEE 0 LCAS_subsystem_integrated_CM_single 0.0 20.0 /end CHARACTERISTIC
/begin CHARACTERISTIC KfLCAS_d_VehWidth "" VALUE 0x70102330 /* @ECU_Address@KfLCAS_d_VehWidth@ */ Scalar_FLOAT32_IEEE 0 LCAS_subsystem_integrated_CM_single 0.0 10.0 /end CHARACTERISTIC
/begin CHARACTERISTIC KfLCAS_r_ObtWidthProportion "" VALUE 0x7010232c /* @ECU_Address@KfLCAS_r_ObtWidthProportion@ */ Scalar_FLOAT32_IEEE 0 LCAS_subsystem_integrated_CM_single 0.0 1.0 /end CHARACTERISTIC
/begin CHARACTERISTIC KfLCAS_t_TTCLargerThrsh_LowLevel "" VALUE 0x70102328 /* @ECU_Address@KfLCAS_t_TTCLargerThrsh_LowLevel@ */ Scalar_FLOAT32_IEEE 0 LCAS_subsystem_integrated_CM_single 3.0 7.5 /end CHARACTERISTIC
/begin CHARACTERISTIC KfLCAS_t_TTCThrshLowLevel "" VALUE 0x70102324 /* @ECU_Address@KfLCAS_t_TTCThrshLowLevel@ */ Scalar_FLOAT32_IEEE 0 LCAS_subsystem_integrated_CM_single 3.0 7.5 /end CHARACTERISTIC
/begin CHARACTERISTIC KfLCAS_t_WarnSustainedTime "" VALUE 0x70102320 /* @ECU_Address@KfLCAS_t_WarnSustainedTime@ */ Scalar_FLOAT32_IEEE 0 LCAS_subsystem_integrated_CM_single 0.0 10.0 /end CHARACTERISTIC
/begin CHARACTERISTIC KfLCAS_v_DisbleVehSpdThrshHi "" VALUE 0x7010231c /* @ECU_Address@KfLCAS_v_DisbleVehSpdThrshHi@ */ Scalar_FLOAT32_IEEE 0 LCAS_subsystem_integrated_CM_single 0.0 100.0 /end CHARACTERISTIC
/begin CHARACTERISTIC KfLCAS_v_DisbleVehSpdThrshLo "" VALUE 0x70102318 /* @ECU_Address@KfLCAS_v_DisbleVehSpdThrshLo@ */ Scalar_FLOAT32_IEEE 0 LCAS_subsystem_integrated_CM_single -5.0 20.0 /end CHARACTERISTIC
/begin CHARACTERISTIC KfLCAS_v_EnbleVehSpdThrshHi "" VALUE 0x70102314 /* @ECU_Address@KfLCAS_v_EnbleVehSpdThrshHi@ */ Scalar_FLOAT32_IEEE 0 LCAS_subsystem_integrated_CM_single 0.0 100.0 /end CHARACTERISTIC
/begin CHARACTERISTIC KfLCAS_v_EnbleVehSpdThrshLo "" VALUE 0x70102310 /* @ECU_Address@KfLCAS_v_EnbleVehSpdThrshLo@ */ Scalar_FLOAT32_IEEE 0 LCAS_subsystem_integrated_CM_single -5.0 20.0 /end CHARACTERISTIC
/begin CHARACTERISTIC KfLCAS_v_LatSpdThr "" VALUE 0x7010230c /* @ECU_Address@KfLCAS_v_LatSpdThr@ */ Scalar_FLOAT32_IEEE 0 LCAS_subsystem_integrated_CM_single_m_s 0.0 20.0 /end CHARACTERISTIC
/begin CHARACTERISTIC KfLCAS_v_staticSpdThr "" VALUE 0x70102308 /* @ECU_Address@KfLCAS_v_staticSpdThr@ */ Scalar_FLOAT32_IEEE 0 LCAS_subsystem_integrated_CM_single 0.0 10.0 /end CHARACTERISTIC
/begin CHARACTERISTIC KfLCAS_d_CVLargerZone_FarDis "" VALUE 0x70102305 /* @ECU_Address@KfLCAS_d_CVLargerZone_FarDis@ */ Scalar_BYTE 0 LCAS_subsystem_integrated_CM_int8 3.0 6.0 /end CHARACTERISTIC
/begin CHARACTERISTIC KbLCAS_Sensor_Error "" VALUE 0x70102304 /* @ECU_Address@KbLCAS_Sensor_Error@ */ Scalar_BOOLEAN 0 LCAS_subsystem_integrated_CM_boolean 0.0 1.0 /end CHARACTERISTIC
/begin CHARACTERISTIC KbLCAS_Sensor_Work "" VALUE 0x70102303 /* @ECU_Address@KbLCAS_Sensor_Work@ */ Scalar_BOOLEAN 0 LCAS_subsystem_integrated_CM_boolean 0.0 1.0 /end CHARACTERISTIC
/begin CHARACTERISTIC KbLCAS_Switch "" VALUE 0x70102302 /* @ECU_Address@KbLCAS_Switch@ */ Scalar_BOOLEAN 0 LCAS_subsystem_integrated_CM_boolean 0.0 1.0 /end CHARACTERISTIC
/begin CHARACTERISTIC KbLCAS_configLCA "" VALUE 0x70102301 /* @ECU_Address@KbLCAS_configLCA@ */ Scalar_BOOLEAN 0 LCAS_subsystem_integrated_CM_boolean 0.0 1.0 /end CHARACTERISTIC
/begin CHARACTERISTIC KbLCAS_curve "" VALUE 0x70102300 /* @ECU_Address@KbLCAS_curve@ */ Scalar_BOOLEAN 0 LCAS_subsystem_integrated_CM_boolean 0.0 1.0 /end CHARACTERISTIC
/begin CHARACTERISTIC KfBSDS_Ang_DisbleStrAngleThrshMax "" VALUE 0x70101ffc /* @ECU_Address@KfBSDS_Ang_DisbleStrAngleThrshMax@ */ Scalar_FLOAT32_IEEE 0 BSDS_subsystem_integrated_CM_single 0.0 12.0 /end CHARACTERISTIC
/begin CHARACTERISTIC KfBSDS_Ang_EnbleStrAngleThrshMax "" VALUE 0x70101ff8 /* @ECU_Address@KfBSDS_Ang_EnbleStrAngleThrshMax@ */ Scalar_FLOAT32_IEEE 0 BSDS_subsystem_integrated_CM_single 0.0 12.0 /end CHARACTERISTIC
/begin CHARACTERISTIC KfBSDS_c_DisbleCurveThrshMax "" VALUE 0x70101ff4 /* @ECU_Address@KfBSDS_c_DisbleCurveThrshMax@ */ Scalar_FLOAT32_IEEE 0 BSDS_subsystem_integrated_CM_single 0.001 0.1 /end CHARACTERISTIC
/begin CHARACTERISTIC KfBSDS_c_EnbleCurveThrshMax "" VALUE 0x70101ff0 /* @ECU_Address@KfBSDS_c_EnbleCurveThrshMax@ */ Scalar_FLOAT32_IEEE 0 BSDS_subsystem_integrated_CM_single 0.001 0.1 /end CHARACTERISTIC
/begin CHARACTERISTIC KfBSDS_d_BSDLargerZone_BackDis "" VALUE 0x70101fec /* @ECU_Address@KfBSDS_d_BSDLargerZone_BackDis@ */ Scalar_FLOAT32_IEEE 0 BSDS_subsystem_integrated_CM_single 3.0 30.0 /end CHARACTERISTIC
/begin CHARACTERISTIC KfBSDS_d_BSDLargerZone_FarDis "" VALUE 0x70101fe8 /* @ECU_Address@KfBSDS_d_BSDLargerZone_FarDis@ */ Scalar_FLOAT32_IEEE 0 BSDS_subsystem_integrated_CM_single 3.0 6.0 /end CHARACTERISTIC
/begin CHARACTERISTIC KfBSDS_d_BSDLargerZone_FrontDis "" VALUE 0x70101fe4 /* @ECU_Address@KfBSDS_d_BSDLargerZone_FrontDis@ */ Scalar_FLOAT32_IEEE 0 BSDS_subsystem_integrated_CM_single -1.0 2.0 /end CHARACTERISTIC
/begin CHARACTERISTIC KfBSDS_d_BSDLargerZone_NearDis "" VALUE 0x70101fe0 /* @ECU_Address@KfBSDS_d_BSDLargerZone_NearDis@ */ Scalar_FLOAT32_IEEE 0 BSDS_subsystem_integrated_CM_single -0.5 0.5 /end CHARACTERISTIC
/begin CHARACTERISTIC KfBSDS_d_BSDZone_BackDis "" VALUE 0x70101fdc /* @ECU_Address@KfBSDS_d_BSDZone_BackDis@ */ Scalar_FLOAT32_IEEE 0 BSDS_subsystem_integrated_CM_single 3.0 30.0 /end CHARACTERISTIC
/begin CHARACTERISTIC KfBSDS_d_BSDZone_Eye95Dis "" VALUE 0x70101fd8 /* @ECU_Address@KfBSDS_d_BSDZone_Eye95Dis@ */ Scalar_FLOAT32_IEEE 0 BSDS_subsystem_integrated_CM_single 0.0 5.0 /end CHARACTERISTIC
/begin CHARACTERISTIC KfBSDS_d_BSDZone_FarDis "" VALUE 0x70101fd4 /* @ECU_Address@KfBSDS_d_BSDZone_FarDis@ */ Scalar_FLOAT32_IEEE 0 BSDS_subsystem_integrated_CM_single 3.0 6.0 /end CHARACTERISTIC
/begin CHARACTERISTIC KfBSDS_d_BSDZone_FrontDis "" VALUE 0x70101fd0 /* @ECU_Address@KfBSDS_d_BSDZone_FrontDis@ */ Scalar_FLOAT32_IEEE 0 BSDS_subsystem_integrated_CM_single -1.0 2.0 /end CHARACTERISTIC
/begin CHARACTERISTIC KfBSDS_d_BSDZone_NearDis "" VALUE 0x70101fcc /* @ECU_Address@KfBSDS_d_BSDZone_NearDis@ */ Scalar_FLOAT32_IEEE 0 BSDS_subsystem_integrated_CM_single -0.5 0.5 /end CHARACTERISTIC
/begin CHARACTERISTIC KfBSDS_d_VehCenterFront "" VALUE 0x70101fc8 /* @ECU_Address@KfBSDS_d_VehCenterFront@ */ Scalar_FLOAT32_IEEE 0 BSDS_subsystem_integrated_CM_single 0.0 4.0 /end CHARACTERISTIC
/begin CHARACTERISTIC KfBSDS_d_VehCenterRear "" VALUE 0x70101fc4 /* @ECU_Address@KfBSDS_d_VehCenterRear@ */ Scalar_FLOAT32_IEEE 0 BSDS_subsystem_integrated_CM_single 0.0 4.0 /end CHARACTERISTIC
/begin CHARACTERISTIC KfBSDS_d_VehLenth "" VALUE 0x70101fc0 /* @ECU_Address@KfBSDS_d_VehLenth@ */ Scalar_FLOAT32_IEEE 0 BSDS_subsystem_integrated_CM_single 0.0 20.0 /end CHARACTERISTIC
/begin CHARACTERISTIC KfBSDS_d_VehWidth "" VALUE 0x70101fbc /* @ECU_Address@KfBSDS_d_VehWidth@ */ Scalar_FLOAT32_IEEE 0 BSDS_subsystem_integrated_CM_single 0.0 10.0 /end CHARACTERISTIC
/begin CHARACTERISTIC KfBSDS_r_ObtWidthProportion "" VALUE 0x70101fb8 /* @ECU_Address@KfBSDS_r_ObtWidthProportion@ */ Scalar_FLOAT32_IEEE 0 BSDS_subsystem_integrated_CM_single 0.0 1.0 /end CHARACTERISTIC
/begin CHARACTERISTIC KfBSDS_t_WarnSustainedTime "" VALUE 0x70101fb4 /* @ECU_Address@KfBSDS_t_WarnSustainedTime@ */ Scalar_FLOAT32_IEEE 0 BSDS_subsystem_integrated_CM_single 0.0 10.0 /end CHARACTERISTIC
/begin CHARACTERISTIC KfBSDS_v_DisbleVehSpdThrshHi "" VALUE 0x70101fb0 /* @ECU_Address@KfBSDS_v_DisbleVehSpdThrshHi@ */ Scalar_FLOAT32_IEEE 0 BSDS_subsystem_integrated_CM_single 0.0 100.0 /end CHARACTERISTIC
/begin CHARACTERISTIC KfBSDS_v_DisbleVehSpdThrshLo "" VALUE 0x70101fac /* @ECU_Address@KfBSDS_v_DisbleVehSpdThrshLo@ */ Scalar_FLOAT32_IEEE 0 BSDS_subsystem_integrated_CM_single -5.0 20.0 /end CHARACTERISTIC
/begin CHARACTERISTIC KfBSDS_v_EnbleVehSpdThrshHi "" VALUE 0x70101fa8 /* @ECU_Address@KfBSDS_v_EnbleVehSpdThrshHi@ */ Scalar_FLOAT32_IEEE 0 BSDS_subsystem_integrated_CM_single 0.0 100.0 /end CHARACTERISTIC
/begin CHARACTERISTIC KfBSDS_v_EnbleVehSpdThrshLo "" VALUE 0x70101fa4 /* @ECU_Address@KfBSDS_v_EnbleVehSpdThrshLo@ */ Scalar_FLOAT32_IEEE 0 BSDS_subsystem_integrated_CM_single -5.0 20.0 /end CHARACTERISTIC
/begin CHARACTERISTIC KfBSDS_v_LatSpdThr "" VALUE 0x70101fa0 /* @ECU_Address@KfBSDS_v_LatSpdThr@ */ Scalar_FLOAT32_IEEE 0 BSDS_subsystem_integrated_CM_single_m_s 0.0 20.0 /end CHARACTERISTIC
/begin CHARACTERISTIC KfBSDS_v_OncomRelSpdThrshHi_in "" VALUE 0x70101f9c /* @ECU_Address@KfBSDS_v_OncomRelSpdThrshHi_in@ */ Scalar_FLOAT32_IEEE 0 BSDS_subsystem_integrated_CM_single 0.0 30.0 /end CHARACTERISTIC
/begin CHARACTERISTIC KfBSDS_v_OncomRelSpdThrshHi_out "" VALUE 0x70101f98 /* @ECU_Address@KfBSDS_v_OncomRelSpdThrshHi_out@ */ Scalar_FLOAT32_IEEE 0 BSDS_subsystem_integrated_CM_single 0.0 30.0 /end CHARACTERISTIC
/begin CHARACTERISTIC KfBSDS_v_staticSpdThr "" VALUE 0x70101f94 /* @ECU_Address@KfBSDS_v_staticSpdThr@ */ Scalar_FLOAT32_IEEE 0 BSDS_subsystem_integrated_CM_single 0.0 10.0 /end CHARACTERISTIC
/begin CHARACTERISTIC KbBSDS_Sensor_Error "" VALUE 0x70101f90 /* @ECU_Address@KbBSDS_Sensor_Error@ */ Scalar_BOOLEAN 0 BSDS_subsystem_integrated_CM_boolean 0.0 1.0 /end CHARACTERISTIC
/begin CHARACTERISTIC KbBSDS_Sensor_Work "" VALUE 0x70101f8f /* @ECU_Address@KbBSDS_Sensor_Work@ */ Scalar_BOOLEAN 0 BSDS_subsystem_integrated_CM_boolean 0.0 1.0 /end CHARACTERISTIC
/begin CHARACTERISTIC KbBSDS_Switch "" VALUE 0x70101f8e /* @ECU_Address@KbBSDS_Switch@ */ Scalar_BOOLEAN 0 BSDS_subsystem_integrated_CM_boolean 0.0 1.0 /end CHARACTERISTIC
/begin CHARACTERISTIC KbBSDS_configBSD "" VALUE 0x70101f8d /* @ECU_Address@KbBSDS_configBSD@ */ Scalar_BOOLEAN 0 BSDS_subsystem_integrated_CM_boolean 0.0 1.0 /end CHARACTERISTIC
/begin CHARACTERISTIC KbBSDS_curve "" VALUE 0x70101f8c /* @ECU_Address@KbBSDS_curve@ */ Scalar_BOOLEAN 0 BSDS_subsystem_integrated_CM_boolean 0.0 1.0 /end CHARACTERISTIC
/begin CHARACTERISTIC KfLDWS_Ang_BkToCnrAng "The angle X axis and the line connecting center of rear axle and front tire." VALUE 0x70102c48 /* @ECU_Address@KfLDWS_Ang_BkToCnrAng@ */ Scalar_FLOAT32_IEEE 0 LDWS_subsystem_integrated_CM_single_rad 0.0 1.5707963267948966 /end CHARACTERISTIC
/begin CHARACTERISTIC KfLDWS_Ang_SuppSteerAngThrsh "The suppression threshold for Steer Angle" VALUE 0x70102c44 /* @ECU_Address@KfLDWS_Ang_SuppSteerAngThrsh@ */ Scalar_FLOAT32_IEEE 0 LDWS_subsystem_integrated_CM_single__ 0.0 360.0 /end CHARACTERISTIC
/begin CHARACTERISTIC KfLDWS_M_SuppTorque "The torque limit that could be treated as suppression" VALUE 0x70102c40 /* @ECU_Address@KfLDWS_M_SuppTorque@ */ Scalar_FLOAT32_IEEE 0 LDWS_subsystem_integrated_CM_single_NM 0.0 10.0 /end CHARACTERISTIC
/begin CHARACTERISTIC KfLDWS_c_CurvLwrBnd "The curvature upper bound for ODD" VALUE 0x70102c3c /* @ECU_Address@KfLDWS_c_CurvLwrBnd@ */ Scalar_FLOAT32_IEEE 0 LDWS_subsystem_integrated_CM_single_1_m 0.0 0.01 /end CHARACTERISTIC
/begin CHARACTERISTIC KfLDWS_c_CurvUprBnd "The curvature lower bound for ODD" VALUE 0x70102c38 /* @ECU_Address@KfLDWS_c_CurvUprBnd@ */ Scalar_FLOAT32_IEEE 0 LDWS_subsystem_integrated_CM_single_1_m 0.0 0.01 /end CHARACTERISTIC
/begin CHARACTERISTIC KfLDWS_d_BkToFrtCnrDist "The distance between one fo the front tires to the center of rear axle." VALUE 0x70102c34 /* @ECU_Address@KfLDWS_d_BkToFrtCnrDist@ */ Scalar_FLOAT32_IEEE 0 LDWS_subsystem_integrated_CM_single_m 0.0 20.0 /end CHARACTERISTIC
/begin CHARACTERISTIC KfLDWS_d_EdgBuff "The edge buffer that added to the calcualted distance to lane markers" VALUE 0x70102c30 /* @ECU_Address@KfLDWS_d_EdgBuff@ */ Scalar_FLOAT32_IEEE 0 LDWS_subsystem_integrated_CM_single_m -2.0 2.0 /end CHARACTERISTIC
/begin CHARACTERISTIC KfLDWS_d_LnWidthLwrBnd "The lane width lower bound for ODD" VALUE 0x70102c2c /* @ECU_Address@KfLDWS_d_LnWidthLwrBnd@ */ Scalar_FLOAT32_IEEE 0 LDWS_subsystem_integrated_CM_single_m 0.0 10.0 /end CHARACTERISTIC
/begin CHARACTERISTIC KfLDWS_d_LnWidthUprBnd "The lane width upper bound for ODD" VALUE 0x70102c28 /* @ECU_Address@KfLDWS_d_LnWidthUprBnd@ */ Scalar_FLOAT32_IEEE 0 LDWS_subsystem_integrated_CM_single_m 0.0 10.0 /end CHARACTERISTIC
/begin CHARACTERISTIC KfLDWS_d_WarnLineLvlOne "When vehicle speed is higher than 1.0m/s, the earliest warning line shall be placed no more than 1.5m inside the lane boundary." VALUE 0x70102c24 /* @ECU_Address@KfLDWS_d_WarnLineLvlOne@ */ Scalar_FLOAT32_IEEE 0 LDWS_subsystem_integrated_CM_single_m 0.0 1.5 /end CHARACTERISTIC
/begin CHARACTERISTIC KfLDWS_d_WarnLineLvlThree "When vehicle speed is not higher than 0.5 m/s, the earliest warning line shall be placed no more than 0.75m inside the lane boundary." VALUE 0x70102c20 /* @ECU_Address@KfLDWS_d_WarnLineLvlThree@ */ Scalar_FLOAT32_IEEE 0 LDWS_subsystem_integrated_CM_single_m 0.0 0.75 /end CHARACTERISTIC
/begin CHARACTERISTIC KfLDWS_k_CurvBuffCoe "The coefficient that multiples the distance to lanemarker when the vehicle is driving under large curavture." VALUE 0x70102c1c /* @ECU_Address@KfLDWS_k_CurvBuffCoe@ */ Scalar_FLOAT32_IEEE 0 LDWS_subsystem_integrated_CM_single 0.0 2.0 /end CHARACTERISTIC
/begin CHARACTERISTIC KfLDWS_k_WarnLineLvlTwo "When vehicle speed is higher than 0.5m/s but not  higher than 1.0m/s, the earliest warning line shall be placed no more than 1.5*Va m inside the lane boundary" VALUE 0x70102c18 /* @ECU_Address@KfLDWS_k_WarnLineLvlTwo@ */ Scalar_FLOAT32_IEEE 0 LDWS_subsystem_integrated_CM_single 0.0 1.5 /end CHARACTERISTIC
/begin CHARACTERISTIC KfLDWS_t_TLCThrsh "Time to lane crossing threshold" VALUE 0x70102c14 /* @ECU_Address@KfLDWS_t_TLCThrsh@ */ Scalar_FLOAT32_IEEE 0 LDWS_subsystem_integrated_CM_single_s 0.0 2.0 /end CHARACTERISTIC
/begin CHARACTERISTIC KfLDWS_v_SpdLwrBnd "The speed lower bound for ODD" VALUE 0x70102c10 /* @ECU_Address@KfLDWS_v_SpdLwrBnd@ */ Scalar_FLOAT32_IEEE 0 LDWS_subsystem_integrated_CM_single_m_s 0.0 55.0 /end CHARACTERISTIC
/begin CHARACTERISTIC KfLDWS_v_SpdUprBnd "The speed upper bound for ODD" VALUE 0x70102c0c /* @ECU_Address@KfLDWS_v_SpdUprBnd@ */ Scalar_FLOAT32_IEEE 0 LDWS_subsystem_integrated_CM_single_m_s 0.0 55.0 /end CHARACTERISTIC
/begin CHARACTERISTIC KfLDWS_v_SuppSteerRateThrsh "The suppression threshold for Steer Rate" VALUE 0x70102c08 /* @ECU_Address@KfLDWS_v_SuppSteerRateThrsh@ */ Scalar_FLOAT32_IEEE 0 LDWS_subsystem_integrated_CM_single___s 0.0 360.0 /end CHARACTERISTIC
/begin CHARACTERISTIC KcLDWS_CntSample "The sample time that state machine uses in a loop." VALUE 0x70102c06 /* @ECU_Address@KcLDWS_CntSample@ */ Scalar_UWORD 0 LDWS_subsystem_integrated_CM_uint16 1.0 10.0 /end CHARACTERISTIC
/begin CHARACTERISTIC KfLDWS_t_CntMaxWarnHold "The maximum time that a warning satte is allowed to last" VALUE 0x70102c04 /* @ECU_Address@KfLDWS_t_CntMaxWarnHold@ */ Scalar_UWORD 0 LDWS_subsystem_integrated_CM_uint16 0.0 1000.0 /end CHARACTERISTIC
/begin CHARACTERISTIC KfLDWS_t_CntMinWarnHold "The minimum time that a warning state shall last." VALUE 0x70102c02 /* @ECU_Address@KfLDWS_t_CntMinWarnHold@ */ Scalar_UWORD 0 LDWS_subsystem_integrated_CM_uint16 0.0 1000.0 /end CHARACTERISTIC
/begin CHARACTERISTIC KfLDWS_t_CntOnHold "The bouncing time that avoids wrong trigger." VALUE 0x70102c00 /* @ECU_Address@KfLDWS_t_CntOnHold@ */ Scalar_UWORD 0 LDWS_subsystem_integrated_CM_uint16 0.0 1000.0 /end CHARACTERISTIC
/begin CHARACTERISTIC KfLDWS_t_CurvNotValidTime "The time that Enabling Manager uses to reset condition for curvature" VALUE 0x70102bfe /* @ECU_Address@KfLDWS_t_CurvNotValidTime@ */ Scalar_UWORD 0 LDWS_subsystem_integrated_CM_uint16 0.0 1000.0 /end CHARACTERISTIC
/begin CHARACTERISTIC KfLDWS_t_CurvValidTime "The time that Enabling Manager uses to set condition for curvature" VALUE 0x70102bfc /* @ECU_Address@KfLDWS_t_CurvValidTime@ */ Scalar_UWORD 0 LDWS_subsystem_integrated_CM_uint16 0.0 1000.0 /end CHARACTERISTIC
/begin CHARACTERISTIC KfLDWS_t_LnMkrMissThrsh "The maximum time that a lane marker could termporarily go missing" VALUE 0x70102bfa /* @ECU_Address@KfLDWS_t_LnMkrMissThrsh@ */ Scalar_UWORD 0 LDWS_subsystem_integrated_CM_uint16 0.0 1000.0 /end CHARACTERISTIC
/begin CHARACTERISTIC KfLDWS_t_LnMkrNotValidTime "The time that Enabling Manager uses set condion for lane marker" VALUE 0x70102bf8 /* @ECU_Address@KfLDWS_t_LnMkrNotValidTime@ */ Scalar_UWORD 0 LDWS_subsystem_integrated_CM_uint16 0.0 1000.0 /end CHARACTERISTIC
/begin CHARACTERISTIC KfLDWS_t_LnMkrValidTime "The time that Enabling Manager uses reset condition for lane marker" VALUE 0x70102bf6 /* @ECU_Address@KfLDWS_t_LnMkrValidTime@ */ Scalar_UWORD 0 LDWS_subsystem_integrated_CM_uint16 0.0 1000.0 /end CHARACTERISTIC
/begin CHARACTERISTIC KfLDWS_t_LnWidthNotValidTime "The time that Enabling Manager uses to reset condition for lane width" VALUE 0x70102bf4 /* @ECU_Address@KfLDWS_t_LnWidthNotValidTime@ */ Scalar_UWORD 0 LDWS_subsystem_integrated_CM_uint16 0.0 1000.0 /end CHARACTERISTIC
/begin CHARACTERISTIC KfLDWS_t_LnWidthValidTime "The time that enabling manager uses to set condition for lane width" VALUE 0x70102bf2 /* @ECU_Address@KfLDWS_t_LnWidthValidTime@ */ Scalar_UWORD 0 LDWS_subsystem_integrated_CM_uint16 0.0 1000.0 /end CHARACTERISTIC
/begin CHARACTERISTIC KfLDWS_t_SpdRngNotValidTime "The time that enabling manager uses to reset condition for speed range" VALUE 0x70102bf0 /* @ECU_Address@KfLDWS_t_SpdRngNotValidTime@ */ Scalar_UWORD 0 LDWS_subsystem_integrated_CM_uint16 0.0 1000.0 /end CHARACTERISTIC
/begin CHARACTERISTIC KfLDWS_t_SpdRngValidTime "The time that enabling manager uses to set condtion for speed range" VALUE 0x70102bee /* @ECU_Address@KfLDWS_t_SpdRngValidTime@ */ Scalar_UWORD 0 LDWS_subsystem_integrated_CM_uint16 0.0 1000.0 /end CHARACTERISTIC
/begin CHARACTERISTIC KfLDWS_t_SuppIndiTime "The time that indicator could be treated as suppression" VALUE 0x70102bec /* @ECU_Address@KfLDWS_t_SuppIndiTime@ */ Scalar_UWORD 0 LDWS_subsystem_integrated_CM_uint16 0.0 1000.0 /end CHARACTERISTIC
/begin CHARACTERISTIC KfLDWS_t_SuppSteerAngTime "The time that steer angle could be treated as suppression" VALUE 0x70102bea /* @ECU_Address@KfLDWS_t_SuppSteerAngTime@ */ Scalar_UWORD 0 LDWS_subsystem_integrated_CM_uint16 0.0 1000.0 /end CHARACTERISTIC
/begin CHARACTERISTIC KfLDWS_t_SuppSteerRateTime "The time that steer rate could be treated as suppression" VALUE 0x70102be8 /* @ECU_Address@KfLDWS_t_SuppSteerRateTime@ */ Scalar_UWORD 0 LDWS_subsystem_integrated_CM_uint16 0.0 1000.0 /end CHARACTERISTIC
/begin CHARACTERISTIC KfLDWS_t_SuppTorqueTime "The time that steer toque could be treated as suppression" VALUE 0x70102be6 /* @ECU_Address@KfLDWS_t_SuppTorqueTime@ */ Scalar_UWORD 0 LDWS_subsystem_integrated_CM_uint16 0.0 1000.0 /end CHARACTERISTIC
/begin CHARACTERISTIC KfLDWS_r_LaMkrQlt "Lane marker quality threshold" VALUE 0x70102be4 /* @ECU_Address@KfLDWS_r_LaMkrQlt@ */ Scalar_UBYTE 0 LDWS_subsystem_integrated_CM_uint8 0.0 100.0 /end CHARACTERISTIC
/begin CHARACTERISTIC KbLDWS_EnableSwitch "" VALUE 0x70102be3 /* @ECU_Address@KbLDWS_EnableSwitch@ */ Scalar_BOOLEAN 0 LDWS_subsystem_integrated_CM_boolean 0.0 1.0 /end CHARACTERISTIC
/begin CHARACTERISTIC KbLDWS_SuppLeSwitch "" VALUE 0x70102be2 /* @ECU_Address@KbLDWS_SuppLeSwitch@ */ Scalar_BOOLEAN 0 LDWS_subsystem_integrated_CM_boolean 0.0 1.0 /end CHARACTERISTIC
/begin CHARACTERISTIC KbLDWS_SuppRiSwitch "" VALUE 0x70102be1 /* @ECU_Address@KbLDWS_SuppRiSwitch@ */ Scalar_BOOLEAN 0 LDWS_subsystem_integrated_CM_boolean 0.0 1.0 /end CHARACTERISTIC
/begin CHARACTERISTIC KbLDWS_ThetaSwitch "" VALUE 0x70102be0 /* @ECU_Address@KbLDWS_ThetaSwitch@ */ Scalar_BOOLEAN 0 LDWS_subsystem_integrated_CM_boolean 0.0 1.0 /end CHARACTERISTIC
/begin AXIS_PTS KtDCSN_c_speed_limit_curve_axis "Speed limit from curvature look up table axis " 0x701021c8 /* @ECU_Address@KtDCSN_c_speed_limit_curve_axis@ */ VfDCSN_largest_curvature_ahead Lookup1D_X_FLOAT32_IEEE 0 DCSN_subsystem_integrated_CM_single_1_m 14 -3.4E+38 3.4E+38 /end AXIS_PTS
/begin AXIS_PTS KtDCSN_v_ahead_timegap_speed_axis "The look-ahead time gap for speed limit from curvature
      speed axis" 0x70102178 /* @ECU_Address@KtDCSN_v_ahead_timegap_speed_axis@ */ VfDCSN_vehicle_speed_egmo Lookup1D_X_FLOAT32_IEEE 0 DCSN_subsystem_integrated_CM_single_m_s 10 -3.4E+38 3.4E+38 /end AXIS_PTS
/begin AXIS_PTS KtLCCS_AXIS_lanemark_switch_time "Lane marker switch time." 0x70102abc /* @ECU_Address@KtLCCS_AXIS_lanemark_switch_time@ */ VfLCCS_left_lanemark_switch_time Lookup1D_X_FLOAT32_IEEE 0 LCCS_subsystem_integrated_CM_single_s 21 0.0 10.0 /end AXIS_PTS
/begin AXIS_PTS KtLCCS_AXIS_route_curvature "Curvature axis." 0x70102aa8 /* @ECU_Address@KtLCCS_AXIS_route_curvature@ */ NO_INPUT_QUANTITY Lookup2D_X_FLOAT32_IEEE 0 LCCS_subsystem_integrated_CM_single 5 -3.4E+38 3.4E+38 /end AXIS_PTS
/begin AXIS_PTS KtLCCS_AXIS_vehicle_speed "Vehicle speed axis." 0x70102a54 /* @ECU_Address@KtLCCS_AXIS_vehicle_speed@ */ VfLCCS_linear_velocity Lookup2D_X_FLOAT32_IEEE 0 LCCS_subsystem_integrated_CM_single 21 -3.4E+38 3.4E+38 /end AXIS_PTS
/begin AXIS_PTS KtLCCS_AXIS_heading_error "AXIS for heading error." 0x70102b10 /* @ECU_Address@KtLCCS_AXIS_heading_error@ */ NO_INPUT_QUANTITY Lookup1D_X_FLOAT32_IEEE 0 LCCS_subsystem_integrated_CM_single_rad 21 0.0 0.1 /end AXIS_PTS
/begin MEASUREMENT VfDCSN_SpdLimt_look_ahead_dis "look ahead distance when judging speed limit from curvature" FLOAT32_IEEE DCSN_subsystem_integrated_CM_single_1_m 0 0 -3.4E+38 3.4E+38 ECU_ADDRESS 0x700042e4 /* @ECU_Address@VfDCSN_SpdLimt_look_ahead_dis@ */ /end MEASUREMENT
/begin MEASUREMENT VfDCSN_largest_curvature_ahead "the largest curvature in look-ahead distance" FLOAT32_IEEE DCSN_subsystem_integrated_CM_single_1_m 0 0 -3.4E+38 3.4E+38 ECU_ADDRESS 0x700042e0 /* @ECU_Address@VfDCSN_largest_curvature_ahead@ */ /end MEASUREMENT
/begin MEASUREMENT VfDCSN_speed_limit_curvature "speed limit from curvature" FLOAT32_IEEE DCSN_subsystem_integrated_CM_single_1_m 0 0 -3.4E+38 3.4E+38 ECU_ADDRESS 0x700042dc /* @ECU_Address@VfDCSN_speed_limit_curvature@ */ /end MEASUREMENT
/begin MEASUREMENT VfDCSN_raw_stop_line_distance "The raw stop line distance from mpfu" FLOAT32_IEEE DCSN_subsystem_integrated_CM_single_m 0 0 -3.4E+38 3.4E+38 ECU_ADDRESS 0x700042d8 /* @ECU_Address@VfDCSN_raw_stop_line_distance@ */ /end MEASUREMENT
/begin MEASUREMENT VfDCSN_stop_s_distance "stop distance" FLOAT32_IEEE DCSN_subsystem_integrated_CM_single_m 0 0 -3.4E+38 3.4E+38 ECU_ADDRESS 0x700042d4 /* @ECU_Address@VfDCSN_stop_s_distance@ */ /end MEASUREMENT
/begin MEASUREMENT VfDCSN_lane_speed_limit "speed limit from ego lane" FLOAT32_IEEE DCSN_subsystem_integrated_CM_single_m_s 0 0 -3.4E+38 3.4E+38 ECU_ADDRESS 0x700042d0 /* @ECU_Address@VfDCSN_lane_speed_limit@ */ /end MEASUREMENT
/begin MEASUREMENT VfDCSN_target_speed_limit "speed limit from target point" FLOAT32_IEEE DCSN_subsystem_integrated_CM_single_m_s 0 0 -3.4E+38 3.4E+38 ECU_ADDRESS 0x700042cc /* @ECU_Address@VfDCSN_target_speed_limit@ */ /end MEASUREMENT
/begin MEASUREMENT VfDCSN_speed_limit_curvature_pos "the position of speed limit from curvature" FLOAT32_IEEE DCSN_subsystem_integrated_CM_single_m 0 0 -3.4E+38 3.4E+38 ECU_ADDRESS 0x700042c8 /* @ECU_Address@VfDCSN_speed_limit_curvature_pos@ */ /end MEASUREMENT
/begin MEASUREMENT VfDCSN_speed_limit_distance "the position of speed limit point" FLOAT32_IEEE DCSN_subsystem_integrated_CM_single_m 0 0 -3.4E+38 3.4E+38 ECU_ADDRESS 0x700042c4 /* @ECU_Address@VfDCSN_speed_limit_distance@ */ /end MEASUREMENT
/begin MEASUREMENT VfDCSN_change_lane_target_speed "target speed when change lane" FLOAT32_IEEE DCSN_subsystem_integrated_CM_single_m_s 0 0 -3.4E+38 3.4E+38 ECU_ADDRESS 0x700042c0 /* @ECU_Address@VfDCSN_change_lane_target_speed@ */ /end MEASUREMENT
/begin MEASUREMENT VfDCSN_right_marker_raw_c0 "The raw c0" FLOAT32_IEEE DCSN_subsystem_integrated_CM_single 0 0 -3.4E+38 3.4E+38 ECU_ADDRESS 0x700042bc /* @ECU_Address@VfDCSN_right_marker_raw_c0@ */ /end MEASUREMENT
/begin MEASUREMENT VfDCSN_current_right_marker_cur "current right marker curvature" FLOAT32_IEEE DCSN_subsystem_integrated_CM_single_1_m 0 0 -3.4E+38 3.4E+38 ECU_ADDRESS 0x700042b8 /* @ECU_Address@VfDCSN_current_right_marker_cur@ */ /end MEASUREMENT
/begin MEASUREMENT VfDCSN_right_marker_raw_c1 "The raw c1" FLOAT32_IEEE DCSN_subsystem_integrated_CM_single 0 0 -3.4E+38 3.4E+38 ECU_ADDRESS 0x700042b4 /* @ECU_Address@VfDCSN_right_marker_raw_c1@ */ /end MEASUREMENT
/begin MEASUREMENT VfDCSN_current_right_edge_cur "current right edge curvature" FLOAT32_IEEE DCSN_subsystem_integrated_CM_single_1_m 0 0 -3.4E+38 3.4E+38 ECU_ADDRESS 0x700042b0 /* @ECU_Address@VfDCSN_current_right_edge_cur@ */ /end MEASUREMENT
/begin MEASUREMENT VfDCSN_right_marker_raw_c2 "The raw c2" FLOAT32_IEEE DCSN_subsystem_integrated_CM_single 0 0 -3.4E+38 3.4E+38 ECU_ADDRESS 0x700042ac /* @ECU_Address@VfDCSN_right_marker_raw_c2@ */ /end MEASUREMENT
/begin MEASUREMENT VfDCSN_right_marker_raw_c3 "The raw c3" FLOAT32_IEEE DCSN_subsystem_integrated_CM_single 0 0 -3.4E+38 3.4E+38 ECU_ADDRESS 0x700042a8 /* @ECU_Address@VfDCSN_right_marker_raw_c3@ */ /end MEASUREMENT
/begin MEASUREMENT VfDCSN_right_marker_raw_start_x "The raw start x" FLOAT32_IEEE DCSN_subsystem_integrated_CM_single 0 0 -3.4E+38 3.4E+38 ECU_ADDRESS 0x700042a4 /* @ECU_Address@VfDCSN_right_marker_raw_start_x@ */ /end MEASUREMENT
/begin MEASUREMENT VfDCSN_right_marker_raw_end_x "The raw end x" FLOAT32_IEEE DCSN_subsystem_integrated_CM_single 0 0 -3.4E+38 3.4E+38 ECU_ADDRESS 0x700042a0 /* @ECU_Address@VfDCSN_right_marker_raw_end_x@ */ /end MEASUREMENT
/begin MEASUREMENT VfDCSN_right_marker_raw_start_y "The raw start y" FLOAT32_IEEE DCSN_subsystem_integrated_CM_single 0 0 -3.4E+38 3.4E+38 ECU_ADDRESS 0x7000429c /* @ECU_Address@VfDCSN_right_marker_raw_start_y@ */ /end MEASUREMENT
/begin MEASUREMENT VfDCSN_right_marker_raw_end_y "The raw end y" FLOAT32_IEEE DCSN_subsystem_integrated_CM_single 0 0 -3.4E+38 3.4E+38 ECU_ADDRESS 0x70004298 /* @ECU_Address@VfDCSN_right_marker_raw_end_y@ */ /end MEASUREMENT
/begin MEASUREMENT VfDCSN_right_marker_raw_quality "The raw quality" FLOAT32_IEEE DCSN_subsystem_integrated_CM_single 0 0 -3.4E+38 3.4E+38 ECU_ADDRESS 0x70004294 /* @ECU_Address@VfDCSN_right_marker_raw_quality@ */ /end MEASUREMENT
/begin MEASUREMENT VfDCSN_left_marker_raw_c0 "The raw c0" FLOAT32_IEEE DCSN_subsystem_integrated_CM_single 0 0 -3.4E+38 3.4E+38 ECU_ADDRESS 0x70004290 /* @ECU_Address@VfDCSN_left_marker_raw_c0@ */ /end MEASUREMENT
/begin MEASUREMENT VfDCSN_current_left_marker_cur "current left marker curvature" FLOAT32_IEEE DCSN_subsystem_integrated_CM_single_1_m 0 0 -3.4E+38 3.4E+38 ECU_ADDRESS 0x7000428c /* @ECU_Address@VfDCSN_current_left_marker_cur@ */ /end MEASUREMENT
/begin MEASUREMENT VfDCSN_left_marker_raw_c1 "The raw c1" FLOAT32_IEEE DCSN_subsystem_integrated_CM_single 0 0 -3.4E+38 3.4E+38 ECU_ADDRESS 0x70004288 /* @ECU_Address@VfDCSN_left_marker_raw_c1@ */ /end MEASUREMENT
/begin MEASUREMENT VfDCSN_current_left_edge_cur "current left edge curvature" FLOAT32_IEEE DCSN_subsystem_integrated_CM_single_1_m 0 0 -3.4E+38 3.4E+38 ECU_ADDRESS 0x70004284 /* @ECU_Address@VfDCSN_current_left_edge_cur@ */ /end MEASUREMENT
/begin MEASUREMENT VfDCSN_left_marker_raw_c2 "The raw c2" FLOAT32_IEEE DCSN_subsystem_integrated_CM_single 0 0 -3.4E+38 3.4E+38 ECU_ADDRESS 0x70004280 /* @ECU_Address@VfDCSN_left_marker_raw_c2@ */ /end MEASUREMENT
/begin MEASUREMENT VfDCSN_left_marker_raw_c3 "The raw c3" FLOAT32_IEEE DCSN_subsystem_integrated_CM_single 0 0 -3.4E+38 3.4E+38 ECU_ADDRESS 0x7000427c /* @ECU_Address@VfDCSN_left_marker_raw_c3@ */ /end MEASUREMENT
/begin MEASUREMENT VfDCSN_left_marker_raw_start_x "The raw start x" FLOAT32_IEEE DCSN_subsystem_integrated_CM_single 0 0 -3.4E+38 3.4E+38 ECU_ADDRESS 0x70004278 /* @ECU_Address@VfDCSN_left_marker_raw_start_x@ */ /end MEASUREMENT
/begin MEASUREMENT VfDCSN_left_marker_raw_end_x "The raw end x" FLOAT32_IEEE DCSN_subsystem_integrated_CM_single 0 0 -3.4E+38 3.4E+38 ECU_ADDRESS 0x70004274 /* @ECU_Address@VfDCSN_left_marker_raw_end_x@ */ /end MEASUREMENT
/begin MEASUREMENT VfDCSN_left_marker_raw_start_y "The raw start y" FLOAT32_IEEE DCSN_subsystem_integrated_CM_single 0 0 -3.4E+38 3.4E+38 ECU_ADDRESS 0x70004270 /* @ECU_Address@VfDCSN_left_marker_raw_start_y@ */ /end MEASUREMENT
/begin MEASUREMENT VfDCSN_left_marker_raw_end_y "The raw end y" FLOAT32_IEEE DCSN_subsystem_integrated_CM_single 0 0 -3.4E+38 3.4E+38 ECU_ADDRESS 0x7000426c /* @ECU_Address@VfDCSN_left_marker_raw_end_y@ */ /end MEASUREMENT
/begin MEASUREMENT VfDCSN_left_marker_raw_quality "The raw quality" FLOAT32_IEEE DCSN_subsystem_integrated_CM_single 0 0 -3.4E+38 3.4E+38 ECU_ADDRESS 0x70004268 /* @ECU_Address@VfDCSN_left_marker_raw_quality@ */ /end MEASUREMENT
/begin MEASUREMENT VfDCSN_speed_limit_ego_lane "speed limit from ego lane" FLOAT32_IEEE DCSN_subsystem_integrated_CM_single_m_s 0 0 -3.4E+38 3.4E+38 ECU_ADDRESS 0x70004264 /* @ECU_Address@VfDCSN_speed_limit_ego_lane@ */ /end MEASUREMENT
/begin MEASUREMENT VfDCSN_C_cond_act_time "The time count from driver presses activate switch and release the brake pedal.
      Valid when driver want to activate autodrive when brake or gas pedal pressed." UWORD DCSN_subsystem_integrated_CM_uint16 0 0 0 65535 ECU_ADDRESS 0x70004260 /* @ECU_Address@VfDCSN_C_cond_act_time@ */ /end MEASUREMENT
/begin MEASUREMENT VfDCSN_mpfu_num_stop_lines "The number of input numbers of stop lines from mpfu" UBYTE DCSN_subsystem_integrated_CM_uint8 0 0 0 255 ECU_ADDRESS 0x7000425f /* @ECU_Address@VfDCSN_mpfu_num_stop_lines@ */ /end MEASUREMENT
/begin MEASUREMENT VbDCSN_CL_delay_finished "Change lane request confirmed.
      Delay finished." UBYTE DCSN_subsystem_integrated_CM_boolean 0 0 0 1 ECU_ADDRESS 0x7000425d /* @ECU_Address@VbDCSN_CL_delay_finished@ */ /end MEASUREMENT
/begin MEASUREMENT VbDCSN_num_lanes_isNaN "Whether lanes number from mpfu is NaN" UBYTE DCSN_subsystem_integrated_CM_boolean 0 0 0 1 ECU_ADDRESS 0x7000425c /* @ECU_Address@VbDCSN_num_lanes_isNaN@ */ /end MEASUREMENT
/begin MEASUREMENT VbDCSN_has_ego_lane "0 = no ego lane
      1 = has ego lane" UBYTE DCSN_subsystem_integrated_CM_boolean 0 0 0 1 ECU_ADDRESS 0x7000425b /* @ECU_Address@VbDCSN_has_ego_lane@ */ /end MEASUREMENT
/begin MEASUREMENT VbDCSN_spd_limt_max_isNaN "0 = input speed limit is valid
      1 = input speed limit is NaN" UBYTE DCSN_subsystem_integrated_CM_boolean 0 0 0 1 ECU_ADDRESS 0x7000425a /* @ECU_Address@VbDCSN_spd_limt_max_isNaN@ */ /end MEASUREMENT
/begin MEASUREMENT VbDCSN_speed_limit_input_isNaN "0 = input is valid
      1 = input is NaN" UBYTE DCSN_subsystem_integrated_CM_boolean 0 0 0 1 ECU_ADDRESS 0x70004259 /* @ECU_Address@VbDCSN_speed_limit_input_isNaN@ */ /end MEASUREMENT
/begin MEASUREMENT VbDCSN_mpfu_num_edges_isNaN "0 = input is valid
      1 = input is NaN" UBYTE DCSN_subsystem_integrated_CM_boolean 0 0 0 1 ECU_ADDRESS 0x70004258 /* @ECU_Address@VbDCSN_mpfu_num_edges_isNaN@ */ /end MEASUREMENT
/begin MEASUREMENT VbDCSN_mpfu_num_markers_isNaN "0 = input is valid
      1 = input is NaN" UBYTE DCSN_subsystem_integrated_CM_boolean 0 0 0 1 ECU_ADDRESS 0x70004257 /* @ECU_Address@VbDCSN_mpfu_num_markers_isNaN@ */ /end MEASUREMENT
/begin MEASUREMENT VbDCSN_has_left_marker "0 = no left_marker
      1 = has left_marker" UBYTE DCSN_subsystem_integrated_CM_boolean 0 0 0 1 ECU_ADDRESS 0x70004256 /* @ECU_Address@VbDCSN_has_left_marker@ */ /end MEASUREMENT
/begin MEASUREMENT VbDCSN_has_right_marker "0 = no right_marker
      1 = has right_marker" UBYTE DCSN_subsystem_integrated_CM_boolean 0 0 0 1 ECU_ADDRESS 0x70004255 /* @ECU_Address@VbDCSN_has_right_marker@ */ /end MEASUREMENT
/begin MEASUREMENT VbDCSN_speed_limit_enabled "Whether the speed limit output is enabled" UBYTE DCSN_subsystem_integrated_CM_boolean 0 0 0 1 ECU_ADDRESS 0x70004254 /* @ECU_Address@VbDCSN_speed_limit_enabled@ */ /end MEASUREMENT
/begin MEASUREMENT VbDCSN_num_stop_lines_isNaN "The output stop lines number from mpfu" UBYTE DCSN_subsystem_integrated_CM_boolean 0 0 0 1 ECU_ADDRESS 0x70004252 /* @ECU_Address@VbDCSN_num_stop_lines_isNaN@ */ /end MEASUREMENT
/begin MEASUREMENT VbDCSN_has_valid_stop_line "0 = no valid stop line
      1 = has valid stop line" UBYTE DCSN_subsystem_integrated_CM_boolean 0 0 0 1 ECU_ADDRESS 0x70004251 /* @ECU_Address@VbDCSN_has_valid_stop_line@ */ /end MEASUREMENT
/begin MEASUREMENT VbDCSN_stop_line_distance_isNaN "0 = distance from stop line is valid
      1 = distance from stop line is NaN" UBYTE DCSN_subsystem_integrated_CM_boolean 0 0 0 1 ECU_ADDRESS 0x70004250 /* @ECU_Address@VbDCSN_stop_line_distance_isNaN@ */ /end MEASUREMENT
/begin MEASUREMENT VbDCSN_raw_stop_finished "The raw signal:
      Whether ACCS has finished stop request before the stop line." UBYTE DCSN_subsystem_integrated_CM_boolean 0 0 0 1 ECU_ADDRESS 0x7000424e /* @ECU_Address@VbDCSN_raw_stop_finished@ */ /end MEASUREMENT
/begin MEASUREMENT VbDCSN_hold_stop_finished "The time hold signal:
      Whether ACCS has finished stop request before the stop line." UBYTE DCSN_subsystem_integrated_CM_boolean 0 0 0 1 ECU_ADDRESS 0x7000424d /* @ECU_Address@VbDCSN_hold_stop_finished@ */ /end MEASUREMENT
/begin MEASUREMENT VbDCSN_raw_stop_finished_late "The raw signal:
      Whether ACCS has finished stop request after the stop line." UBYTE DCSN_subsystem_integrated_CM_boolean 0 0 0 1 ECU_ADDRESS 0x7000424c /* @ECU_Address@VbDCSN_raw_stop_finished_late@ */ /end MEASUREMENT
/begin MEASUREMENT VbDCSN_stop_request_enabled "0 = Sending stop request is disabled
      1 = Sending stop request is ensabled" UBYTE DCSN_subsystem_integrated_CM_boolean 0 0 0 1 ECU_ADDRESS 0x7000424b /* @ECU_Address@VbDCSN_stop_request_enabled@ */ /end MEASUREMENT
/begin MEASUREMENT VbDCSN_should_send_stop_req "0 = should not send stop req
      1 = should send stop req" UBYTE DCSN_subsystem_integrated_CM_boolean 0 0 0 1 ECU_ADDRESS 0x7000424a /* @ECU_Address@VbDCSN_should_send_stop_req@ */ /end MEASUREMENT
/begin MEASUREMENT VbDCSN_stop_line_is_close "0 = stop line is far
      1 = stop line is close and will be updated by vehicle speed" UBYTE DCSN_subsystem_integrated_CM_boolean 0 0 0 1 ECU_ADDRESS 0x70004249 /* @ECU_Address@VbDCSN_stop_line_is_close@ */ /end MEASUREMENT
/begin MEASUREMENT VbDCSN_stop_unsuccess "Whether the ego vehicle failed to stop for this stop request" UBYTE DCSN_subsystem_integrated_CM_boolean 0 0 0 1 ECU_ADDRESS 0x70004248 /* @ECU_Address@VbDCSN_stop_unsuccess@ */ /end MEASUREMENT
/begin MEASUREMENT VbDCSN_stop_request "0 = no stop request
      1 = stop request" UBYTE DCSN_subsystem_integrated_CM_boolean 0 0 0 1 ECU_ADDRESS 0x70004247 /* @ECU_Address@VbDCSN_stop_request@ */ /end MEASUREMENT
/begin MEASUREMENT VbDCSN_change_lane_request "0 = no change lane request
      1 = change lane request" UBYTE DCSN_subsystem_integrated_CM_boolean 0 0 0 1 ECU_ADDRESS 0x70004246 /* @ECU_Address@VbDCSN_change_lane_request@ */ /end MEASUREMENT
/begin MEASUREMENT VbDCSN_change_lane_cancel_request "0 = no change lane cancel request
      1 = cancel change lane" UBYTE DCSN_subsystem_integrated_CM_boolean 0 0 0 1 ECU_ADDRESS 0x70004245 /* @ECU_Address@VbDCSN_change_lane_cancel_request@ */ /end MEASUREMENT
/begin MEASUREMENT VbDCSN_inlane_nudge_request "0 = no inlane nudge request
      1 = request inlane nudge" UBYTE DCSN_subsystem_integrated_CM_boolean 0 0 0 1 ECU_ADDRESS 0x70004244 /* @ECU_Address@VbDCSN_inlane_nudge_request@ */ /end MEASUREMENT
/begin MEASUREMENT VbDCSN_pull_over_request "0 = no pull over request
      1 = pull over" UBYTE DCSN_subsystem_integrated_CM_boolean 0 0 0 1 ECU_ADDRESS 0x70004243 /* @ECU_Address@VbDCSN_pull_over_request@ */ /end MEASUREMENT
/begin MEASUREMENT VbDCSN_stop_line_input_isNaN "0 = input is valid
      1 = input is NaN" UBYTE DCSN_subsystem_integrated_CM_boolean 0 0 0 1 ECU_ADDRESS 0x70004242 /* @ECU_Address@VbDCSN_stop_line_input_isNaN@ */ /end MEASUREMENT
/begin MEASUREMENT VbDCSN_right_marker_para_isNaN "0 = c0/c1/c2/c3 no NaN input
      1 = c0/c1/c2/c3 have NaN input" UBYTE DCSN_subsystem_integrated_CM_boolean 0 0 0 1 ECU_ADDRESS 0x7000423e /* @ECU_Address@VbDCSN_right_marker_para_isNaN@ */ /end MEASUREMENT
/begin MEASUREMENT VbDCSN_left_marker_para_isNaN "0 = c0/c1/c2/c3 no NaN input
      1 = c0/c1/c2/c3 have NaN input" UBYTE DCSN_subsystem_integrated_CM_boolean 0 0 0 1 ECU_ADDRESS 0x7000423d /* @ECU_Address@VbDCSN_left_marker_para_isNaN@ */ /end MEASUREMENT
/begin MEASUREMENT VbDCSN_right_edge_para_isNaN "0 = c0/c1/c2/c3 no NaN input
      1 = c0/c1/c2/c3 have NaN input" UBYTE DCSN_subsystem_integrated_CM_boolean 0 0 0 1 ECU_ADDRESS 0x7000423c /* @ECU_Address@VbDCSN_right_edge_para_isNaN@ */ /end MEASUREMENT
/begin MEASUREMENT VbDCSN_left_edge_para_isNaN "0 = c0/c1/c2/c3 no NaN input
      1 = c0/c1/c2/c3 have NaN input" UBYTE DCSN_subsystem_integrated_CM_boolean 0 0 0 1 ECU_ADDRESS 0x7000423b /* @ECU_Address@VbDCSN_left_edge_para_isNaN@ */ /end MEASUREMENT
/begin MEASUREMENT VbDCSN_cond_activate_met "0 = no acitvate request when brake/gas pedal is pressed
      1 = activate request when brake/gas pedal is pressed" UBYTE DCSN_subsystem_integrated_CM_boolean 0 0 0 1 ECU_ADDRESS 0x70004227 /* @ECU_Address@VbDCSN_cond_activate_met@ */ /end MEASUREMENT
/begin MEASUREMENT VbDCSN_fault_detected "Whether system fault is level 3,4,5." UBYTE DCSN_subsystem_integrated_CM_boolean 0 0 0 1 ECU_ADDRESS 0x70004226 /* @ECU_Address@VbDCSN_fault_detected@ */ /end MEASUREMENT
/begin MEASUREMENT VbDCSN_autodrive_ready_to_engage "Whether the requirements of autodrive activation is all satisfied." UBYTE DCSN_subsystem_integrated_CM_boolean 0 0 0 1 ECU_ADDRESS 0x70004223 /* @ECU_Address@VbDCSN_autodrive_ready_to_engage@ */ /end MEASUREMENT
/begin MEASUREMENT VbDCSN_autodrive_exit "the flag if autodrive reqest exit" UBYTE DCSN_subsystem_integrated_CM_boolean 0 0 0 1 ECU_ADDRESS 0x70004222 /* @ECU_Address@VbDCSN_autodrive_exit@ */ /end MEASUREMENT
/begin MEASUREMENT VbDCSN_autodrive_warning "the flag if autodrive reqest warning" UBYTE DCSN_subsystem_integrated_CM_boolean 0 0 0 1 ECU_ADDRESS 0x70004221 /* @ECU_Address@VbDCSN_autodrive_warning@ */ /end MEASUREMENT
/begin MEASUREMENT VeDCSN_change_lane_req_side "0 = FORWARD
      1 = LEFT
      2 = RIGHT" UBYTE DCSN_subsystem_integrated_CM_EnumDCSN_driving_direction 0 0 0 2 ECU_ADDRESS 0x7000421d /* @ECU_Address@VeDCSN_change_lane_req_side@ */ /end MEASUREMENT
/begin MEASUREMENT VfDCSN_inlane_nudge_side "inlane nudge side
      0 = NA
      1 = LEFT
      2 = RIGHT" UBYTE DCSN_subsystem_integrated_CM_EnumDCSN_driving_direction 0 0 0 2 ECU_ADDRESS 0x7000421c /* @ECU_Address@VfDCSN_inlane_nudge_side@ */ /end MEASUREMENT
/begin MEASUREMENT VeDCSN_CL_req_side_pre "0 = FORWARD
      1 = LEFT
      2 = RIGHT" UBYTE DCSN_subsystem_integrated_CM_EnumDCSN_driving_direction 0 0 0 2 ECU_ADDRESS 0x7000421b /* @ECU_Address@VeDCSN_CL_req_side_pre@ */ /end MEASUREMENT
/begin MEASUREMENT VeDCSN_stop_reason "0 = NO_STOP_REQUEST
      1 = STOP_FOR_DESTINATION
      2 = STOP_FOR_TRAFFIC_LIGHT
      3 = STOP_FOR_STOP_SIGN
      4 = STOP_FOR_STOP_LINE
      5 = STOP_FOR_CROSSWALK
      6 = STOP_FOR_KEEP_CLEAR" UBYTE DCSN_subsystem_integrated_CM_EnumDCSN_stop_reason 0 0 0 6 ECU_ADDRESS 0x70004216 /* @ECU_Address@VeDCSN_stop_reason@ */ /end MEASUREMENT
/begin MEASUREMENT VeDCSN_speed_limit_reason "0 = NO_LIMIT
      1 = LIMIT_FOR_EGO_LANE
      2 = LIMIT_FOR_DRIVER_REQ
      3 = LIMIT_FOR_CROSSWALK
      4 = LIMIT_FOR_NUDGE" UBYTE DCSN_subsystem_integrated_CM_EnumDCSN_speed_limit_reason 0 0 0 3 ECU_ADDRESS 0x70004215 /* @ECU_Address@VeDCSN_speed_limit_reason@ */ /end MEASUREMENT
/begin MEASUREMENT VeDCSN_change_lane_reason "0 = LC_NO_REQUEST
      1 = LC_USER_CMD
      2 = LC_NAVIGATION_CMD
      3 = LC_FRONT_OBSTACLE" UBYTE DCSN_subsystem_integrated_CM_EnumDCSN_change_lane_reason 0 0 0 3 ECU_ADDRESS 0x70004214 /* @ECU_Address@VeDCSN_change_lane_reason@ */ /end MEASUREMENT
/begin MEASUREMENT VeDCSN_change_lane_cancel_reason "0 = LC_CANCEL_NO_REQUEST
      1 = LC_CANCEL_USR_CMD" UBYTE DCSN_subsystem_integrated_CM_EnumDCSN_change_lane_cancel_reason 0 0 0 1 ECU_ADDRESS 0x70004213 /* @ECU_Address@VeDCSN_change_lane_cancel_reason@ */ /end MEASUREMENT
/begin MEASUREMENT VeDCSN_inlane_nudge_reason "0 = NUDGE_NO_REQUEST
      1 = NUDGE_FRONT_OBSTACLE
      2 = NUDGE_SIDE_OBSTACLE" UBYTE DCSN_subsystem_integrated_CM_EnumDCSN_inlane_nudge_reason 0 0 0 2 ECU_ADDRESS 0x70004212 /* @ECU_Address@VeDCSN_inlane_nudge_reason@ */ /end MEASUREMENT
/begin MEASUREMENT VeDCSN_pull_over_reason "0 = PULLOVER_NO_REQUEST
      1 = PULLOVER_USER_CMD
      2 = PULLOVER_POLICE
      3 = PULLOVER_SYSTEM_FAULT" UBYTE DCSN_subsystem_integrated_CM_EnumDCSN_pull_over_reason 0 0 0 3 ECU_ADDRESS 0x70004211 /* @ECU_Address@VeDCSN_pull_over_reason@ */ /end MEASUREMENT
/begin MEASUREMENT VeDCSN_stop_request_mode "0 = NotEnabled
      1 = WaitForValidStopLine
      2 = CheckStopCond
      3 = SendStopReqEgmoDis
      4 = UpdateStopDis
      5 = HoldForStopLineUpdate" UBYTE DCSN_subsystem_integrated_CM_EnumDCSN_stop_request_mode 0 0 0 5 ECU_ADDRESS 0x70004210 /* @ECU_Address@VeDCSN_stop_request_mode@ */ /end MEASUREMENT
/begin MEASUREMENT VfLCCS_timestamp_EGMO "Timestamp of EGMO interface." FLOAT64_IEEE LCCS_subsystem_integrated_CM_double_s 0 0 -1.7E+308 1.7E+308 ECU_ADDRESS 0xb0006788 /* @ECU_Address@VfLCCS_timestamp_EGMO@ */ /end MEASUREMENT
/begin MEASUREMENT VfLCCS_timestamp_MPFU "Timestamp of MPFU interface." FLOAT64_IEEE LCCS_subsystem_integrated_CM_double_s 0 0 -1.7E+308 1.7E+308 ECU_ADDRESS 0xb0006780 /* @ECU_Address@VfLCCS_timestamp_MPFU@ */ /end MEASUREMENT
/begin MEASUREMENT VfLCCS_steering_angle_diff_abs "Steering angle delta absolute value." FLOAT32_IEEE LCCS_subsystem_integrated_CM_single 0 0 -3.4E+38 3.4E+38 ECU_ADDRESS 0xb000677c /* @ECU_Address@VfLCCS_steering_angle_diff_abs@ */ /end MEASUREMENT
/begin MEASUREMENT VfLCCS_lateral_v_from_ALCA "ALCA requested lateral speed to shift lane center." FLOAT32_IEEE LCCS_subsystem_integrated_CM_single_m_s 0 0 -3.4E+38 3.4E+38 ECU_ADDRESS 0xb0006778 /* @ECU_Address@VfLCCS_lateral_v_from_ALCA@ */ /end MEASUREMENT
/begin MEASUREMENT VfLCCS_linear_velocity "Linear velocity." FLOAT32_IEEE LCCS_subsystem_integrated_CM_single 0 0 -3.4E+38 3.4E+38 ECU_ADDRESS 0xb0006774 /* @ECU_Address@VfLCCS_linear_velocity@ */ /end MEASUREMENT
/begin MEASUREMENT VfLCCS_velocity_rel_y "Longitudinal speed Vy." FLOAT32_IEEE LCCS_subsystem_integrated_CM_single 0 0 -3.4E+38 3.4E+38 ECU_ADDRESS 0xb0006770 /* @ECU_Address@VfLCCS_velocity_rel_y@ */ /end MEASUREMENT
/begin MEASUREMENT VfLCCS_velocity_rel_x "Lateral speed Vx." FLOAT32_IEEE LCCS_subsystem_integrated_CM_single 0 0 -3.4E+38 3.4E+38 ECU_ADDRESS 0xb000676c /* @ECU_Address@VfLCCS_velocity_rel_x@ */ /end MEASUREMENT
/begin MEASUREMENT VfLCCS_veh_heading_rel "Slip angle of center of mass." FLOAT32_IEEE LCCS_subsystem_integrated_CM_single 0 0 -3.4E+38 3.4E+38 ECU_ADDRESS 0xb0006768 /* @ECU_Address@VfLCCS_veh_heading_rel@ */ /end MEASUREMENT
/begin MEASUREMENT VfLCCS_VCU1_ICPV_StrAngle "Steering wheel angle from CAN." FLOAT32_IEEE LCCS_subsystem_integrated_CM_single 0 0 -3.4E+38 3.4E+38 ECU_ADDRESS 0xb0006764 /* @ECU_Address@VfLCCS_VCU1_ICPV_StrAngle@ */ /end MEASUREMENT
/begin MEASUREMENT VfLCCS_yaw_rate "Yaw rate from CAN." FLOAT32_IEEE LCCS_subsystem_integrated_CM_single_rad_s 0 0 -3.4E+38 3.4E+38 ECU_ADDRESS 0xb0006760 /* @ECU_Address@VfLCCS_yaw_rate@ */ /end MEASUREMENT
/begin MEASUREMENT VfLCCS_lookahead_distance "Lookahead distance." FLOAT32_IEEE LCCS_subsystem_integrated_CM_single 0 0 -3.4E+38 3.4E+38 ECU_ADDRESS 0xb000675c /* @ECU_Address@VfLCCS_lookahead_distance@ */ /end MEASUREMENT
/begin MEASUREMENT VfLCCS_veh_frtwhl_angle_act "Vehicle front wheel angle actual value." FLOAT32_IEEE LCCS_subsystem_integrated_CM_single 0 0 -3.4E+38 3.4E+38 ECU_ADDRESS 0xb0006758 /* @ECU_Address@VfLCCS_veh_frtwhl_angle_act@ */ /end MEASUREMENT
/begin MEASUREMENT VaLCCS_raw_left_lanemark "Raw left lanemark." FLOAT32_IEEE LCCS_subsystem_integrated_CM_single 0 0 -3.4E+38 3.4E+38 ARRAY_SIZE 6 ECU_ADDRESS 0xb0006740 /* @ECU_Address@VaLCCS_raw_left_lanemark@ */ /end MEASUREMENT
/begin MEASUREMENT VaLCCS_raw_right_lanemark "Raw right lanemark." FLOAT32_IEEE LCCS_subsystem_integrated_CM_single 0 0 -3.4E+38 3.4E+38 ARRAY_SIZE 6 ECU_ADDRESS 0xb0006728 /* @ECU_Address@VaLCCS_raw_right_lanemark@ */ /end MEASUREMENT
/begin MEASUREMENT VfLCCS_smoothed_lane_width "Smoothed lane width." FLOAT32_IEEE LCCS_subsystem_integrated_CM_single 0 0 -3.4E+38 3.4E+38 ECU_ADDRESS 0xb0006724 /* @ECU_Address@VfLCCS_smoothed_lane_width@ */ /end MEASUREMENT
/begin MEASUREMENT VfLCCS_left_lanemark_confidence "" FLOAT32_IEEE LCCS_subsystem_integrated_CM_single 0 0 -3.4E+38 3.4E+38 ECU_ADDRESS 0xb0006720 /* @ECU_Address@VfLCCS_left_lanemark_confidence@ */ /end MEASUREMENT
/begin MEASUREMENT VfLCCS_right_lanemark_confidence "" FLOAT32_IEEE LCCS_subsystem_integrated_CM_single 0 0 -3.4E+38 3.4E+38 ECU_ADDRESS 0xb000671c /* @ECU_Address@VfLCCS_right_lanemark_confidence@ */ /end MEASUREMENT
/begin MEASUREMENT VaLCCS_virtual_left_lanemark "Virtual left lanemark." FLOAT32_IEEE LCCS_subsystem_integrated_CM_single 0 0 -3.4E+38 3.4E+38 ARRAY_SIZE 4 ECU_ADDRESS 0xb000670c /* @ECU_Address@VaLCCS_virtual_left_lanemark@ */ /end MEASUREMENT
/begin MEASUREMENT VaLCCS_virtual_right_lanemark "Virtual right lanemark." FLOAT32_IEEE LCCS_subsystem_integrated_CM_single 0 0 -3.4E+38 3.4E+38 ARRAY_SIZE 4 ECU_ADDRESS 0xb00066fc /* @ECU_Address@VaLCCS_virtual_right_lanemark@ */ /end MEASUREMENT
/begin MEASUREMENT VfLCCS_raw_lane_width "Raw lane width." FLOAT32_IEEE LCCS_subsystem_integrated_CM_single 0 0 -3.4E+38 3.4E+38 ECU_ADDRESS 0xb00066f8 /* @ECU_Address@VfLCCS_raw_lane_width@ */ /end MEASUREMENT
/begin MEASUREMENT VfLCCS_c0_scaling "c0 scaling factor against lane width." FLOAT32_IEEE LCCS_subsystem_integrated_CM_single 0 0 -3.4E+38 3.4E+38 ECU_ADDRESS 0xb00066f4 /* @ECU_Address@VfLCCS_c0_scaling@ */ /end MEASUREMENT
/begin MEASUREMENT VfLCCS_target_lateral_shift_width "Target shift width for lane change or inlane nudge." FLOAT32_IEEE LCCS_subsystem_integrated_CM_single 0 0 -3.4E+38 3.4E+38 ECU_ADDRESS 0xb00066f0 /* @ECU_Address@VfLCCS_target_lateral_shift_width@ */ /end MEASUREMENT
/begin MEASUREMENT VfLCCS_lateral_shift_step "Lane change or nudge shift lateral distance step." FLOAT32_IEEE LCCS_subsystem_integrated_CM_single 0 0 -3.4E+38 3.4E+38 ECU_ADDRESS 0xb00066ec /* @ECU_Address@VfLCCS_lateral_shift_step@ */ /end MEASUREMENT
/begin MEASUREMENT VfLCCS_lateral_dist_to_go "Lateral distance from shifted lane center to target lane center." FLOAT32_IEEE LCCS_subsystem_integrated_CM_single_m 0 0 -3.4E+38 3.4E+38 ECU_ADDRESS 0xb00066e8 /* @ECU_Address@VfLCCS_lateral_dist_to_go@ */ /end MEASUREMENT
/begin MEASUREMENT VfLCCS_lateral_shift_width "Lane change or inlane nudge lateral shift width, which is an offset to raw lane center." FLOAT32_IEEE LCCS_subsystem_integrated_CM_single 0 0 -3.4E+38 3.4E+38 ECU_ADDRESS 0xb00066e4 /* @ECU_Address@VfLCCS_lateral_shift_width@ */ /end MEASUREMENT
/begin MEASUREMENT VaLCCS_shifted_lane_center_line "Shifted lane center line." FLOAT32_IEEE LCCS_subsystem_integrated_CM_single 0 0 -3.4E+38 3.4E+38 ARRAY_SIZE 4 ECU_ADDRESS 0xb00066d4 /* @ECU_Address@VaLCCS_shifted_lane_center_line@ */ /end MEASUREMENT
/begin MEASUREMENT VfLCCS_frtwhl_angle_step_limit "Front wheel angle step limit." FLOAT32_IEEE LCCS_subsystem_integrated_CM_single 0 0 -3.4E+38 3.4E+38 ECU_ADDRESS 0xb00066d0 /* @ECU_Address@VfLCCS_frtwhl_angle_step_limit@ */ /end MEASUREMENT
/begin MEASUREMENT VfLCCS_frtwhl_angle_limit_manual "Front wheel angle limit manual." FLOAT32_IEEE LCCS_subsystem_integrated_CM_single 0 0 -3.4E+38 3.4E+38 ECU_ADDRESS 0xb00066cc /* @ECU_Address@VfLCCS_frtwhl_angle_limit_manual@ */ /end MEASUREMENT
/begin MEASUREMENT VfLCCS_veh_frtwhl_angle_des_ramped "Vehicle front wheel angle desired value ramped." FLOAT32_IEEE LCCS_subsystem_integrated_CM_single 0 0 -3.4E+38 3.4E+38 ECU_ADDRESS 0xb00066c8 /* @ECU_Address@VfLCCS_veh_frtwhl_angle_des_ramped@ */ /end MEASUREMENT
/begin MEASUREMENT VfLCCS_veh_strwhl_angle_des "Desired steering wheel angle." FLOAT32_IEEE LCCS_subsystem_integrated_CM_single 0 0 -3.4E+38 3.4E+38 ECU_ADDRESS 0xb00066c4 /* @ECU_Address@VfLCCS_veh_strwhl_angle_des@ */ /end MEASUREMENT
/begin MEASUREMENT VfLCCS_steer_angle_feedback "Steer angle feedback." FLOAT32_IEEE LCCS_subsystem_integrated_CM_single 0 0 -3.4E+38 3.4E+38 ECU_ADDRESS 0xb00066c0 /* @ECU_Address@VfLCCS_steer_angle_feedback@ */ /end MEASUREMENT
/begin MEASUREMENT VfLCCS_steer_angle_feedforward "Steer angle feedforward." FLOAT32_IEEE LCCS_subsystem_integrated_CM_single 0 0 -3.4E+38 3.4E+38 ECU_ADDRESS 0xb00066bc /* @ECU_Address@VfLCCS_steer_angle_feedforward@ */ /end MEASUREMENT
/begin MEASUREMENT VfLCCS_slowpath_steer_P "Slowpath steer P part." FLOAT32_IEEE LCCS_subsystem_integrated_CM_single 0 0 -3.4E+38 3.4E+38 ECU_ADDRESS 0xb00066b8 /* @ECU_Address@VfLCCS_slowpath_steer_P@ */ /end MEASUREMENT
/begin MEASUREMENT VfLCCS_slowpath_steer_I "Slowpath steer I part." FLOAT32_IEEE LCCS_subsystem_integrated_CM_single 0 0 -3.4E+38 3.4E+38 ECU_ADDRESS 0xb00066b4 /* @ECU_Address@VfLCCS_slowpath_steer_I@ */ /end MEASUREMENT
/begin MEASUREMENT VfLCCS_slowpath_steer_PI "Slowpath steer PI part." FLOAT32_IEEE LCCS_subsystem_integrated_CM_single 0 0 -3.4E+38 3.4E+38 ECU_ADDRESS 0xb00066b0 /* @ECU_Address@VfLCCS_slowpath_steer_PI@ */ /end MEASUREMENT
/begin MEASUREMENT VfLCCS_frtwhl_angle_limit_lat_acc "Front wheel angle limit lat acc." FLOAT32_IEEE LCCS_subsystem_integrated_CM_single 0 0 -3.4E+38 3.4E+38 ECU_ADDRESS 0xb00066ac /* @ECU_Address@VfLCCS_frtwhl_angle_limit_lat_acc@ */ /end MEASUREMENT
/begin MEASUREMENT VfLCCS_veh_frtwhl_angle_des "Vehicle front wheel angle desired value raw." FLOAT32_IEEE LCCS_subsystem_integrated_CM_single 0 0 -3.4E+38 3.4E+38 ECU_ADDRESS 0xb00066a8 /* @ECU_Address@VfLCCS_veh_frtwhl_angle_des@ */ /end MEASUREMENT
/begin MEASUREMENT VfLCCS_heading_error_contribution "Heading error contribution." FLOAT32_IEEE LCCS_subsystem_integrated_CM_single 0 0 -3.4E+38 3.4E+38 ECU_ADDRESS 0xb00066a4 /* @ECU_Address@VfLCCS_heading_error_contribution@ */ /end MEASUREMENT
/begin MEASUREMENT VfLCCS_heading_error_rate_contribution "Heading error rate contribution." FLOAT32_IEEE LCCS_subsystem_integrated_CM_single 0 0 -3.4E+38 3.4E+38 ECU_ADDRESS 0xb00066a0 /* @ECU_Address@VfLCCS_heading_error_rate_contribution@ */ /end MEASUREMENT
/begin MEASUREMENT VfLCCS_lateral_error_contribution "Lateral error contribution." FLOAT32_IEEE LCCS_subsystem_integrated_CM_single 0 0 -3.4E+38 3.4E+38 ECU_ADDRESS 0xb000669c /* @ECU_Address@VfLCCS_lateral_error_contribution@ */ /end MEASUREMENT
/begin MEASUREMENT VfLCCS_lateral_error_rate_contribution "Lateral error rate contribution." FLOAT32_IEEE LCCS_subsystem_integrated_CM_single 0 0 -3.4E+38 3.4E+38 ECU_ADDRESS 0xb0006698 /* @ECU_Address@VfLCCS_lateral_error_rate_contribution@ */ /end MEASUREMENT
/begin MEASUREMENT VfLCCS_left_lanemark_switch_time "Left lanemark switch time." FLOAT32_IEEE LCCS_subsystem_integrated_CM_single 0 0 -3.4E+38 3.4E+38 ECU_ADDRESS 0xb0006694 /* @ECU_Address@VfLCCS_left_lanemark_switch_time@ */ /end MEASUREMENT
/begin MEASUREMENT VaLCCS_final_left_lanemark "Final left lanemarker." FLOAT32_IEEE LCCS_subsystem_integrated_CM_single 0 0 -3.4E+38 3.4E+38 ARRAY_SIZE 4 ECU_ADDRESS 0xb0006684 /* @ECU_Address@VaLCCS_final_left_lanemark@ */ /end MEASUREMENT
/begin MEASUREMENT VfLCCS_right_lanemark_switch_time "Right lanemark switch time." FLOAT32_IEEE LCCS_subsystem_integrated_CM_single 0 0 -3.4E+38 3.4E+38 ECU_ADDRESS 0xb0006680 /* @ECU_Address@VfLCCS_right_lanemark_switch_time@ */ /end MEASUREMENT
/begin MEASUREMENT VaLCCS_final_right_lanemark "Final right lanemarker." FLOAT32_IEEE LCCS_subsystem_integrated_CM_single 0 0 -3.4E+38 3.4E+38 ARRAY_SIZE 4 ECU_ADDRESS 0xb0006670 /* @ECU_Address@VaLCCS_final_right_lanemark@ */ /end MEASUREMENT
/begin MEASUREMENT VaLCCS_raw_lane_center_line "Raw lane center line." FLOAT32_IEEE LCCS_subsystem_integrated_CM_single 0 0 -3.4E+38 3.4E+38 ARRAY_SIZE 4 ECU_ADDRESS 0xb0006660 /* @ECU_Address@VaLCCS_raw_lane_center_line@ */ /end MEASUREMENT
/begin MEASUREMENT VaLCCS_com_point "Center of mass position." FLOAT32_IEEE LCCS_subsystem_integrated_CM_single 0 0 -3.4E+38 3.4E+38 ARRAY_SIZE 3 ECU_ADDRESS 0xb0006654 /* @ECU_Address@VaLCCS_com_point@ */ /end MEASUREMENT
/begin MEASUREMENT VaLCCS_preview_proj_point "Lookahead point projection position." FLOAT32_IEEE LCCS_subsystem_integrated_CM_single 0 0 -3.4E+38 3.4E+38 ARRAY_SIZE 3 ECU_ADDRESS 0xb0006648 /* @ECU_Address@VaLCCS_preview_proj_point@ */ /end MEASUREMENT
/begin MEASUREMENT VfLCCS_lookahead_angle "Lookahead angle." FLOAT32_IEEE LCCS_subsystem_integrated_CM_single 0 0 -3.4E+38 3.4E+38 ECU_ADDRESS 0xb0006644 /* @ECU_Address@VfLCCS_lookahead_angle@ */ /end MEASUREMENT
/begin MEASUREMENT VaLCCS_com_proj_point "Center of mass projection point position." FLOAT32_IEEE LCCS_subsystem_integrated_CM_single 0 0 -3.4E+38 3.4E+38 ARRAY_SIZE 3 ECU_ADDRESS 0xb0006638 /* @ECU_Address@VaLCCS_com_proj_point@ */ /end MEASUREMENT
/begin MEASUREMENT VfLCCS_lateral_error "Lateral error." FLOAT32_IEEE LCCS_subsystem_integrated_CM_single 0 0 -3.4E+38 3.4E+38 ECU_ADDRESS 0xb0006634 /* @ECU_Address@VfLCCS_lateral_error@ */ /end MEASUREMENT
/begin MEASUREMENT VfLCCS_heading_error_rate "Heading error rate." FLOAT32_IEEE LCCS_subsystem_integrated_CM_single 0 0 -3.4E+38 3.4E+38 ECU_ADDRESS 0xb0006630 /* @ECU_Address@VfLCCS_heading_error_rate@ */ /end MEASUREMENT
/begin MEASUREMENT VfLCCS_lateral_error_rate "Lateral error rate." FLOAT32_IEEE LCCS_subsystem_integrated_CM_single 0 0 -3.4E+38 3.4E+38 ECU_ADDRESS 0xb000662c /* @ECU_Address@VfLCCS_lateral_error_rate@ */ /end MEASUREMENT
/begin MEASUREMENT VfLCCS_preview_curvature "The lane center curvature of preview projection point." FLOAT32_IEEE LCCS_subsystem_integrated_CM_single 0 0 -3.4E+38 3.4E+38 ECU_ADDRESS 0xb0006628 /* @ECU_Address@VfLCCS_preview_curvature@ */ /end MEASUREMENT
/begin MEASUREMENT VfLCCS_heading_error "Heading error." FLOAT32_IEEE LCCS_subsystem_integrated_CM_single 0 0 -3.4E+38 3.4E+38 ECU_ADDRESS 0xb0006624 /* @ECU_Address@VfLCCS_heading_error@ */ /end MEASUREMENT
/begin MEASUREMENT VcLCCS_VCU1_ICPV_EPSMODE "EPS control mode feedback." UBYTE LCCS_subsystem_integrated_CM_uint8 0 0 0 255 ECU_ADDRESS 0xb0006621 /* @ECU_Address@VcLCCS_VCU1_ICPV_EPSMODE@ */ /end MEASUREMENT
/begin MEASUREMENT VfLCCS_num_lane_markers "" UBYTE LCCS_subsystem_integrated_CM_uint8 0 0 0 255 ECU_ADDRESS 0xb0006620 /* @ECU_Address@VfLCCS_num_lane_markers@ */ /end MEASUREMENT
/begin MEASUREMENT VcLCCS_num_iteration "" UBYTE LCCS_subsystem_integrated_CM_uint8 0 0 0 255 ECU_ADDRESS 0xb000661f /* @ECU_Address@VcLCCS_num_iteration@ */ /end MEASUREMENT
/begin MEASUREMENT VbLCCS_steering_control_active "Steering control active." UBYTE LCCS_subsystem_integrated_CM_boolean 0 0 0 1 ECU_ADDRESS 0xb000661e /* @ECU_Address@VbLCCS_steering_control_active@ */ /end MEASUREMENT
/begin MEASUREMENT VbLCCS_LCC_ReadyToEngage "LCC ReadyToEngage." UBYTE LCCS_subsystem_integrated_CM_boolean 0 0 0 1 ECU_ADDRESS 0xb000661d /* @ECU_Address@VbLCCS_LCC_ReadyToEngage@ */ /end MEASUREMENT
/begin MEASUREMENT VbLCCS_LCC_ForceToDisengage "Lane centering control is forced to disengage due to one of following reasons:
      1. EGMO and MPFU timestamp don't match.
      2. No valid lane marker." UBYTE LCCS_subsystem_integrated_CM_boolean 0 0 0 1 ECU_ADDRESS 0xb000661c /* @ECU_Address@VbLCCS_LCC_ForceToDisengage@ */ /end MEASUREMENT
/begin MEASUREMENT VbLCCS_steering_control_stable "Steering control stable." UBYTE LCCS_subsystem_integrated_CM_boolean 0 0 0 1 ECU_ADDRESS 0xb000661b /* @ECU_Address@VbLCCS_steering_control_stable@ */ /end MEASUREMENT
/begin MEASUREMENT VbLCCS_steering_control_engaged "Steering control engaged." UBYTE LCCS_subsystem_integrated_CM_boolean 0 0 0 1 ECU_ADDRESS 0xb000661a /* @ECU_Address@VbLCCS_steering_control_engaged@ */ /end MEASUREMENT
/begin MEASUREMENT VbLCCS_lateral_movement_enabled "Flag to indicate lateral movement is allowed." UBYTE LCCS_subsystem_integrated_CM_boolean 0 0 0 1 ECU_ADDRESS 0xb0006619 /* @ECU_Address@VbLCCS_lateral_movement_enabled@ */ /end MEASUREMENT
/begin MEASUREMENT VbLCCS_lane_change_request "" UBYTE LCCS_subsystem_integrated_CM_boolean 0 0 0 1 ECU_ADDRESS 0xb0006618 /* @ECU_Address@VbLCCS_lane_change_request@ */ /end MEASUREMENT
/begin MEASUREMENT VbLCCS_inlane_nudge_request "Inlane nudge request." UBYTE LCCS_subsystem_integrated_CM_boolean 0 0 0 1 ECU_ADDRESS 0xb0006617 /* @ECU_Address@VbLCCS_inlane_nudge_request@ */ /end MEASUREMENT
/begin MEASUREMENT VbLCCS_input_isNaN_DCSN "" UBYTE LCCS_subsystem_integrated_CM_boolean 0 0 0 1 ECU_ADDRESS 0xb0006616 /* @ECU_Address@VbLCCS_input_isNaN_DCSN@ */ /end MEASUREMENT
/begin MEASUREMENT VbLCCS_lcc_feature_enable "" UBYTE LCCS_subsystem_integrated_CM_boolean 0 0 0 1 ECU_ADDRESS 0xb0006615 /* @ECU_Address@VbLCCS_lcc_feature_enable@ */ /end MEASUREMENT
/begin MEASUREMENT VbLCCS_steer_control_enable "LCC is allowed by decision module." UBYTE LCCS_subsystem_integrated_CM_boolean 0 0 0 1 ECU_ADDRESS 0xb0006614 /* @ECU_Address@VbLCCS_steer_control_enable@ */ /end MEASUREMENT
/begin MEASUREMENT VbLCCS_input_isNaN_ALCA "" UBYTE LCCS_subsystem_integrated_CM_boolean 0 0 0 1 ECU_ADDRESS 0xb0006613 /* @ECU_Address@VbLCCS_input_isNaN_ALCA@ */ /end MEASUREMENT
/begin MEASUREMENT VbLCCS_input_isNaN_COMM "" UBYTE LCCS_subsystem_integrated_CM_boolean 0 0 0 1 ECU_ADDRESS 0xb0006612 /* @ECU_Address@VbLCCS_input_isNaN_COMM@ */ /end MEASUREMENT
/begin MEASUREMENT VbLCCS_input_isNaN_EGMO "" UBYTE LCCS_subsystem_integrated_CM_boolean 0 0 0 1 ECU_ADDRESS 0xb0006611 /* @ECU_Address@VbLCCS_input_isNaN_EGMO@ */ /end MEASUREMENT
/begin MEASUREMENT VbLCCS_input_isNaN_MPFU "" UBYTE LCCS_subsystem_integrated_CM_boolean 0 0 0 1 ECU_ADDRESS 0xb0006610 /* @ECU_Address@VbLCCS_input_isNaN_MPFU@ */ /end MEASUREMENT
/begin MEASUREMENT VbLCCS_left_lanemark_valid "Left lanemark valid." UBYTE LCCS_subsystem_integrated_CM_boolean 0 0 0 1 ECU_ADDRESS 0xb000660f /* @ECU_Address@VbLCCS_left_lanemark_valid@ */ /end MEASUREMENT
/begin MEASUREMENT VbLCCS_right_lanemark_valid "Right lanemark valid." UBYTE LCCS_subsystem_integrated_CM_boolean 0 0 0 1 ECU_ADDRESS 0xb000660e /* @ECU_Address@VbLCCS_right_lanemark_valid@ */ /end MEASUREMENT
/begin MEASUREMENT VbLCCS_both_lanemark_available "" UBYTE LCCS_subsystem_integrated_CM_boolean 0 0 0 1 ECU_ADDRESS 0xb000660d /* @ECU_Address@VbLCCS_both_lanemark_available@ */ /end MEASUREMENT
/begin MEASUREMENT VbLCCS_shifting_in_progress "Flag to indicate lateral shifting is in progress." UBYTE LCCS_subsystem_integrated_CM_boolean 0 0 0 1 ECU_ADDRESS 0xb000660c /* @ECU_Address@VbLCCS_shifting_in_progress@ */ /end MEASUREMENT
/begin MEASUREMENT VbLCCS_touched_new_lane "Flag to to indicate that ego car has crossed lane marker." UBYTE LCCS_subsystem_integrated_CM_boolean 0 0 0 1 ECU_ADDRESS 0xb000660b /* @ECU_Address@VbLCCS_touched_new_lane@ */ /end MEASUREMENT
/begin MEASUREMENT VeLCCS_shifting_direction_raw "Inlane nudge or lane change shifting_direction. 1 = left. 2 = right." UBYTE LCCS_subsystem_integrated_CM_EnumDCSN_driving_direction 0 0 0 2 ECU_ADDRESS 0xb000660a /* @ECU_Address@VeLCCS_shifting_direction_raw@ */ /end MEASUREMENT
/begin MEASUREMENT VeLCCS_shifting_direction_final "Inlane nudge or lane change shifting_direction." UBYTE LCCS_subsystem_integrated_CM_EnumDCSN_driving_direction 0 0 0 2 ECU_ADDRESS 0xb0006609 /* @ECU_Address@VeLCCS_shifting_direction_final@ */ /end MEASUREMENT
/begin MEASUREMENT VeLCCS_valid_lane_marker "Valid lane marker. 0 = LCCS_NoLane; 1 = LCCS_LeftLane; 2 = LCCS_RightLane; 3 = BothLane." UBYTE LCCS_subsystem_integrated_CM_EnumLCCS_ValidLane 0 0 0 3 ECU_ADDRESS 0xb0006608 /* @ECU_Address@VeLCCS_valid_lane_marker@ */ /end MEASUREMENT
/begin MEASUREMENT VfLCAS_curvature "" FLOAT32_IEEE LCAS_subsystem_integrated_CM_single 0 0 -3.4E+38 3.4E+38 ECU_ADDRESS 0xb0005fb4 /* @ECU_Address@VfLCAS_curvature@ */ /end MEASUREMENT
/begin MEASUREMENT VfLCAS_speed_in "" FLOAT32_IEEE LCAS_subsystem_integrated_CM_single 0 0 -3.4E+38 3.4E+38 ECU_ADDRESS 0xb0005fb0 /* @ECU_Address@VfLCAS_speed_in@ */ /end MEASUREMENT
/begin MEASUREMENT VaLCAS_Obt "" FLOAT32_IEEE LCAS_subsystem_integrated_CM_single 0 0 -3.4E+38 3.4E+38 ARRAY_SIZE 16 ECU_ADDRESS 0xb0005f70 /* @ECU_Address@VaLCAS_Obt@ */ /end MEASUREMENT
/begin MEASUREMENT ViLCAS_cvwR_ID "" SLONG LCAS_subsystem_integrated_CM_int32 0 0 -2147483648 2147483647 ECU_ADDRESS 0xb0005f6c /* @ECU_Address@ViLCAS_cvwR_ID@ */ /end MEASUREMENT
/begin MEASUREMENT ViLCAS_cvwL_ID "" SLONG LCAS_subsystem_integrated_CM_int32 0 0 -2147483648 2147483647 ECU_ADDRESS 0xb0005f68 /* @ECU_Address@ViLCAS_cvwL_ID@ */ /end MEASUREMENT
/begin MEASUREMENT VnLCAS_num_R "" UWORD LCAS_subsystem_integrated_CM_uint16 0 0 0 65535 ECU_ADDRESS 0xb0005f66 /* @ECU_Address@VnLCAS_num_R@ */ /end MEASUREMENT
/begin MEASUREMENT VnLCAS_num_L "" UWORD LCAS_subsystem_integrated_CM_uint16 0 0 0 65535 ECU_ADDRESS 0xb0005f64 /* @ECU_Address@VnLCAS_num_L@ */ /end MEASUREMENT
/begin MEASUREMENT VfLCAS_gear_in "" UBYTE LCAS_subsystem_integrated_CM_uint8 0 0 0 255 ECU_ADDRESS 0xb0005f63 /* @ECU_Address@VfLCAS_gear_in@ */ /end MEASUREMENT
/begin MEASUREMENT ViLCAS_cvwR "" UBYTE LCAS_subsystem_integrated_CM_uint8 0 0 0 255 ECU_ADDRESS 0xb0005f62 /* @ECU_Address@ViLCAS_cvwR@ */ /end MEASUREMENT
/begin MEASUREMENT ViLCAS_cvwL "" UBYTE LCAS_subsystem_integrated_CM_uint8 0 0 0 255 ECU_ADDRESS 0xb0005f61 /* @ECU_Address@ViLCAS_cvwL@ */ /end MEASUREMENT
/begin MEASUREMENT VeLCAS_active_status "" UBYTE LCAS_subsystem_integrated_CM_EnumLCAS_Active_Status 0 0 0 5 ECU_ADDRESS 0xb0005f60 /* @ECU_Address@VeLCAS_active_status@ */ /end MEASUREMENT
/begin MEASUREMENT VeLCAS_right_warning_status_out "" UBYTE LCAS_subsystem_integrated_CM_EnumLCAS_Warning_Status 0 0 0 2 ECU_ADDRESS 0xb0005f5f /* @ECU_Address@VeLCAS_right_warning_status_out@ */ /end MEASUREMENT
/begin MEASUREMENT VeLCAS_left_warning_status_out "" UBYTE LCAS_subsystem_integrated_CM_EnumLCAS_Warning_Status 0 0 0 2 ECU_ADDRESS 0xb0005f5e /* @ECU_Address@VeLCAS_left_warning_status_out@ */ /end MEASUREMENT
/begin MEASUREMENT VeLCAS_right_warning_status "" UBYTE LCAS_subsystem_integrated_CM_EnumLCAS_Warning_Status 0 0 0 2 ECU_ADDRESS 0xb0005f5d /* @ECU_Address@VeLCAS_right_warning_status@ */ /end MEASUREMENT
/begin MEASUREMENT VeLCAS_left_warning_status "" UBYTE LCAS_subsystem_integrated_CM_EnumLCAS_Warning_Status 0 0 0 2 ECU_ADDRESS 0xb0005f5c /* @ECU_Address@VeLCAS_left_warning_status@ */ /end MEASUREMENT
/begin MEASUREMENT VfBSDS_curvature "" FLOAT32_IEEE BSDS_subsystem_integrated_CM_single 0 0 -3.4E+38 3.4E+38 ECU_ADDRESS 0xb00038fc /* @ECU_Address@VfBSDS_curvature@ */ /end MEASUREMENT
/begin MEASUREMENT VfBSDS_speed_in "" FLOAT32_IEEE BSDS_subsystem_integrated_CM_single 0 0 -3.4E+38 3.4E+38 ECU_ADDRESS 0xb00038f8 /* @ECU_Address@VfBSDS_speed_in@ */ /end MEASUREMENT
/begin MEASUREMENT VfBSDS_veh_vx "" FLOAT32_IEEE BSDS_subsystem_integrated_CM_single 0 0 -3.4E+38 3.4E+38 ECU_ADDRESS 0xb00038f4 /* @ECU_Address@VfBSDS_veh_vx@ */ /end MEASUREMENT
/begin MEASUREMENT VaLCWS_Obt "" FLOAT32_IEEE BSDS_subsystem_integrated_CM_single 0 0 -3.4E+38 3.4E+38 ARRAY_SIZE 33 ECU_ADDRESS 0xb0003870 /* @ECU_Address@VaLCWS_Obt@ */ /end MEASUREMENT
/begin MEASUREMENT VaLCWS_x_in "" FLOAT32_IEEE BSDS_subsystem_integrated_CM_single 0 0 -3.4E+38 3.4E+38 ARRAY_SIZE 10 ECU_ADDRESS 0xb0003848 /* @ECU_Address@VaLCWS_x_in@ */ /end MEASUREMENT
/begin MEASUREMENT VaLCWS_y_in "" FLOAT32_IEEE BSDS_subsystem_integrated_CM_single 0 0 -3.4E+38 3.4E+38 ARRAY_SIZE 10 ECU_ADDRESS 0xb0003820 /* @ECU_Address@VaLCWS_y_in@ */ /end MEASUREMENT
/begin MEASUREMENT VaLCWS_heading_in "" FLOAT32_IEEE BSDS_subsystem_integrated_CM_single 0 0 -3.4E+38 3.4E+38 ARRAY_SIZE 10 ECU_ADDRESS 0xb00037f8 /* @ECU_Address@VaLCWS_heading_in@ */ /end MEASUREMENT
/begin MEASUREMENT VaLCWS_Vx_in "" FLOAT32_IEEE BSDS_subsystem_integrated_CM_single 0 0 -3.4E+38 3.4E+38 ARRAY_SIZE 10 ECU_ADDRESS 0xb00037d0 /* @ECU_Address@VaLCWS_Vx_in@ */ /end MEASUREMENT
/begin MEASUREMENT VaLCWS_Vy_in "" FLOAT32_IEEE BSDS_subsystem_integrated_CM_single 0 0 -3.4E+38 3.4E+38 ARRAY_SIZE 10 ECU_ADDRESS 0xb00037a8 /* @ECU_Address@VaLCWS_Vy_in@ */ /end MEASUREMENT
/begin MEASUREMENT VaLCWS_obt_lenth_in "" FLOAT32_IEEE BSDS_subsystem_integrated_CM_single 0 0 -3.4E+38 3.4E+38 ARRAY_SIZE 10 ECU_ADDRESS 0xb0003780 /* @ECU_Address@VaLCWS_obt_lenth_in@ */ /end MEASUREMENT
/begin MEASUREMENT VaLCWS_obt_width_in "" FLOAT32_IEEE BSDS_subsystem_integrated_CM_single 0 0 -3.4E+38 3.4E+38 ARRAY_SIZE 10 ECU_ADDRESS 0xb0003758 /* @ECU_Address@VaLCWS_obt_width_in@ */ /end MEASUREMENT
/begin MEASUREMENT VaLCWS_nearest_point_rel_x_in "" FLOAT32_IEEE BSDS_subsystem_integrated_CM_single 0 0 -3.4E+38 3.4E+38 ARRAY_SIZE 10 ECU_ADDRESS 0xb0003730 /* @ECU_Address@VaLCWS_nearest_point_rel_x_in@ */ /end MEASUREMENT
/begin MEASUREMENT VaLCWS_nearest_point_rel_y_in "" FLOAT32_IEEE BSDS_subsystem_integrated_CM_single 0 0 -3.4E+38 3.4E+38 ARRAY_SIZE 10 ECU_ADDRESS 0xb0003708 /* @ECU_Address@VaLCWS_nearest_point_rel_y_in@ */ /end MEASUREMENT
/begin MEASUREMENT VaLCWS_id_in "" SLONG BSDS_subsystem_integrated_CM_int32 0 0 -2147483648 2147483647 ARRAY_SIZE 10 ECU_ADDRESS 0xb00036e0 /* @ECU_Address@VaLCWS_id_in@ */ /end MEASUREMENT
/begin MEASUREMENT ViBSDS_bswR_ID "" SLONG BSDS_subsystem_integrated_CM_int32 0 0 -2147483648 2147483647 ECU_ADDRESS 0xb00036dc /* @ECU_Address@ViBSDS_bswR_ID@ */ /end MEASUREMENT
/begin MEASUREMENT ViBSDS_bswL_ID "" SLONG BSDS_subsystem_integrated_CM_int32 0 0 -2147483648 2147483647 ECU_ADDRESS 0xb00036d8 /* @ECU_Address@ViBSDS_bswL_ID@ */ /end MEASUREMENT
/begin MEASUREMENT VnLCWS_num_R "" UWORD BSDS_subsystem_integrated_CM_uint16 0 0 0 65535 ECU_ADDRESS 0xb00036d4 /* @ECU_Address@VnLCWS_num_R@ */ /end MEASUREMENT
/begin MEASUREMENT VnLCWS_num_L "" UWORD BSDS_subsystem_integrated_CM_uint16 0 0 0 65535 ECU_ADDRESS 0xb00036d2 /* @ECU_Address@VnLCWS_num_L@ */ /end MEASUREMENT
/begin MEASUREMENT VnLCWS_num_in "" UWORD BSDS_subsystem_integrated_CM_uint16 0 0 0 65535 ECU_ADDRESS 0xb00036d0 /* @ECU_Address@VnLCWS_num_in@ */ /end MEASUREMENT
/begin MEASUREMENT VaLCWS_position_zone_in "" SBYTE BSDS_subsystem_integrated_CM_int8 0 0 -128 127 ARRAY_SIZE 10 ECU_ADDRESS 0xb00036c5 /* @ECU_Address@VaLCWS_position_zone_in@ */ /end MEASUREMENT
/begin MEASUREMENT VaLCWS_orientation_in "" SBYTE BSDS_subsystem_integrated_CM_int8 0 0 -128 127 ARRAY_SIZE 10 ECU_ADDRESS 0xb00036bb /* @ECU_Address@VaLCWS_orientation_in@ */ /end MEASUREMENT
/begin MEASUREMENT VaLCWS_motion_status_in "" SBYTE BSDS_subsystem_integrated_CM_int8 0 0 -128 127 ARRAY_SIZE 10 ECU_ADDRESS 0xb00036b1 /* @ECU_Address@VaLCWS_motion_status_in@ */ /end MEASUREMENT
/begin MEASUREMENT VfBSDS_gear_in "" UBYTE BSDS_subsystem_integrated_CM_uint8 0 0 0 255 ECU_ADDRESS 0xb00036b0 /* @ECU_Address@VfBSDS_gear_in@ */ /end MEASUREMENT
/begin MEASUREMENT VaLCWS_type_in "" UBYTE BSDS_subsystem_integrated_CM_uint8 0 0 0 255 ARRAY_SIZE 10 ECU_ADDRESS 0xb00036a6 /* @ECU_Address@VaLCWS_type_in@ */ /end MEASUREMENT
/begin MEASUREMENT ViBSDS_bswR "" UBYTE BSDS_subsystem_integrated_CM_uint8 0 0 0 255 ECU_ADDRESS 0xb00036a5 /* @ECU_Address@ViBSDS_bswR@ */ /end MEASUREMENT
/begin MEASUREMENT ViBSDS_bswL "" UBYTE BSDS_subsystem_integrated_CM_uint8 0 0 0 255 ECU_ADDRESS 0xb00036a4 /* @ECU_Address@ViBSDS_bswL@ */ /end MEASUREMENT
/begin MEASUREMENT VeBSDS_LturnON "" UBYTE BSDS_subsystem_integrated_CM_boolean 0 0 0 1 ECU_ADDRESS 0xb00036a3 /* @ECU_Address@VeBSDS_LturnON@ */ /end MEASUREMENT
/begin MEASUREMENT VeBSDS_RturnON "" UBYTE BSDS_subsystem_integrated_CM_boolean 0 0 0 1 ECU_ADDRESS 0xb00036a2 /* @ECU_Address@VeBSDS_RturnON@ */ /end MEASUREMENT
/begin MEASUREMENT VeBSDS_active_status "" UBYTE BSDS_subsystem_integrated_CM_EnumBSDS_Active_Status 0 0 0 5 ECU_ADDRESS 0xb00036a1 /* @ECU_Address@VeBSDS_active_status@ */ /end MEASUREMENT
/begin MEASUREMENT VeBSDS_right_warning_status_out "" UBYTE BSDS_subsystem_integrated_CM_EnumBSDS_Warning_Status 0 0 0 2 ECU_ADDRESS 0xb00036a0 /* @ECU_Address@VeBSDS_right_warning_status_out@ */ /end MEASUREMENT
/begin MEASUREMENT VeBSDS_left_warning_status_out "" UBYTE BSDS_subsystem_integrated_CM_EnumBSDS_Warning_Status 0 0 0 2 ECU_ADDRESS 0xb000369f /* @ECU_Address@VeBSDS_left_warning_status_out@ */ /end MEASUREMENT
/begin MEASUREMENT VeBSDS_right_warning_status "" UBYTE BSDS_subsystem_integrated_CM_EnumBSDS_Warning_Status 0 0 0 2 ECU_ADDRESS 0xb000369e /* @ECU_Address@VeBSDS_right_warning_status@ */ /end MEASUREMENT
/begin MEASUREMENT VeBSDS_left_warning_status "" UBYTE BSDS_subsystem_integrated_CM_EnumBSDS_Warning_Status 0 0 0 2 ECU_ADDRESS 0xb000369d /* @ECU_Address@VeBSDS_left_warning_status@ */ /end MEASUREMENT
/begin MEASUREMENT ViBSDS_bswLL "" UBYTE BSDS_subsystem_integrated_CM_EnumBSDS_warningArea 0 0 0 4 ECU_ADDRESS 0xb000369c /* @ECU_Address@ViBSDS_bswLL@ */ /end MEASUREMENT
/begin MEASUREMENT VfLDWS_SteerAngleRate "" FLOAT32_IEEE LDWS_subsystem_integrated_CM_single 0 0 -3.4E+38 3.4E+38 ECU_ADDRESS 0xb0006894 /* @ECU_Address@VfLDWS_SteerAngleRate@ */ /end MEASUREMENT
/begin MEASUREMENT VfLDWS_BackToRiDist "The distacne bewteen center of rear axle and right lane marker" FLOAT32_IEEE LDWS_subsystem_integrated_CM_single 0 0 -3.4E+38 3.4E+38 ECU_ADDRESS 0xb0006890 /* @ECU_Address@VfLDWS_BackToRiDist@ */ /end MEASUREMENT
/begin MEASUREMENT VfLDWS_Theta "The angle between linear velocity and heading" FLOAT32_IEEE LDWS_subsystem_integrated_CM_single 0 0 -3.4E+38 3.4E+38 ECU_ADDRESS 0xb000688c /* @ECU_Address@VfLDWS_Theta@ */ /end MEASUREMENT
/begin MEASUREMENT VfLDWS_Vx "The value of Vx" FLOAT32_IEEE LDWS_subsystem_integrated_CM_single 0 0 -3.4E+38 3.4E+38 ECU_ADDRESS 0xb0006888 /* @ECU_Address@VfLDWS_Vx@ */ /end MEASUREMENT
/begin MEASUREMENT VfLDWS_Vy "The value of Vy" FLOAT32_IEEE LDWS_subsystem_integrated_CM_single 0 0 -3.4E+38 3.4E+38 ECU_ADDRESS 0xb0006884 /* @ECU_Address@VfLDWS_Vy@ */ /end MEASUREMENT
/begin MEASUREMENT VfLDWS_VLatLe "" FLOAT32_IEEE LDWS_subsystem_integrated_CM_single 0 0 -3.4E+38 3.4E+38 ECU_ADDRESS 0xb0006880 /* @ECU_Address@VfLDWS_VLatLe@ */ /end MEASUREMENT
/begin MEASUREMENT VfLDWS_EdgeLaneLe "The vertical distacne between left front wheel and left lane marker" FLOAT32_IEEE LDWS_subsystem_integrated_CM_single 0 0 -3.4E+38 3.4E+38 ECU_ADDRESS 0xb000687c /* @ECU_Address@VfLDWS_EdgeLaneLe@ */ /end MEASUREMENT
/begin MEASUREMENT VfLDWS_TLCLe "The time to collision of left side" FLOAT32_IEEE LDWS_subsystem_integrated_CM_single 0 0 -3.4E+38 3.4E+38 ECU_ADDRESS 0xb0006878 /* @ECU_Address@VfLDWS_TLCLe@ */ /end MEASUREMENT
/begin MEASUREMENT VfLDWS_EdgeLaneRi "The vertical distacne between right front wheel and right lane marker" FLOAT32_IEEE LDWS_subsystem_integrated_CM_single 0 0 -3.4E+38 3.4E+38 ECU_ADDRESS 0xb0006874 /* @ECU_Address@VfLDWS_EdgeLaneRi@ */ /end MEASUREMENT
/begin MEASUREMENT VfLDWS_VLatRi "" FLOAT32_IEEE LDWS_subsystem_integrated_CM_single 0 0 -3.4E+38 3.4E+38 ECU_ADDRESS 0xb0006870 /* @ECU_Address@VfLDWS_VLatRi@ */ /end MEASUREMENT
/begin MEASUREMENT VfLDWS_TLCRi "The time to collision of right side" FLOAT32_IEEE LDWS_subsystem_integrated_CM_single 0 0 -3.4E+38 3.4E+38 ECU_ADDRESS 0xb000686c /* @ECU_Address@VfLDWS_TLCRi@ */ /end MEASUREMENT
/begin MEASUREMENT VfLDWS_SteerAngle "The vehicle's steering angle" FLOAT32_IEEE LDWS_subsystem_integrated_CM_single 0 0 -3.4E+38 3.4E+38 ECU_ADDRESS 0xb0006868 /* @ECU_Address@VfLDWS_SteerAngle@ */ /end MEASUREMENT
/begin MEASUREMENT VfLDWS_SteerTorque "" FLOAT32_IEEE LDWS_subsystem_integrated_CM_single 0 0 -3.4E+38 3.4E+38 ECU_ADDRESS 0xb0006864 /* @ECU_Address@VfLDWS_SteerTorque@ */ /end MEASUREMENT
/begin MEASUREMENT VfLDWS_Curvature "" FLOAT32_IEEE LDWS_subsystem_integrated_CM_single 0 0 -3.4E+38 3.4E+38 ECU_ADDRESS 0xb0006860 /* @ECU_Address@VfLDWS_Curvature@ */ /end MEASUREMENT
/begin MEASUREMENT VfLDWS_LeC0Filtd "The C0 coefficient of left lane marker after filtering" FLOAT32_IEEE LDWS_subsystem_integrated_CM_single 0 0 -3.4E+38 3.4E+38 ECU_ADDRESS 0xb000685c /* @ECU_Address@VfLDWS_LeC0Filtd@ */ /end MEASUREMENT
/begin MEASUREMENT VfLDWS_RiC0Filtd "The C0 coefficient of right lane marker after filtering" FLOAT32_IEEE LDWS_subsystem_integrated_CM_single 0 0 -3.4E+38 3.4E+38 ECU_ADDRESS 0xb0006858 /* @ECU_Address@VfLDWS_RiC0Filtd@ */ /end MEASUREMENT
/begin MEASUREMENT VfLDWS_LeC1Filtd "The C1 coefficient of left lane marker after filtering" FLOAT32_IEEE LDWS_subsystem_integrated_CM_single 0 0 -3.4E+38 3.4E+38 ECU_ADDRESS 0xb0006854 /* @ECU_Address@VfLDWS_LeC1Filtd@ */ /end MEASUREMENT
/begin MEASUREMENT VfLDWS_RiC1Filtd "The C1 coefficient of right lane marker after filtering" FLOAT32_IEEE LDWS_subsystem_integrated_CM_single 0 0 -3.4E+38 3.4E+38 ECU_ADDRESS 0xb0006850 /* @ECU_Address@VfLDWS_RiC1Filtd@ */ /end MEASUREMENT
/begin MEASUREMENT VfLDWS_BackToLeDist "The distacne bewteen center of rear axle and left lane marker" FLOAT32_IEEE LDWS_subsystem_integrated_CM_single 0 0 -3.4E+38 3.4E+38 ECU_ADDRESS 0xb000684c /* @ECU_Address@VfLDWS_BackToLeDist@ */ /end MEASUREMENT
/begin MEASUREMENT VfLDWS_LeIndicatorSt "The status of right indicator" UBYTE LDWS_subsystem_integrated_CM_uint8 0 0 0 255 ECU_ADDRESS 0xb0006848 /* @ECU_Address@VfLDWS_LeIndicatorSt@ */ /end MEASUREMENT
/begin MEASUREMENT VfLDWS_RiIndicatorSt "The status of right indicator" UBYTE LDWS_subsystem_integrated_CM_uint8 0 0 0 255 ECU_ADDRESS 0xb0006847 /* @ECU_Address@VfLDWS_RiIndicatorSt@ */ /end MEASUREMENT
/begin MEASUREMENT VbLDWS_IsOnLeLine "The vehicle is on left lane marker or not" UBYTE LDWS_subsystem_integrated_CM_boolean 0 0 0 1 ECU_ADDRESS 0xb0006846 /* @ECU_Address@VbLDWS_IsOnLeLine@ */ /end MEASUREMENT
/begin MEASUREMENT VbLDWS_LeadDrctn "The heading of vehicle is left or right. True is on left, fale is on right." UBYTE LDWS_subsystem_integrated_CM_boolean 0 0 0 1 ECU_ADDRESS 0xb0006845 /* @ECU_Address@VbLDWS_LeadDrctn@ */ /end MEASUREMENT
/begin MEASUREMENT VbLDWS_ActLeLDW "The left LDW is whether trggered or not" UBYTE LDWS_subsystem_integrated_CM_boolean 0 0 0 1 ECU_ADDRESS 0xb0006844 /* @ECU_Address@VbLDWS_ActLeLDW@ */ /end MEASUREMENT
/begin MEASUREMENT VbLDWS_IsOnRiLine "The vehicle is on right lane marker or not" UBYTE LDWS_subsystem_integrated_CM_boolean 0 0 0 1 ECU_ADDRESS 0xb0006843 /* @ECU_Address@VbLDWS_IsOnRiLine@ */ /end MEASUREMENT
/begin MEASUREMENT VbLDWS_ActRiLDW "The right LDW is whether triggered or not" UBYTE LDWS_subsystem_integrated_CM_boolean 0 0 0 1 ECU_ADDRESS 0xb0006842 /* @ECU_Address@VbLDWS_ActRiLDW@ */ /end MEASUREMENT
/begin MEASUREMENT VbLDWS_SuppLe "The left LDW is whether suppressed or not" UBYTE LDWS_subsystem_integrated_CM_boolean 0 0 0 1 ECU_ADDRESS 0xb0006841 /* @ECU_Address@VbLDWS_SuppLe@ */ /end MEASUREMENT
/begin MEASUREMENT VbLDWS_SuppRi "The right LDW is whether suppressed or not" UBYTE LDWS_subsystem_integrated_CM_boolean 0 0 0 1 ECU_ADDRESS 0xb0006840 /* @ECU_Address@VbLDWS_SuppRi@ */ /end MEASUREMENT
/begin MEASUREMENT VbLDWS_RdEnblLe "The left Lane Marker is whether enabled or not" UBYTE LDWS_subsystem_integrated_CM_boolean 0 0 0 1 ECU_ADDRESS 0xb000683f /* @ECU_Address@VbLDWS_RdEnblLe@ */ /end MEASUREMENT
/begin MEASUREMENT VbLDWS_RdEnblRi "The right Lane Marker is whether enabled or not" UBYTE LDWS_subsystem_integrated_CM_boolean 0 0 0 1 ECU_ADDRESS 0xb000683e /* @ECU_Address@VbLDWS_RdEnblRi@ */ /end MEASUREMENT
/begin MEASUREMENT VbLDWS_WrnSt "The warning is whether issued or not" UBYTE LDWS_subsystem_integrated_CM_boolean 0 0 0 1 ECU_ADDRESS 0xb000683d /* @ECU_Address@VbLDWS_WrnSt@ */ /end MEASUREMENT
/begin MEASUREMENT VbLDWS_EnabledLDW "The system is whether enabled or not" UBYTE LDWS_subsystem_integrated_CM_boolean 0 0 0 1 ECU_ADDRESS 0xb000683c /* @ECU_Address@VbLDWS_EnabledLDW@ */ /end MEASUREMENT
/begin MEASUREMENT VbLDWS_SpdRngValid "The ODD of speed range is whether fullfiled" UBYTE LDWS_subsystem_integrated_CM_boolean 0 0 0 1 ECU_ADDRESS 0xb000683b /* @ECU_Address@VbLDWS_SpdRngValid@ */ /end MEASUREMENT
/begin MEASUREMENT VbLDWS_CurvValid "The ODD of lane curvature is whether fullfiled" UBYTE LDWS_subsystem_integrated_CM_boolean 0 0 0 1 ECU_ADDRESS 0xb000683a /* @ECU_Address@VbLDWS_CurvValid@ */ /end MEASUREMENT
/begin MEASUREMENT VbLDWS_WidthValid "The ODD of lane width is whether fullfiled" UBYTE LDWS_subsystem_integrated_CM_boolean 0 0 0 1 ECU_ADDRESS 0xb0006839 /* @ECU_Address@VbLDWS_WidthValid@ */ /end MEASUREMENT
/begin MEASUREMENT VbLDWS_LnMkrValid "The ODD of lane marker is whether fullfiled" UBYTE LDWS_subsystem_integrated_CM_boolean 0 0 0 1 ECU_ADDRESS 0xb0006838 /* @ECU_Address@VbLDWS_LnMkrValid@ */ /end MEASUREMENT
/begin MEASUREMENT VeLDWS_LaDetecSt "" UBYTE LDWS_subsystem_integrated_CM_EnumLDWS_la_detec_st 0 0 0 3 ECU_ADDRESS 0xb0006837 /* @ECU_Address@VeLDWS_LaDetecSt@ */ /end MEASUREMENT
/begin MEASUREMENT VeLDWS_WrnSd "" UBYTE LDWS_subsystem_integrated_CM_EnumLDWS_warn_side 0 0 0 2 ECU_ADDRESS 0xb0006836 /* @ECU_Address@VeLDWS_WrnSd@ */ /end MEASUREMENT
/begin MEASUREMENT VeLDWS_SysSt "" UBYTE LDWS_subsystem_integrated_CM_EnumLDWS_system_st 0 0 0 2 ECU_ADDRESS 0xb0006835 /* @ECU_Address@VeLDWS_SysSt@ */ /end MEASUREMENT
/begin MEASUREMENT VeLDWS_OnStateSt "" UBYTE LDWS_subsystem_integrated_CM_EnumLDWS_on_state_st 0 0 0 3 ECU_ADDRESS 0xb0006834 /* @ECU_Address@VeLDWS_OnStateSt@ */ /end MEASUREMENT
/begin COMPU_METHOD DCSN_subsystem_integrated_CM_single_m_s "Q = V" RAT_FUNC "%8.6" "m/s" COEFFS 0 1 0 0 0 1 /end COMPU_METHOD
/begin COMPU_METHOD DCSN_subsystem_integrated_CM_single_1_m "Q = V" RAT_FUNC "%8.6" "1/m" COEFFS 0 1 0 0 0 1 /end COMPU_METHOD
/begin COMPU_METHOD DCSN_subsystem_integrated_CM_single_s "Q = V" RAT_FUNC "%8.6" "s" COEFFS 0 1 0 0 0 1 /end COMPU_METHOD
/begin COMPU_METHOD DCSN_subsystem_integrated_CM_single_nm "Q = V" RAT_FUNC "%8.6" "nm" COEFFS 0 1 0 0 0 1 /end COMPU_METHOD
/begin COMPU_METHOD DCSN_subsystem_integrated_CM_single_m "Q = V" RAT_FUNC "%8.6" "m" COEFFS 0 1 0 0 0 1 /end COMPU_METHOD
/begin COMPU_METHOD DCSN_subsystem_integrated_CM_uint8 "Q = V" RAT_FUNC "%3.0" "" COEFFS 0 1 0 0 0 1 /end COMPU_METHOD
/begin COMPU_METHOD DCSN_subsystem_integrated_CM_boolean "Q = V" RAT_FUNC "%1.0" "" COEFFS 0 1 0 0 0 1 /end COMPU_METHOD
/begin COMPU_METHOD DCSN_subsystem_integrated_CM_single "Q = V" RAT_FUNC "%8.6" "" COEFFS 0 1 0 0 0 1 /end COMPU_METHOD
/begin COMPU_METHOD DCSN_subsystem_integrated_CM_uint16 "Q = V" RAT_FUNC "%5.0" "" COEFFS 0 1 0 0 0 1 /end COMPU_METHOD
/begin COMPU_METHOD DCSN_subsystem_integrated_CM_EnumDCSN_driving_direction "Enumerated data type: EnumDCSN_driving_direction" TAB_VERB "%0.6" "" COMPU_TAB_REF VTAB_FOR_DCSN_subsystem_integrated_CM_EnumDCSN_driving_direction /end COMPU_METHOD
/begin COMPU_METHOD DCSN_subsystem_integrated_CM_EnumDCSN_stop_reason "Enumerated data type: EnumDCSN_stop_reason" TAB_VERB "%0.6" "" COMPU_TAB_REF VTAB_FOR_DCSN_subsystem_integrated_CM_EnumDCSN_stop_reason /end COMPU_METHOD
/begin COMPU_METHOD DCSN_subsystem_integrated_CM_EnumDCSN_speed_limit_reason "Enumerated data type: EnumDCSN_speed_limit_reason" TAB_VERB "%0.6" "" COMPU_TAB_REF VTAB_FOR_DCSN_subsystem_integrated_CM_EnumDCSN_speed_limit_reason /end COMPU_METHOD
/begin COMPU_METHOD DCSN_subsystem_integrated_CM_EnumDCSN_change_lane_reason "Enumerated data type: EnumDCSN_change_lane_reason" TAB_VERB "%0.6" "" COMPU_TAB_REF VTAB_FOR_DCSN_subsystem_integrated_CM_EnumDCSN_change_lane_reason /end COMPU_METHOD
/begin COMPU_METHOD DCSN_subsystem_integrated_CM_EnumDCSN_change_lane_cancel_reason "Enumerated data type: EnumDCSN_change_lane_cancel_reason" TAB_VERB "%0.6" "" COMPU_TAB_REF VTAB_FOR_DCSN_subsystem_integrated_CM_EnumDCSN_change_lane_cancel_reason /end COMPU_METHOD
/begin COMPU_METHOD DCSN_subsystem_integrated_CM_EnumDCSN_inlane_nudge_reason "Enumerated data type: EnumDCSN_inlane_nudge_reason" TAB_VERB "%0.6" "" COMPU_TAB_REF VTAB_FOR_DCSN_subsystem_integrated_CM_EnumDCSN_inlane_nudge_reason /end COMPU_METHOD
/begin COMPU_METHOD DCSN_subsystem_integrated_CM_EnumDCSN_pull_over_reason "Enumerated data type: EnumDCSN_pull_over_reason" TAB_VERB "%0.6" "" COMPU_TAB_REF VTAB_FOR_DCSN_subsystem_integrated_CM_EnumDCSN_pull_over_reason /end COMPU_METHOD
/begin COMPU_METHOD DCSN_subsystem_integrated_CM_EnumDCSN_stop_request_mode "Enumerated data type: EnumDCSN_stop_request_mode" TAB_VERB "%0.6" "" COMPU_TAB_REF VTAB_FOR_DCSN_subsystem_integrated_CM_EnumDCSN_stop_request_mode /end COMPU_METHOD
/begin COMPU_METHOD LCCS_subsystem_integrated_CM_single "Q = V" RAT_FUNC "%8.6" "" COEFFS 0 1 0 0 0 1 /end COMPU_METHOD
/begin COMPU_METHOD LCCS_subsystem_integrated_CM_single_s "Q = V" RAT_FUNC "%8.6" "s" COEFFS 0 1 0 0 0 1 /end COMPU_METHOD
/begin COMPU_METHOD LCCS_subsystem_integrated_CM_single_m "Q = V" RAT_FUNC "%8.6" "m" COEFFS 0 1 0 0 0 1 /end COMPU_METHOD
/begin COMPU_METHOD LCCS_subsystem_integrated_CM_single_rad "Q = V" RAT_FUNC "%8.6" "rad" COEFFS 0 1 0 0 0 1 /end COMPU_METHOD
/begin COMPU_METHOD LCCS_subsystem_integrated_CM_single_kg "Q = V" RAT_FUNC "%8.6" "kg" COEFFS 0 1 0 0 0 1 /end COMPU_METHOD
/begin COMPU_METHOD LCCS_subsystem_integrated_CM_single_m_s "Q = V" RAT_FUNC "%8.6" "m/s" COEFFS 0 1 0 0 0 1 /end COMPU_METHOD
/begin COMPU_METHOD LCCS_subsystem_integrated_CM_int32 "Q = V" RAT_FUNC "%10.0" "" COEFFS 0 1 0 0 0 1 /end COMPU_METHOD
/begin COMPU_METHOD LCCS_subsystem_integrated_CM_boolean "Q = V" RAT_FUNC "%1.0" "" COEFFS 0 1 0 0 0 1 /end COMPU_METHOD
/begin COMPU_METHOD LCCS_subsystem_integrated_CM_EnumDCSN_driving_direction "Enumerated data type: EnumDCSN_driving_direction" TAB_VERB "%0.6" "" COMPU_TAB_REF VTAB_FOR_LCCS_subsystem_integrated_CM_EnumDCSN_driving_direction /end COMPU_METHOD
/begin COMPU_METHOD LCCS_subsystem_integrated_CM_double_s "Q = V" RAT_FUNC "%15.10" "s" COEFFS 0 1 0 0 0 1 /end COMPU_METHOD
/begin COMPU_METHOD LCCS_subsystem_integrated_CM_single_rad_s "Q = V" RAT_FUNC "%8.6" "rad/s" COEFFS 0 1 0 0 0 1 /end COMPU_METHOD
/begin COMPU_METHOD LCCS_subsystem_integrated_CM_uint8 "Q = V" RAT_FUNC "%3.0" "" COEFFS 0 1 0 0 0 1 /end COMPU_METHOD
/begin COMPU_METHOD LCCS_subsystem_integrated_CM_EnumLCCS_ValidLane "Enumerated data type: EnumLCCS_ValidLane" TAB_VERB "%0.6" "" COMPU_TAB_REF VTAB_FOR_LCCS_subsystem_integrated_CM_EnumLCCS_ValidLane /end COMPU_METHOD
/begin COMPU_METHOD LCAS_subsystem_integrated_CM_single "Q = V" RAT_FUNC "%8.6" "" COEFFS 0 1 0 0 0 1 /end COMPU_METHOD
/begin COMPU_METHOD LCAS_subsystem_integrated_CM_single_m_s "Q = V" RAT_FUNC "%8.6" "m/s" COEFFS 0 1 0 0 0 1 /end COMPU_METHOD
/begin COMPU_METHOD LCAS_subsystem_integrated_CM_int8 "Q = V" RAT_FUNC "%3.0" "" COEFFS 0 1 0 0 0 1 /end COMPU_METHOD
/begin COMPU_METHOD LCAS_subsystem_integrated_CM_boolean "Q = V" RAT_FUNC "%1.0" "" COEFFS 0 1 0 0 0 1 /end COMPU_METHOD
/begin COMPU_METHOD LCAS_subsystem_integrated_CM_int32 "Q = V" RAT_FUNC "%10.0" "" COEFFS 0 1 0 0 0 1 /end COMPU_METHOD
/begin COMPU_METHOD LCAS_subsystem_integrated_CM_uint16 "Q = V" RAT_FUNC "%5.0" "" COEFFS 0 1 0 0 0 1 /end COMPU_METHOD
/begin COMPU_METHOD LCAS_subsystem_integrated_CM_uint8 "Q = V" RAT_FUNC "%3.0" "" COEFFS 0 1 0 0 0 1 /end COMPU_METHOD
/begin COMPU_METHOD LCAS_subsystem_integrated_CM_EnumLCAS_Active_Status "Enumerated data type: EnumLCAS_Active_Status" TAB_VERB "%0.6" "" COMPU_TAB_REF VTAB_FOR_LCAS_subsystem_integrated_CM_EnumLCAS_Active_Status /end COMPU_METHOD
/begin COMPU_METHOD LCAS_subsystem_integrated_CM_EnumLCAS_Warning_Status "Enumerated data type: EnumLCAS_Warning_Status" TAB_VERB "%0.6" "" COMPU_TAB_REF VTAB_FOR_LCAS_subsystem_integrated_CM_EnumLCAS_Warning_Status /end COMPU_METHOD
/begin COMPU_METHOD BSDS_subsystem_integrated_CM_single "Q = V" RAT_FUNC "%8.6" "" COEFFS 0 1 0 0 0 1 /end COMPU_METHOD
/begin COMPU_METHOD BSDS_subsystem_integrated_CM_single_m_s "Q = V" RAT_FUNC "%8.6" "m/s" COEFFS 0 1 0 0 0 1 /end COMPU_METHOD
/begin COMPU_METHOD BSDS_subsystem_integrated_CM_boolean "Q = V" RAT_FUNC "%1.0" "" COEFFS 0 1 0 0 0 1 /end COMPU_METHOD
/begin COMPU_METHOD BSDS_subsystem_integrated_CM_int32 "Q = V" RAT_FUNC "%10.0" "" COEFFS 0 1 0 0 0 1 /end COMPU_METHOD
/begin COMPU_METHOD BSDS_subsystem_integrated_CM_uint16 "Q = V" RAT_FUNC "%5.0" "" COEFFS 0 1 0 0 0 1 /end COMPU_METHOD
/begin COMPU_METHOD BSDS_subsystem_integrated_CM_int8 "Q = V" RAT_FUNC "%3.0" "" COEFFS 0 1 0 0 0 1 /end COMPU_METHOD
/begin COMPU_METHOD BSDS_subsystem_integrated_CM_uint8 "Q = V" RAT_FUNC "%3.0" "" COEFFS 0 1 0 0 0 1 /end COMPU_METHOD
/begin COMPU_METHOD BSDS_subsystem_integrated_CM_EnumBSDS_Active_Status "Enumerated data type: EnumBSDS_Active_Status" TAB_VERB "%0.6" "" COMPU_TAB_REF VTAB_FOR_BSDS_subsystem_integrated_CM_EnumBSDS_Active_Status /end COMPU_METHOD
/begin COMPU_METHOD BSDS_subsystem_integrated_CM_EnumBSDS_Warning_Status "Enumerated data type: EnumBSDS_Warning_Status" TAB_VERB "%0.6" "" COMPU_TAB_REF VTAB_FOR_BSDS_subsystem_integrated_CM_EnumBSDS_Warning_Status /end COMPU_METHOD
/begin COMPU_METHOD BSDS_subsystem_integrated_CM_EnumBSDS_warningArea "Enumerated data type: EnumBSDS_warningArea" TAB_VERB "%0.6" "" COMPU_TAB_REF VTAB_FOR_BSDS_subsystem_integrated_CM_EnumBSDS_warningArea /end COMPU_METHOD
/begin COMPU_METHOD LDWS_subsystem_integrated_CM_single_rad "Q = V" RAT_FUNC "%8.6" "rad" COEFFS 0 1 0 0 0 1 /end COMPU_METHOD
/begin COMPU_METHOD LDWS_subsystem_integrated_CM_single__ "Q = V" RAT_FUNC "%8.6" "��" COEFFS 0 1 0 0 0 1 /end COMPU_METHOD
/begin COMPU_METHOD LDWS_subsystem_integrated_CM_single_NM "Q = V" RAT_FUNC "%8.6" "NM" COEFFS 0 1 0 0 0 1 /end COMPU_METHOD
/begin COMPU_METHOD LDWS_subsystem_integrated_CM_single_1_m "Q = V" RAT_FUNC "%8.6" "1/m" COEFFS 0 1 0 0 0 1 /end COMPU_METHOD
/begin COMPU_METHOD LDWS_subsystem_integrated_CM_single_m "Q = V" RAT_FUNC "%8.6" "m" COEFFS 0 1 0 0 0 1 /end COMPU_METHOD
/begin COMPU_METHOD LDWS_subsystem_integrated_CM_single "Q = V" RAT_FUNC "%8.6" "" COEFFS 0 1 0 0 0 1 /end COMPU_METHOD
/begin COMPU_METHOD LDWS_subsystem_integrated_CM_single_s "Q = V" RAT_FUNC "%8.6" "s" COEFFS 0 1 0 0 0 1 /end COMPU_METHOD
/begin COMPU_METHOD LDWS_subsystem_integrated_CM_single_m_s "Q = V" RAT_FUNC "%8.6" "m/s" COEFFS 0 1 0 0 0 1 /end COMPU_METHOD
/begin COMPU_METHOD LDWS_subsystem_integrated_CM_single___s "Q = V" RAT_FUNC "%8.6" "��/s" COEFFS 0 1 0 0 0 1 /end COMPU_METHOD
/begin COMPU_METHOD LDWS_subsystem_integrated_CM_uint16 "Q = V" RAT_FUNC "%5.0" "" COEFFS 0 1 0 0 0 1 /end COMPU_METHOD
/begin COMPU_METHOD LDWS_subsystem_integrated_CM_uint8 "Q = V" RAT_FUNC "%3.0" "" COEFFS 0 1 0 0 0 1 /end COMPU_METHOD
/begin COMPU_METHOD LDWS_subsystem_integrated_CM_boolean "Q = V" RAT_FUNC "%1.0" "" COEFFS 0 1 0 0 0 1 /end COMPU_METHOD
/begin COMPU_METHOD LDWS_subsystem_integrated_CM_EnumLDWS_la_detec_st "Enumerated data type: EnumLDWS_la_detec_st" TAB_VERB "%0.6" "" COMPU_TAB_REF VTAB_FOR_LDWS_subsystem_integrated_CM_EnumLDWS_la_detec_st /end COMPU_METHOD
/begin COMPU_METHOD LDWS_subsystem_integrated_CM_EnumLDWS_warn_side "Enumerated data type: EnumLDWS_warn_side" TAB_VERB "%0.6" "" COMPU_TAB_REF VTAB_FOR_LDWS_subsystem_integrated_CM_EnumLDWS_warn_side /end COMPU_METHOD
/begin COMPU_METHOD LDWS_subsystem_integrated_CM_EnumLDWS_system_st "Enumerated data type: EnumLDWS_system_st" TAB_VERB "%0.6" "" COMPU_TAB_REF VTAB_FOR_LDWS_subsystem_integrated_CM_EnumLDWS_system_st /end COMPU_METHOD
/begin COMPU_METHOD LDWS_subsystem_integrated_CM_EnumLDWS_on_state_st "Enumerated data type: EnumLDWS_on_state_st" TAB_VERB "%0.6" "" COMPU_TAB_REF VTAB_FOR_LDWS_subsystem_integrated_CM_EnumLDWS_on_state_st /end COMPU_METHOD
/begin COMPU_VTAB VTAB_FOR_DCSN_subsystem_integrated_CM_EnumDCSN_driving_direction "Enumerated data type: EnumDCSN_driving_direction" TAB_VERB 3 0 "FORWARD" 1 "LEFT" 2 "RIGHT" /end COMPU_VTAB
/begin COMPU_VTAB VTAB_FOR_DCSN_subsystem_integrated_CM_EnumDCSN_stop_reason "Enumerated data type: EnumDCSN_stop_reason" TAB_VERB 7 0 "NO_STOP_REQUEST" 1 "STOP_FOR_DESTINATION" 2 "STOP_FOR_TRAFFIC_LIGHT" 3 "STOP_FOR_STOP_LINE" 4 "STOP_FOR_STOP_SIGN" 5 "STOP_FOR_CROSSWALK" 6 "STOP_FOR_KEEP_CLEAR" /end COMPU_VTAB
/begin COMPU_VTAB VTAB_FOR_DCSN_subsystem_integrated_CM_EnumDCSN_speed_limit_reason "Enumerated data type: EnumDCSN_speed_limit_reason" TAB_VERB 4 0 "NO_LIMIT" 1 "LIMIT_FOR_CROSSWALK" 2 "LIMIT_FOR_NUDGE" 3 "LIMIT_FOR_CURVATURE" /end COMPU_VTAB
/begin COMPU_VTAB VTAB_FOR_DCSN_subsystem_integrated_CM_EnumDCSN_change_lane_reason "Enumerated data type: EnumDCSN_change_lane_reason" TAB_VERB 4 0 "LC_NO_REQUEST" 1 "LC_USER_CMD" 2 "LC_NAVIGATION_CMD" 3 "LC_FRONT_OBSTACLE" /end COMPU_VTAB
/begin COMPU_VTAB VTAB_FOR_DCSN_subsystem_integrated_CM_EnumDCSN_change_lane_cancel_reason "Enumerated data type: EnumDCSN_change_lane_cancel_reason" TAB_VERB 2 0 "LC_CANCEL_NO_REQUEST" 1 "LC_CANCEL_USR_CMD" /end COMPU_VTAB
/begin COMPU_VTAB VTAB_FOR_DCSN_subsystem_integrated_CM_EnumDCSN_inlane_nudge_reason "Enumerated data type: EnumDCSN_inlane_nudge_reason" TAB_VERB 3 0 "NUDGE_NO_REQUEST" 1 "NUDGE_FRONT_OBSTACLE" 2 "NUDGE_SIDE_OBSTACLE" /end COMPU_VTAB
/begin COMPU_VTAB VTAB_FOR_DCSN_subsystem_integrated_CM_EnumDCSN_pull_over_reason "Enumerated data type: EnumDCSN_pull_over_reason" TAB_VERB 4 0 "PULLOVER_NO_REQUEST" 1 "PULLOVER_USER_CMD" 2 "PULLOVER_POLICE" 3 "PULLOVER_SYSTEM_FAULT" /end COMPU_VTAB
/begin COMPU_VTAB VTAB_FOR_DCSN_subsystem_integrated_CM_EnumDCSN_stop_request_mode "Enumerated data type: EnumDCSN_stop_request_mode" TAB_VERB 6 0 "NotEnabled" 1 "WaitForValidStopLine" 2 "CheckStopCond" 3 "SendStopReqMpfuDis" 4 "UpdateStopDis" 5 "HoldForStopLineUpdate" /end COMPU_VTAB
/begin COMPU_VTAB VTAB_FOR_LCCS_subsystem_integrated_CM_EnumDCSN_driving_direction "Enumerated data type: EnumDCSN_driving_direction" TAB_VERB 3 0 "FORWARD" 1 "LEFT" 2 "RIGHT" /end COMPU_VTAB
/begin COMPU_VTAB VTAB_FOR_LCCS_subsystem_integrated_CM_EnumLCCS_ValidLane "Enumerated data type: EnumLCCS_ValidLane" TAB_VERB 4 0 "LCCS_NoLane" 1 "LCCS_LeftLane" 2 "LCCS_RightLane" 3 "LCCS_BothLane" /end COMPU_VTAB
/begin COMPU_VTAB VTAB_FOR_LCAS_subsystem_integrated_CM_EnumLCAS_Active_Status "Enumerated data type: EnumLCAS_Active_Status" TAB_VERB 6 0 "LCAS_NONE" 1 "LCAS_OFF" 2 "LCAS_INACTIVE" 3 "LCAS_ERROR" 4 "LCAS_ACTIVE" 5 "LCAS_SELF_CHECK" /end COMPU_VTAB
/begin COMPU_VTAB VTAB_FOR_LCAS_subsystem_integrated_CM_EnumLCAS_Warning_Status "Enumerated data type: EnumLCAS_Warning_Status" TAB_VERB 3 0 "LCAS_NO_WARNING" 1 "LCAS_WARNING_LOW_LEVEL" 2 "LCAS_WARNING_HIGH_LEVEL" /end COMPU_VTAB
/begin COMPU_VTAB VTAB_FOR_BSDS_subsystem_integrated_CM_EnumBSDS_Active_Status "Enumerated data type: EnumBSDS_Active_Status" TAB_VERB 6 0 "BSDS_NONE" 1 "BSDS_OFF" 2 "BSDS_INACTIVE" 3 "BSDS_ERROR" 4 "BSDS_ACTIVE" 5 "BSDS_SELF_CHECK" /end COMPU_VTAB
/begin COMPU_VTAB VTAB_FOR_BSDS_subsystem_integrated_CM_EnumBSDS_Warning_Status "Enumerated data type: EnumBSDS_Warning_Status" TAB_VERB 3 0 "BSDS_NO_WARNING" 1 "BSDS_WARNING_LOW_LEVEL" 2 "BSDS_WARNING_HIGH_LEVEL" /end COMPU_VTAB
/begin COMPU_VTAB VTAB_FOR_BSDS_subsystem_integrated_CM_EnumBSDS_warningArea "Enumerated data type: EnumBSDS_warningArea" TAB_VERB 5 0 "WARNING_HLEVEL_AREA" 1 "WARNING_S_AREA" 2 "WARNING_L_AREA" 3 "MAY_WARNING_AREA" 4 "NO_WARNING_AREA" /end COMPU_VTAB
/begin COMPU_VTAB VTAB_FOR_LDWS_subsystem_integrated_CM_EnumLDWS_la_detec_st "Enumerated data type: EnumLDWS_la_detec_st" TAB_VERB 4 3 "LDWS_BothAvl" 1 "LDWS_LeAvl" 2 "LDWS_RiAvl" 0 "LDWS_NotAvl" /end COMPU_VTAB
/begin COMPU_VTAB VTAB_FOR_LDWS_subsystem_integrated_CM_EnumLDWS_warn_side "Enumerated data type: EnumLDWS_warn_side" TAB_VERB 3 1 "LDWS_WarnLe" 2 "LDWS_WarnRi" 0 "LDWS_NoWarn" /end COMPU_VTAB
/begin COMPU_VTAB VTAB_FOR_LDWS_subsystem_integrated_CM_EnumLDWS_system_st "Enumerated data type: EnumLDWS_system_st" TAB_VERB 3 0 "LDWS_Off" 1 "LDWS_On" 2 "LDWS_Error" /end COMPU_VTAB
/begin COMPU_VTAB VTAB_FOR_LDWS_subsystem_integrated_CM_EnumLDWS_on_state_st "Enumerated data type: EnumLDWS_on_state_st" TAB_VERB 4 0 "LDWS_Enabling" 1 "LDWS_Standby" 2 "LDWS_Active" 3 "LDWS_Passive" /end COMPU_VTAB
/begin GROUP S5_MngDCSN_TrafficDeciderManager "DCSN_subsystem_integrated/DtrmnDCSN_Integrated/DtrmnDCSN_TrafficDecider/MngDCSN_TrafficDeciderManager"
 /begin REF_CHARACTERISTIC KbDCSN_change_lane_enable KbDCSN_overspeed_warning_enable KbDCSN_speed_limit_enable KbDCSN_stop_request_enable /end REF_CHARACTERISTIC
 /begin REF_MEASUREMENT VbDCSN_speed_limit_enabled VbDCSN_stop_request_enabled /end REF_MEASUREMENT
/end GROUP
/begin GROUP S5_MngDCSN_TrafficDeciderOutputM "DCSN_subsystem_integrated/DtrmnDCSN_Integrated/DtrmnDCSN_TrafficDecider/MngDCSN_TrafficDeciderOutputM"
 /begin REF_CHARACTERISTIC KbDCSN_change_lane_cancel_request_man_value KbDCSN_change_lane_man_enbl KbDCSN_change_lane_request_man_value KbDCSN_inlane_nudge_man_enbl KbDCSN_inlane_nudge_request_man_value KbDCSN_pull_over_man_enbl KbDCSN_pull_over_request_man_value KbDCSN_speed_limit_man_enbl KbDCSN_stop_man_enbl KbDCSN_stop_request_man_value KeDCSN_change_lane_cancel_reason_man_value KeDCSN_change_lane_reason_man_value KeDCSN_change_lane_req_side_man_value KeDCSN_inlane_nudge_reason_man_value KeDCSN_pull_over_reason_man_value KeDCSN_speed_limit_reason_man_value KeDCSN_stop_reason_man_value KfDCSN_d_inlane_nudge_side_man_value KfDCSN_d_speed_limit_distance_man_value KfDCSN_v_change_lane_target_speed_man_value KfDCSN_v_lane_speed_limit_man_value KfDCSN_v_target_speed_limit_man_value /end REF_CHARACTERISTIC
 /begin REF_MEASUREMENT VbDCSN_change_lane_cancel_request VbDCSN_change_lane_request VbDCSN_inlane_nudge_request VbDCSN_pull_over_request VbDCSN_stop_request VeDCSN_change_lane_cancel_reason VeDCSN_change_lane_reason VeDCSN_change_lane_req_side VeDCSN_inlane_nudge_reason VeDCSN_pull_over_reason VeDCSN_speed_limit_reason VeDCSN_stop_reason VfDCSN_change_lane_target_speed VfDCSN_inlane_nudge_side VfDCSN_lane_speed_limit VfDCSN_speed_limit_distance VfDCSN_stop_s_distance VfDCSN_target_speed_limit /end REF_MEASUREMENT
/end GROUP
/begin GROUP S8_CheckDCSN_StateCheck "DCSN_subsystem_integrated/DtrmnDCSN_Integrated/DtrmnDCSN_ADM/DtrmnDCSN_ADMMainManager/CheckDCSN_StateCheck"
 /begin SUB_GROUP S11_CheckDCSN_ActivationStateCheck S11_CheckDCSN_ExitStateCheck S11_CheckDCSN_WarningStateCheck /end SUB_GROUP
/end GROUP
/begin GROUP S8_CheckDCSN_SystemFaultCheck "DCSN_subsystem_integrated/DtrmnDCSN_Integrated/DtrmnDCSN_ADM/DtrmnDCSN_ADMMainManager/CheckDCSN_SystemFaultCheck" /begin REF_MEASUREMENT VbDCSN_fault_detected /end REF_MEASUREMENT /end GROUP
/begin GROUP S8_DtrmnDCSN_CondActivation "DCSN_subsystem_integrated/DtrmnDCSN_Integrated/DtrmnDCSN_ADM/DtrmnDCSN_ADMMainManager/DtrmnDCSN_CondActivation" /begin SUB_GROUP S14_CvrtDCSN_DataConvert /end SUB_GROUP
 /begin REF_CHARACTERISTIC KfDCSN_t_allowed_time_cond_activate KfDCSN_t_max_wait_cond_activate /end REF_CHARACTERISTIC
 /begin REF_MEASUREMENT VbDCSN_cond_activate_met /end REF_MEASUREMENT
/end GROUP
/begin GROUP S9_DtrmnDCSN_TakeOverLogicFAW "DCSN_subsystem_integrated/DtrmnDCSN_Integrated/DtrmnDCSN_ADM/DtrmnDCSN_DRIVIintentionSimu/DtrmnDCSN_TakeOverLogicFAW"
 /begin REF_CHARACTERISTIC KbDCSN_use_faw_handoff_as_ovrd KbDCSN_use_faw_handoff_as_resume /end REF_CHARACTERISTIC
/end GROUP
/begin GROUP S9_SteerOvrrideTorque "DCSN_subsystem_integrated/DtrmnDCSN_Integrated/DtrmnDCSN_ADM/DtrmnDCSN_DRIVIintentionSimu/SteerOvrrideTorque" /begin REF_CHARACTERISTIC KfDCSN_M_adm_temp_steering_ovrd_torque /end REF_CHARACTERISTIC /end GROUP
/begin GROUP S9_SteerResumeTorque "DCSN_subsystem_integrated/DtrmnDCSN_Integrated/DtrmnDCSN_ADM/DtrmnDCSN_DRIVIintentionSimu/SteerResumeTorque" /begin REF_CHARACTERISTIC KfDCSN_M_adm_temp_steering_resume_torque /end REF_CHARACTERISTIC /end GROUP
/begin GROUP S53_DtrmnDCSN_AutodriveActDelay "DCSN_subsystem_integrated/DtrmnDCSN_Integrated/DtrmnDCSN_EnablingManager/DtrmnDCSN_AutoDriveModeManager/DtrmnDCSN_AutodriveActDelay" /begin REF_CHARACTERISTIC KfDCSN_t_autodrive_control_mode_delay /end REF_CHARACTERISTIC /end GROUP
/begin GROUP S67_CalcDCSN_curvature_speed_limit "DCSN_subsystem_integrated/DtrmnDCSN_Integrated/DtrmnDCSN_TrafficDecider/CalcDCSN_SpeedLimit/CalcDCSN_curvature_speed_limit"
 /begin SUB_GROUP S74_CalcDCSN_max_curvature2 S74_CalcDCSN_max_curvature3 S74_CalcDCSN_select_left_edge_para S74_CalcDCSN_select_left_marker_para S74_CalcDCSN_select_right_edge_para S74_CalcDCSN_select_right_marker_para S74_Input_variables_observation /end SUB_GROUP
 /begin REF_CHARACTERISTIC KfDCSN_d_arc_length_integration_step KfDCSN_k_largest_curvature_filter KtDCSN_t_curvature_ahead_timegap KtDCSN_v_speed_limit_curve /end REF_CHARACTERISTIC
 /begin REF_MEASUREMENT VbDCSN_has_left_marker VbDCSN_has_right_marker VfDCSN_SpdLimt_look_ahead_dis VfDCSN_largest_curvature_ahead VfDCSN_speed_limit_curvature VfDCSN_speed_limit_curvature_pos /end REF_MEASUREMENT
/end GROUP
/begin GROUP S67_CalcDCSN_ego_lane_speed_limit "DCSN_subsystem_integrated/DtrmnDCSN_Integrated/DtrmnDCSN_TrafficDecider/CalcDCSN_SpeedLimit/CalcDCSN_ego_lane_speed_limit" /begin SUB_GROUP S75_Pass /end SUB_GROUP
 /begin REF_MEASUREMENT VbDCSN_has_ego_lane VbDCSN_spd_limt_max_isNaN VbDCSN_speed_limit_input_isNaN /end REF_MEASUREMENT
/end GROUP
/begin GROUP S68_CalcDCSN_RawStopDistance "DCSN_subsystem_integrated/DtrmnDCSN_Integrated/DtrmnDCSN_TrafficDecider/CalcDCSN_StopRequest/CalcDCSN_RawStopDistance" /begin SUB_GROUP S164_select_stop_line_distance /end SUB_GROUP
 /begin REF_MEASUREMENT VbDCSN_has_valid_stop_line VbDCSN_stop_line_distance_isNaN VbDCSN_stop_line_input_isNaN VfDCSN_raw_stop_line_distance /end REF_MEASUREMENT
/end GROUP
/begin GROUP S68_CalcDCSN_SLEWStopDistance "DCSN_subsystem_integrated/DtrmnDCSN_Integrated/DtrmnDCSN_TrafficDecider/CalcDCSN_StopRequest/CalcDCSN_SLEWStopDistance" /begin SUB_GROUP S165_StopDis /end SUB_GROUP /begin REF_CHARACTERISTIC KbDCSN_stop_request_man_value /end REF_CHARACTERISTIC /end GROUP
/begin GROUP S68_CalcDCSN_StopReasonDistance "DCSN_subsystem_integrated/DtrmnDCSN_Integrated/DtrmnDCSN_TrafficDecider/CalcDCSN_StopRequest/CalcDCSN_StopReasonDistance"
 /begin SUB_GROUP S166_CheckDCSN_VariableTimeHold S166_CheckDCSN_VariableTimeHold1 /end SUB_GROUP
 /begin REF_CHARACTERISTIC KfDCSN_d_Thrsh_request_stop KfDCSN_d_stop_cleared_Thrsh KfDCSN_d_stop_close_Thrsh KfDCSN_d_stop_finished_dis KfDCSN_d_stop_unsuccess_Thrsh KfDCSN_t_sample_time /end REF_CHARACTERISTIC
 /begin REF_MEASUREMENT VbDCSN_raw_stop_finished VbDCSN_raw_stop_finished_late VbDCSN_should_send_stop_req VbDCSN_stop_line_is_close VbDCSN_stop_unsuccess VeDCSN_stop_request_mode /end REF_MEASUREMENT
/end GROUP
/begin GROUP S70_CheckDCSN_num_lane_markers_isNaN "DCSN_subsystem_integrated/DtrmnDCSN_Integrated/DtrmnDCSN_TrafficDecider/CvrtDCSN_DataSelector/CheckDCSN_num_lane_markers_isNaN" /begin REF_MEASUREMENT VbDCSN_mpfu_num_markers_isNaN /end REF_MEASUREMENT /end GROUP
/begin GROUP S70_CheckDCSN_num_lanes_isNaN "DCSN_subsystem_integrated/DtrmnDCSN_Integrated/DtrmnDCSN_TrafficDecider/CvrtDCSN_DataSelector/CheckDCSN_num_lanes_isNaN" /begin REF_MEASUREMENT VbDCSN_num_lanes_isNaN /end REF_MEASUREMENT /end GROUP
/begin GROUP S70_CheckDCSN_num_road_edges_isNaN "DCSN_subsystem_integrated/DtrmnDCSN_Integrated/DtrmnDCSN_TrafficDecider/CvrtDCSN_DataSelector/CheckDCSN_num_road_edges_isNaN" /begin REF_MEASUREMENT VbDCSN_mpfu_num_edges_isNaN /end REF_MEASUREMENT /end GROUP
/begin GROUP S70_CheckDCSN_num_stop_lines_isNaN "DCSN_subsystem_integrated/DtrmnDCSN_Integrated/DtrmnDCSN_TrafficDecider/CvrtDCSN_DataSelector/CheckDCSN_num_stop_lines_isNaN" /begin REF_MEASUREMENT VbDCSN_num_stop_lines_isNaN VfDCSN_mpfu_num_stop_lines /end REF_MEASUREMENT /end GROUP
/begin GROUP S71_DtrmnDCSN_UsrChangeLaneReq "DCSN_subsystem_integrated/DtrmnDCSN_Integrated/DtrmnDCSN_TrafficDecider/DtrmnDCSN_ChangeLaneReq/DtrmnDCSN_UsrChangeLaneReq" /begin SUB_GROUP S189_CvrtDCSN_DataConvert S189_OnDelay /end SUB_GROUP /begin REF_CHARACTERISTIC KfDCSN_t_usr_change_lane_delay /end REF_CHARACTERISTIC /end GROUP
/begin GROUP S11_CheckDCSN_ActivationStateCheck "DCSN_subsystem_integrated/DtrmnDCSN_Integrated/DtrmnDCSN_ADM/DtrmnDCSN_ADMMainManager/CheckDCSN_StateCheck/CheckDCSN_ActivationStateCheck" /begin SUB_GROUP S15_CheckDCSN_VehicleActivation /end SUB_GROUP /begin REF_MEASUREMENT VbDCSN_autodrive_ready_to_engage /end REF_MEASUREMENT /end GROUP
/begin GROUP S11_CheckDCSN_ExitStateCheck "DCSN_subsystem_integrated/DtrmnDCSN_Integrated/DtrmnDCSN_ADM/DtrmnDCSN_ADMMainManager/CheckDCSN_StateCheck/CheckDCSN_ExitStateCheck" /begin SUB_GROUP S16_CheckDCSN_VehicleExit /end SUB_GROUP /begin REF_MEASUREMENT VbDCSN_autodrive_exit /end REF_MEASUREMENT /end GROUP
/begin GROUP S11_CheckDCSN_WarningStateCheck "DCSN_subsystem_integrated/DtrmnDCSN_Integrated/DtrmnDCSN_ADM/DtrmnDCSN_ADMMainManager/CheckDCSN_StateCheck/CheckDCSN_WarningStateCheck" /begin SUB_GROUP S17_CheckDCSN_VehicleWarning /end SUB_GROUP /begin REF_MEASUREMENT VbDCSN_autodrive_warning /end REF_MEASUREMENT /end GROUP
/begin GROUP S14_CvrtDCSN_DataConvert "DCSN_subsystem_integrated/DtrmnDCSN_Integrated/DtrmnDCSN_ADM/DtrmnDCSN_ADMMainManager/DtrmnDCSN_CondActivation/CvrtDCSN_DataConvert" /begin REF_MEASUREMENT VfDCSN_C_cond_act_time /end REF_MEASUREMENT /end GROUP
/begin GROUP S74_CalcDCSN_max_curvature2 "DCSN_subsystem_integrated/DtrmnDCSN_Integrated/DtrmnDCSN_TrafficDecider/CalcDCSN_SpeedLimit/CalcDCSN_curvature_speed_limit/CalcDCSN_max_curvature2" /begin REF_CHARACTERISTIC KfDCSN_Pct_lane_marker_valid_quality /end REF_CHARACTERISTIC /end GROUP
/begin GROUP S74_CalcDCSN_max_curvature3 "DCSN_subsystem_integrated/DtrmnDCSN_Integrated/DtrmnDCSN_TrafficDecider/CalcDCSN_SpeedLimit/CalcDCSN_curvature_speed_limit/CalcDCSN_max_curvature3" /begin REF_CHARACTERISTIC KfDCSN_Pct_lane_marker_valid_quality /end REF_CHARACTERISTIC /end GROUP
/begin GROUP S74_CalcDCSN_select_left_edge_para "DCSN_subsystem_integrated/DtrmnDCSN_Integrated/DtrmnDCSN_TrafficDecider/CalcDCSN_SpeedLimit/CalcDCSN_curvature_speed_limit/CalcDCSN_select_left_edge_para" /begin REF_MEASUREMENT VbDCSN_left_edge_para_isNaN /end REF_MEASUREMENT /end GROUP
/begin GROUP S74_CalcDCSN_select_left_marker_para "DCSN_subsystem_integrated/DtrmnDCSN_Integrated/DtrmnDCSN_TrafficDecider/CalcDCSN_SpeedLimit/CalcDCSN_curvature_speed_limit/CalcDCSN_select_left_marker_para" /begin REF_MEASUREMENT VbDCSN_left_marker_para_isNaN /end REF_MEASUREMENT /end GROUP
/begin GROUP S74_CalcDCSN_select_right_edge_para "DCSN_subsystem_integrated/DtrmnDCSN_Integrated/DtrmnDCSN_TrafficDecider/CalcDCSN_SpeedLimit/CalcDCSN_curvature_speed_limit/CalcDCSN_select_right_edge_para" /begin REF_MEASUREMENT VbDCSN_right_edge_para_isNaN /end REF_MEASUREMENT /end GROUP
/begin GROUP S74_CalcDCSN_select_right_marker_para "DCSN_subsystem_integrated/DtrmnDCSN_Integrated/DtrmnDCSN_TrafficDecider/CalcDCSN_SpeedLimit/CalcDCSN_curvature_speed_limit/CalcDCSN_select_right_marker_para" /begin REF_MEASUREMENT VbDCSN_right_marker_para_isNaN /end REF_MEASUREMENT /end GROUP
/begin GROUP S74_Input_variables_observation "DCSN_subsystem_integrated/DtrmnDCSN_Integrated/DtrmnDCSN_TrafficDecider/CalcDCSN_SpeedLimit/CalcDCSN_curvature_speed_limit/Input_variables_observation"
 /begin SUB_GROUP S102_CalcDCSN_current_curvature S102_CalcDCSN_current_curvature1 S102_CalcDCSN_current_curvature2 S102_CalcDCSN_current_curvature3 /end SUB_GROUP
 /begin REF_MEASUREMENT VfDCSN_left_marker_raw_c0 VfDCSN_left_marker_raw_c1 VfDCSN_left_marker_raw_c2 VfDCSN_left_marker_raw_c3 VfDCSN_left_marker_raw_end_x VfDCSN_left_marker_raw_end_y VfDCSN_left_marker_raw_quality VfDCSN_left_marker_raw_start_x VfDCSN_left_marker_raw_start_y VfDCSN_right_marker_raw_c0 VfDCSN_right_marker_raw_c1 VfDCSN_right_marker_raw_c2 VfDCSN_right_marker_raw_c3 VfDCSN_right_marker_raw_end_x VfDCSN_right_marker_raw_end_y VfDCSN_right_marker_raw_quality VfDCSN_right_marker_raw_start_x VfDCSN_right_marker_raw_start_y /end REF_MEASUREMENT
/end GROUP
/begin GROUP S75_Pass "DCSN_subsystem_integrated/DtrmnDCSN_Integrated/DtrmnDCSN_TrafficDecider/CalcDCSN_SpeedLimit/CalcDCSN_ego_lane_speed_limit/Pass" /begin REF_MEASUREMENT VfDCSN_speed_limit_ego_lane /end REF_MEASUREMENT /end GROUP
/begin GROUP S164_select_stop_line_distance "DCSN_subsystem_integrated/DtrmnDCSN_Integrated/DtrmnDCSN_TrafficDecider/CalcDCSN_StopRequest/CalcDCSN_RawStopDistance/select_stop_line_distance" /begin SUB_GROUP S170_CheckDCSN_stop_line_distance_isNAN /end SUB_GROUP /end GROUP
/begin GROUP S165_StopDis "DCSN_subsystem_integrated/DtrmnDCSN_Integrated/DtrmnDCSN_TrafficDecider/CalcDCSN_StopRequest/CalcDCSN_SLEWStopDistance/StopDis" /begin REF_CHARACTERISTIC KfDCSN_d_stop_s_distance_man_value KfDCSN_t_sample_time /end REF_CHARACTERISTIC /end GROUP
/begin GROUP S166_CheckDCSN_VariableTimeHold "DCSN_subsystem_integrated/DtrmnDCSN_Integrated/DtrmnDCSN_TrafficDecider/CalcDCSN_StopRequest/CalcDCSN_StopReasonDistance/CheckDCSN_VariableTimeHold" /begin REF_CHARACTERISTIC KfDCSN_t_stop_req_hold /end REF_CHARACTERISTIC /begin REF_MEASUREMENT VbDCSN_hold_stop_finished /end REF_MEASUREMENT /end GROUP
/begin GROUP S166_CheckDCSN_VariableTimeHold1 "DCSN_subsystem_integrated/DtrmnDCSN_Integrated/DtrmnDCSN_TrafficDecider/CalcDCSN_StopRequest/CalcDCSN_StopReasonDistance/CheckDCSN_VariableTimeHold1" /begin REF_CHARACTERISTIC KfDCSN_t_stop_req_hold /end REF_CHARACTERISTIC /end GROUP
/begin GROUP S189_CvrtDCSN_DataConvert "DCSN_subsystem_integrated/DtrmnDCSN_Integrated/DtrmnDCSN_TrafficDecider/DtrmnDCSN_ChangeLaneReq/DtrmnDCSN_UsrChangeLaneReq/CvrtDCSN_DataConvert" /begin REF_MEASUREMENT VeDCSN_CL_req_side_pre /end REF_MEASUREMENT /end GROUP
/begin GROUP S189_OnDelay "DCSN_subsystem_integrated/DtrmnDCSN_Integrated/DtrmnDCSN_TrafficDecider/DtrmnDCSN_ChangeLaneReq/DtrmnDCSN_UsrChangeLaneReq/OnDelay" /begin REF_MEASUREMENT VbDCSN_CL_delay_finished /end REF_MEASUREMENT /end GROUP
/begin GROUP S15_CheckDCSN_VehicleActivation "DCSN_subsystem_integrated/DtrmnDCSN_Integrated/DtrmnDCSN_ADM/DtrmnDCSN_ADMMainManager/CheckDCSN_StateCheck/CheckDCSN_ActivationStateCheck/CheckDCSN_VehicleActivation" /begin REF_CHARACTERISTIC KfDCSN_v_adm_active_extraspeed KfDCSN_v_setspeed_thrsh_hi /end REF_CHARACTERISTIC /end GROUP
/begin GROUP S16_CheckDCSN_VehicleExit "DCSN_subsystem_integrated/DtrmnDCSN_Integrated/DtrmnDCSN_ADM/DtrmnDCSN_ADMMainManager/CheckDCSN_StateCheck/CheckDCSN_ExitStateCheck/CheckDCSN_VehicleExit"
 /begin REF_CHARACTERISTIC KbDCSN_adm_BrkPressDeactivateEnabled KfDCSN_v_autodrive_max_speed /end REF_CHARACTERISTIC
/end GROUP
/begin GROUP S17_CheckDCSN_VehicleWarning "DCSN_subsystem_integrated/DtrmnDCSN_Integrated/DtrmnDCSN_ADM/DtrmnDCSN_ADMMainManager/CheckDCSN_StateCheck/CheckDCSN_WarningStateCheck/CheckDCSN_VehicleWarning" /begin REF_CHARACTERISTIC KfDCSN_v_adm_active_extraspeed KfDCSN_v_setspeed_thrsh_hi /end REF_CHARACTERISTIC /end GROUP
/begin GROUP S102_CalcDCSN_current_curvature "DCSN_subsystem_integrated/DtrmnDCSN_Integrated/DtrmnDCSN_TrafficDecider/CalcDCSN_SpeedLimit/CalcDCSN_curvature_speed_limit/Input_variables_observation/CalcDCSN_current_curvature" /begin REF_MEASUREMENT VfDCSN_current_left_edge_cur /end REF_MEASUREMENT /end GROUP
/begin GROUP S102_CalcDCSN_current_curvature1 "DCSN_subsystem_integrated/DtrmnDCSN_Integrated/DtrmnDCSN_TrafficDecider/CalcDCSN_SpeedLimit/CalcDCSN_curvature_speed_limit/Input_variables_observation/CalcDCSN_current_curvature1" /begin REF_MEASUREMENT VfDCSN_current_right_edge_cur /end REF_MEASUREMENT /end GROUP
/begin GROUP S102_CalcDCSN_current_curvature2 "DCSN_subsystem_integrated/DtrmnDCSN_Integrated/DtrmnDCSN_TrafficDecider/CalcDCSN_SpeedLimit/CalcDCSN_curvature_speed_limit/Input_variables_observation/CalcDCSN_current_curvature2" /begin REF_MEASUREMENT VfDCSN_current_left_marker_cur /end REF_MEASUREMENT /end GROUP
/begin GROUP S102_CalcDCSN_current_curvature3 "DCSN_subsystem_integrated/DtrmnDCSN_Integrated/DtrmnDCSN_TrafficDecider/CalcDCSN_SpeedLimit/CalcDCSN_curvature_speed_limit/Input_variables_observation/CalcDCSN_current_curvature3" /begin REF_MEASUREMENT VfDCSN_current_right_marker_cur /end REF_MEASUREMENT /end GROUP
/begin GROUP S170_CheckDCSN_stop_line_distance_isNAN "DCSN_subsystem_integrated/DtrmnDCSN_Integrated/DtrmnDCSN_TrafficDecider/CalcDCSN_StopRequest/CalcDCSN_RawStopDistance/select_stop_line_distance/CheckDCSN_stop_line_distance_isNAN" /begin REF_CHARACTERISTIC KfDCSN_d_rearaxle_frontbump KfDCSN_d_stop_distance_buffer /end REF_CHARACTERISTIC /end GROUP
/begin GROUP LCCS_subsystem_integrated "LCCS_subsystem_integrated" ROOT /begin SUB_GROUP Root_LCCS /end SUB_GROUP /end GROUP
/begin GROUP Root_LCCS "LCCS_subsystem_integrated/LCCS" /begin SUB_GROUP S1_LCCS /end SUB_GROUP /end GROUP
/begin GROUP S1_LCCS "LCCS_subsystem_integrated/LCCS/LCCS"
 /begin SUB_GROUP S2_CalcLCCS_compute_lateral_errors S2_CalcLCCS_lane_center_discretize S2_CalcLCCS_lane_center_line S2_CalcLCCS_lateral_control_main S2_CalcLCCS_lateral_shift_width S2_CalcLCCS_virtual_lane_marker S2_DtrmnLCCS_sensor_signal_processing S2_DtrmnLCCS_sensor_signal_rationality S2_DtrmnLCCS_steering_control_output /end SUB_GROUP
/end GROUP
/begin GROUP S2_CalcLCCS_compute_lateral_errors "LCCS_subsystem_integrated/LCCS/LCCS/CalcLCCS_compute_lateral_errors"
 /begin SUB_GROUP S4_center_of_mass_projection S4_compute_lateral_errors S4_preview_point_projection /end SUB_GROUP
/end GROUP
/begin GROUP S2_CalcLCCS_lane_center_discretize "LCCS_subsystem_integrated/LCCS/LCCS/CalcLCCS_lane_center_discretize" /begin REF_CHARACTERISTIC KfLCCS_d_RearAxleToCameraOrigin /end REF_CHARACTERISTIC /end GROUP
/begin GROUP S2_CalcLCCS_lane_center_line "LCCS_subsystem_integrated/LCCS/LCCS/CalcLCCS_lane_center_line" /begin REF_CHARACTERISTIC KfLCCS_t_SampleTime KtLCCS_k_LanemarkMergeCoef /end REF_CHARACTERISTIC
 /begin REF_MEASUREMENT VaLCCS_final_left_lanemark VaLCCS_final_right_lanemark VaLCCS_raw_lane_center_line VbLCCS_touched_new_lane VfLCCS_left_lanemark_switch_time VfLCCS_right_lanemark_switch_time /end REF_MEASUREMENT
/end GROUP
/begin GROUP S2_CalcLCCS_lateral_control_main "LCCS_subsystem_integrated/LCCS/LCCS/CalcLCCS_lateral_control_main" /begin SUB_GROUP S7_lateral_control S7_steering_wheel_angle /end SUB_GROUP /end GROUP
/begin GROUP S2_CalcLCCS_lateral_shift_width "LCCS_subsystem_integrated/LCCS/LCCS/CalcLCCS_lateral_shift_width" /begin SUB_GROUP S8_CalcLCCS_target_shift_width /end SUB_GROUP
 /begin REF_CHARACTERISTIC KbLCCS_lane_change_source_ALCA KfLCCS_r_MaxLateralSpeedPortion KfLCCS_r_shift_speed_gain KfLCCS_t_SampleTime KfLCCS_v_shift_speed_high_limit KfLCCS_v_shift_speed_low_limit /end REF_CHARACTERISTIC
 /begin REF_MEASUREMENT VaLCCS_shifted_lane_center_line VbLCCS_shifting_in_progress VeLCCS_shifting_direction_final VfLCCS_lateral_dist_to_go VfLCCS_lateral_shift_step VfLCCS_lateral_shift_width /end REF_MEASUREMENT
/end GROUP
/begin GROUP S2_CalcLCCS_virtual_lane_marker "LCCS_subsystem_integrated/LCCS/LCCS/CalcLCCS_virtual_lane_marker" /begin SUB_GROUP S9_1st_order_filter /end SUB_GROUP
 /begin REF_CHARACTERISTIC KfLCCS_LanemarkerQualityThrsh KfLCCS_d_ValidLaneWidthLimit KfLCCS_k_LaneWidthFilter KfLCCS_t_SampleTime /end REF_CHARACTERISTIC
 /begin REF_MEASUREMENT VaLCCS_virtual_left_lanemark VaLCCS_virtual_right_lanemark VbLCCS_both_lanemark_available VbLCCS_left_lanemark_valid VbLCCS_right_lanemark_valid VeLCCS_valid_lane_marker VfLCCS_c0_scaling VfLCCS_left_lanemark_confidence VfLCCS_raw_lane_width VfLCCS_right_lanemark_confidence /end REF_MEASUREMENT
/end GROUP
/begin GROUP S2_DtrmnLCCS_sensor_signal_processing "LCCS_subsystem_integrated/LCCS/LCCS/DtrmnLCCS_sensor_signal_processing" /begin SUB_GROUP S10_check_signal_isNan10 /end SUB_GROUP
 /begin REF_CHARACTERISTIC KfLCCS_Ang_steering_center_position KfLCCS_d_wheel_base KfLCCS_r_veh_strwhl_2_frtwhl_ratio KtLCCS_d_lookahead_distance /end REF_CHARACTERISTIC
 /begin REF_MEASUREMENT VaLCCS_raw_left_lanemark VaLCCS_raw_right_lanemark VbLCCS_input_isNaN_MPFU VfLCCS_lookahead_distance VfLCCS_timestamp_MPFU VfLCCS_veh_frtwhl_angle_act /end REF_MEASUREMENT
/end GROUP
/begin GROUP S2_DtrmnLCCS_sensor_signal_rationality "LCCS_subsystem_integrated/LCCS/LCCS/DtrmnLCCS_sensor_signal_rationality"
 /begin SUB_GROUP S11_check_signal_isNan S11_check_signal_isNan12 S11_check_signal_isNan14 S11_check_signal_isNan2 S11_check_signal_isNan6 S11_check_signal_isNan8 S11_check_signal_isNan9 /end SUB_GROUP
 /begin REF_CHARACTERISTIC KbLCCS_WheelEncoderReady KbLCCS_inlane_nudge_request_SLEW KbLCCS_inlane_nudge_request_value KbLCCS_lane_change_request_SLEW KbLCCS_lane_change_request_value KbLCCS_lane_change_source_ALCA KeLCCS_shifting_direction_value KfLCCS_r_YawRateCorrection /end REF_CHARACTERISTIC
 /begin REF_MEASUREMENT VbLCCS_inlane_nudge_request VbLCCS_input_isNaN_ALCA VbLCCS_input_isNaN_COMM VbLCCS_input_isNaN_DCSN VbLCCS_input_isNaN_EGMO VbLCCS_lane_change_request VeLCCS_shifting_direction_raw VfLCCS_timestamp_EGMO VfLCCS_veh_heading_rel VfLCCS_velocity_rel_y VfLCCS_yaw_rate /end REF_MEASUREMENT
/end GROUP
/begin GROUP S2_DtrmnLCCS_steering_control_output "LCCS_subsystem_integrated/LCCS/LCCS/DtrmnLCCS_steering_control_output" /begin SUB_GROUP S12_steering_control_machine /end SUB_GROUP
 /begin REF_CHARACTERISTIC KfLCCS_t_TimestampAliveThresh KtLCCS_Ang_steering_angle_reentry_zone /end REF_CHARACTERISTIC
 /begin REF_MEASUREMENT VbLCCS_LCC_ForceToDisengage VbLCCS_LCC_ReadyToEngage VfLCCS_steering_angle_diff_abs /end REF_MEASUREMENT
/end GROUP
/begin GROUP S4_center_of_mass_projection "LCCS_subsystem_integrated/LCCS/LCCS/CalcLCCS_compute_lateral_errors/center_of_mass_projection" /begin REF_CHARACTERISTIC KfLCCS_d_lr /end REF_CHARACTERISTIC /begin REF_MEASUREMENT VaLCCS_com_point VaLCCS_com_proj_point /end REF_MEASUREMENT /end GROUP
/begin GROUP S4_compute_lateral_errors "LCCS_subsystem_integrated/LCCS/LCCS/CalcLCCS_compute_lateral_errors/compute_lateral_errors"
 /begin REF_CHARACTERISTIC KbLCCS_UsePurePursuit KcLCCS_HeadingErrorRateSmooth KfLCCS_heading_error_rate_limit KfLCCS_t_SampleTime /end REF_CHARACTERISTIC
 /begin REF_MEASUREMENT VfLCCS_heading_error VfLCCS_heading_error_rate VfLCCS_lateral_error VfLCCS_lateral_error_rate VfLCCS_lookahead_angle VfLCCS_preview_curvature /end REF_MEASUREMENT
/end GROUP
/begin GROUP S4_preview_point_projection "LCCS_subsystem_integrated/LCCS/LCCS/CalcLCCS_compute_lateral_errors/preview_point_projection" /begin REF_MEASUREMENT VaLCCS_preview_proj_point /end REF_MEASUREMENT /end GROUP
/begin GROUP S7_lateral_control "LCCS_subsystem_integrated/LCCS/LCCS/CalcLCCS_lateral_control_main/lateral_control" /begin SUB_GROUP S56_Compute_Feed_Forward S56_slowpath_steer_PI /end SUB_GROUP
 /begin REF_CHARACTERISTIC KbLCCS_UsePurePursuit KfLCCS_Ang_slowpath_steer_limit KfLCCS_WeightMatrixStates_R KfLCCS_a_max_lat_acc KfLCCS_cf KfLCCS_cr KfLCCS_d_lf KfLCCS_d_lr KfLCCS_d_min_turn_radius KfLCCS_eps KfLCCS_iz KfLCCS_mass KtLCCS_heading_err_correction KtLCCS_heading_err_gain_scheduler KtLCCS_heading_err_rate_correction KtLCCS_heading_err_rate_gain_scheduler KtLCCS_lateral_err_correction KtLCCS_lateral_err_gain_scheduler KtLCCS_lateral_err_rate_correction KtLCCS_lateral_err_rate_gain_scheduler KtLCCS_slowpath_steer_I_gain KtLCCS_slowpath_steer_P_gain KtLCCS_t_lateral_oscillation_period /end REF_CHARACTERISTIC
 /begin REF_MEASUREMENT VcLCCS_num_iteration VfLCCS_frtwhl_angle_limit_lat_acc VfLCCS_heading_error_contribution VfLCCS_heading_error_rate_contribution VfLCCS_lateral_error_contribution VfLCCS_lateral_error_rate_contribution VfLCCS_steer_angle_feedback VfLCCS_steer_angle_feedforward VfLCCS_veh_frtwhl_angle_des /end REF_MEASUREMENT
/end GROUP
/begin GROUP S7_steering_wheel_angle "LCCS_subsystem_integrated/LCCS/LCCS/CalcLCCS_lateral_control_main/steering_wheel_angle" /begin SUB_GROUP S57_angular_vel_limit /end SUB_GROUP /end GROUP
/begin GROUP S8_CalcLCCS_target_shift_width "LCCS_subsystem_integrated/LCCS/LCCS/CalcLCCS_lateral_shift_width/CalcLCCS_target_shift_width" /begin REF_CHARACTERISTIC KfLCCS_d_NudgeSafetyZone KfLCCS_d_VehicleWidth /end REF_CHARACTERISTIC /begin REF_MEASUREMENT VfLCCS_target_lateral_shift_width /end REF_MEASUREMENT /end GROUP
/begin GROUP S9_1st_order_filter "LCCS_subsystem_integrated/LCCS/LCCS/CalcLCCS_virtual_lane_marker/1st order filter" /begin REF_MEASUREMENT VfLCCS_smoothed_lane_width /end REF_MEASUREMENT /end GROUP
/begin GROUP S10_check_signal_isNan10 "LCCS_subsystem_integrated/LCCS/LCCS/DtrmnLCCS_sensor_signal_processing/check_signal_isNan10" /begin REF_MEASUREMENT VfLCCS_num_lane_markers /end REF_MEASUREMENT /end GROUP
/begin GROUP S11_check_signal_isNan "LCCS_subsystem_integrated/LCCS/LCCS/DtrmnLCCS_sensor_signal_rationality/check_signal_isNan" /begin REF_MEASUREMENT VfLCCS_linear_velocity /end REF_MEASUREMENT /end GROUP
/begin GROUP S11_check_signal_isNan12 "LCCS_subsystem_integrated/LCCS/LCCS/DtrmnLCCS_sensor_signal_rationality/check_signal_isNan12" /begin REF_MEASUREMENT VbLCCS_lcc_feature_enable /end REF_MEASUREMENT /end GROUP
/begin GROUP S11_check_signal_isNan14 "LCCS_subsystem_integrated/LCCS/LCCS/DtrmnLCCS_sensor_signal_rationality/check_signal_isNan14" /begin REF_MEASUREMENT VfLCCS_lateral_v_from_ALCA /end REF_MEASUREMENT /end GROUP
/begin GROUP S11_check_signal_isNan2 "LCCS_subsystem_integrated/LCCS/LCCS/DtrmnLCCS_sensor_signal_rationality/check_signal_isNan2" /begin REF_MEASUREMENT VfLCCS_velocity_rel_x /end REF_MEASUREMENT /end GROUP
/begin GROUP S11_check_signal_isNan6 "LCCS_subsystem_integrated/LCCS/LCCS/DtrmnLCCS_sensor_signal_rationality/check_signal_isNan6" /begin REF_MEASUREMENT VbLCCS_steer_control_enable /end REF_MEASUREMENT /end GROUP
/begin GROUP S11_check_signal_isNan8 "LCCS_subsystem_integrated/LCCS/LCCS/DtrmnLCCS_sensor_signal_rationality/check_signal_isNan8" /begin REF_MEASUREMENT VcLCCS_VCU1_ICPV_EPSMODE /end REF_MEASUREMENT /end GROUP
/begin GROUP S11_check_signal_isNan9 "LCCS_subsystem_integrated/LCCS/LCCS/DtrmnLCCS_sensor_signal_rationality/check_signal_isNan9" /begin REF_MEASUREMENT VfLCCS_VCU1_ICPV_StrAngle /end REF_MEASUREMENT /end GROUP
/begin GROUP S12_steering_control_machine "LCCS_subsystem_integrated/LCCS/LCCS/DtrmnLCCS_steering_control_output/steering_control_machine" /begin REF_CHARACTERISTIC KfLCCS_t_SampleTime KfLCCS_t_lateral_movement_delay /end REF_CHARACTERISTIC
 /begin REF_MEASUREMENT VbLCCS_lateral_movement_enabled VbLCCS_steering_control_active VbLCCS_steering_control_engaged VbLCCS_steering_control_stable /end REF_MEASUREMENT
/end GROUP
/begin GROUP S56_Compute_Feed_Forward "LCCS_subsystem_integrated/LCCS/LCCS/CalcLCCS_lateral_control_main/lateral_control/Compute_Feed_Forward"
 /begin REF_CHARACTERISTIC KfLCCS_cf KfLCCS_cr KfLCCS_d_lf KfLCCS_d_lr KfLCCS_d_wheel_base KfLCCS_mass /end REF_CHARACTERISTIC
/end GROUP
/begin GROUP S56_slowpath_steer_PI "LCCS_subsystem_integrated/LCCS/LCCS/CalcLCCS_lateral_control_main/lateral_control/slowpath_steer_PI" /begin REF_CHARACTERISTIC KfLCCS_d_LateralErrorDeadBand KfLCCS_t_SampleTime /end REF_CHARACTERISTIC
 /begin REF_MEASUREMENT VfLCCS_slowpath_steer_I VfLCCS_slowpath_steer_P VfLCCS_slowpath_steer_PI /end REF_MEASUREMENT
/end GROUP
/begin GROUP S57_angular_vel_limit "LCCS_subsystem_integrated/LCCS/LCCS/CalcLCCS_lateral_control_main/steering_wheel_angle/angular_vel_limit"
 /begin SUB_GROUP S79_frontwheel_2_steeringwheel S79_rate_limit S79_steering_angle_limit /end SUB_GROUP
/end GROUP
/begin GROUP S79_frontwheel_2_steeringwheel "LCCS_subsystem_integrated/LCCS/LCCS/CalcLCCS_lateral_control_main/steering_wheel_angle/angular_vel_limit/frontwheel_2_steeringwheel"
 /begin REF_CHARACTERISTIC KfLCCS_Ang_steering_center_position KfLCCS_r_veh_strwhl_2_frtwhl_ratio /end REF_CHARACTERISTIC
 /begin REF_MEASUREMENT VfLCCS_veh_strwhl_angle_des /end REF_MEASUREMENT
/end GROUP
/begin GROUP S79_rate_limit "LCCS_subsystem_integrated/LCCS/LCCS/CalcLCCS_lateral_control_main/steering_wheel_angle/angular_vel_limit/rate_limit" /begin REF_CHARACTERISTIC KfLCCS_r_steering_rate_forward_gain /end REF_CHARACTERISTIC
 /begin REF_MEASUREMENT VfLCCS_frtwhl_angle_step_limit VfLCCS_veh_frtwhl_angle_des_ramped /end REF_MEASUREMENT
/end GROUP
/begin GROUP S79_steering_angle_limit "LCCS_subsystem_integrated/LCCS/LCCS/CalcLCCS_lateral_control_main/steering_wheel_angle/angular_vel_limit/steering_angle_limit"
 /begin REF_CHARACTERISTIC KfLCCS_r_veh_strwhl_2_frtwhl_ratio KfLCCS_t_SampleTime KtLCCS_Ang_steering_angle_max KtLCCS_Ang_steering_angle_step KtLCCS_Ang_steering_angle_step_engaging /end REF_CHARACTERISTIC
 /begin REF_MEASUREMENT VfLCCS_frtwhl_angle_limit_manual /end REF_MEASUREMENT
/end GROUP
/begin GROUP LCAS_subsystem_integrated "LCAS_subsystem_integrated" ROOT /begin SUB_GROUP Root_LCAS_Subsystem /end SUB_GROUP /end GROUP
/begin GROUP Root_LCAS_Subsystem "LCAS_subsystem_integrated/LCAS_Subsystem"
 /begin SUB_GROUP S1_CalcLLCAEnabledSubsystem S1_CalcRLCAEnabledSubsystem S1_DtmnLCAEnabledSubsystem S1_LCAS_input_Subsystem S1_LCAS_output_Subsystem /end SUB_GROUP
/end GROUP
/begin GROUP S1_CalcLLCAEnabledSubsystem "LCAS_subsystem_integrated/LCAS_Subsystem/CalcLLCAEnabledSubsystem" /begin REF_MEASUREMENT VeLCAS_left_warning_status ViLCAS_cvwL ViLCAS_cvwL_ID /end REF_MEASUREMENT /end GROUP
/begin GROUP S1_CalcRLCAEnabledSubsystem "LCAS_subsystem_integrated/LCAS_Subsystem/CalcRLCAEnabledSubsystem" /begin REF_MEASUREMENT VeLCAS_right_warning_status ViLCAS_cvwR ViLCAS_cvwR_ID /end REF_MEASUREMENT /end GROUP
/begin GROUP S1_DtmnLCAEnabledSubsystem "LCAS_subsystem_integrated/LCAS_Subsystem/DtmnLCAEnabledSubsystem" /begin REF_CHARACTERISTIC KbLCAS_Sensor_Error KbLCAS_Sensor_Work /end REF_CHARACTERISTIC /end GROUP
/begin GROUP S1_LCAS_input_Subsystem "LCAS_subsystem_integrated/LCAS_Subsystem/LCAS_input_Subsystem"
 /begin SUB_GROUP S5_LCAS_Calibration_Subsystem S5_LCAS_CvrtInput_Subsystem S5_LCAS_CvrtObtVecFunctionEnabled /end SUB_GROUP
/end GROUP
/begin GROUP S1_LCAS_output_Subsystem "LCAS_subsystem_integrated/LCAS_Subsystem/LCAS_output_Subsystem"
 /begin REF_MEASUREMENT VeLCAS_active_status VeLCAS_left_warning_status_out VeLCAS_right_warning_status_out /end REF_MEASUREMENT
/end GROUP
/begin GROUP S5_LCAS_Calibration_Subsystem "LCAS_subsystem_integrated/LCAS_Subsystem/LCAS_input_Subsystem/LCAS_Calibration_Subsystem"
 /begin REF_CHARACTERISTIC KbLCAS_Switch KbLCAS_configLCA KfLCAS_Ang_DisbleStrAngleThrshMax KfLCAS_Ang_EnbleStrAngleThrshMax KfLCAS_c_DisbleCurveThrshMax KfLCAS_c_EnbleCurveThrshMax KfLCAS_d_CVLargerZone_FarDis KfLCAS_d_CVLargerZone_FrontDis KfLCAS_d_CVLargerZone_NearDis KfLCAS_d_CVZone_FarDis KfLCAS_d_CVZone_FrontDis KfLCAS_d_CVZone_NearDis KfLCAS_d_VehCenterFront KfLCAS_d_VehCenterRear KfLCAS_d_VehLenth KfLCAS_d_VehWidth KfLCAS_r_ObtWidthProportion KfLCAS_t_TTCLargerThrsh_LowLevel KfLCAS_t_TTCThrshLowLevel KfLCAS_t_WarnSustainedTime KfLCAS_v_DisbleVehSpdThrshHi KfLCAS_v_DisbleVehSpdThrshLo KfLCAS_v_EnbleVehSpdThrshHi KfLCAS_v_EnbleVehSpdThrshLo KfLCAS_v_LatSpdThr KfLCAS_v_staticSpdThr /end REF_CHARACTERISTIC
/end GROUP
/begin GROUP S5_LCAS_CvrtInput_Subsystem "LCAS_subsystem_integrated/LCAS_Subsystem/LCAS_input_Subsystem/LCAS_CvrtInput_Subsystem" /begin REF_CHARACTERISTIC KbLCAS_curve /end REF_CHARACTERISTIC /begin REF_MEASUREMENT VfLCAS_curvature VfLCAS_gear_in VfLCAS_speed_in /end REF_MEASUREMENT /end GROUP
/begin GROUP S5_LCAS_CvrtObtVecFunctionEnabled "LCAS_subsystem_integrated/LCAS_Subsystem/LCAS_input_Subsystem/LCAS_CvrtObtVecFunctionEnabled" /begin REF_MEASUREMENT VaLCAS_Obt VnLCAS_num_L VnLCAS_num_R /end REF_MEASUREMENT /end GROUP
/begin GROUP BSDS_subsystem_integrated "BSDS_subsystem_integrated" ROOT /begin SUB_GROUP Root_BSDS_Subsystem /end SUB_GROUP /end GROUP
/begin GROUP Root_BSDS_Subsystem "BSDS_subsystem_integrated/BSDS_Subsystem"
 /begin SUB_GROUP S1_CalcLBSDEnabledSubsystem S1_CalcRBSDEnabledSubsystem S1_DtmnEnabledSubsystem S1_input_Subsystem S1_output_Subsystem /end SUB_GROUP
/end GROUP
/begin GROUP S1_CalcLBSDEnabledSubsystem "BSDS_subsystem_integrated/BSDS_Subsystem/CalcLBSDEnabledSubsystem"
 /begin REF_MEASUREMENT VeBSDS_left_warning_status ViBSDS_bswL ViBSDS_bswLL ViBSDS_bswL_ID /end REF_MEASUREMENT
/end GROUP
/begin GROUP S1_CalcRBSDEnabledSubsystem "BSDS_subsystem_integrated/BSDS_Subsystem/CalcRBSDEnabledSubsystem" /begin REF_MEASUREMENT VeBSDS_right_warning_status ViBSDS_bswR ViBSDS_bswR_ID /end REF_MEASUREMENT /end GROUP
/begin GROUP S1_DtmnEnabledSubsystem "BSDS_subsystem_integrated/BSDS_Subsystem/DtmnEnabledSubsystem" /begin REF_CHARACTERISTIC KbBSDS_Sensor_Error KbBSDS_Sensor_Work /end REF_CHARACTERISTIC /end GROUP
/begin GROUP S1_input_Subsystem "BSDS_subsystem_integrated/BSDS_Subsystem/input_Subsystem"
 /begin SUB_GROUP S5_Calibration_Subsystem S5_CvrtInput_Subsystem S5_CvrtObtVecFunctionEnabled /end SUB_GROUP
/end GROUP
/begin GROUP S1_output_Subsystem "BSDS_subsystem_integrated/BSDS_Subsystem/output_Subsystem"
 /begin REF_MEASUREMENT VeBSDS_active_status VeBSDS_left_warning_status_out VeBSDS_right_warning_status_out /end REF_MEASUREMENT
/end GROUP
/begin GROUP S5_Calibration_Subsystem "BSDS_subsystem_integrated/BSDS_Subsystem/input_Subsystem/Calibration_Subsystem"
 /begin REF_CHARACTERISTIC KbBSDS_Switch KbBSDS_configBSD KfBSDS_Ang_DisbleStrAngleThrshMax KfBSDS_Ang_EnbleStrAngleThrshMax KfBSDS_c_DisbleCurveThrshMax KfBSDS_c_EnbleCurveThrshMax KfBSDS_d_BSDLargerZone_BackDis KfBSDS_d_BSDLargerZone_FarDis KfBSDS_d_BSDLargerZone_FrontDis KfBSDS_d_BSDLargerZone_NearDis KfBSDS_d_BSDZone_BackDis KfBSDS_d_BSDZone_Eye95Dis KfBSDS_d_BSDZone_FarDis KfBSDS_d_BSDZone_FrontDis KfBSDS_d_BSDZone_NearDis KfBSDS_d_VehCenterFront KfBSDS_d_VehCenterRear KfBSDS_d_VehLenth KfBSDS_d_VehWidth KfBSDS_r_ObtWidthProportion KfBSDS_t_WarnSustainedTime KfBSDS_v_DisbleVehSpdThrshHi KfBSDS_v_DisbleVehSpdThrshLo KfBSDS_v_EnbleVehSpdThrshHi KfBSDS_v_EnbleVehSpdThrshLo KfBSDS_v_LatSpdThr KfBSDS_v_OncomRelSpdThrshHi_in KfBSDS_v_OncomRelSpdThrshHi_out KfBSDS_v_staticSpdThr /end REF_CHARACTERISTIC
/end GROUP
/begin GROUP S5_CvrtInput_Subsystem "BSDS_subsystem_integrated/BSDS_Subsystem/input_Subsystem/CvrtInput_Subsystem" /begin REF_CHARACTERISTIC KbBSDS_curve /end REF_CHARACTERISTIC
 /begin REF_MEASUREMENT VeBSDS_LturnON VeBSDS_RturnON VfBSDS_curvature VfBSDS_gear_in VfBSDS_speed_in /end REF_MEASUREMENT
/end GROUP
/begin GROUP S5_CvrtObtVecFunctionEnabled "BSDS_subsystem_integrated/BSDS_Subsystem/input_Subsystem/CvrtObtVecFunctionEnabled"
 /begin REF_MEASUREMENT VaLCWS_Obt VaLCWS_Vx_in VaLCWS_Vy_in VaLCWS_heading_in VaLCWS_id_in VaLCWS_motion_status_in VaLCWS_nearest_point_rel_x_in VaLCWS_nearest_point_rel_y_in VaLCWS_obt_lenth_in VaLCWS_obt_width_in VaLCWS_orientation_in VaLCWS_position_zone_in VaLCWS_type_in VaLCWS_x_in VaLCWS_y_in VfBSDS_veh_vx VnLCWS_num_L VnLCWS_num_R VnLCWS_num_in /end REF_MEASUREMENT
/end GROUP
/begin GROUP LDWS_subsystem_integrated "LDWS_subsystem_integrated" ROOT /begin SUB_GROUP Root_LDWS_subsystem_integrated /end SUB_GROUP /end GROUP
/begin GROUP Root_LDWS_subsystem_integrated "LDWS_subsystem_integrated/LDWS_subsystem_integrated"
 /begin SUB_GROUP S1_Derivation S1_EnablingManager_LDW S1_LnMkrFilter_LDW S1_OutputManager_LDW S1_Road_Enable_Estimator_LDW S1_SuppressionManager_LDW S1_TriggerManager_LDW S1_WarningManager_LDW /end SUB_GROUP
/end GROUP
/begin GROUP S1_Derivation "LDWS_subsystem_integrated/LDWS_subsystem_integrated/Derivation" /begin REF_MEASUREMENT VfLDWS_SteerAngleRate /end REF_MEASUREMENT /end GROUP
/begin GROUP S1_EnablingManager_LDW "LDWS_subsystem_integrated/LDWS_subsystem_integrated/EnablingManager_LDW" /begin SUB_GROUP S3_ResetCondition S3_SR_FF S3_SetCondition /end SUB_GROUP
 /begin REF_CHARACTERISTIC KfLDWS_c_CurvLwrBnd KfLDWS_c_CurvUprBnd KfLDWS_d_LnWidthLwrBnd KfLDWS_d_LnWidthUprBnd KfLDWS_v_SpdLwrBnd KfLDWS_v_SpdUprBnd /end REF_CHARACTERISTIC
 /begin REF_MEASUREMENT VbLDWS_CurvValid VbLDWS_LnMkrValid VbLDWS_SpdRngValid VbLDWS_WidthValid /end REF_MEASUREMENT
/end GROUP
/begin GROUP S1_LnMkrFilter_LDW "LDWS_subsystem_integrated/LDWS_subsystem_integrated/LnMkrFilter_LDW" /begin SUB_GROUP S4_Filter_Left S4_Filter_Right /end SUB_GROUP
 /begin REF_MEASUREMENT VfLDWS_BackToLeDist VfLDWS_Curvature VfLDWS_LeC1Filtd VfLDWS_RiC1Filtd /end REF_MEASUREMENT
/end GROUP
/begin GROUP S1_OutputManager_LDW "LDWS_subsystem_integrated/LDWS_subsystem_integrated/OutputManager_LDW" /begin REF_MEASUREMENT VbLDWS_WrnSt VeLDWS_LaDetecSt VeLDWS_WrnSd /end REF_MEASUREMENT /end GROUP
/begin GROUP S1_Road_Enable_Estimator_LDW "LDWS_subsystem_integrated/LDWS_subsystem_integrated/Road_Enable_Estimator_LDW" /begin SUB_GROUP S6_Subsystem S6_Subsystem1 /end SUB_GROUP /end GROUP
/begin GROUP S1_SuppressionManager_LDW "LDWS_subsystem_integrated/LDWS_subsystem_integrated/SuppressionManager_LDW" /begin SUB_GROUP S7_DtrmnSuppLe S7_DtrmnSuppRi /end SUB_GROUP /begin REF_CHARACTERISTIC KbLDWS_SuppLeSwitch KbLDWS_SuppRiSwitch /end REF_CHARACTERISTIC
 /begin REF_MEASUREMENT VfLDWS_LeIndicatorSt VfLDWS_RiIndicatorSt VfLDWS_SteerTorque /end REF_MEASUREMENT
/end GROUP
/begin GROUP S1_TriggerManager_LDW "LDWS_subsystem_integrated/LDWS_subsystem_integrated/TriggerManager_LDW"
 /begin SUB_GROUP S8_DtrmnActLe S8_DtrmnActRi S8_LanePositionConstraint S8_LeadDirectionCondition S8_TTLCondition S8_ThetaCalc S8_VehicleToBdlnCalc /end SUB_GROUP
 /begin REF_MEASUREMENT VbLDWS_ActLeLDW VbLDWS_ActRiLDW VfLDWS_BackToRiDist VfLDWS_SteerAngle VfLDWS_Vx VfLDWS_Vy /end REF_MEASUREMENT
/end GROUP
/begin GROUP S1_WarningManager_LDW "LDWS_subsystem_integrated/LDWS_subsystem_integrated/WarningManager_LDW"
 /begin REF_CHARACTERISTIC KbLDWS_EnableSwitch KcLDWS_CntSample KfLDWS_t_CntMaxWarnHold KfLDWS_t_CntMinWarnHold KfLDWS_t_CntOnHold /end REF_CHARACTERISTIC
 /begin REF_MEASUREMENT VeLDWS_OnStateSt VeLDWS_SysSt /end REF_MEASUREMENT
/end GROUP
/begin GROUP S3_ResetCondition "LDWS_subsystem_integrated/LDWS_subsystem_integrated/EnablingManager_LDW/ResetCondition"
 /begin REF_CHARACTERISTIC KcLDWS_CntSample KfLDWS_t_CurvNotValidTime KfLDWS_t_LnMkrNotValidTime KfLDWS_t_LnWidthNotValidTime KfLDWS_t_SpdRngNotValidTime /end REF_CHARACTERISTIC
/end GROUP
/begin GROUP S3_SR_FF "LDWS_subsystem_integrated/LDWS_subsystem_integrated/EnablingManager_LDW/SR_FF" /begin REF_MEASUREMENT VbLDWS_EnabledLDW /end REF_MEASUREMENT /end GROUP
/begin GROUP S3_SetCondition "LDWS_subsystem_integrated/LDWS_subsystem_integrated/EnablingManager_LDW/SetCondition"
 /begin REF_CHARACTERISTIC KcLDWS_CntSample KfLDWS_t_CurvValidTime KfLDWS_t_LnMkrValidTime KfLDWS_t_LnWidthValidTime KfLDWS_t_SpdRngValidTime /end REF_CHARACTERISTIC
/end GROUP
/begin GROUP S4_Filter_Left "LDWS_subsystem_integrated/LDWS_subsystem_integrated/LnMkrFilter_LDW/Filter_Left" /begin REF_MEASUREMENT VfLDWS_LeC0Filtd /end REF_MEASUREMENT /end GROUP
/begin GROUP S4_Filter_Right "LDWS_subsystem_integrated/LDWS_subsystem_integrated/LnMkrFilter_LDW/Filter_Right" /begin REF_MEASUREMENT VfLDWS_RiC0Filtd /end REF_MEASUREMENT /end GROUP
/begin GROUP S6_Subsystem "LDWS_subsystem_integrated/LDWS_subsystem_integrated/Road_Enable_Estimator_LDW/Subsystem" /begin REF_CHARACTERISTIC KcLDWS_CntSample KfLDWS_r_LaMkrQlt KfLDWS_t_LnMkrMissThrsh /end REF_CHARACTERISTIC /begin REF_MEASUREMENT VbLDWS_RdEnblLe /end REF_MEASUREMENT /end GROUP
/begin GROUP S6_Subsystem1 "LDWS_subsystem_integrated/LDWS_subsystem_integrated/Road_Enable_Estimator_LDW/Subsystem1" /begin REF_CHARACTERISTIC KcLDWS_CntSample KfLDWS_r_LaMkrQlt KfLDWS_t_LnMkrMissThrsh /end REF_CHARACTERISTIC /begin REF_MEASUREMENT VbLDWS_RdEnblRi /end REF_MEASUREMENT /end GROUP
/begin GROUP S7_DtrmnSuppLe "LDWS_subsystem_integrated/LDWS_subsystem_integrated/SuppressionManager_LDW/DtrmnSuppLe"
 /begin REF_CHARACTERISTIC KcLDWS_CntSample KfLDWS_Ang_SuppSteerAngThrsh KfLDWS_M_SuppTorque KfLDWS_t_SuppIndiTime KfLDWS_t_SuppSteerAngTime KfLDWS_t_SuppSteerRateTime KfLDWS_t_SuppTorqueTime KfLDWS_v_SuppSteerRateThrsh /end REF_CHARACTERISTIC
 /begin REF_MEASUREMENT VbLDWS_SuppLe /end REF_MEASUREMENT
/end GROUP
/begin GROUP S7_DtrmnSuppRi "LDWS_subsystem_integrated/LDWS_subsystem_integrated/SuppressionManager_LDW/DtrmnSuppRi"
 /begin REF_CHARACTERISTIC KcLDWS_CntSample KfLDWS_Ang_SuppSteerAngThrsh KfLDWS_M_SuppTorque KfLDWS_t_SuppIndiTime KfLDWS_t_SuppSteerAngTime KfLDWS_t_SuppSteerRateTime KfLDWS_t_SuppTorqueTime KfLDWS_v_SuppSteerRateThrsh /end REF_CHARACTERISTIC
 /begin REF_MEASUREMENT VbLDWS_SuppRi /end REF_MEASUREMENT
/end GROUP
/begin GROUP S8_DtrmnActLe "LDWS_subsystem_integrated/LDWS_subsystem_integrated/TriggerManager_LDW/DtrmnActLe" /begin REF_CHARACTERISTIC KfLDWS_t_TLCThrsh /end REF_CHARACTERISTIC /end GROUP
/begin GROUP S8_DtrmnActRi "LDWS_subsystem_integrated/LDWS_subsystem_integrated/TriggerManager_LDW/DtrmnActRi" /begin REF_CHARACTERISTIC KfLDWS_t_TLCThrsh /end REF_CHARACTERISTIC /end GROUP
/begin GROUP S8_LanePositionConstraint "LDWS_subsystem_integrated/LDWS_subsystem_integrated/TriggerManager_LDW/LanePositionConstraint" /begin SUB_GROUP S46_DtrmnIsOnLeLine S46_DtrmnIsOnRiLine /end SUB_GROUP /end GROUP
/begin GROUP S8_LeadDirectionCondition "LDWS_subsystem_integrated/LDWS_subsystem_integrated/TriggerManager_LDW/LeadDirectionCondition" /begin REF_MEASUREMENT VbLDWS_LeadDrctn /end REF_MEASUREMENT /end GROUP
/begin GROUP S8_TTLCondition "LDWS_subsystem_integrated/LDWS_subsystem_integrated/TriggerManager_LDW/TTLCondition" /begin SUB_GROUP S48_TLC_calculation S48_v_lat_calculation /end SUB_GROUP /end GROUP
/begin GROUP S8_ThetaCalc "LDWS_subsystem_integrated/LDWS_subsystem_integrated/TriggerManager_LDW/ThetaCalc" /begin REF_CHARACTERISTIC KbLDWS_ThetaSwitch /end REF_CHARACTERISTIC /begin REF_MEASUREMENT VfLDWS_Theta /end REF_MEASUREMENT /end GROUP
/begin GROUP S8_VehicleToBdlnCalc "LDWS_subsystem_integrated/LDWS_subsystem_integrated/TriggerManager_LDW/VehicleToBdlnCalc"
 /begin REF_CHARACTERISTIC KfLDWS_Ang_BkToCnrAng KfLDWS_c_CurvUprBnd KfLDWS_d_BkToFrtCnrDist KfLDWS_d_EdgBuff KfLDWS_k_CurvBuffCoe /end REF_CHARACTERISTIC
 /begin REF_MEASUREMENT VfLDWS_EdgeLaneLe VfLDWS_EdgeLaneRi /end REF_MEASUREMENT
/end GROUP
/begin GROUP S46_DtrmnIsOnLeLine "LDWS_subsystem_integrated/LDWS_subsystem_integrated/TriggerManager_LDW/LanePositionConstraint/DtrmnIsOnLeLine"
 /begin REF_CHARACTERISTIC KfLDWS_d_WarnLineLvlOne KfLDWS_d_WarnLineLvlThree KfLDWS_k_WarnLineLvlTwo /end REF_CHARACTERISTIC
 /begin REF_MEASUREMENT VbLDWS_IsOnLeLine /end REF_MEASUREMENT
/end GROUP
/begin GROUP S46_DtrmnIsOnRiLine "LDWS_subsystem_integrated/LDWS_subsystem_integrated/TriggerManager_LDW/LanePositionConstraint/DtrmnIsOnRiLine"
 /begin REF_CHARACTERISTIC KfLDWS_d_WarnLineLvlOne KfLDWS_d_WarnLineLvlThree KfLDWS_k_WarnLineLvlTwo /end REF_CHARACTERISTIC
 /begin REF_MEASUREMENT VbLDWS_IsOnRiLine /end REF_MEASUREMENT
/end GROUP
/begin GROUP S48_TLC_calculation "LDWS_subsystem_integrated/LDWS_subsystem_integrated/TriggerManager_LDW/TTLCondition/TLC_calculation" /begin REF_MEASUREMENT VfLDWS_TLCLe VfLDWS_TLCRi /end REF_MEASUREMENT /end GROUP
/begin GROUP S48_v_lat_calculation "LDWS_subsystem_integrated/LDWS_subsystem_integrated/TriggerManager_LDW/TTLCondition/v_lat_calculation" /begin REF_MEASUREMENT VfLDWS_VLatLe VfLDWS_VLatRi /end REF_MEASUREMENT /end GROUP
/begin GROUP AEBD_subsystem_integrated "AEBD_subsystem_integrated" ROOT /begin SUB_GROUP Root_AEBD_Subsystem /end SUB_GROUP /end GROUP
/end MODULE
/end PROJECT
