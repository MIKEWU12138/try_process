ASAP2_VERSION 1 60
/begin PROJECT hj_adcu "_default_ProjectLongIdentifier"
/begin HEADER "_default_HeaderComment" PROJECT_NO _default_ProjectNr /end HEADER
/begin MODULE _default_ModuleName "_default_ModuleLongIdentifier"
/begin MOD_COMMON "_default_ModCommonComment" DEPOSIT ABSOLUTE BYTE_ORDER MSB_LAST ALIGNMENT_BYTE 1 ALIGNMENT_WORD 2 ALIGNMENT_LONG 4 ALIGNMENT_FLOAT32_IEEE 4 ALIGNMENT_FLOAT64_IEEE 4 /end MOD_COMMON
/begin MOD_COMMON "Mod Common Comment Here" BYTE_ORDER MSB_LAST /end MOD_COMMON
/begin RECORD_LAYOUT Scalar_BOOLEAN FNC_VALUES 1 UBYTE COLUMN_DIR DIRECT /end RECORD_LAYOUT
/begin RECORD_LAYOUT Scalar_UBYTE FNC_VALUES 1 UBYTE COLUMN_DIR DIRECT /end RECORD_LAYOUT
/begin RECORD_LAYOUT Scalar_UWORD FNC_VALUES 1 UWORD COLUMN_DIR DIRECT /end RECORD_LAYOUT
/begin RECORD_LAYOUT Scalar_FLOAT32_IEEE FNC_VALUES 1 FLOAT32_IEEE COLUMN_DIR DIRECT /end RECORD_LAYOUT
/begin RECORD_LAYOUT Lookup1D_FLOAT32_IEEE FNC_VALUES 1 FLOAT32_IEEE COLUMN_DIR DIRECT /end RECORD_LAYOUT
/begin RECORD_LAYOUT Lookup1D_X_FLOAT32_IEEE AXIS_PTS_X 1 FLOAT32_IEEE INDEX_INCR DIRECT /end RECORD_LAYOUT
/begin RECORD_LAYOUT Lookup2D_UBYTE FNC_VALUES 1 UBYTE COLUMN_DIR DIRECT /end RECORD_LAYOUT
/begin RECORD_LAYOUT Lookup2D_X_UBYTE AXIS_PTS_X 1 UBYTE INDEX_INCR DIRECT /end RECORD_LAYOUT
/begin RECORD_LAYOUT Lookup2D_BYTE FNC_VALUES 1 SBYTE COLUMN_DIR DIRECT /end RECORD_LAYOUT
/begin RECORD_LAYOUT Lookup2D_X_BYTE AXIS_PTS_X 1 SBYTE INDEX_INCR DIRECT /end RECORD_LAYOUT
/begin RECORD_LAYOUT Lookup2D_UWORD FNC_VALUES 1 UWORD COLUMN_DIR DIRECT /end RECORD_LAYOUT
/begin RECORD_LAYOUT Lookup2D_X_UWORD AXIS_PTS_X 1 UWORD INDEX_INCR DIRECT /end RECORD_LAYOUT
/begin RECORD_LAYOUT Lookup2D_WORD FNC_VALUES 1 SWORD COLUMN_DIR DIRECT /end RECORD_LAYOUT
/begin RECORD_LAYOUT Lookup2D_X_WORD AXIS_PTS_X 1 SWORD INDEX_INCR DIRECT /end RECORD_LAYOUT
/begin RECORD_LAYOUT Lookup2D_ULONG FNC_VALUES 1 ULONG COLUMN_DIR DIRECT /end RECORD_LAYOUT
/begin RECORD_LAYOUT Lookup2D_X_ULONG AXIS_PTS_X 1 ULONG INDEX_INCR DIRECT /end RECORD_LAYOUT
/begin RECORD_LAYOUT Lookup2D_LONG FNC_VALUES 1 SLONG COLUMN_DIR DIRECT /end RECORD_LAYOUT
/begin RECORD_LAYOUT Lookup2D_X_LONG AXIS_PTS_X 1 SLONG INDEX_INCR DIRECT /end RECORD_LAYOUT
/begin RECORD_LAYOUT Lookup2D_FLOAT32_IEEE FNC_VALUES 1 FLOAT32_IEEE COLUMN_DIR DIRECT /end RECORD_LAYOUT
/begin RECORD_LAYOUT Lookup2D_X_FLOAT32_IEEE AXIS_PTS_X 1 FLOAT32_IEEE INDEX_INCR DIRECT /end RECORD_LAYOUT
/begin RECORD_LAYOUT Lookup2D_FLOAT64_IEEE FNC_VALUES 1 FLOAT64_IEEE COLUMN_DIR DIRECT /end RECORD_LAYOUT
/begin RECORD_LAYOUT Lookup2D_X_FLOAT64_IEEE AXIS_PTS_X 1 FLOAT64_IEEE INDEX_INCR DIRECT /end RECORD_LAYOUT
/begin CHARACTERISTIC KtACCS_t_CalOpenAccelForStopFrmDCSN "Want how long to stop the vehicle" CURVE 0x70100034 /* @ECU_Address@KtACCS_t_CalOpenAccelForStopFrmDCSN@ */ Lookup1D_FLOAT32_IEEE 0 ACCS_subsystem_integrated_CM_single_s 0.0 1200.0
 /begin AXIS_DESCR COM_AXIS NO_INPUT_QUANTITY ACCS_subsystem_integrated_CM_single_m 6 0.0 200.0 AXIS_PTS_REF KtACCS_AXIS_OpenAccelStop_StopDis /end AXIS_DESCR
/end CHARACTERISTIC
/begin CHARACTERISTIC KtACCS_a_OpenAccel_SpeedCtrl "This is open acceleration table under speed control mode,it is the function of speed error" CURVE 0x701009f4 /* @ECU_Address@KtACCS_a_OpenAccel_SpeedCtrl@ */ Lookup1D_FLOAT32_IEEE 0 ACCS_subsystem_integrated_CM_single_m_s2 -4.0 4.0
 /begin AXIS_DESCR COM_AXIS NO_INPUT_QUANTITY ACCS_subsystem_integrated_CM_single_m_s 7 -30.0 30.0 AXIS_PTS_REF KtACCS_AXIS_OpenAccelSpedCtrl_SpedErr /end AXIS_DESCR
/end CHARACTERISTIC
/begin CHARACTERISTIC KtACCS_a_OpenAccel_LowSpeedCtrl "his is open acceleration table under low speed control mode,it is the function of speed error" CURVE 0x70100a10 /* @ECU_Address@KtACCS_a_OpenAccel_LowSpeedCtrl@ */ Lookup1D_FLOAT32_IEEE 0 ACCS_subsystem_integrated_CM_single_m_s2 -4.0 4.0
 /begin AXIS_DESCR COM_AXIS NO_INPUT_QUANTITY ACCS_subsystem_integrated_CM_single_m_s 7 -45.0 45.0 AXIS_PTS_REF KtACCS_AXIS_OpenAccelLowSpedCtrl_SpedErr /end AXIS_DESCR
/end CHARACTERISTIC
/begin CHARACTERISTIC KtACCS_a_OpenAccel_Launch "This is open acceleration table under launch control mode,it is the function of Ego current speed" CURVE 0x70100a2c /* @ECU_Address@KtACCS_a_OpenAccel_Launch@ */ Lookup1D_FLOAT32_IEEE 0 ACCS_subsystem_integrated_CM_single_m_s2 -4.0 4.0
 /begin AXIS_DESCR COM_AXIS NO_INPUT_QUANTITY ACCS_subsystem_integrated_CM_single_m_s 6 0.0 50.0 AXIS_PTS_REF KtACCS_AXIS_OpenAccelLaunch_CurSpd /end AXIS_DESCR
/end CHARACTERISTIC
/begin CHARACTERISTIC KtACCS_a_StopStatus_Accel "When KbACCS_UseStopStatus_Accel=true, accel will be form this cal during status is Stop.This cal is the function of pitch" CURVE 0x701009cc /* @ECU_Address@KtACCS_a_StopStatus_Accel@ */ Lookup1D_FLOAT32_IEEE 0 ACCS_subsystem_integrated_CM_single_m_s2 -4.0 0.0
 /begin AXIS_DESCR COM_AXIS NO_INPUT_QUANTITY ACCS_subsystem_integrated_CM_single_deg 10 0.0 90.0 AXIS_PTS_REF KtACCS_AXIS_StopStatus_Accel_Pitch /end AXIS_DESCR
/end CHARACTERISTIC
/begin CHARACTERISTIC KfLDWS_Ang_BkToCnrAng "The angle X axis and the line connecting center of rear axle and front tire." VALUE 0x70102c54 /* @ECU_Address@KfLDWS_Ang_BkToCnrAng@ */ Scalar_FLOAT32_IEEE 0 LDWS_subsystem_integrated_CM_single_rad 0.0 1.5707963267948966 /end CHARACTERISTIC
/begin CHARACTERISTIC KfLDWS_Ang_SuppSteerAngThrsh "The suppression threshold for Steer Angle" VALUE 0x70102c50 /* @ECU_Address@KfLDWS_Ang_SuppSteerAngThrsh@ */ Scalar_FLOAT32_IEEE 0 LDWS_subsystem_integrated_CM_single__ 0.0 360.0 /end CHARACTERISTIC
/begin CHARACTERISTIC KfLDWS_M_SuppTorque "The torque limit that could be treated as suppression" VALUE 0x70102c4c /* @ECU_Address@KfLDWS_M_SuppTorque@ */ Scalar_FLOAT32_IEEE 0 LDWS_subsystem_integrated_CM_single_NM 0.0 10.0 /end CHARACTERISTIC
/begin CHARACTERISTIC KfLDWS_d_BkToFrtCnrDist "The distance between one fo the front tires to the center of rear axle." VALUE 0x70102c40 /* @ECU_Address@KfLDWS_d_BkToFrtCnrDist@ */ Scalar_FLOAT32_IEEE 0 LDWS_subsystem_integrated_CM_single_m 0.0 20.0 /end CHARACTERISTIC
/begin CHARACTERISTIC KfLDWS_d_EdgBuff "The edge buffer that added to the calcualted distance to lane markers" VALUE 0x70102c3c /* @ECU_Address@KfLDWS_d_EdgBuff@ */ Scalar_FLOAT32_IEEE 0 LDWS_subsystem_integrated_CM_single_m -2.0 2.0 /end CHARACTERISTIC
/begin CHARACTERISTIC KfLDWS_d_WarnLineLvlOne "When vehicle speed is higher than 1.0m/s, the earliest warning line shall be placed no more than 1.5m inside the lane boundary." VALUE 0x70102c30 /* @ECU_Address@KfLDWS_d_WarnLineLvlOne@ */ Scalar_FLOAT32_IEEE 0 LDWS_subsystem_integrated_CM_single_m 0.0 1.5 /end CHARACTERISTIC
/begin CHARACTERISTIC KfLDWS_d_WarnLineLvlThree "When vehicle speed is not higher than 0.5 m/s, the earliest warning line shall be placed no more than 0.75m inside the lane boundary." VALUE 0x70102c2c /* @ECU_Address@KfLDWS_d_WarnLineLvlThree@ */ Scalar_FLOAT32_IEEE 0 LDWS_subsystem_integrated_CM_single_m 0.0 0.75 /end CHARACTERISTIC
/begin CHARACTERISTIC KfLDWS_k_CurvBuffCoe "The coefficient that multiples the distance to lanemarker when the vehicle is driving under large curavture." VALUE 0x70102c28 /* @ECU_Address@KfLDWS_k_CurvBuffCoe@ */ Scalar_FLOAT32_IEEE 0 LDWS_subsystem_integrated_CM_single 0.0 2.0 /end CHARACTERISTIC
/begin CHARACTERISTIC KfLDWS_k_WarnLineLvlTwo "When vehicle speed is higher than 0.5m/s but not  higher than 1.0m/s, the earliest warning line shall be placed no more than 1.5*Va m inside the lane boundary" VALUE 0x70102c24 /* @ECU_Address@KfLDWS_k_WarnLineLvlTwo@ */ Scalar_FLOAT32_IEEE 0 LDWS_subsystem_integrated_CM_single 0.0 1.5 /end CHARACTERISTIC
/begin CHARACTERISTIC KfLDWS_t_TLCThrsh "Time to lane crossing threshold" VALUE 0x70102c20 /* @ECU_Address@KfLDWS_t_TLCThrsh@ */ Scalar_FLOAT32_IEEE 0 LDWS_subsystem_integrated_CM_single_s 0.0 2.0 /end CHARACTERISTIC
/begin CHARACTERISTIC KfLDWS_v_SuppSteerRateThrsh "The suppression threshold for Steer Rate" VALUE 0x70102c14 /* @ECU_Address@KfLDWS_v_SuppSteerRateThrsh@ */ Scalar_FLOAT32_IEEE 0 LDWS_subsystem_integrated_CM_single___s 0.0 360.0 /end CHARACTERISTIC
/begin CHARACTERISTIC KfLDWS_t_LnMkrMissThrsh "The maximum time that a lane marker could termporarily go missing" VALUE 0x70102c06 /* @ECU_Address@KfLDWS_t_LnMkrMissThrsh@ */ Scalar_UWORD 0 LDWS_subsystem_integrated_CM_uint16 0.0 1000.0 /end CHARACTERISTIC
/begin CHARACTERISTIC KfLDWS_t_SuppIndiTime "The time that indicator could be treated as suppression" VALUE 0x70102bf8 /* @ECU_Address@KfLDWS_t_SuppIndiTime@ */ Scalar_UWORD 0 LDWS_subsystem_integrated_CM_uint16 0.0 1000.0 /end CHARACTERISTIC
/begin CHARACTERISTIC KfLDWS_t_SuppSteerAngTime "The time that steer angle could be treated as suppression" VALUE 0x70102bf6 /* @ECU_Address@KfLDWS_t_SuppSteerAngTime@ */ Scalar_UWORD 0 LDWS_subsystem_integrated_CM_uint16 0.0 1000.0 /end CHARACTERISTIC
/begin CHARACTERISTIC KfLDWS_t_SuppSteerRateTime "The time that steer rate could be treated as suppression" VALUE 0x70102bf4 /* @ECU_Address@KfLDWS_t_SuppSteerRateTime@ */ Scalar_UWORD 0 LDWS_subsystem_integrated_CM_uint16 0.0 1000.0 /end CHARACTERISTIC
/begin CHARACTERISTIC KfLDWS_t_SuppTorqueTime "The time that steer toque could be treated as suppression" VALUE 0x70102bf2 /* @ECU_Address@KfLDWS_t_SuppTorqueTime@ */ Scalar_UWORD 0 LDWS_subsystem_integrated_CM_uint16 0.0 1000.0 /end CHARACTERISTIC
/begin CHARACTERISTIC KfLDWS_r_LaMkrQlt "Lane marker quality threshold" VALUE 0x70102bf0 /* @ECU_Address@KfLDWS_r_LaMkrQlt@ */ Scalar_UBYTE 0 LDWS_subsystem_integrated_CM_uint8 0.0 100.0 /end CHARACTERISTIC
/begin CHARACTERISTIC KbLDWS_ThetaSwitch "" VALUE 0x70102bec /* @ECU_Address@KbLDWS_ThetaSwitch@ */ Scalar_BOOLEAN 0 LDWS_subsystem_integrated_CM_boolean 0.0 1.0 /end CHARACTERISTIC
/begin CHARACTERISTIC KfAEBD_a_AccelDeviation "" VALUE 0x701012fc /* @ECU_Address@KfAEBD_a_AccelDeviation@ */ Scalar_FLOAT32_IEEE 0 AEBD_subsystem_integrated_CM_single 0.0 10.0 /end CHARACTERISTIC
/begin CHARACTERISTIC KcAEBD_ErrorCountThrsh "" VALUE 0x701012fa /* @ECU_Address@KcAEBD_ErrorCountThrsh@ */ Scalar_UWORD 0 AEBD_subsystem_integrated_CM_uint16 0.0 65535.0 /end CHARACTERISTIC
/begin CHARACTERISTIC KfAEBD_t_WaitTimeThrsh "" VALUE 0x701012f8 /* @ECU_Address@KfAEBD_t_WaitTimeThrsh@ */ Scalar_UBYTE 0 AEBD_subsystem_integrated_CM_uint8 0.0 200.0 /end CHARACTERISTIC
/begin CHARACTERISTIC KbAEBD_ADCU_CANError "" VALUE 0x701012f7 /* @ECU_Address@KbAEBD_ADCU_CANError@ */ Scalar_BOOLEAN 0 AEBD_subsystem_integrated_CM_boolean 0.0 1.0 /end CHARACTERISTIC
/begin CHARACTERISTIC KbAEBD_AccelerationSensorError "" VALUE 0x701012f6 /* @ECU_Address@KbAEBD_AccelerationSensorError@ */ Scalar_BOOLEAN 0 AEBD_subsystem_integrated_CM_boolean 0.0 1.0 /end CHARACTERISTIC
/begin CHARACTERISTIC KbAEBD_ESCError "" VALUE 0x701012f5 /* @ECU_Address@KbAEBD_ESCError@ */ Scalar_BOOLEAN 0 AEBD_subsystem_integrated_CM_boolean 0.0 1.0 /end CHARACTERISTIC
/begin CHARACTERISTIC KbAEBD_ErrorClear "" VALUE 0x701012f4 /* @ECU_Address@KbAEBD_ErrorClear@ */ Scalar_BOOLEAN 0 AEBD_subsystem_integrated_CM_boolean 0.0 1.0 /end CHARACTERISTIC
/begin CHARACTERISTIC KtALCA_d_RangeFrontOfCheckObstacle "" MAP 0x70101c08 /* @ECU_Address@KtALCA_d_RangeFrontOfCheckObstacle@ */ Lookup2D_FLOAT32_IEEE 0 ALCA_subsystem_integrated_CM_single 0.0 200.0
 /begin AXIS_DESCR COM_AXIS NO_INPUT_QUANTITY ALCA_subsystem_integrated_CM_single 15 -70.0 70.0 AXIS_PTS_REF KaALCA_AXIS_RelativeSpeedHost2Obstacle /end AXIS_DESCR
 /begin AXIS_DESCR COM_AXIS NO_INPUT_QUANTITY ALCA_subsystem_integrated_CM_single 8 0.0 35.0 AXIS_PTS_REF KaALCA_AXIS_VehSpeed /end AXIS_DESCR
/end CHARACTERISTIC
/begin CHARACTERISTIC KtALCA_d_RangeRearOfCheckObstacle "" MAP 0x70101a28 /* @ECU_Address@KtALCA_d_RangeRearOfCheckObstacle@ */ Lookup2D_FLOAT32_IEEE 0 ALCA_subsystem_integrated_CM_single 0.0 200.0
 /begin AXIS_DESCR COM_AXIS NO_INPUT_QUANTITY ALCA_subsystem_integrated_CM_single 15 -70.0 70.0 AXIS_PTS_REF KaALCA_AXIS_RelativeSpeedHost2Obstacle /end AXIS_DESCR
 /begin AXIS_DESCR COM_AXIS NO_INPUT_QUANTITY ALCA_subsystem_integrated_CM_single 8 0.0 35.0 AXIS_PTS_REF KaALCA_AXIS_VehSpeed /end AXIS_DESCR
/end CHARACTERISTIC
/begin CHARACTERISTIC KtALCA_r_VComfortable2VLon "" CURVE 0x7010198c /* @ECU_Address@KtALCA_r_VComfortable2VLon@ */ Lookup1D_FLOAT32_IEEE 0 ALCA_subsystem_integrated_CM_single 0.0 2.0
 /begin AXIS_DESCR COM_AXIS NO_INPUT_QUANTITY ALCA_subsystem_integrated_CM_single 18 0.0 35.0 AXIS_PTS_REF KaALCA_AXIS_VehLonSpeed /end AXIS_DESCR
/end CHARACTERISTIC
/begin CHARACTERISTIC KtALCA_r_LateralDist2LateralV "" CURVE 0x701019d4 /* @ECU_Address@KtALCA_r_LateralDist2LateralV@ */ Lookup1D_FLOAT32_IEEE 0 ALCA_subsystem_integrated_CM_single 0.0 1.0
 /begin AXIS_DESCR COM_AXIS NO_INPUT_QUANTITY ALCA_subsystem_integrated_CM_single 21 0.0 4.0 AXIS_PTS_REF KaALCA_AXIS_LateralDist2Go /end AXIS_DESCR
/end CHARACTERISTIC
/begin CHARACTERISTIC KfALCA_d_DefaultLaneLength "" VALUE 0x70101e4c /* @ECU_Address@KfALCA_d_DefaultLaneLength@ */ Scalar_FLOAT32_IEEE 0 ALCA_subsystem_integrated_CM_single_m 0.0 1000.0 /end CHARACTERISTIC
/begin CHARACTERISTIC KfALCA_d_Dist2LaneChangeFinish "Max distance for determine lane change finished." VALUE 0x70101e48 /* @ECU_Address@KfALCA_d_Dist2LaneChangeFinish@ */ Scalar_FLOAT32_IEEE 0 ALCA_subsystem_integrated_CM_single_m 0.1 3.75 /end CHARACTERISTIC
/begin CHARACTERISTIC KfALCA_d_EgoVehWheelBase "" VALUE 0x70101e44 /* @ECU_Address@KfALCA_d_EgoVehWheelBase@ */ Scalar_FLOAT32_IEEE 0 ALCA_subsystem_integrated_CM_single_m -3.4E+38 3.4E+38 /end CHARACTERISTIC
/begin CHARACTERISTIC KfALCA_d_EgoVehWidth "The width of EGO." VALUE 0x70101e40 /* @ECU_Address@KfALCA_d_EgoVehWidth@ */ Scalar_FLOAT32_IEEE 0 ALCA_subsystem_integrated_CM_single_m 1.5 5.0 /end CHARACTERISTIC
/begin CHARACTERISTIC KfALCA_d_EnterSecondStageThrsh "" VALUE 0x70101e3c /* @ECU_Address@KfALCA_d_EnterSecondStageThrsh@ */ Scalar_FLOAT32_IEEE 0 ALCA_subsystem_integrated_CM_single_m 0.0 3.0 /end CHARACTERISTIC
/begin CHARACTERISTIC KfALCA_d_LaneWidthMax "Max width of lane." VALUE 0x70101e38 /* @ECU_Address@KfALCA_d_LaneWidthMax@ */ Scalar_FLOAT32_IEEE 0 ALCA_subsystem_integrated_CM_single_m 0.1 4.0 /end CHARACTERISTIC
/begin CHARACTERISTIC KfALCA_d_TouchedNewLaneDist "Min jump distance for touched new lane." VALUE 0x70101e34 /* @ECU_Address@KfALCA_d_TouchedNewLaneDist@ */ Scalar_FLOAT32_IEEE 0 ALCA_subsystem_integrated_CM_single_m 0.0 3.75 /end CHARACTERISTIC
/begin CHARACTERISTIC KfALCA_r_CoeffStrwhl2Radius "" VALUE 0x70101e30 /* @ECU_Address@KfALCA_r_CoeffStrwhl2Radius@ */ Scalar_FLOAT32_IEEE 0 ALCA_subsystem_integrated_CM_single -3.4E+38 3.4E+38 /end CHARACTERISTIC
/begin CHARACTERISTIC KfALCA_r_ComfortableVRatio "" VALUE 0x70101e2c /* @ECU_Address@KfALCA_r_ComfortableVRatio@ */ Scalar_FLOAT32_IEEE 0 ALCA_subsystem_integrated_CM_single 0.01 1.0 /end CHARACTERISTIC
/begin CHARACTERISTIC KfALCA_r_EgoVehStrwhl2FrtwhlRatio "" VALUE 0x70101e28 /* @ECU_Address@KfALCA_r_EgoVehStrwhl2FrtwhlRatio@ */ Scalar_FLOAT32_IEEE 0 ALCA_subsystem_integrated_CM_single -3.4E+38 3.4E+38 /end CHARACTERISTIC
/begin CHARACTERISTIC KfALCA_r_EgoWidth2LaneWidthRation "Target lane width must > ego_veh_width * KfALCA_r_EgoWidth2LaneWidthRation." VALUE 0x70101e24 /* @ECU_Address@KfALCA_r_EgoWidth2LaneWidthRation@ */ Scalar_FLOAT32_IEEE 0 ALCA_subsystem_integrated_CM_single 0.1 3.0 /end CHARACTERISTIC
/begin CHARACTERISTIC KfALCA_r_OutputLarteralVRatioInterrupt "" VALUE 0x70101e20 /* @ECU_Address@KfALCA_r_OutputLarteralVRatioInterrupt@ */ Scalar_FLOAT32_IEEE 0 ALCA_subsystem_integrated_CM_single 0.01 5.0 /end CHARACTERISTIC
/begin CHARACTERISTIC KfALCA_t_ExitFinishDelay "The time of wait for exit Finish state (Cooling time)." VALUE 0x70101e1c /* @ECU_Address@KfALCA_t_ExitFinishDelay@ */ Scalar_FLOAT32_IEEE 0 ALCA_subsystem_integrated_CM_single_s 0.01 3.0 /end CHARACTERISTIC
/begin CHARACTERISTIC KfALCA_t_ExitHandoverDelay "The time of wait for exit Waitting state. ALCA will inform some info to driver In Waitting state." VALUE 0x70101e18 /* @ECU_Address@KfALCA_t_ExitHandoverDelay@ */ Scalar_FLOAT32_IEEE 0 ALCA_subsystem_integrated_CM_single_s 0.01 28.0 /end CHARACTERISTIC
/begin CHARACTERISTIC KfALCA_t_ExitWaitingDelay "The time of wait for exit Waitting state. ALCA will inform some info to driver In Waitting state." VALUE 0x70101e14 /* @ECU_Address@KfALCA_t_ExitWaitingDelay@ */ Scalar_FLOAT32_IEEE 0 ALCA_subsystem_integrated_CM_single_s 0.01 8.0 /end CHARACTERISTIC
/begin CHARACTERISTIC KfALCA_t_HoldTimeForLCAccept "" VALUE 0x70101e10 /* @ECU_Address@KfALCA_t_HoldTimeForLCAccept@ */ Scalar_FLOAT32_IEEE 0 ALCA_subsystem_integrated_CM_single 0.0 10.0 /end CHARACTERISTIC
/begin CHARACTERISTIC KfALCA_t_HoldTimeForLCComplete "" VALUE 0x70101e0c /* @ECU_Address@KfALCA_t_HoldTimeForLCComplete@ */ Scalar_FLOAT32_IEEE 0 ALCA_subsystem_integrated_CM_single_s 0.0 6.0 /end CHARACTERISTIC
/begin CHARACTERISTIC KfALCA_t_LaneChangeTimeMax "Max time of lane change (s)." VALUE 0x70101e08 /* @ECU_Address@KfALCA_t_LaneChangeTimeMax@ */ Scalar_FLOAT32_IEEE 0 ALCA_subsystem_integrated_CM_single_s 0.0 16.0 /end CHARACTERISTIC
/begin CHARACTERISTIC KfALCA_t_LaneChangeTimeMin "Min time of lane change (s)." VALUE 0x70101e04 /* @ECU_Address@KfALCA_t_LaneChangeTimeMin@ */ Scalar_FLOAT32_IEEE 0 ALCA_subsystem_integrated_CM_single_s 0.0 16.0 /end CHARACTERISTIC
/begin CHARACTERISTIC KfALCA_t_PeriodFunctionCall "The time of Period-Function-Call." VALUE 0x70101e00 /* @ECU_Address@KfALCA_t_PeriodFunctionCall@ */ Scalar_FLOAT32_IEEE 0 ALCA_subsystem_integrated_CM_single_s 0.01 1.0 /end CHARACTERISTIC
/begin CHARACTERISTIC KfALCA_t_TimeNReceivedThrsh "The threshold of time that not received OBFU/MPFU/EGMO data." VALUE 0x70101dfc /* @ECU_Address@KfALCA_t_TimeNReceivedThrsh@ */ Scalar_FLOAT32_IEEE 0 ALCA_subsystem_integrated_CM_single_s 0.0 1.0 /end CHARACTERISTIC
/begin CHARACTERISTIC KfALCA_t_WaitForDriverActionMax "The time of wait for driver`s commond in Inform state." VALUE 0x70101df8 /* @ECU_Address@KfALCA_t_WaitForDriverActionMax@ */ Scalar_FLOAT32_IEEE 0 ALCA_subsystem_integrated_CM_single_s 0.0 6.0 /end CHARACTERISTIC
/begin CHARACTERISTIC KfALCA_v_LateralSpeedOfSecondStage "" VALUE 0x70101df4 /* @ECU_Address@KfALCA_v_LateralSpeedOfSecondStage@ */ Scalar_FLOAT32_IEEE 0 ALCA_subsystem_integrated_CM_single 0.0 3.0 /end CHARACTERISTIC
/begin CHARACTERISTIC KfALCA_v_SpeedLaneChangeEnblMax "The veh_speed threshold for lane change enable. (high)" VALUE 0x70101df0 /* @ECU_Address@KfALCA_v_SpeedLaneChangeEnblMax@ */ Scalar_FLOAT32_IEEE 0 ALCA_subsystem_integrated_CM_single_m_s 0.0 40.0 /end CHARACTERISTIC
/begin CHARACTERISTIC KfALCA_v_SpeedLaneChangeEnblMin "The veh_speed threshold for lane change enable. (low)" VALUE 0x70101dec /* @ECU_Address@KfALCA_v_SpeedLaneChangeEnblMin@ */ Scalar_FLOAT32_IEEE 0 ALCA_subsystem_integrated_CM_single_m_s -1.0 30.0 /end CHARACTERISTIC
/begin CHARACTERISTIC KfAlCA_d_CheckObstacleDistMin "" VALUE 0x70101de8 /* @ECU_Address@KfAlCA_d_CheckObstacleDistMin@ */ Scalar_FLOAT32_IEEE 0 ALCA_subsystem_integrated_CM_single_m 0.0 200.0 /end CHARACTERISTIC
/begin CHARACTERISTIC KbALCA_EnblCalibrateLateralSpeed "" VALUE 0x7010198a /* @ECU_Address@KbALCA_EnblCalibrateLateralSpeed@ */ Scalar_BOOLEAN 0 ALCA_subsystem_integrated_CM_boolean 0 1 /end CHARACTERISTIC
/begin CHARACTERISTIC KbALCA_EnblCheckMPFUFusionStatus "Enable check MPFU fusion status." VALUE 0x70101989 /* @ECU_Address@KbALCA_EnblCheckMPFUFusionStatus@ */ Scalar_BOOLEAN 0 ALCA_subsystem_integrated_CM_boolean 0 1 /end CHARACTERISTIC
/begin CHARACTERISTIC KbALCA_EnblCheckMPFULaneMarkerType "Enable check MPFU lane marker type." VALUE 0x70101988 /* @ECU_Address@KbALCA_EnblCheckMPFULaneMarkerType@ */ Scalar_BOOLEAN 0 ALCA_subsystem_integrated_CM_boolean 0 1 /end CHARACTERISTIC
/begin CHARACTERISTIC KbALCA_EnblCheckObstacles "" VALUE 0x70101987 /* @ECU_Address@KbALCA_EnblCheckObstacles@ */ Scalar_BOOLEAN 0 ALCA_subsystem_integrated_CM_boolean 0 1 /end CHARACTERISTIC
/begin CHARACTERISTIC KbALCA_EnblCheckTimestamp "Enable check timestamp of MPFU/EGMO/OBFU." VALUE 0x70101986 /* @ECU_Address@KbALCA_EnblCheckTimestamp@ */ Scalar_BOOLEAN 0 ALCA_subsystem_integrated_CM_boolean 0 1 /end CHARACTERISTIC
/begin CHARACTERISTIC KbALCA_EnblInterrupt "" VALUE 0x70101985 /* @ECU_Address@KbALCA_EnblInterrupt@ */ Scalar_BOOLEAN 0 ALCA_subsystem_integrated_CM_boolean 0 1 /end CHARACTERISTIC
/begin CHARACTERISTIC KbALCA_EnblOvrdInterruptAction "" VALUE 0x70101984 /* @ECU_Address@KbALCA_EnblOvrdInterruptAction@ */ Scalar_BOOLEAN 0 ALCA_subsystem_integrated_CM_boolean 0 1 /end CHARACTERISTIC
/begin CHARACTERISTIC KbALCA_EnblOvrdLaneLength "" VALUE 0x70101983 /* @ECU_Address@KbALCA_EnblOvrdLaneLength@ */ Scalar_BOOLEAN 0 ALCA_subsystem_integrated_CM_boolean 0 1 /end CHARACTERISTIC
/begin CHARACTERISTIC KbALCA_EnblOvrdLaneWidth "" VALUE 0x70101982 /* @ECU_Address@KbALCA_EnblOvrdLaneWidth@ */ Scalar_BOOLEAN 0 ALCA_subsystem_integrated_CM_boolean 0 1 /end CHARACTERISTIC
/begin CHARACTERISTIC KbALCA_OvrdLaneChangeTime "" VALUE 0x70101981 /* @ECU_Address@KbALCA_OvrdLaneChangeTime@ */ Scalar_BOOLEAN 0 ALCA_subsystem_integrated_CM_boolean 0 1 /end CHARACTERISTIC
/begin CHARACTERISTIC KbALCA_UseNewAPI_Of_MPFU "" VALUE 0x70101980 /* @ECU_Address@KbALCA_UseNewAPI_Of_MPFU@ */ Scalar_BOOLEAN 0 ALCA_subsystem_integrated_CM_boolean 0 1 /end CHARACTERISTIC
/begin CHARACTERISTIC KtLKAS_r_OffstCtrlPropGain "" MAP 0x70102c6c /* @ECU_Address@KtLKAS_r_OffstCtrlPropGain@ */ Lookup2D_FLOAT32_IEEE 0 LKAS_subsystem_integrated_CM_single -3.4E+38 3.4E+38
 /begin AXIS_DESCR COM_AXIS NO_INPUT_QUANTITY LKAS_subsystem_integrated_CM_single 9 -3.4E+38 3.4E+38 AXIS_PTS_REF KtLKAS_AXIS_OffstCtrlPropGain_Vlong /end AXIS_DESCR
 /begin AXIS_DESCR COM_AXIS NO_INPUT_QUANTITY LKAS_subsystem_integrated_CM_single 6 -3.4E+38 3.4E+38 AXIS_PTS_REF KtLKAS_AXIS_OffstCtrlPropGain_Vlat /end AXIS_DESCR
/end CHARACTERISTIC
/begin CHARACTERISTIC KtLKAS_r_OffstCtrlDiffGain "" CURVE 0x70102d44 /* @ECU_Address@KtLKAS_r_OffstCtrlDiffGain@ */ Lookup1D_FLOAT32_IEEE 0 LKAS_subsystem_integrated_CM_single -3.4E+38 3.4E+38
 /begin AXIS_DESCR COM_AXIS NO_INPUT_QUANTITY LKAS_subsystem_integrated_CM_single 9 -3.4E+38 3.4E+38 AXIS_PTS_REF KtLKAS_AXIS_OffstCtrlDiffGain_Vlong /end AXIS_DESCR
/end CHARACTERISTIC
/begin CHARACTERISTIC KtLKAS_Ang_StrAngLwrSaturation "" CURVE 0x70102d8c /* @ECU_Address@KtLKAS_Ang_StrAngLwrSaturation@ */ Lookup1D_FLOAT32_IEEE 0 LKAS_subsystem_integrated_CM_single -3.4E+38 3.4E+38
 /begin AXIS_DESCR COM_AXIS NO_INPUT_QUANTITY LKAS_subsystem_integrated_CM_single 9 -3.4E+38 3.4E+38 AXIS_PTS_REF KtLKAS_AXIS_StrAngSaturation /end AXIS_DESCR
/end CHARACTERISTIC
/begin CHARACTERISTIC KtLKAS_Ang_StrAngUpperSaturation "" CURVE 0x70102d68 /* @ECU_Address@KtLKAS_Ang_StrAngUpperSaturation@ */ Lookup1D_FLOAT32_IEEE 0 LKAS_subsystem_integrated_CM_single -3.4E+38 3.4E+38
 /begin AXIS_DESCR COM_AXIS NO_INPUT_QUANTITY LKAS_subsystem_integrated_CM_single 9 -3.4E+38 3.4E+38 AXIS_PTS_REF KtLKAS_AXIS_StrAngSaturation /end AXIS_DESCR
/end CHARACTERISTIC
/begin CHARACTERISTIC KfLKAS_Ang_BkToCnrAng "The angle X axis and the line connecting center of rear axle and front tire." VALUE 0x70102ee4 /* @ECU_Address@KfLKAS_Ang_BkToCnrAng@ */ Scalar_FLOAT32_IEEE 0 LKAS_subsystem_integrated_CM_single_rad 0.0 3.14 /end CHARACTERISTIC
/begin CHARACTERISTIC KfLKAS_Ang_SteerOffset "" VALUE 0x70102ee0 /* @ECU_Address@KfLKAS_Ang_SteerOffset@ */ Scalar_FLOAT32_IEEE 0 LKAS_subsystem_integrated_CM_single_degree -3.4E+38 3.4E+38 /end CHARACTERISTIC
/begin CHARACTERISTIC KfLKAS_C_CfForLatCtrl "Front tire cornering stiffness." VALUE 0x70102edc /* @ECU_Address@KfLKAS_C_CfForLatCtrl@ */ Scalar_FLOAT32_IEEE 0 LKAS_subsystem_integrated_CM_single_N_rad -3.4E+38 3.4E+38 /end CHARACTERISTIC
/begin CHARACTERISTIC KfLKAS_C_CrForLatCtrl "Rear tire cornering stiffness." VALUE 0x70102ed8 /* @ECU_Address@KfLKAS_C_CrForLatCtrl@ */ Scalar_FLOAT32_IEEE 0 LKAS_subsystem_integrated_CM_single_N_rad -3.4E+38 3.4E+38 /end CHARACTERISTIC
/begin CHARACTERISTIC KfLKAS_CallFreq "Frequency used for delay block, if the frequency is larger, the delay time is longer." VALUE 0x70102ed4 /* @ECU_Address@KfLKAS_CallFreq@ */ Scalar_FLOAT32_IEEE 0 LKAS_subsystem_integrated_CM_single_1_s 10.0 20.0 /end CHARACTERISTIC
/begin CHARACTERISTIC KfLKAS_a_AMaxInPathToTrig_sLKA "The max acceleration in generated trajectory that allows triggering LKAS." VALUE 0x70102ed0 /* @ECU_Address@KfLKAS_a_AMaxInPathToTrig_sLKA@ */ Scalar_FLOAT32_IEEE 0 LKAS_subsystem_integrated_CM_single 0.0 5.0 /end CHARACTERISTIC
/begin CHARACTERISTIC KfLKAS_a_SarnOfRelALatForPahCalcn "The saturation used for vehicle acceleration relative to lane marker." VALUE 0x70102ecc /* @ECU_Address@KfLKAS_a_SarnOfRelALatForPahCalcn@ */ Scalar_FLOAT32_IEEE 0 LKAS_subsystem_integrated_CM_single_m_s_2 0.1 0.2 /end CHARACTERISTIC
/begin CHARACTERISTIC KfLKAS_c_CurvUprBnd "The curavature upperbound that determines whether to use extra buffer coefficient." VALUE 0x70102ec8 /* @ECU_Address@KfLKAS_c_CurvUprBnd@ */ Scalar_FLOAT32_IEEE 0 LKAS_subsystem_integrated_CM_single_1_m 0.0 0.01 /end CHARACTERISTIC
/begin CHARACTERISTIC KfLKAS_c_CurveSuppOff "When the road curvature is smaller than CurveSuppOff, it is considered that the road is straight." VALUE 0x70102ec4 /* @ECU_Address@KfLKAS_c_CurveSuppOff@ */ Scalar_FLOAT32_IEEE 0 LKAS_subsystem_integrated_CM_single_1_m 0.0 0.5 /end CHARACTERISTIC
/begin CHARACTERISTIC KfLKAS_c_CurveSuppOn "When the road curvature is bigger than CurveSuppOn, it is considered that the road is not straight." VALUE 0x70102ec0 /* @ECU_Address@KfLKAS_c_CurveSuppOn@ */ Scalar_FLOAT32_IEEE 0 LKAS_subsystem_integrated_CM_single_1_m 1.0 2.0 /end CHARACTERISTIC
/begin CHARACTERISTIC KfLKAS_c_MaxCurvStep "The maximum change allowed for curvature at one step." VALUE 0x70102ebc /* @ECU_Address@KfLKAS_c_MaxCurvStep@ */ Scalar_FLOAT32_IEEE 0 LKAS_subsystem_integrated_CM_single_1_m 1.0 2.0 /end CHARACTERISTIC
/begin CHARACTERISTIC KfLKAS_d_BkToFrtCnrDist "The distance between one fo the front tires to the center of rear axle." VALUE 0x70102eb8 /* @ECU_Address@KfLKAS_d_BkToFrtCnrDist@ */ Scalar_FLOAT32_IEEE 0 LKAS_subsystem_integrated_CM_single_m 0.0 10.0 /end CHARACTERISTIC
/begin CHARACTERISTIC KfLKAS_d_EdgBuff "The edge buffer that added to the calcualted distance to lane markers" VALUE 0x70102eb4 /* @ECU_Address@KfLKAS_d_EdgBuff@ */ Scalar_FLOAT32_IEEE 0 LKAS_subsystem_integrated_CM_single_m -2.0 2.0 /end CHARACTERISTIC
/begin CHARACTERISTIC KfLKAS_d_ExtraMargin "" VALUE 0x70102eb0 /* @ECU_Address@KfLKAS_d_ExtraMargin@ */ Scalar_FLOAT32_IEEE 0 LKAS_subsystem_integrated_CM_single_m -2.0 2.0 /end CHARACTERISTIC
/begin CHARACTERISTIC KfLKAS_d_LfForLatCtrl "The distance beetween front axle and center of mass." VALUE 0x70102eac /* @ECU_Address@KfLKAS_d_LfForLatCtrl@ */ Scalar_FLOAT32_IEEE 0 LKAS_subsystem_integrated_CM_single_m 0.0 10.0 /end CHARACTERISTIC
/begin CHARACTERISTIC KfLKAS_d_LrForLatCtrl "The distance beetween front axle and center of mass." VALUE 0x70102ea8 /* @ECU_Address@KfLKAS_d_LrForLatCtrl@ */ Scalar_FLOAT32_IEEE 0 LKAS_subsystem_integrated_CM_single_m 0.0 10.0 /end CHARACTERISTIC
/begin CHARACTERISTIC KfLKAS_d_MaxEnblLaneWidth "If the road lane width is larger than the max enable lane width, the LKA function will not be activated." VALUE 0x70102ea4 /* @ECU_Address@KfLKAS_d_MaxEnblLaneWidth@ */ Scalar_FLOAT32_IEEE 0 LKAS_subsystem_integrated_CM_single_m 4.0 5.0 /end CHARACTERISTIC
/begin CHARACTERISTIC KfLKAS_d_MaxOffstStep "The maximum change allowed for offset at one step." VALUE 0x70102ea0 /* @ECU_Address@KfLKAS_d_MaxOffstStep@ */ Scalar_FLOAT32_IEEE 0 LKAS_subsystem_integrated_CM_single_m 1.0 2.0 /end CHARACTERISTIC
/begin CHARACTERISTIC KfLKAS_d_MinDeltaPosFirst "If the lateral offset minus extra margin is bigger than minimum delta position first, the LKA function will not be activated." VALUE 0x70102e9c /* @ECU_Address@KfLKAS_d_MinDeltaPosFirst@ */ Scalar_FLOAT32_IEEE 0 LKAS_subsystem_integrated_CM_single_m 0.1 0.2 /end CHARACTERISTIC
/begin CHARACTERISTIC KfLKAS_d_MinDeltaPosSec "If the lateral offset minus extra margin is smaller than minimum delta position , the LKA function will not be activated." VALUE 0x70102e98 /* @ECU_Address@KfLKAS_d_MinDeltaPosSec@ */ Scalar_FLOAT32_IEEE 0 LKAS_subsystem_integrated_CM_single_m 0.1 0.2 /end CHARACTERISTIC
/begin CHARACTERISTIC KfLKAS_d_MinDisLaneWidthMargin "The lane width is disabled if the current lane width is smaller than the vehicle width plus Minimum Disable Lane Width Margin" VALUE 0x70102e94 /* @ECU_Address@KfLKAS_d_MinDisLaneWidthMargin@ */ Scalar_FLOAT32_IEEE 0 LKAS_subsystem_integrated_CM_single_m 0.0 0.4 /end CHARACTERISTIC
/begin CHARACTERISTIC KfLKAS_d_MinEnblLaneWidthMargin "The lane width is enabled, if the current lane width is largrer than the vehicle width plus minimum enable lane width margin." VALUE 0x70102e90 /* @ECU_Address@KfLKAS_d_MinEnblLaneWidthMargin@ */ Scalar_FLOAT32_IEEE 0 LKAS_subsystem_integrated_CM_single_m 0.5 1.0 /end CHARACTERISTIC
/begin CHARACTERISTIC KfLKAS_d_OffsAtMinDeltaPos "The offset to lane marker at the end of the caculated trajectory." VALUE 0x70102e8c /* @ECU_Address@KfLKAS_d_OffsAtMinDeltaPos@ */ Scalar_FLOAT32_IEEE 0 LKAS_subsystem_integrated_CM_single_m 0.0 0.2 /end CHARACTERISTIC
/begin CHARACTERISTIC KfLKAS_d_OffstCtrlr_DeadZone "" VALUE 0x70102e88 /* @ECU_Address@KfLKAS_d_OffstCtrlr_DeadZone@ */ Scalar_FLOAT32_IEEE 0 LKAS_subsystem_integrated_CM_single_m 0.0 1.0 /end CHARACTERISTIC
/begin CHARACTERISTIC KfLKAS_d_PosVal "The threshold used for trajectory generation." VALUE 0x70102e84 /* @ECU_Address@KfLKAS_d_PosVal@ */ Scalar_FLOAT32_IEEE 0 LKAS_subsystem_integrated_CM_single_m 0.5 1.0 /end CHARACTERISTIC
/begin CHARACTERISTIC KfLKAS_d_VehicleWheelBase "" VALUE 0x70102e80 /* @ECU_Address@KfLKAS_d_VehicleWheelBase@ */ Scalar_FLOAT32_IEEE 0 LKAS_subsystem_integrated_CM_single_m 0.0 10.0 /end CHARACTERISTIC
/begin CHARACTERISTIC KfLKAS_d_VehicleWidth "" VALUE 0x70102e7c /* @ECU_Address@KfLKAS_d_VehicleWidth@ */ Scalar_FLOAT32_IEEE 0 LKAS_subsystem_integrated_CM_single_m 0.0 5.0 /end CHARACTERISTIC
/begin CHARACTERISTIC KfLKAS_d_WarnLineLvlOne "When vehicle speed is higher than 1.0m/s, the earliest warning line shall be placed no more than 1.5m inside the lane boundary." VALUE 0x70102e78 /* @ECU_Address@KfLKAS_d_WarnLineLvlOne@ */ Scalar_FLOAT32_IEEE 0 LKAS_subsystem_integrated_CM_single_m 0.0 1.5 /end CHARACTERISTIC
/begin CHARACTERISTIC KfLKAS_d_WarnLineLvlThree "When vehicle speed is not higher than 0.5 m/s, the earliest warning line shall be placed no more than 0.75m inside the lane boundary." VALUE 0x70102e74 /* @ECU_Address@KfLKAS_d_WarnLineLvlThree@ */ Scalar_FLOAT32_IEEE 0 LKAS_subsystem_integrated_CM_single_m 0.0 0.75 /end CHARACTERISTIC
/begin CHARACTERISTIC KfLKAS_j_MaxTrigJerk_sLKA "The max jerk in generated trajectory that allows to trigger LKAS." VALUE 0x70102e70 /* @ECU_Address@KfLKAS_j_MaxTrigJerk_sLKA@ */ Scalar_FLOAT32_IEEE 0 LKAS_subsystem_integrated_CM_single_m__s__3_ 0.0 5.0 /end CHARACTERISTIC
/begin CHARACTERISTIC KfLKAS_k_StrAngFilt "" VALUE 0x70102e6c /* @ECU_Address@KfLKAS_k_StrAngFilt@ */ Scalar_FLOAT32_IEEE 0 LKAS_subsystem_integrated_CM_single 0.0 1.0 /end CHARACTERISTIC
/begin CHARACTERISTIC KfLKAS_m_MForLatCtrl "The mass of vehicle being used in two-wheel model calculation." VALUE 0x70102e68 /* @ECU_Address@KfLKAS_m_MForLatCtrl@ */ Scalar_FLOAT32_IEEE 0 LKAS_subsystem_integrated_CM_single_kg 0.0 10000.0 /end CHARACTERISTIC
/begin CHARACTERISTIC KfLKAS_r_CurvBuffCoe "The coefficient that multiples the distance to lanemarker when the vehicle is driving under large curavture." VALUE 0x70102e64 /* @ECU_Address@KfLKAS_r_CurvBuffCoe@ */ Scalar_FLOAT32_IEEE 0 LKAS_subsystem_integrated_CM_single 0.0 2.0 /end CHARACTERISTIC
/begin CHARACTERISTIC KfLKAS_r_PGainForVlat "The proportional gain for Vlat in lateral controller." VALUE 0x70102e60 /* @ECU_Address@KfLKAS_r_PGainForVlat@ */ Scalar_FLOAT32_IEEE 0 LKAS_subsystem_integrated_CM_single 0.0 20.0 /end CHARACTERISTIC
/begin CHARACTERISTIC KfLKAS_r_StrRatioForLatCtrl "Steer ratio used in two-wheel model" VALUE 0x70102e5c /* @ECU_Address@KfLKAS_r_StrRatioForLatCtrl@ */ Scalar_FLOAT32_IEEE 0 LKAS_subsystem_integrated_CM_single 0.0 30.0 /end CHARACTERISTIC
/begin CHARACTERISTIC KfLKAS_r_WarnLineLvlTwo "When vehicle speed is higher than 0.5m/s but not  higher than 1.0m/s, the earliest warning line shall be placed no more than 1.5*Va m inside the lane boundary" VALUE 0x70102e58 /* @ECU_Address@KfLKAS_r_WarnLineLvlTwo@ */ Scalar_FLOAT32_IEEE 0 LKAS_subsystem_integrated_CM_single 0.0 1.5 /end CHARACTERISTIC
/begin CHARACTERISTIC KfLKAS_t_MaxIntvTime "Max intervention time that allows in a single time." VALUE 0x70102e54 /* @ECU_Address@KfLKAS_t_MaxIntvTime@ */ Scalar_FLOAT32_IEEE 0 LKAS_subsystem_integrated_CM_single_s 0.0 50.0 /end CHARACTERISTIC
/begin CHARACTERISTIC KfLKAS_t_RoadEnblOKHoldLow "The road is enabled if the time of road lane width enable is larger than RoadEnableOKHoldLow." VALUE 0x70102e50 /* @ECU_Address@KfLKAS_t_RoadEnblOKHoldLow@ */ Scalar_FLOAT32_IEEE 0 LKAS_subsystem_integrated_CM_single_s 1.0 2.0 /end CHARACTERISTIC
/begin CHARACTERISTIC KfLKAS_t_TLCThrsh "Time to lane crossing (TTLC) threshold." VALUE 0x70102e4c /* @ECU_Address@KfLKAS_t_TLCThrsh@ */ Scalar_FLOAT32_IEEE 0 LKAS_subsystem_integrated_CM_single_s 0.0 2.0 /end CHARACTERISTIC
/begin CHARACTERISTIC KfLKAS_t_TMaxNeeded_sLKA "The max time allowed in generated trajectory to trigger LKAS." VALUE 0x70102e48 /* @ECU_Address@KfLKAS_t_TMaxNeeded_sLKA@ */ Scalar_FLOAT32_IEEE 0 LKAS_subsystem_integrated_CM_single_s 0.0 50.0 /end CHARACTERISTIC
/begin CHARACTERISTIC KfLKAS_v_MaxStepForVLat "The max change allowed for lateral velocity at one step." VALUE 0x70102e44 /* @ECU_Address@KfLKAS_v_MaxStepForVLat@ */ Scalar_FLOAT32_IEEE 0 LKAS_subsystem_integrated_CM_single_m_s 1.0 2.0 /end CHARACTERISTIC
/begin CHARACTERISTIC KfLKAS_v_VMaxToTrigZeroPath_sLKA "The max lateral velocity that allows to use zero trajectory." VALUE 0x70102e40 /* @ECU_Address@KfLKAS_v_VMaxToTrigZeroPath_sLKA@ */ Scalar_FLOAT32_IEEE 0 LKAS_subsystem_integrated_CM_single_m_s 0.0 5.0 /end CHARACTERISTIC
/begin CHARACTERISTIC KfLKAS_v_VlatCtrlr_DeadZone "" VALUE 0x70102e3c /* @ECU_Address@KfLKAS_v_VlatCtrlr_DeadZone@ */ Scalar_FLOAT32_IEEE 0 LKAS_subsystem_integrated_CM_single_m_s 0.0 1.0 /end CHARACTERISTIC
/begin CHARACTERISTIC KfLKAS_v_VlatMaxForCmpl "The max lateral velocity used for inervention completion." VALUE 0x70102e38 /* @ECU_Address@KfLKAS_v_VlatMaxForCmpl@ */ Scalar_FLOAT32_IEEE 0 LKAS_subsystem_integrated_CM_single_m_s 0.0 5.0 /end CHARACTERISTIC
/begin CHARACTERISTIC KfLKAS_v_VlatMinForCmpl "The max lateral velocity used for inervention completion." VALUE 0x70102e34 /* @ECU_Address@KfLKAS_v_VlatMinForCmpl@ */ Scalar_FLOAT32_IEEE 0 LKAS_subsystem_integrated_CM_single_m_s 0.0 5.0 /end CHARACTERISTIC
/begin CHARACTERISTIC KcLKAS_CntSample "The sample time that state machine uses in a loop." VALUE 0x70102c6a /* @ECU_Address@KcLKAS_CntSample@ */ Scalar_UWORD 0 LKAS_subsystem_integrated_CM_uint16 1.0 10.0 /end CHARACTERISTIC
/begin CHARACTERISTIC KfLKAS_t_LnMkrMissThrsh "The maximum time that a lane marker could termporarily go missing" VALUE 0x70102c68 /* @ECU_Address@KfLKAS_t_LnMkrMissThrsh@ */ Scalar_UWORD 0 LKAS_subsystem_integrated_CM_uint16_10ms 0.0 1000.0 /end CHARACTERISTIC
/begin CHARACTERISTIC KfLKAS_t_TDelayForAct_sLKA "Time delay for activation to increase robustness." VALUE 0x70102c66 /* @ECU_Address@KfLKAS_t_TDelayForAct_sLKA@ */ Scalar_UWORD 0 LKAS_subsystem_integrated_CM_uint16_10ms 0.0 100.0 /end CHARACTERISTIC
/begin CHARACTERISTIC KfLKAS_t_TDelayForCmpl_sLKA "" VALUE 0x70102c64 /* @ECU_Address@KfLKAS_t_TDelayForCmpl_sLKA@ */ Scalar_UWORD 0 LKAS_subsystem_integrated_CM_uint16_10ms 0.0 100.0 /end CHARACTERISTIC
/begin CHARACTERISTIC KfLKAS_t_TimeDlyAbort "Time delay for activation abort." VALUE 0x70102c62 /* @ECU_Address@KfLKAS_t_TimeDlyAbort@ */ Scalar_UWORD 0 LKAS_subsystem_integrated_CM_uint16_10ms 0.0 1000.0 /end CHARACTERISTIC
/begin CHARACTERISTIC KfLKAS_r_QlyVld "Lane marker quality threshold" VALUE 0x70102c60 /* @ECU_Address@KfLKAS_r_QlyVld@ */ Scalar_UBYTE 0 LKAS_subsystem_integrated_CM_uint8 0.0 100.0 /end CHARACTERISTIC
/begin CHARACTERISTIC KbLKAS_A0Trigger_Temp "" VALUE 0x70102c5f /* @ECU_Address@KbLKAS_A0Trigger_Temp@ */ Scalar_BOOLEAN 0 LKAS_subsystem_integrated_CM_boolean 0.0 1.0 /end CHARACTERISTIC
/begin CHARACTERISTIC KbLKAS_AbortSwitch_Temp "" VALUE 0x70102c5e /* @ECU_Address@KbLKAS_AbortSwitch_Temp@ */ Scalar_BOOLEAN 0 LKAS_subsystem_integrated_CM_boolean 0.0 1.0 /end CHARACTERISTIC
/begin CHARACTERISTIC KbLKAS_NotUseOffstForCmpl_Temp "" VALUE 0x70102c5d /* @ECU_Address@KbLKAS_NotUseOffstForCmpl_Temp@ */ Scalar_BOOLEAN 0 LKAS_subsystem_integrated_CM_boolean 0.0 1.0 /end CHARACTERISTIC
/begin CHARACTERISTIC KbLKAS_SuppSwitch_Temp "" VALUE 0x70102c5c /* @ECU_Address@KbLKAS_SuppSwitch_Temp@ */ Scalar_BOOLEAN 0 LKAS_subsystem_integrated_CM_boolean 0.0 1.0 /end CHARACTERISTIC
/begin CHARACTERISTIC KbLKAS_TargetSwitch_Temp "" VALUE 0x70102c5b /* @ECU_Address@KbLKAS_TargetSwitch_Temp@ */ Scalar_BOOLEAN 0 LKAS_subsystem_integrated_CM_boolean 0.0 1.0 /end CHARACTERISTIC
/begin CHARACTERISTIC KbLKAS_TriggerLDWSwitch "The switch that uses LDWS triggering conditions." VALUE 0x70102c5a /* @ECU_Address@KbLKAS_TriggerLDWSwitch@ */ Scalar_BOOLEAN 0 LKAS_subsystem_integrated_CM_boolean 0.0 1.0 /end CHARACTERISTIC
/begin CHARACTERISTIC KbLKAS_UseInsidePathForCmpl_Temp "" VALUE 0x70102c59 /* @ECU_Address@KbLKAS_UseInsidePathForCmpl_Temp@ */ Scalar_BOOLEAN 0 LKAS_subsystem_integrated_CM_boolean 0.0 1.0 /end CHARACTERISTIC
/begin CHARACTERISTIC KbLKAS_UseVmaxForCmpl_Temp "" VALUE 0x70102c58 /* @ECU_Address@KbLKAS_UseVmaxForCmpl_Temp@ */ Scalar_BOOLEAN 0 LKAS_subsystem_integrated_CM_boolean 0.0 1.0 /end CHARACTERISTIC
/begin CHARACTERISTIC KfDRIV_CoeffStrwhl2Radius "When there's no EGMO, steer wheel angle is used to calculate Radius,
      Coefficent correction of radius." VALUE 0x70102308 /* @ECU_Address@KfDRIV_CoeffStrwhl2Radius@ */ Scalar_FLOAT32_IEEE 0 DRIV_subsystem_integrated_CM_single 0.0 10.0 /end CHARACTERISTIC
/begin CHARACTERISTIC KfDRIV_Veh_Strwhl2FrtwhlRatio "steer ratio =17" VALUE 0x70102304 /* @ECU_Address@KfDRIV_Veh_Strwhl2FrtwhlRatio@ */ Scalar_FLOAT32_IEEE 0 DRIV_subsystem_integrated_CM_single 17.0 20.0 /end CHARACTERISTIC
/begin CHARACTERISTIC KfDRIV_Veh_WheelBase "wheel base" VALUE 0x70102300 /* @ECU_Address@KfDRIV_Veh_WheelBase@ */ Scalar_FLOAT32_IEEE 0 DRIV_subsystem_integrated_CM_single 3.0 3.5 /end CHARACTERISTIC
/begin CHARACTERISTIC KfDRIV_d_Dist2LaneChangeFinish "to lane_center distance < 0.4" VALUE 0x701022fc /* @ECU_Address@KfDRIV_d_Dist2LaneChangeFinish@ */ Scalar_FLOAT32_IEEE 0 DRIV_subsystem_integrated_CM_single 0.0 1.0 /end CHARACTERISTIC
/begin CHARACTERISTIC KfDRIV_d_TouchedNewLaneDist "when vehicle touched new lane ,the distance to lane can increase in one sample time" VALUE 0x701022f8 /* @ECU_Address@KfDRIV_d_TouchedNewLaneDist@ */ Scalar_FLOAT32_IEEE 0 DRIV_subsystem_integrated_CM_single 2.0 5.0 /end CHARACTERISTIC
/begin CHARACTERISTIC KfDRIV_t_TimeEGMOReceivedThrsh "TimeEGMOReceivedThrsh" VALUE 0x701022f4 /* @ECU_Address@KfDRIV_t_TimeEGMOReceivedThrsh@ */ Scalar_FLOAT32_IEEE 0 DRIV_subsystem_integrated_CM_single 0.0 10.0 /end CHARACTERISTIC
/begin CHARACTERISTIC KfDRIV_t_TimeMPFUReceivedThrsh "TimeMPFUReceivedThrsh" VALUE 0x701022f0 /* @ECU_Address@KfDRIV_t_TimeMPFUReceivedThrsh@ */ Scalar_FLOAT32_IEEE 0 DRIV_subsystem_integrated_CM_single 0.0 10.0 /end CHARACTERISTIC
/begin CHARACTERISTIC KfDRIV_t_TimeOBFUNReceivedThrsh "TimeOBFUNReceivedThrsh" VALUE 0x701022ec /* @ECU_Address@KfDRIV_t_TimeOBFUNReceivedThrsh@ */ Scalar_FLOAT32_IEEE 0 DRIV_subsystem_integrated_CM_single 0.0 10.0 /end CHARACTERISTIC
/begin CHARACTERISTIC KfDRIV_t_WaitTimeDriverDistracted "WaitTimeDriverDistracted" VALUE 0x701022e8 /* @ECU_Address@KfDRIV_t_WaitTimeDriverDistracted@ */ Scalar_FLOAT32_IEEE 0 DRIV_subsystem_integrated_CM_single 0.0 8.0 /end CHARACTERISTIC
/begin CHARACTERISTIC KfDRIV_t_WaitTimeLaneChangeFinish "WaitTimeLaneChangeFinish" VALUE 0x701022e4 /* @ECU_Address@KfDRIV_t_WaitTimeLaneChangeFinish@ */ Scalar_FLOAT32_IEEE 0 DRIV_subsystem_integrated_CM_single 0.0 4.0 /end CHARACTERISTIC
/begin CHARACTERISTIC KfDRIV_w_LaneWidthMax "LaneWidthMax" VALUE 0x701022e0 /* @ECU_Address@KfDRIV_w_LaneWidthMax@ */ Scalar_FLOAT32_IEEE 0 DRIV_subsystem_integrated_CM_single 3.0 4.0 /end CHARACTERISTIC
/begin CHARACTERISTIC kfDRIV_M_TorqueOverrideThreshold "steer torque threshold " VALUE 0x701022dc /* @ECU_Address@kfDRIV_M_TorqueOverrideThreshold@ */ Scalar_FLOAT32_IEEE 0 DRIV_subsystem_integrated_CM_single -10.0 10.0 /end CHARACTERISTIC
/begin CHARACTERISTIC kfDRIV_M_TorqueOverrideThreshold_ACC "steer torque threshold ACC" VALUE 0x701022d8 /* @ECU_Address@kfDRIV_M_TorqueOverrideThreshold_ACC@ */ Scalar_FLOAT32_IEEE 0 DRIV_subsystem_integrated_CM_single -5.0 10.0 /end CHARACTERISTIC
/begin CHARACTERISTIC kfDRIV_M_TorqueOverrideThreshold_Auto "TorqueOverrideThreshold_Auto" VALUE 0x701022d4 /* @ECU_Address@kfDRIV_M_TorqueOverrideThreshold_Auto@ */ Scalar_FLOAT32_IEEE 0 DRIV_subsystem_integrated_CM_single -5.0 10.0 /end CHARACTERISTIC
/begin CHARACTERISTIC kfDRIV_M_TorqueOverrideThreshold_LCC "TorqueOverrideThreshold LCC driver  take over " VALUE 0x701022d0 /* @ECU_Address@kfDRIV_M_TorqueOverrideThreshold_LCC@ */ Scalar_FLOAT32_IEEE 0 DRIV_subsystem_integrated_CM_single -5.0 10.0 /end CHARACTERISTIC
/begin CHARACTERISTIC kfDRIV_M_TorqueThreshold_Distracted "" VALUE 0x701022cc /* @ECU_Address@kfDRIV_M_TorqueThreshold_Distracted@ */ Scalar_FLOAT32_IEEE 0 DRIV_subsystem_integrated_CM_single -5.0 10.0 /end CHARACTERISTIC
/begin CHARACTERISTIC kfDRIV_SteerAngleRateThreshold "SteerAngleRateThreshold" VALUE 0x701022c8 /* @ECU_Address@kfDRIV_SteerAngleRateThreshold@ */ Scalar_FLOAT32_IEEE 0 DRIV_subsystem_integrated_CM_single 0.0 5.0 /end CHARACTERISTIC
/begin CHARACTERISTIC kfDRIV_SteerAngleThreshold "" VALUE 0x701022c4 /* @ECU_Address@kfDRIV_SteerAngleThreshold@ */ Scalar_FLOAT32_IEEE 0 DRIV_subsystem_integrated_CM_single 0.0 8.0 /end CHARACTERISTIC
/begin CHARACTERISTIC kfDRIV_TorqueRateThreshold "TorqueRateThreshold" VALUE 0x701022c0 /* @ECU_Address@kfDRIV_TorqueRateThreshold@ */ Scalar_FLOAT32_IEEE 0 DRIV_subsystem_integrated_CM_single 0.0 10.0 /end CHARACTERISTIC
/begin CHARACTERISTIC kfDRIV_TorqueRate_LC_Threshold "TorqueRate_LC_Threshold" VALUE 0x701022bc /* @ECU_Address@kfDRIV_TorqueRate_LC_Threshold@ */ Scalar_FLOAT32_IEEE 0 DRIV_subsystem_integrated_CM_single 0.0 10.0 /end CHARACTERISTIC
/begin CHARACTERISTIC kfDRIV_YawRateThreshold "YawRateThreshold" VALUE 0x701022b8 /* @ECU_Address@kfDRIV_YawRateThreshold@ */ Scalar_FLOAT32_IEEE 0 DRIV_subsystem_integrated_CM_single 0.0 3.0 /end CHARACTERISTIC
/begin CHARACTERISTIC kfDRIV_YawRateThreshold2 "YawRateThreshold2" VALUE 0x701022b4 /* @ECU_Address@kfDRIV_YawRateThreshold2@ */ Scalar_FLOAT32_IEEE 0 DRIV_subsystem_integrated_CM_single 0.0 3.0 /end CHARACTERISTIC
/begin CHARACTERISTIC kfDRIV_c1_threshold "Lane Coefficient c1" VALUE 0x701022b0 /* @ECU_Address@kfDRIV_c1_threshold@ */ Scalar_FLOAT32_IEEE 0 DRIV_subsystem_integrated_CM_single -1.0 1.0 /end CHARACTERISTIC
/begin CHARACTERISTIC kfDRIV_k_FilterGain "steer torque  filter gain 0.9" VALUE 0x701022ac /* @ECU_Address@kfDRIV_k_FilterGain@ */ Scalar_FLOAT32_IEEE 0 DRIV_subsystem_integrated_CM_single 0.0 1.0 /end CHARACTERISTIC
/begin CHARACTERISTIC kfDRIV_t_PeriodFunctionCall "model  sample time " VALUE 0x701022a8 /* @ECU_Address@kfDRIV_t_PeriodFunctionCall@ */ Scalar_FLOAT32_IEEE 0 DRIV_subsystem_integrated_CM_single 0.0 1.0 /end CHARACTERISTIC
/begin CHARACTERISTIC kfDRIV_t_TurnLightLeftOn_Time "TurnLightLeftOn_Time" VALUE 0x701022a4 /* @ECU_Address@kfDRIV_t_TurnLightLeftOn_Time@ */ Scalar_FLOAT32_IEEE 0 DRIV_subsystem_integrated_CM_single 0.0 8.0 /end CHARACTERISTIC
/begin CHARACTERISTIC kfDRIV_t_TurnLightOn_Time "TurnLightOn_Time" VALUE 0x701022a0 /* @ECU_Address@kfDRIV_t_TurnLightOn_Time@ */ Scalar_FLOAT32_IEEE 0 DRIV_subsystem_integrated_CM_single 0.0 8.0 /end CHARACTERISTIC
/begin CHARACTERISTIC kfDRIV_t_TurnLightRightOn_Time "TurnLightRightOn_Time" VALUE 0x7010229c /* @ECU_Address@kfDRIV_t_TurnLightRightOn_Time@ */ Scalar_FLOAT32_IEEE 0 DRIV_subsystem_integrated_CM_single 0.0 8.0 /end CHARACTERISTIC
/begin CHARACTERISTIC kfDRIV_DelayLoopGain "button delay loop gain " VALUE 0x70102299 /* @ECU_Address@kfDRIV_DelayLoopGain@ */ Scalar_UBYTE 0 DRIV_subsystem_integrated_CM_uint8 0.0 10.0 /end CHARACTERISTIC
/begin CHARACTERISTIC KbDRIV_DRIVEnable "DRIV mode status is true" VALUE 0x70102298 /* @ECU_Address@KbDRIV_DRIVEnable@ */ Scalar_BOOLEAN 0 DRIV_subsystem_integrated_CM_boolean 0.0 1.0 /end CHARACTERISTIC
/begin CHARACTERISTIC KbDRIV_Default_EnableAutoDrive "Default auto drive is false" VALUE 0x70102297 /* @ECU_Address@KbDRIV_Default_EnableAutoDrive@ */ Scalar_BOOLEAN 0 DRIV_subsystem_integrated_CM_boolean 0.0 1.0 /end CHARACTERISTIC
/begin CHARACTERISTIC KbDRIV_Default_LaneKeepAssist "default vehicle is lanekeeping" VALUE 0x70102296 /* @ECU_Address@KbDRIV_Default_LaneKeepAssist@ */ Scalar_BOOLEAN 0 DRIV_subsystem_integrated_CM_boolean 0.0 1.0 /end CHARACTERISTIC
/begin CHARACTERISTIC KbDRIV_Default_Override_Steering "default override steering  status is false" VALUE 0x70102295 /* @ECU_Address@KbDRIV_Default_Override_Steering@ */ Scalar_BOOLEAN 0 DRIV_subsystem_integrated_CM_boolean 0.0 1.0 /end CHARACTERISTIC
/begin CHARACTERISTIC KbDRIV_Update_Override_Steering "update override steering status is true" VALUE 0x70102294 /* @ECU_Address@KbDRIV_Update_Override_Steering@ */ Scalar_BOOLEAN 0 DRIV_subsystem_integrated_CM_boolean 0.0 1.0 /end CHARACTERISTIC
/begin AXIS_PTS KtACCS_AXIS_OpenAccelStop_StopDis "The axis for the calibration KtACCS_t_CalOpenAccelForStopFrmDCSN" 0x70100f40 /* @ECU_Address@KtACCS_AXIS_OpenAccelStop_StopDis@ */ NO_INPUT_QUANTITY Lookup1D_X_FLOAT32_IEEE 0 ACCS_subsystem_integrated_CM_single_m 6 0.0 200.0 /end AXIS_PTS
/begin AXIS_PTS KtACCS_AXIS_OpenAccelSpedCtrl_SpedErr "This is speed error axis for KtACCS_OpenAccel_SpeedCtrl" 0x70100f58 /* @ECU_Address@KtACCS_AXIS_OpenAccelSpedCtrl_SpedErr@ */ NO_INPUT_QUANTITY Lookup1D_X_FLOAT32_IEEE 0 ACCS_subsystem_integrated_CM_single_m_s 7 -30.0 30.0 /end AXIS_PTS
/begin AXIS_PTS KtACCS_AXIS_OpenAccelLowSpedCtrl_SpedErr "This is speed error axis for KtACCS_a_OpenAccel_LowSpeedCtrl" 0x70100f74 /* @ECU_Address@KtACCS_AXIS_OpenAccelLowSpedCtrl_SpedErr@ */ NO_INPUT_QUANTITY Lookup1D_X_FLOAT32_IEEE 0 ACCS_subsystem_integrated_CM_single_m_s 7 -45.0 45.0 /end AXIS_PTS
/begin AXIS_PTS KtACCS_AXIS_OpenAccelLaunch_CurSpd "This is vehcile speed axis for KtACCS_OpenAccel_Launch" 0x70100f90 /* @ECU_Address@KtACCS_AXIS_OpenAccelLaunch_CurSpd@ */ NO_INPUT_QUANTITY Lookup1D_X_FLOAT32_IEEE 0 ACCS_subsystem_integrated_CM_single_m_s 6 0.0 50.0 /end AXIS_PTS
/begin AXIS_PTS KtACCS_AXIS_StopStatus_Accel_Pitch "This is Pitch axis for KtACCS_StopStatus_Accel" 0x70100ea8 /* @ECU_Address@KtACCS_AXIS_StopStatus_Accel_Pitch@ */ NO_INPUT_QUANTITY Lookup1D_X_FLOAT32_IEEE 0 ACCS_subsystem_integrated_CM_single_deg 10 0.0 90.0 /end AXIS_PTS
/begin AXIS_PTS KaALCA_AXIS_VehSpeed "" 0x70101e50 /* @ECU_Address@KaALCA_AXIS_VehSpeed@ */ NO_INPUT_QUANTITY Lookup2D_X_FLOAT32_IEEE 0 ALCA_subsystem_integrated_CM_single 8 0.0 35.0 /end AXIS_PTS
/begin AXIS_PTS KaALCA_AXIS_RelativeSpeedHost2Obstacle "" 0x70101eb8 /* @ECU_Address@KaALCA_AXIS_RelativeSpeedHost2Obstacle@ */ NO_INPUT_QUANTITY Lookup2D_X_FLOAT32_IEEE 0 ALCA_subsystem_integrated_CM_single 15 -70.0 70.0 /end AXIS_PTS
/begin AXIS_PTS KaALCA_AXIS_VehLonSpeed "" 0x70101e70 /* @ECU_Address@KaALCA_AXIS_VehLonSpeed@ */ NO_INPUT_QUANTITY Lookup1D_X_FLOAT32_IEEE 0 ALCA_subsystem_integrated_CM_single 18 0.0 35.0 /end AXIS_PTS
/begin AXIS_PTS KaALCA_AXIS_LateralDist2Go "" 0x70101ef4 /* @ECU_Address@KaALCA_AXIS_LateralDist2Go@ */ NO_INPUT_QUANTITY Lookup1D_X_FLOAT32_IEEE 0 ALCA_subsystem_integrated_CM_single 21 0.0 4.0 /end AXIS_PTS
/begin AXIS_PTS KtLKAS_AXIS_OffstCtrlPropGain_Vlat "" 0x70102df8 /* @ECU_Address@KtLKAS_AXIS_OffstCtrlPropGain_Vlat@ */ NO_INPUT_QUANTITY Lookup2D_X_FLOAT32_IEEE 0 LKAS_subsystem_integrated_CM_single 6 -3.4E+38 3.4E+38 /end AXIS_PTS
/begin AXIS_PTS KtLKAS_AXIS_OffstCtrlPropGain_Vlong "" 0x70102dd4 /* @ECU_Address@KtLKAS_AXIS_OffstCtrlPropGain_Vlong@ */ NO_INPUT_QUANTITY Lookup2D_X_FLOAT32_IEEE 0 LKAS_subsystem_integrated_CM_single 9 -3.4E+38 3.4E+38 /end AXIS_PTS
/begin AXIS_PTS KtLKAS_AXIS_OffstCtrlDiffGain_Vlong "" 0x70102e10 /* @ECU_Address@KtLKAS_AXIS_OffstCtrlDiffGain_Vlong@ */ NO_INPUT_QUANTITY Lookup1D_X_FLOAT32_IEEE 0 LKAS_subsystem_integrated_CM_single 9 -3.4E+38 3.4E+38 /end AXIS_PTS
/begin AXIS_PTS KtLKAS_AXIS_StrAngSaturation "" 0x70102db0 /* @ECU_Address@KtLKAS_AXIS_StrAngSaturation@ */ NO_INPUT_QUANTITY Lookup1D_X_FLOAT32_IEEE 0 LKAS_subsystem_integrated_CM_single 9 -3.4E+38 3.4E+38 /end AXIS_PTS
/begin MEASUREMENT VfLDWS_Theta "The angle between linear velocity and heading" FLOAT32_IEEE LDWS_subsystem_integrated_CM_single 0 0 -3.4E+38 3.4E+38 ECU_ADDRESS 0xb0007294 /* @ECU_Address@VfLDWS_Theta@ */ /end MEASUREMENT
/begin MEASUREMENT VfLDWS_VLatLe "" FLOAT32_IEEE LDWS_subsystem_integrated_CM_single 0 0 -3.4E+38 3.4E+38 ECU_ADDRESS 0xb0007288 /* @ECU_Address@VfLDWS_VLatLe@ */ /end MEASUREMENT
/begin MEASUREMENT VfLDWS_EdgeLaneLe "The vertical distacne between left front wheel and left lane marker" FLOAT32_IEEE LDWS_subsystem_integrated_CM_single 0 0 -3.4E+38 3.4E+38 ECU_ADDRESS 0xb0007284 /* @ECU_Address@VfLDWS_EdgeLaneLe@ */ /end MEASUREMENT
/begin MEASUREMENT VfLDWS_TLCLe "The time to collision of left side" FLOAT32_IEEE LDWS_subsystem_integrated_CM_single 0 0 -3.4E+38 3.4E+38 ECU_ADDRESS 0xb0007280 /* @ECU_Address@VfLDWS_TLCLe@ */ /end MEASUREMENT
/begin MEASUREMENT VfLDWS_EdgeLaneRi "The vertical distacne between right front wheel and right lane marker" FLOAT32_IEEE LDWS_subsystem_integrated_CM_single 0 0 -3.4E+38 3.4E+38 ECU_ADDRESS 0xb000727c /* @ECU_Address@VfLDWS_EdgeLaneRi@ */ /end MEASUREMENT
/begin MEASUREMENT VfLDWS_VLatRi "" FLOAT32_IEEE LDWS_subsystem_integrated_CM_single 0 0 -3.4E+38 3.4E+38 ECU_ADDRESS 0xb0007278 /* @ECU_Address@VfLDWS_VLatRi@ */ /end MEASUREMENT
/begin MEASUREMENT VfLDWS_TLCRi "The time to collision of right side" FLOAT32_IEEE LDWS_subsystem_integrated_CM_single 0 0 -3.4E+38 3.4E+38 ECU_ADDRESS 0xb0007274 /* @ECU_Address@VfLDWS_TLCRi@ */ /end MEASUREMENT
/begin MEASUREMENT VbLDWS_IsOnLeLine "The vehicle is on left lane marker or not" UBYTE LDWS_subsystem_integrated_CM_boolean 0 0 0 1 ECU_ADDRESS 0xb000724e /* @ECU_Address@VbLDWS_IsOnLeLine@ */ /end MEASUREMENT
/begin MEASUREMENT VbLDWS_LeadDrctn "The heading of vehicle is left or right. True is on left, fale is on right." UBYTE LDWS_subsystem_integrated_CM_boolean 0 0 0 1 ECU_ADDRESS 0xb000724d /* @ECU_Address@VbLDWS_LeadDrctn@ */ /end MEASUREMENT
/begin MEASUREMENT VbLDWS_IsOnRiLine "The vehicle is on right lane marker or not" UBYTE LDWS_subsystem_integrated_CM_boolean 0 0 0 1 ECU_ADDRESS 0xb000724b /* @ECU_Address@VbLDWS_IsOnRiLine@ */ /end MEASUREMENT
/begin MEASUREMENT VbLDWS_SuppLe "The left LDW is whether suppressed or not" UBYTE LDWS_subsystem_integrated_CM_boolean 0 0 0 1 ECU_ADDRESS 0xb0007249 /* @ECU_Address@VbLDWS_SuppLe@ */ /end MEASUREMENT
/begin MEASUREMENT VbLDWS_SuppRi "The right LDW is whether suppressed or not" UBYTE LDWS_subsystem_integrated_CM_boolean 0 0 0 1 ECU_ADDRESS 0xb0007248 /* @ECU_Address@VbLDWS_SuppRi@ */ /end MEASUREMENT
/begin MEASUREMENT VbLDWS_RdEnblLe "The left Lane Marker is whether enabled or not" UBYTE LDWS_subsystem_integrated_CM_boolean 0 0 0 1 ECU_ADDRESS 0xb0007247 /* @ECU_Address@VbLDWS_RdEnblLe@ */ /end MEASUREMENT
/begin MEASUREMENT VbLDWS_RdEnblRi "The right Lane Marker is whether enabled or not" UBYTE LDWS_subsystem_integrated_CM_boolean 0 0 0 1 ECU_ADDRESS 0xb0007246 /* @ECU_Address@VbLDWS_RdEnblRi@ */ /end MEASUREMENT
/begin MEASUREMENT VfAEBD_AEB_a "" FLOAT32_IEEE AEBD_subsystem_integrated_CM_single 0 0 -3.4E+38 3.4E+38 ECU_ADDRESS 0xb000213c /* @ECU_Address@VfAEBD_AEB_a@ */ /end MEASUREMENT
/begin MEASUREMENT VcAEBD_ErrorCount "" UWORD AEBD_subsystem_integrated_CM_uint16 0 0 0 65535 ECU_ADDRESS 0xb000213a /* @ECU_Address@VcAEBD_ErrorCount@ */ /end MEASUREMENT
/begin MEASUREMENT VfAEBD_t_DelayTime "" UBYTE AEBD_subsystem_integrated_CM_uint8 0 0 0 255 ECU_ADDRESS 0xb0002139 /* @ECU_Address@VfAEBD_t_DelayTime@ */ /end MEASUREMENT
/begin MEASUREMENT VbAEBD_Error "" UBYTE AEBD_subsystem_integrated_CM_boolean 0 0 0 1 ECU_ADDRESS 0xb0002138 /* @ECU_Address@VbAEBD_Error@ */ /end MEASUREMENT
/begin MEASUREMENT VbAEBD_Suppress "" UBYTE AEBD_subsystem_integrated_CM_boolean 0 0 0 1 ECU_ADDRESS 0xb0002137 /* @ECU_Address@VbAEBD_Suppress@ */ /end MEASUREMENT
/begin MEASUREMENT VbAEBD_Pedoff "" UBYTE AEBD_subsystem_integrated_CM_boolean 0 0 0 1 ECU_ADDRESS 0xb0002136 /* @ECU_Address@VbAEBD_Pedoff@ */ /end MEASUREMENT
/begin MEASUREMENT VbAEBD_AEBaError "" UBYTE AEBD_subsystem_integrated_CM_boolean 0 0 0 1 ECU_ADDRESS 0xb0002135 /* @ECU_Address@VbAEBD_AEBaError@ */ /end MEASUREMENT
/begin MEASUREMENT VbAEBD_AEBrequest "" UBYTE AEBD_subsystem_integrated_CM_boolean 0 0 0 1 ECU_ADDRESS 0xb0002134 /* @ECU_Address@VbAEBD_AEBrequest@ */ /end MEASUREMENT
/begin MEASUREMENT VfALCA_v_LateralSpeedOutput "ALCA outpurt." FLOAT32_IEEE ALCA_subsystem_integrated_CM_single_m_s 0 0 -3.4E+38 3.4E+38 ECU_ADDRESS 0xb0002e90 /* @ECU_Address@VfALCA_v_LateralSpeedOutput@ */ /end MEASUREMENT
/begin MEASUREMENT VfALCA_d_LateralDist2GoFromLCCS "Larteral distance to go from LCCS." FLOAT32_IEEE ALCA_subsystem_integrated_CM_single_m 0 0 -3.4E+38 3.4E+38 ECU_ADDRESS 0xb0002e8c /* @ECU_Address@VfALCA_d_LateralDist2GoFromLCCS@ */ /end MEASUREMENT
/begin MEASUREMENT VfALCA_RightLaneMarker_C0 "" FLOAT32_IEEE ALCA_subsystem_integrated_CM_single 0 0 -3.4E+38 3.4E+38 ECU_ADDRESS 0xb0002e88 /* @ECU_Address@VfALCA_RightLaneMarker_C0@ */ /end MEASUREMENT
/begin MEASUREMENT VfALCA_RightLaneMarker_C1 "" FLOAT32_IEEE ALCA_subsystem_integrated_CM_single 0 0 -3.4E+38 3.4E+38 ECU_ADDRESS 0xb0002e84 /* @ECU_Address@VfALCA_RightLaneMarker_C1@ */ /end MEASUREMENT
/begin MEASUREMENT VfALCA_RightLaneMarker_C2 "" FLOAT32_IEEE ALCA_subsystem_integrated_CM_single 0 0 -3.4E+38 3.4E+38 ECU_ADDRESS 0xb0002e80 /* @ECU_Address@VfALCA_RightLaneMarker_C2@ */ /end MEASUREMENT
/begin MEASUREMENT VfALCA_RightLaneMarker_C3 "" FLOAT32_IEEE ALCA_subsystem_integrated_CM_single 0 0 -3.4E+38 3.4E+38 ECU_ADDRESS 0xb0002e7c /* @ECU_Address@VfALCA_RightLaneMarker_C3@ */ /end MEASUREMENT
/begin MEASUREMENT VfALCA_RightDist2Host "Distance-to-host of right lane marker." FLOAT32_IEEE ALCA_subsystem_integrated_CM_single_m 0 0 -3.4E+38 3.4E+38 ECU_ADDRESS 0xb0002e78 /* @ECU_Address@VfALCA_RightDist2Host@ */ /end MEASUREMENT
/begin MEASUREMENT VfALCA_LeftLaneMarker_C0 "" FLOAT32_IEEE ALCA_subsystem_integrated_CM_single 0 0 -3.4E+38 3.4E+38 ECU_ADDRESS 0xb0002e74 /* @ECU_Address@VfALCA_LeftLaneMarker_C0@ */ /end MEASUREMENT
/begin MEASUREMENT VfALCA_LeftLaneMarker_C1 "" FLOAT32_IEEE ALCA_subsystem_integrated_CM_single 0 0 -3.4E+38 3.4E+38 ECU_ADDRESS 0xb0002e70 /* @ECU_Address@VfALCA_LeftLaneMarker_C1@ */ /end MEASUREMENT
/begin MEASUREMENT VfALCA_LeftLaneMarker_C2 "" FLOAT32_IEEE ALCA_subsystem_integrated_CM_single 0 0 -3.4E+38 3.4E+38 ECU_ADDRESS 0xb0002e6c /* @ECU_Address@VfALCA_LeftLaneMarker_C2@ */ /end MEASUREMENT
/begin MEASUREMENT VfALCA_LeftLaneMarker_C3 "" FLOAT32_IEEE ALCA_subsystem_integrated_CM_single 0 0 -3.4E+38 3.4E+38 ECU_ADDRESS 0xb0002e68 /* @ECU_Address@VfALCA_LeftLaneMarker_C3@ */ /end MEASUREMENT
/begin MEASUREMENT VfALCA_LeftDist2Host "Distance-to-host of left lane marker." FLOAT32_IEEE ALCA_subsystem_integrated_CM_single_m 0 0 -3.4E+38 3.4E+38 ECU_ADDRESS 0xb0002e64 /* @ECU_Address@VfALCA_LeftDist2Host@ */ /end MEASUREMENT
/begin MEASUREMENT VfALCA_v_VehSpeed "Speed of ego veh." FLOAT32_IEEE ALCA_subsystem_integrated_CM_single_m_s 0 0 -3.4E+38 3.4E+38 ECU_ADDRESS 0xb0002e60 /* @ECU_Address@VfALCA_v_VehSpeed@ */ /end MEASUREMENT
/begin MEASUREMENT VfALCA_v_VehVx "Speed of ego veh." FLOAT32_IEEE ALCA_subsystem_integrated_CM_single_m_s 0 0 -3.4E+38 3.4E+38 ECU_ADDRESS 0xb0002e5c /* @ECU_Address@VfALCA_v_VehVx@ */ /end MEASUREMENT
/begin MEASUREMENT VfALCA_v_VehVy "Speed of ego veh." FLOAT32_IEEE ALCA_subsystem_integrated_CM_single_m_s 0 0 -3.4E+38 3.4E+38 ECU_ADDRESS 0xb0002e58 /* @ECU_Address@VfALCA_v_VehVy@ */ /end MEASUREMENT
/begin MEASUREMENT VfALCA_ObstacleNearest_x "" FLOAT32_IEEE ALCA_subsystem_integrated_CM_single 0 0 -3.4E+38 3.4E+38 ECU_ADDRESS 0xb0002e54 /* @ECU_Address@VfALCA_ObstacleNearest_x@ */ /end MEASUREMENT
/begin MEASUREMENT VfALCA_ObstacleNearest_y "" FLOAT32_IEEE ALCA_subsystem_integrated_CM_single 0 0 -3.4E+38 3.4E+38 ECU_ADDRESS 0xb0002e50 /* @ECU_Address@VfALCA_ObstacleNearest_y@ */ /end MEASUREMENT
/begin MEASUREMENT VfALCA_ObstacleCenter_x "" FLOAT32_IEEE ALCA_subsystem_integrated_CM_single 0 0 -3.4E+38 3.4E+38 ECU_ADDRESS 0xb0002e4c /* @ECU_Address@VfALCA_ObstacleCenter_x@ */ /end MEASUREMENT
/begin MEASUREMENT VfALCA_v_Obstacle_Vx "" FLOAT32_IEEE ALCA_subsystem_integrated_CM_single_m_s 0 0 -3.4E+38 3.4E+38 ECU_ADDRESS 0xb0002e48 /* @ECU_Address@VfALCA_v_Obstacle_Vx@ */ /end MEASUREMENT
/begin MEASUREMENT VfALCA_v_Obstacle_Vy "" FLOAT32_IEEE ALCA_subsystem_integrated_CM_single_m_s 0 0 -3.4E+38 3.4E+38 ECU_ADDRESS 0xb0002e44 /* @ECU_Address@VfALCA_v_Obstacle_Vy@ */ /end MEASUREMENT
/begin MEASUREMENT VfALCA_ObstacleCenter_y "" FLOAT32_IEEE ALCA_subsystem_integrated_CM_single 0 0 -3.4E+38 3.4E+38 ECU_ADDRESS 0xb0002e40 /* @ECU_Address@VfALCA_ObstacleCenter_y@ */ /end MEASUREMENT
/begin MEASUREMENT VfALCA_ObstacleLength "" FLOAT32_IEEE ALCA_subsystem_integrated_CM_single_m 0 0 -3.4E+38 3.4E+38 ECU_ADDRESS 0xb0002e3c /* @ECU_Address@VfALCA_ObstacleLength@ */ /end MEASUREMENT
/begin MEASUREMENT VfALCA_ObstacleWidth "" FLOAT32_IEEE ALCA_subsystem_integrated_CM_single_m 0 0 -3.4E+38 3.4E+38 ECU_ADDRESS 0xb0002e38 /* @ECU_Address@VfALCA_ObstacleWidth@ */ /end MEASUREMENT
/begin MEASUREMENT VfALCA_ObstacleHeading "" FLOAT32_IEEE ALCA_subsystem_integrated_CM_single 0 0 -3.4E+38 3.4E+38 ECU_ADDRESS 0xb0002e34 /* @ECU_Address@VfALCA_ObstacleHeading@ */ /end MEASUREMENT
/begin MEASUREMENT VfALCA_t_LCTime "" FLOAT32_IEEE ALCA_subsystem_integrated_CM_single_s 0 0 -3.4E+38 3.4E+38 ECU_ADDRESS 0xb0002e30 /* @ECU_Address@VfALCA_t_LCTime@ */ /end MEASUREMENT
/begin MEASUREMENT VfALCA_d_Host2TargetLaneCenter "Distance of ost to target lane center." FLOAT32_IEEE ALCA_subsystem_integrated_CM_single_m 0 0 -3.4E+38 3.4E+38 ECU_ADDRESS 0xb0002e2c /* @ECU_Address@VfALCA_d_Host2TargetLaneCenter@ */ /end MEASUREMENT
/begin MEASUREMENT VfALCA_d_EGOLaneCenter2Host "Distance of ost to ego lane center." FLOAT32_IEEE ALCA_subsystem_integrated_CM_single_m 0 0 -3.4E+38 3.4E+38 ECU_ADDRESS 0xb0002e28 /* @ECU_Address@VfALCA_d_EGOLaneCenter2Host@ */ /end MEASUREMENT
/begin MEASUREMENT VfALCA_d_TargetSideLaneMarker2Host "Distance of host to request-side-lane-marker." FLOAT32_IEEE ALCA_subsystem_integrated_CM_single_m 0 0 -3.4E+38 3.4E+38 ECU_ADDRESS 0xb0002e24 /* @ECU_Address@VfALCA_d_TargetSideLaneMarker2Host@ */ /end MEASUREMENT
/begin MEASUREMENT VfALCA_ObstacleID "" SLONG ALCA_subsystem_integrated_CM_int32 0 0 -2147483648 2147483647 ECU_ADDRESS 0xb0002e20 /* @ECU_Address@VfALCA_ObstacleID@ */ /end MEASUREMENT
/begin MEASUREMENT VfALCA_RightLaneMarkerFusionStatus "Right Lane Marker`s Fusion Status" SBYTE ALCA_subsystem_integrated_CM_int8 0 0 -128 127 ECU_ADDRESS 0xb0002e1e /* @ECU_Address@VfALCA_RightLaneMarkerFusionStatus@ */ /end MEASUREMENT
/begin MEASUREMENT VfALCA_RightLaneMarkerType "Right Lane Marker`s  type" SBYTE ALCA_subsystem_integrated_CM_int8 0 0 -128 127 ECU_ADDRESS 0xb0002e1d /* @ECU_Address@VfALCA_RightLaneMarkerType@ */ /end MEASUREMENT
/begin MEASUREMENT VfALCA_LeftLaneMarkerFusionStatus "Left Lane Marker`s Fusion Status" SBYTE ALCA_subsystem_integrated_CM_int8 0 0 -128 127 ECU_ADDRESS 0xb0002e1c /* @ECU_Address@VfALCA_LeftLaneMarkerFusionStatus@ */ /end MEASUREMENT
/begin MEASUREMENT VfALCA_LeftLaneMarkerType "Left Lane Marker`s type." SBYTE ALCA_subsystem_integrated_CM_int8 0 0 -128 127 ECU_ADDRESS 0xb0002e1b /* @ECU_Address@VfALCA_LeftLaneMarkerType@ */ /end MEASUREMENT
/begin MEASUREMENT VfALCA_FaultOutput "ALCA outpurt." UBYTE ALCA_subsystem_integrated_CM_uint8 0 0 0 255 ECU_ADDRESS 0xb0002e1a /* @ECU_Address@VfALCA_FaultOutput@ */ /end MEASUREMENT
/begin MEASUREMENT VfALCA_FaultInit "Fault before outpurt." UBYTE ALCA_subsystem_integrated_CM_uint8 0 0 0 255 ECU_ADDRESS 0xb0002e19 /* @ECU_Address@VfALCA_FaultInit@ */ /end MEASUREMENT
/begin MEASUREMENT VfALCA_InterruptAction "" UBYTE ALCA_subsystem_integrated_CM_uint8 0 0 0 255 ECU_ADDRESS 0xb0002e18 /* @ECU_Address@VfALCA_InterruptAction@ */ /end MEASUREMENT
/begin MEASUREMENT VbALCA_ALCAEnableFromDCSN "ALCA enable from Dcsn." UBYTE ALCA_subsystem_integrated_CM_boolean 0 0 0 1 ECU_ADDRESS 0xb0002e17 /* @ECU_Address@VbALCA_ALCAEnableFromDCSN@ */ /end MEASUREMENT
/begin MEASUREMENT VbALCA_RequestOutput "ALCA outpurt." UBYTE ALCA_subsystem_integrated_CM_boolean 0 0 0 1 ECU_ADDRESS 0xb0002e16 /* @ECU_Address@VbALCA_RequestOutput@ */ /end MEASUREMENT
/begin MEASUREMENT VfALCA_v_InterruptOutput "" UBYTE ALCA_subsystem_integrated_CM_boolean 0 0 0 1 ECU_ADDRESS 0xb0002e15 /* @ECU_Address@VfALCA_v_InterruptOutput@ */ /end MEASUREMENT
/begin MEASUREMENT VbALCA_LC_CancelReqFromDCSN "Lane change cancel request from DCSN." UBYTE ALCA_subsystem_integrated_CM_boolean 0 0 0 1 ECU_ADDRESS 0xb0002e14 /* @ECU_Address@VbALCA_LC_CancelReqFromDCSN@ */ /end MEASUREMENT
/begin MEASUREMENT VbALCA_LC_ReqFromDCSN "Lane change from DCSN." UBYTE ALCA_subsystem_integrated_CM_boolean 0 0 0 1 ECU_ADDRESS 0xb0002e13 /* @ECU_Address@VbALCA_LC_ReqFromDCSN@ */ /end MEASUREMENT
/begin MEASUREMENT VbALCA_LC_Req "Lane change from DCSN." UBYTE ALCA_subsystem_integrated_CM_boolean 0 0 0 1 ECU_ADDRESS 0xb0002e12 /* @ECU_Address@VbALCA_LC_Req@ */ /end MEASUREMENT
/begin MEASUREMENT VbALCA_LC_CancelReq "Lane change cancel request from DCSN." UBYTE ALCA_subsystem_integrated_CM_boolean 0 0 0 1 ECU_ADDRESS 0xb0002e11 /* @ECU_Address@VbALCA_LC_CancelReq@ */ /end MEASUREMENT
/begin MEASUREMENT VbALCA_ResetLaneChangeReq "Reset lane change request from DCSN." UBYTE ALCA_subsystem_integrated_CM_boolean 0 0 0 1 ECU_ADDRESS 0xb0002e10 /* @ECU_Address@VbALCA_ResetLaneChangeReq@ */ /end MEASUREMENT
/begin MEASUREMENT VbALCA_LC_Complete "Lane change complete flag." UBYTE ALCA_subsystem_integrated_CM_boolean 0 0 0 1 ECU_ADDRESS 0xb0002e0f /* @ECU_Address@VbALCA_LC_Complete@ */ /end MEASUREMENT
/begin MEASUREMENT VbALCA_TouchedNewLane "Has touched new lane." UBYTE ALCA_subsystem_integrated_CM_boolean 0 0 0 1 ECU_ADDRESS 0xb0002e0e /* @ECU_Address@VbALCA_TouchedNewLane@ */ /end MEASUREMENT
/begin MEASUREMENT VeALCA_ReqSideOutput "ALCA outpurt." UBYTE ALCA_subsystem_integrated_CM_EnumDCSN_driving_direction 0 0 0 2 ECU_ADDRESS 0xb0002e0d /* @ECU_Address@VeALCA_ReqSideOutput@ */ /end MEASUREMENT
/begin MEASUREMENT VeALCA_ReqSideFromDCSN "Request side from DCSN." UBYTE ALCA_subsystem_integrated_CM_EnumDCSN_driving_direction 0 0 0 2 ECU_ADDRESS 0xb0002e0c /* @ECU_Address@VeALCA_ReqSideFromDCSN@ */ /end MEASUREMENT
/begin MEASUREMENT VeALCA_ReqSide "Request side from DCSN." UBYTE ALCA_subsystem_integrated_CM_EnumDCSN_driving_direction 0 0 0 2 ECU_ADDRESS 0xb0002e0b /* @ECU_Address@VeALCA_ReqSide@ */ /end MEASUREMENT
/begin MEASUREMENT VeALCA_StateOutput "ALCA outpurt." UBYTE ALCA_subsystem_integrated_CM_EnumALCA_state 0 0 0 7 ECU_ADDRESS 0xb0002e0a /* @ECU_Address@VeALCA_StateOutput@ */ /end MEASUREMENT
/begin MEASUREMENT VeALCA_NotFulfillReasonOutput "ALCA outpurt." UBYTE ALCA_subsystem_integrated_CM_EnumALCA_not_fulfill_reason 0 0 0 9 ECU_ADDRESS 0xb0002e09 /* @ECU_Address@VeALCA_NotFulfillReasonOutput@ */ /end MEASUREMENT
/begin MEASUREMENT VfALCA_v_InterruptTypeOutput "" UBYTE ALCA_subsystem_integrated_CM_EnumALCA_interrupt_type 0 0 0 2 ECU_ADDRESS 0xb0002e08 /* @ECU_Address@VfALCA_v_InterruptTypeOutput@ */ /end MEASUREMENT
/begin MEASUREMENT VfALCA_TargetLaneLength "" FLOAT32_IEEE ALCA_subsystem_integrated_CM_single 0 0 -3.4E+38 3.4E+38 ECU_ADDRESS 0xb0002e04 /* @ECU_Address@VfALCA_TargetLaneLength@ */ /end MEASUREMENT
/begin MEASUREMENT VfALCA_TargetLaneWidth "" FLOAT32_IEEE ALCA_subsystem_integrated_CM_single 0 0 -3.4E+38 3.4E+38 ECU_ADDRESS 0xb0002e00 /* @ECU_Address@VfALCA_TargetLaneWidth@ */ /end MEASUREMENT
/begin MEASUREMENT VfALCA_d_EGOLaneLength "Length of ego lane." FLOAT32_IEEE ALCA_subsystem_integrated_CM_single_m 0 0 -3.4E+38 3.4E+38 ECU_ADDRESS 0xb0002dfc /* @ECU_Address@VfALCA_d_EGOLaneLength@ */ /end MEASUREMENT
/begin MEASUREMENT VfALCA_d_EGOLaneWidth "Width of ego lane." FLOAT32_IEEE ALCA_subsystem_integrated_CM_single_m 0 0 -3.4E+38 3.4E+38 ECU_ADDRESS 0xb0002df8 /* @ECU_Address@VfALCA_d_EGOLaneWidth@ */ /end MEASUREMENT
/begin MEASUREMENT VfALCA_v_VehLonSpeed2LaneMarker "" FLOAT32_IEEE ALCA_subsystem_integrated_CM_single 0 0 -3.4E+38 3.4E+38 ECU_ADDRESS 0xb0002df4 /* @ECU_Address@VfALCA_v_VehLonSpeed2LaneMarker@ */ /end MEASUREMENT
/begin MEASUREMENT VfALCA_ObstacleNum "" UWORD ALCA_subsystem_integrated_CM_uint16 0 0 0 65535 ECU_ADDRESS 0xb0002df0 /* @ECU_Address@VfALCA_ObstacleNum@ */ /end MEASUREMENT
/begin MEASUREMENT VfALCA_TargetLaneType "" SBYTE ALCA_subsystem_integrated_CM_int8 0 0 -128 127 ECU_ADDRESS 0xb0002def /* @ECU_Address@VfALCA_TargetLaneType@ */ /end MEASUREMENT
/begin MEASUREMENT VfALCA_TargetSideLaneMarkerType "" SBYTE ALCA_subsystem_integrated_CM_int8 0 0 -128 127 ECU_ADDRESS 0xb0002dee /* @ECU_Address@VfALCA_TargetSideLaneMarkerType@ */ /end MEASUREMENT
/begin MEASUREMENT VfALCA_HasLeftLane "Has left lane." UBYTE ALCA_subsystem_integrated_CM_boolean 0 0 0 1 ECU_ADDRESS 0xb0002ded /* @ECU_Address@VfALCA_HasLeftLane@ */ /end MEASUREMENT
/begin MEASUREMENT VfALCA_HasRightLane "Has right lane." UBYTE ALCA_subsystem_integrated_CM_boolean 0 0 0 1 ECU_ADDRESS 0xb0002dec /* @ECU_Address@VfALCA_HasRightLane@ */ /end MEASUREMENT
/begin MEASUREMENT VfLKAS_Vlat_sLKA "" FLOAT32_IEEE LKAS_subsystem_integrated_CM_single 0 0 -3.4E+38 3.4E+38 ECU_ADDRESS 0xb00075a4 /* @ECU_Address@VfLKAS_Vlat_sLKA@ */ /end MEASUREMENT
/begin MEASUREMENT VfLKAS_L_DistToCross_sLKA "" FLOAT32_IEEE LKAS_subsystem_integrated_CM_single 0 0 -3.4E+38 3.4E+38 ECU_ADDRESS 0xb00075a0 /* @ECU_Address@VfLKAS_L_DistToCross_sLKA@ */ /end MEASUREMENT
/begin MEASUREMENT VfLKAS_L_ExtraMargin_sLKA "" FLOAT32_IEEE LKAS_subsystem_integrated_CM_single 0 0 -3.4E+38 3.4E+38 ECU_ADDRESS 0xb000759c /* @ECU_Address@VfLKAS_L_ExtraMargin_sLKA@ */ /end MEASUREMENT
/begin MEASUREMENT VfLKAS_A_ALatRelLaneMkr_sLKA "" FLOAT32_IEEE LKAS_subsystem_integrated_CM_single 0 0 -3.4E+38 3.4E+38 ECU_ADDRESS 0xb0007598 /* @ECU_Address@VfLKAS_A_ALatRelLaneMkr_sLKA@ */ /end MEASUREMENT
/begin MEASUREMENT VfLKAS_A_ALatRelLaneMkrLe "" FLOAT32_IEEE LKAS_subsystem_integrated_CM_single 0 0 -3.4E+38 3.4E+38 ECU_ADDRESS 0xb0007594 /* @ECU_Address@VfLKAS_A_ALatRelLaneMkrLe@ */ /end MEASUREMENT
/begin MEASUREMENT VfLKAS_A_ALatRelLaneMkrRi "" FLOAT32_IEEE LKAS_subsystem_integrated_CM_single 0 0 -3.4E+38 3.4E+38 ECU_ADDRESS 0xb0007590 /* @ECU_Address@VfLKAS_A_ALatRelLaneMkrRi@ */ /end MEASUREMENT
/begin MEASUREMENT VfLKAS_Vlong_sLKA "" FLOAT32_IEEE LKAS_subsystem_integrated_CM_single 0 0 -3.4E+38 3.4E+38 ECU_ADDRESS 0xb000758c /* @ECU_Address@VfLKAS_Vlong_sLKA@ */ /end MEASUREMENT
/begin MEASUREMENT VfLKAS_vlat_0 "" FLOAT32_IEEE LKAS_subsystem_integrated_CM_single 0 0 -3.4E+38 3.4E+38 ECU_ADDRESS 0xb0007588 /* @ECU_Address@VfLKAS_vlat_0@ */ /end MEASUREMENT
/begin MEASUREMENT VfLKAS_alat_0 "" FLOAT32_IEEE LKAS_subsystem_integrated_CM_single 0 0 -3.4E+38 3.4E+38 ECU_ADDRESS 0xb0007584 /* @ECU_Address@VfLKAS_alat_0@ */ /end MEASUREMENT
/begin MEASUREMENT VfLKAS_delta_pos_sLKA "" FLOAT32_IEEE LKAS_subsystem_integrated_CM_single 0 0 -3.4E+38 3.4E+38 ECU_ADDRESS 0xb0007580 /* @ECU_Address@VfLKAS_delta_pos_sLKA@ */ /end MEASUREMENT
/begin MEASUREMENT VfLKAS_TimeNeeded_sLKA "" FLOAT32_IEEE LKAS_subsystem_integrated_CM_single 0 0 -3.4E+38 3.4E+38 ECU_ADDRESS 0xb000757c /* @ECU_Address@VfLKAS_TimeNeeded_sLKA@ */ /end MEASUREMENT
/begin MEASUREMENT VfLKAS_end_offst_sLKA "" FLOAT32_IEEE LKAS_subsystem_integrated_CM_single 0 0 -3.4E+38 3.4E+38 ECU_ADDRESS 0xb0007578 /* @ECU_Address@VfLKAS_end_offst_sLKA@ */ /end MEASUREMENT
/begin MEASUREMENT VfLKAS_dt_sLKA "" FLOAT32_IEEE LKAS_subsystem_integrated_CM_single 0 0 -3.4E+38 3.4E+38 ECU_ADDRESS 0xb0007574 /* @ECU_Address@VfLKAS_dt_sLKA@ */ /end MEASUREMENT
/begin MEASUREMENT VfLKAS_A0_sLKA "" FLOAT32_IEEE LKAS_subsystem_integrated_CM_single 0 0 -3.4E+38 3.4E+38 ECU_ADDRESS 0xb0007570 /* @ECU_Address@VfLKAS_A0_sLKA@ */ /end MEASUREMENT
/begin MEASUREMENT VfLKAS_Am_sLKA "" FLOAT32_IEEE LKAS_subsystem_integrated_CM_single 0 0 -3.4E+38 3.4E+38 ECU_ADDRESS 0xb000756c /* @ECU_Address@VfLKAS_Am_sLKA@ */ /end MEASUREMENT
/begin MEASUREMENT VfLKAS_Ae_sLKA "" FLOAT32_IEEE LKAS_subsystem_integrated_CM_single 0 0 -3.4E+38 3.4E+38 ECU_ADDRESS 0xb0007568 /* @ECU_Address@VfLKAS_Ae_sLKA@ */ /end MEASUREMENT
/begin MEASUREMENT VfLKAS_Am1 "" FLOAT32_IEEE LKAS_subsystem_integrated_CM_single 0 0 -3.4E+38 3.4E+38 ECU_ADDRESS 0xb0007564 /* @ECU_Address@VfLKAS_Am1@ */ /end MEASUREMENT
/begin MEASUREMENT VfLKAS_Am2 "" FLOAT32_IEEE LKAS_subsystem_integrated_CM_single 0 0 -3.4E+38 3.4E+38 ECU_ADDRESS 0xb0007560 /* @ECU_Address@VfLKAS_Am2@ */ /end MEASUREMENT
/begin MEASUREMENT VfLKAS_dt1 "" FLOAT32_IEEE LKAS_subsystem_integrated_CM_single 0 0 -3.4E+38 3.4E+38 ECU_ADDRESS 0xb000755c /* @ECU_Address@VfLKAS_dt1@ */ /end MEASUREMENT
/begin MEASUREMENT VfLKAS_dt2 "" FLOAT32_IEEE LKAS_subsystem_integrated_CM_single 0 0 -3.4E+38 3.4E+38 ECU_ADDRESS 0xb0007558 /* @ECU_Address@VfLKAS_dt2@ */ /end MEASUREMENT
/begin MEASUREMENT VfLKAS_JerkNeeded_sLkA "" FLOAT32_IEEE LKAS_subsystem_integrated_CM_single 0 0 -3.4E+38 3.4E+38 ECU_ADDRESS 0xb0007554 /* @ECU_Address@VfLKAS_JerkNeeded_sLkA@ */ /end MEASUREMENT
/begin MEASUREMENT VfLKAS_LatAccNeeded_sLKA "" FLOAT32_IEEE LKAS_subsystem_integrated_CM_single 0 0 -3.4E+38 3.4E+38 ECU_ADDRESS 0xb0007550 /* @ECU_Address@VfLKAS_LatAccNeeded_sLKA@ */ /end MEASUREMENT
/begin MEASUREMENT VfLKAS_FirstEndPos "" FLOAT32_IEEE LKAS_subsystem_integrated_CM_single 0 0 -3.4E+38 3.4E+38 ECU_ADDRESS 0xb000754c /* @ECU_Address@VfLKAS_FirstEndPos@ */ /end MEASUREMENT
/begin MEASUREMENT VfLKAS_FirstEndVlat "" FLOAT32_IEEE LKAS_subsystem_integrated_CM_single 0 0 -3.4E+38 3.4E+38 ECU_ADDRESS 0xb0007548 /* @ECU_Address@VfLKAS_FirstEndVlat@ */ /end MEASUREMENT
/begin MEASUREMENT VfLKAS_SecEndPos "" FLOAT32_IEEE LKAS_subsystem_integrated_CM_single 0 0 -3.4E+38 3.4E+38 ECU_ADDRESS 0xb0007544 /* @ECU_Address@VfLKAS_SecEndPos@ */ /end MEASUREMENT
/begin MEASUREMENT VfLKAS_SecEndVlat "" FLOAT32_IEEE LKAS_subsystem_integrated_CM_single 0 0 -3.4E+38 3.4E+38 ECU_ADDRESS 0xb0007540 /* @ECU_Address@VfLKAS_SecEndVlat@ */ /end MEASUREMENT
/begin MEASUREMENT VfLKAS_V_Latleft "" FLOAT32_IEEE LKAS_subsystem_integrated_CM_single 0 0 -3.4E+38 3.4E+38 ECU_ADDRESS 0xb000753c /* @ECU_Address@VfLKAS_V_Latleft@ */ /end MEASUREMENT
/begin MEASUREMENT VfLKAS_L_OffstLeft "" FLOAT32_IEEE LKAS_subsystem_integrated_CM_single 0 0 -3.4E+38 3.4E+38 ECU_ADDRESS 0xb0007538 /* @ECU_Address@VfLKAS_L_OffstLeft@ */ /end MEASUREMENT
/begin MEASUREMENT VfLKAS_Heading "" FLOAT32_IEEE LKAS_subsystem_integrated_CM_single 0 0 -3.4E+38 3.4E+38 ECU_ADDRESS 0xb0007534 /* @ECU_Address@VfLKAS_Heading@ */ /end MEASUREMENT
/begin MEASUREMENT VfLKAS_VLatRight "" FLOAT32_IEEE LKAS_subsystem_integrated_CM_single 0 0 -3.4E+38 3.4E+38 ECU_ADDRESS 0xb0007530 /* @ECU_Address@VfLKAS_VLatRight@ */ /end MEASUREMENT
/begin MEASUREMENT VfLKAS_OffstRi_sLKA "" FLOAT32_IEEE LKAS_subsystem_integrated_CM_single 0 0 -3.4E+38 3.4E+38 ECU_ADDRESS 0xb000752c /* @ECU_Address@VfLKAS_OffstRi_sLKA@ */ /end MEASUREMENT
/begin MEASUREMENT VfLKAS_Cr_Road "" FLOAT32_IEEE LKAS_subsystem_integrated_CM_single 0 0 -3.4E+38 3.4E+38 ECU_ADDRESS 0xb0007528 /* @ECU_Address@VfLKAS_Cr_Road@ */ /end MEASUREMENT
/begin MEASUREMENT VfLKAS_LaneWidth "" FLOAT32_IEEE LKAS_subsystem_integrated_CM_single 0 0 -3.4E+38 3.4E+38 ECU_ADDRESS 0xb0007524 /* @ECU_Address@VfLKAS_LaneWidth@ */ /end MEASUREMENT
/begin MEASUREMENT VfLKAS_Velocity_x "" FLOAT32_IEEE LKAS_subsystem_integrated_CM_single 0 0 -3.4E+38 3.4E+38 ECU_ADDRESS 0xb0007520 /* @ECU_Address@VfLKAS_Velocity_x@ */ /end MEASUREMENT
/begin MEASUREMENT VfLKAS_yaw_rate_utm "" FLOAT32_IEEE LKAS_subsystem_integrated_CM_single 0 0 -3.4E+38 3.4E+38 ECU_ADDRESS 0xb000751c /* @ECU_Address@VfLKAS_yaw_rate_utm@ */ /end MEASUREMENT
/begin MEASUREMENT VfLKAS_Acceleration_x "" FLOAT32_IEEE LKAS_subsystem_integrated_CM_single 0 0 -3.4E+38 3.4E+38 ECU_ADDRESS 0xb0007518 /* @ECU_Address@VfLKAS_Acceleration_x@ */ /end MEASUREMENT
/begin MEASUREMENT VfLKAS_Acce_y "" FLOAT32_IEEE LKAS_subsystem_integrated_CM_single 0 0 -3.4E+38 3.4E+38 ECU_ADDRESS 0xb0007514 /* @ECU_Address@VfLKAS_Acce_y@ */ /end MEASUREMENT
/begin MEASUREMENT VfLKAS_T_AftIntvStart_IntOut "" FLOAT32_IEEE LKAS_subsystem_integrated_CM_single 0 0 -3.4E+38 3.4E+38 ECU_ADDRESS 0xb0007510 /* @ECU_Address@VfLKAS_T_AftIntvStart_IntOut@ */ /end MEASUREMENT
/begin MEASUREMENT VfLKAS_RiC0 "" FLOAT32_IEEE LKAS_subsystem_integrated_CM_single 0 0 -3.4E+38 3.4E+38 ECU_ADDRESS 0xb000750c /* @ECU_Address@VfLKAS_RiC0@ */ /end MEASUREMENT
/begin MEASUREMENT VfLKAS_RiC1 "" FLOAT32_IEEE LKAS_subsystem_integrated_CM_single 0 0 -3.4E+38 3.4E+38 ECU_ADDRESS 0xb0007508 /* @ECU_Address@VfLKAS_RiC1@ */ /end MEASUREMENT
/begin MEASUREMENT VfLKAS_RiC2 "" FLOAT32_IEEE LKAS_subsystem_integrated_CM_single 0 0 -3.4E+38 3.4E+38 ECU_ADDRESS 0xb0007504 /* @ECU_Address@VfLKAS_RiC2@ */ /end MEASUREMENT
/begin MEASUREMENT VfLKAS_Ri_Length "" FLOAT32_IEEE LKAS_subsystem_integrated_CM_single 0 0 -3.4E+38 3.4E+38 ECU_ADDRESS 0xb0007500 /* @ECU_Address@VfLKAS_Ri_Length@ */ /end MEASUREMENT
/begin MEASUREMENT VfLKAS_L_DistToCrossRight "" FLOAT32_IEEE LKAS_subsystem_integrated_CM_single 0 0 -3.4E+38 3.4E+38 ECU_ADDRESS 0xb00074fc /* @ECU_Address@VfLKAS_L_DistToCrossRight@ */ /end MEASUREMENT
/begin MEASUREMENT VfLAKS_LeC0 "" FLOAT32_IEEE LKAS_subsystem_integrated_CM_single 0 0 -3.4E+38 3.4E+38 ECU_ADDRESS 0xb00074f8 /* @ECU_Address@VfLAKS_LeC0@ */ /end MEASUREMENT
/begin MEASUREMENT VfLAKS_LeC1 "" FLOAT32_IEEE LKAS_subsystem_integrated_CM_single 0 0 -3.4E+38 3.4E+38 ECU_ADDRESS 0xb00074f4 /* @ECU_Address@VfLAKS_LeC1@ */ /end MEASUREMENT
/begin MEASUREMENT VfLKAS_LeC2 "" FLOAT32_IEEE LKAS_subsystem_integrated_CM_single 0 0 -3.4E+38 3.4E+38 ECU_ADDRESS 0xb00074f0 /* @ECU_Address@VfLKAS_LeC2@ */ /end MEASUREMENT
/begin MEASUREMENT VfLKAS_LeLength "" FLOAT32_IEEE LKAS_subsystem_integrated_CM_single 0 0 -3.4E+38 3.4E+38 ECU_ADDRESS 0xb00074ec /* @ECU_Address@VfLKAS_LeLength@ */ /end MEASUREMENT
/begin MEASUREMENT VfLKAS_L_DisToCrossLeft "" FLOAT32_IEEE LKAS_subsystem_integrated_CM_single 0 0 -3.4E+38 3.4E+38 ECU_ADDRESS 0xb00074e8 /* @ECU_Address@VfLKAS_L_DisToCrossLeft@ */ /end MEASUREMENT
/begin MEASUREMENT VfLKAS_T_AftIntvStart "" FLOAT32_IEEE LKAS_subsystem_integrated_CM_single 0 0 -3.4E+38 3.4E+38 ECU_ADDRESS 0xb00074e4 /* @ECU_Address@VfLKAS_T_AftIntvStart@ */ /end MEASUREMENT
/begin MEASUREMENT VfLKAS_dtFreezed_sLKA "" FLOAT32_IEEE LKAS_subsystem_integrated_CM_single 0 0 -3.4E+38 3.4E+38 ECU_ADDRESS 0xb00074e0 /* @ECU_Address@VfLKAS_dtFreezed_sLKA@ */ /end MEASUREMENT
/begin MEASUREMENT VfLKAS_AmFreezed_sLKA "" FLOAT32_IEEE LKAS_subsystem_integrated_CM_single 0 0 -3.4E+38 3.4E+38 ECU_ADDRESS 0xb00074dc /* @ECU_Address@VfLKAS_AmFreezed_sLKA@ */ /end MEASUREMENT
/begin MEASUREMENT VfLKAS_V0Freezed_sLKA "" FLOAT32_IEEE LKAS_subsystem_integrated_CM_single 0 0 -3.4E+38 3.4E+38 ECU_ADDRESS 0xb00074d8 /* @ECU_Address@VfLKAS_V0Freezed_sLKA@ */ /end MEASUREMENT
/begin MEASUREMENT VfLKAS_A0Freezed_sLKA "" FLOAT32_IEEE LKAS_subsystem_integrated_CM_single 0 0 -3.4E+38 3.4E+38 ECU_ADDRESS 0xb00074d4 /* @ECU_Address@VfLKAS_A0Freezed_sLKA@ */ /end MEASUREMENT
/begin MEASUREMENT VfLKAS_AeFreezed_sLKA "" FLOAT32_IEEE LKAS_subsystem_integrated_CM_single 0 0 -3.4E+38 3.4E+38 ECU_ADDRESS 0xb00074d0 /* @ECU_Address@VfLKAS_AeFreezed_sLKA@ */ /end MEASUREMENT
/begin MEASUREMENT VfLKAS_Jerk2 "" FLOAT32_IEEE LKAS_subsystem_integrated_CM_single 0 0 -3.4E+38 3.4E+38 ECU_ADDRESS 0xb00074cc /* @ECU_Address@VfLKAS_Jerk2@ */ /end MEASUREMENT
/begin MEASUREMENT VfLKAS_TargetDist_Freezed2 "" FLOAT32_IEEE LKAS_subsystem_integrated_CM_single 0 0 -3.4E+38 3.4E+38 ECU_ADDRESS 0xb00074c8 /* @ECU_Address@VfLKAS_TargetDist_Freezed2@ */ /end MEASUREMENT
/begin MEASUREMENT VfLKAS_Jerk1 "" FLOAT32_IEEE LKAS_subsystem_integrated_CM_single 0 0 -3.4E+38 3.4E+38 ECU_ADDRESS 0xb00074c4 /* @ECU_Address@VfLKAS_Jerk1@ */ /end MEASUREMENT
/begin MEASUREMENT VfLKAS_TargetDist_Freezed1 "" FLOAT32_IEEE LKAS_subsystem_integrated_CM_single 0 0 -3.4E+38 3.4E+38 ECU_ADDRESS 0xb00074c0 /* @ECU_Address@VfLKAS_TargetDist_Freezed1@ */ /end MEASUREMENT
/begin MEASUREMENT VfLKAS_TargetV "" FLOAT32_IEEE LKAS_subsystem_integrated_CM_single 0 0 -3.4E+38 3.4E+38 ECU_ADDRESS 0xb00074bc /* @ECU_Address@VfLKAS_TargetV@ */ /end MEASUREMENT
/begin MEASUREMENT VfLKAS_Offst_Actual "" FLOAT32_IEEE LKAS_subsystem_integrated_CM_single 0 0 -3.4E+38 3.4E+38 ECU_ADDRESS 0xb00074b8 /* @ECU_Address@VfLKAS_Offst_Actual@ */ /end MEASUREMENT
/begin MEASUREMENT VfLKAS_Offst_start "" FLOAT32_IEEE LKAS_subsystem_integrated_CM_single 0 0 -3.4E+38 3.4E+38 ECU_ADDRESS 0xb00074b4 /* @ECU_Address@VfLKAS_Offst_start@ */ /end MEASUREMENT
/begin MEASUREMENT VfLKAS_DesiredDistToEdge "" FLOAT32_IEEE LKAS_subsystem_integrated_CM_single 0 0 -3.4E+38 3.4E+38 ECU_ADDRESS 0xb00074b0 /* @ECU_Address@VfLKAS_DesiredDistToEdge@ */ /end MEASUREMENT
/begin MEASUREMENT VfLKAS_OffstError "" FLOAT32_IEEE LKAS_subsystem_integrated_CM_single 0 0 -3.4E+38 3.4E+38 ECU_ADDRESS 0xb00074ac /* @ECU_Address@VfLKAS_OffstError@ */ /end MEASUREMENT
/begin MEASUREMENT VfLKAS_Offst_ErrorDiff "" FLOAT32_IEEE LKAS_subsystem_integrated_CM_single 0 0 -3.4E+38 3.4E+38 ECU_ADDRESS 0xb00074a8 /* @ECU_Address@VfLKAS_Offst_ErrorDiff@ */ /end MEASUREMENT
/begin MEASUREMENT VfLKAS_Vlat_Desired "" FLOAT32_IEEE LKAS_subsystem_integrated_CM_single 0 0 -3.4E+38 3.4E+38 ECU_ADDRESS 0xb00074a4 /* @ECU_Address@VfLKAS_Vlat_Desired@ */ /end MEASUREMENT
/begin MEASUREMENT VfLKAS_VlatError "" FLOAT32_IEEE LKAS_subsystem_integrated_CM_single 0 0 -3.4E+38 3.4E+38 ECU_ADDRESS 0xb00074a0 /* @ECU_Address@VfLKAS_VlatError@ */ /end MEASUREMENT
/begin MEASUREMENT VfLKAS_Vlat_ErrorDiff "" FLOAT32_IEEE LKAS_subsystem_integrated_CM_single 0 0 -3.4E+38 3.4E+38 ECU_ADDRESS 0xb000749c /* @ECU_Address@VfLKAS_Vlat_ErrorDiff@ */ /end MEASUREMENT
/begin MEASUREMENT VfLKAS_TargetA "" FLOAT32_IEEE LKAS_subsystem_integrated_CM_single 0 0 -3.4E+38 3.4E+38 ECU_ADDRESS 0xb0007498 /* @ECU_Address@VfLKAS_TargetA@ */ /end MEASUREMENT
/begin MEASUREMENT VfLKAS_Alat_Desired "" FLOAT32_IEEE LKAS_subsystem_integrated_CM_single 0 0 -3.4E+38 3.4E+38 ECU_ADDRESS 0xb0007494 /* @ECU_Address@VfLKAS_Alat_Desired@ */ /end MEASUREMENT
/begin MEASUREMENT VfLKAS_YawRateDesired "" FLOAT32_IEEE LKAS_subsystem_integrated_CM_single 0 0 -3.4E+38 3.4E+38 ECU_ADDRESS 0xb0007490 /* @ECU_Address@VfLKAS_YawRateDesired@ */ /end MEASUREMENT
/begin MEASUREMENT VfLKAS_SteerAngleRequest "" FLOAT32_IEEE LKAS_subsystem_integrated_CM_single 0 0 -3.4E+38 3.4E+38 ECU_ADDRESS 0xb000748c /* @ECU_Address@VfLKAS_SteerAngleRequest@ */ /end MEASUREMENT
/begin MEASUREMENT VfLKAS_StrAngFilted "" FLOAT32_IEEE LKAS_subsystem_integrated_CM_single 0 0 -3.4E+38 3.4E+38 ECU_ADDRESS 0xb0007488 /* @ECU_Address@VfLKAS_StrAngFilted@ */ /end MEASUREMENT
/begin MEASUREMENT VfLKAS_SteerAngleRequest_Saturated "" FLOAT32_IEEE LKAS_subsystem_integrated_CM_single 0 0 -3.4E+38 3.4E+38 ECU_ADDRESS 0xb0007484 /* @ECU_Address@VfLKAS_SteerAngleRequest_Saturated@ */ /end MEASUREMENT
/begin MEASUREMENT VfLKAS_TargetA_2 "" FLOAT32_IEEE LKAS_subsystem_integrated_CM_single 0 0 -3.4E+38 3.4E+38 ECU_ADDRESS 0xb0007480 /* @ECU_Address@VfLKAS_TargetA_2@ */ /end MEASUREMENT
/begin MEASUREMENT VfLKAS_TargetDist_2 "" FLOAT32_IEEE LKAS_subsystem_integrated_CM_single 0 0 -3.4E+38 3.4E+38 ECU_ADDRESS 0xb000747c /* @ECU_Address@VfLKAS_TargetDist_2@ */ /end MEASUREMENT
/begin MEASUREMENT VfLKAS_TargetV_2 "" FLOAT32_IEEE LKAS_subsystem_integrated_CM_single 0 0 -3.4E+38 3.4E+38 ECU_ADDRESS 0xb0007478 /* @ECU_Address@VfLKAS_TargetV_2@ */ /end MEASUREMENT
/begin MEASUREMENT VfLKAS_TargetA_1 "" FLOAT32_IEEE LKAS_subsystem_integrated_CM_single 0 0 -3.4E+38 3.4E+38 ECU_ADDRESS 0xb0007474 /* @ECU_Address@VfLKAS_TargetA_1@ */ /end MEASUREMENT
/begin MEASUREMENT VfLKAS_V0Increment "" FLOAT32_IEEE LKAS_subsystem_integrated_CM_single 0 0 -3.4E+38 3.4E+38 ECU_ADDRESS 0xb0007470 /* @ECU_Address@VfLKAS_V0Increment@ */ /end MEASUREMENT
/begin MEASUREMENT VfLKAS_TargetDist_1 "" FLOAT32_IEEE LKAS_subsystem_integrated_CM_single 0 0 -3.4E+38 3.4E+38 ECU_ADDRESS 0xb000746c /* @ECU_Address@VfLKAS_TargetDist_1@ */ /end MEASUREMENT
/begin MEASUREMENT VfLKAS_TargetV_1 "" FLOAT32_IEEE LKAS_subsystem_integrated_CM_single 0 0 -3.4E+38 3.4E+38 ECU_ADDRESS 0xb0007468 /* @ECU_Address@VfLKAS_TargetV_1@ */ /end MEASUREMENT
/begin MEASUREMENT VfLKAS_TargetDist "" FLOAT32_IEEE LKAS_subsystem_integrated_CM_single 0 0 -3.4E+38 3.4E+38 ECU_ADDRESS 0xb0007464 /* @ECU_Address@VfLKAS_TargetDist@ */ /end MEASUREMENT
/begin MEASUREMENT VfLKAS_QlyLe "" UBYTE LKAS_subsystem_integrated_CM_uint8 0 0 0 255 ECU_ADDRESS 0xb0007461 /* @ECU_Address@VfLKAS_QlyLe@ */ /end MEASUREMENT
/begin MEASUREMENT VfLKAS_QlyRi "" UBYTE LKAS_subsystem_integrated_CM_uint8 0 0 0 255 ECU_ADDRESS 0xb0007460 /* @ECU_Address@VfLKAS_QlyRi@ */ /end MEASUREMENT
/begin MEASUREMENT VfLKAS_AbortID "" UBYTE LKAS_subsystem_integrated_CM_uint8 0 0 0 255 ECU_ADDRESS 0xb000745f /* @ECU_Address@VfLKAS_AbortID@ */ /end MEASUREMENT
/begin MEASUREMENT VbLKAS_zero_trajectory_found "" UBYTE LKAS_subsystem_integrated_CM_boolean 0 0 0 1 ECU_ADDRESS 0xb000745e /* @ECU_Address@VbLKAS_zero_trajectory_found@ */ /end MEASUREMENT
/begin MEASUREMENT VbLKAS_LaneWidthEnbl "" UBYTE LKAS_subsystem_integrated_CM_boolean 0 0 0 1 ECU_ADDRESS 0xb000745d /* @ECU_Address@VbLKAS_LaneWidthEnbl@ */ /end MEASUREMENT
/begin MEASUREMENT VbLKAS_RoadEnblRi "" UBYTE LKAS_subsystem_integrated_CM_boolean 0 0 0 1 ECU_ADDRESS 0xb000745c /* @ECU_Address@VbLKAS_RoadEnblRi@ */ /end MEASUREMENT
/begin MEASUREMENT VbLKAS_RoadEnblLe "" UBYTE LKAS_subsystem_integrated_CM_boolean 0 0 0 1 ECU_ADDRESS 0xb000745b /* @ECU_Address@VbLKAS_RoadEnblLe@ */ /end MEASUREMENT
/begin MEASUREMENT VbLKAS__RoadEnbl "" UBYTE LKAS_subsystem_integrated_CM_boolean 0 0 0 1 ECU_ADDRESS 0xb000745a /* @ECU_Address@VbLKAS__RoadEnbl@ */ /end MEASUREMENT
/begin MEASUREMENT VbLKAS_InnerCurvLe_sLKA "" UBYTE LKAS_subsystem_integrated_CM_boolean 0 0 0 1 ECU_ADDRESS 0xb0007459 /* @ECU_Address@VbLKAS_InnerCurvLe_sLKA@ */ /end MEASUREMENT
/begin MEASUREMENT VbLKAS_InnerCurvRi_sLKA "" UBYTE LKAS_subsystem_integrated_CM_boolean 0 0 0 1 ECU_ADDRESS 0xb0007458 /* @ECU_Address@VbLKAS_InnerCurvRi_sLKA@ */ /end MEASUREMENT
/begin MEASUREMENT VbLKAS_SolutionFoundForAm "" UBYTE LKAS_subsystem_integrated_CM_boolean 0 0 0 1 ECU_ADDRESS 0xb0007457 /* @ECU_Address@VbLKAS_SolutionFoundForAm@ */ /end MEASUREMENT
/begin MEASUREMENT VbLKAS_TrajectoryFound_sLKA "" UBYTE LKAS_subsystem_integrated_CM_boolean 0 0 0 1 ECU_ADDRESS 0xb0007456 /* @ECU_Address@VbLKAS_TrajectoryFound_sLKA@ */ /end MEASUREMENT
/begin MEASUREMENT VbLKAS_FirstEndPositionOK "" UBYTE LKAS_subsystem_integrated_CM_boolean 0 0 0 1 ECU_ADDRESS 0xb0007455 /* @ECU_Address@VbLKAS_FirstEndPositionOK@ */ /end MEASUREMENT
/begin MEASUREMENT VbLKAS_FirstEndVLatOK "" UBYTE LKAS_subsystem_integrated_CM_boolean 0 0 0 1 ECU_ADDRESS 0xb0007454 /* @ECU_Address@VbLKAS_FirstEndVLatOK@ */ /end MEASUREMENT
/begin MEASUREMENT VbLKAS_TrajectoryFoundAm1 "" UBYTE LKAS_subsystem_integrated_CM_boolean 0 0 0 1 ECU_ADDRESS 0xb0007453 /* @ECU_Address@VbLKAS_TrajectoryFoundAm1@ */ /end MEASUREMENT
/begin MEASUREMENT VbLKAS_SecEndPositionOK "" UBYTE LKAS_subsystem_integrated_CM_boolean 0 0 0 1 ECU_ADDRESS 0xb0007452 /* @ECU_Address@VbLKAS_SecEndPositionOK@ */ /end MEASUREMENT
/begin MEASUREMENT VbLKAS_SecEndVLatOK "" UBYTE LKAS_subsystem_integrated_CM_boolean 0 0 0 1 ECU_ADDRESS 0xb0007451 /* @ECU_Address@VbLKAS_SecEndVLatOK@ */ /end MEASUREMENT
/begin MEASUREMENT VbLKAS_TrajectoryFoundAm2 "" UBYTE LKAS_subsystem_integrated_CM_boolean 0 0 0 1 ECU_ADDRESS 0xb0007450 /* @ECU_Address@VbLKAS_TrajectoryFoundAm2@ */ /end MEASUREMENT
/begin MEASUREMENT VbLKAS_QlyValidLe "" UBYTE LKAS_subsystem_integrated_CM_boolean 0 0 0 1 ECU_ADDRESS 0xb000744f /* @ECU_Address@VbLKAS_QlyValidLe@ */ /end MEASUREMENT
/begin MEASUREMENT VbLKAS_LeftVLatStep "" UBYTE LKAS_subsystem_integrated_CM_boolean 0 0 0 1 ECU_ADDRESS 0xb000744e /* @ECU_Address@VbLKAS_LeftVLatStep@ */ /end MEASUREMENT
/begin MEASUREMENT VbLKAS_LeftCurvStep "" UBYTE LKAS_subsystem_integrated_CM_boolean 0 0 0 1 ECU_ADDRESS 0xb000744d /* @ECU_Address@VbLKAS_LeftCurvStep@ */ /end MEASUREMENT
/begin MEASUREMENT VbLKAS_LeftOffstStep "" UBYTE LKAS_subsystem_integrated_CM_boolean 0 0 0 1 ECU_ADDRESS 0xb000744c /* @ECU_Address@VbLKAS_LeftOffstStep@ */ /end MEASUREMENT
/begin MEASUREMENT VbLKAS_QlyValidRi "" UBYTE LKAS_subsystem_integrated_CM_boolean 0 0 0 1 ECU_ADDRESS 0xb000744b /* @ECU_Address@VbLKAS_QlyValidRi@ */ /end MEASUREMENT
/begin MEASUREMENT VbLKAS_RightVlatStep "" UBYTE LKAS_subsystem_integrated_CM_boolean 0 0 0 1 ECU_ADDRESS 0xb000744a /* @ECU_Address@VbLKAS_RightVlatStep@ */ /end MEASUREMENT
/begin MEASUREMENT VbLKAS_RightCurvStep "" UBYTE LKAS_subsystem_integrated_CM_boolean 0 0 0 1 ECU_ADDRESS 0xb0007449 /* @ECU_Address@VbLKAS_RightCurvStep@ */ /end MEASUREMENT
/begin MEASUREMENT VbLKAS_RightOffstStep "" UBYTE LKAS_subsystem_integrated_CM_boolean 0 0 0 1 ECU_ADDRESS 0xb0007448 /* @ECU_Address@VbLKAS_RightOffstStep@ */ /end MEASUREMENT
/begin MEASUREMENT VbLKAS_IsIntvCompleted_sLKA_IntOut "" UBYTE LKAS_subsystem_integrated_CM_boolean 0 0 0 1 ECU_ADDRESS 0xb0007447 /* @ECU_Address@VbLKAS_IsIntvCompleted_sLKA_IntOut@ */ /end MEASUREMENT
/begin MEASUREMENT VbLKAS_IsLDWSTriggered "" UBYTE LKAS_subsystem_integrated_CM_boolean 0 0 0 1 ECU_ADDRESS 0xb0007446 /* @ECU_Address@VbLKAS_IsLDWSTriggered@ */ /end MEASUREMENT
/begin MEASUREMENT VbLKAS_IsPathAccPlausible "" UBYTE LKAS_subsystem_integrated_CM_boolean 0 0 0 1 ECU_ADDRESS 0xb0007445 /* @ECU_Address@VbLKAS_IsPathAccPlausible@ */ /end MEASUREMENT
/begin MEASUREMENT VbLKAS_IsTrajInTrigZone "" UBYTE LKAS_subsystem_integrated_CM_boolean 0 0 0 1 ECU_ADDRESS 0xb0007444 /* @ECU_Address@VbLKAS_IsTrajInTrigZone@ */ /end MEASUREMENT
/begin MEASUREMENT VbLKAS_IsTrajectoryFound "" UBYTE LKAS_subsystem_integrated_CM_boolean 0 0 0 1 ECU_ADDRESS 0xb0007443 /* @ECU_Address@VbLKAS_IsTrajectoryFound@ */ /end MEASUREMENT
/begin MEASUREMENT VbLKAS_IsVlatOkForZeroPath "" UBYTE LKAS_subsystem_integrated_CM_boolean 0 0 0 1 ECU_ADDRESS 0xb0007442 /* @ECU_Address@VbLKAS_IsVlatOkForZeroPath@ */ /end MEASUREMENT
/begin MEASUREMENT VbLKAS_IsTrackingIntvSide "" UBYTE LKAS_subsystem_integrated_CM_boolean 0 0 0 1 ECU_ADDRESS 0xb0007441 /* @ECU_Address@VbLKAS_IsTrackingIntvSide@ */ /end MEASUREMENT
/begin MEASUREMENT VbLKAS_IsVlatTowardsIntvSide "" UBYTE LKAS_subsystem_integrated_CM_boolean 0 0 0 1 ECU_ADDRESS 0xb0007440 /* @ECU_Address@VbLKAS_IsVlatTowardsIntvSide@ */ /end MEASUREMENT
/begin MEASUREMENT VbLKAS_IsActivated_sLKA "" UBYTE LKAS_subsystem_integrated_CM_boolean 0 0 0 1 ECU_ADDRESS 0xb000743f /* @ECU_Address@VbLKAS_IsActivated_sLKA@ */ /end MEASUREMENT
/begin MEASUREMENT VbLKAS_LeftChangeLane "" UBYTE LKAS_subsystem_integrated_CM_boolean 0 0 0 1 ECU_ADDRESS 0xb000743e /* @ECU_Address@VbLKAS_LeftChangeLane@ */ /end MEASUREMENT
/begin MEASUREMENT VbLKAS_InnerCurvLe "" UBYTE LKAS_subsystem_integrated_CM_boolean 0 0 0 1 ECU_ADDRESS 0xb000743d /* @ECU_Address@VbLKAS_InnerCurvLe@ */ /end MEASUREMENT
/begin MEASUREMENT VbLKAS_NotQualDrpLeft "" UBYTE LKAS_subsystem_integrated_CM_boolean 0 0 0 1 ECU_ADDRESS 0xb000743c /* @ECU_Address@VbLKAS_NotQualDrpLeft@ */ /end MEASUREMENT
/begin MEASUREMENT VbLKAS_DlyAftAbort "" UBYTE LKAS_subsystem_integrated_CM_boolean 0 0 0 1 ECU_ADDRESS 0xb000743b /* @ECU_Address@VbLKAS_DlyAftAbort@ */ /end MEASUREMENT
/begin MEASUREMENT VbLKAS_IsSuppLe "" UBYTE LKAS_subsystem_integrated_CM_boolean 0 0 0 1 ECU_ADDRESS 0xb000743a /* @ECU_Address@VbLKAS_IsSuppLe@ */ /end MEASUREMENT
/begin MEASUREMENT VbLKAS_RightChangeLane "" UBYTE LKAS_subsystem_integrated_CM_boolean 0 0 0 1 ECU_ADDRESS 0xb0007439 /* @ECU_Address@VbLKAS_RightChangeLane@ */ /end MEASUREMENT
/begin MEASUREMENT VbLKAS_InnerCurvRi "" UBYTE LKAS_subsystem_integrated_CM_boolean 0 0 0 1 ECU_ADDRESS 0xb0007438 /* @ECU_Address@VbLKAS_InnerCurvRi@ */ /end MEASUREMENT
/begin MEASUREMENT VbLKAS_NotQualDrpRight "" UBYTE LKAS_subsystem_integrated_CM_boolean 0 0 0 1 ECU_ADDRESS 0xb0007437 /* @ECU_Address@VbLKAS_NotQualDrpRight@ */ /end MEASUREMENT
/begin MEASUREMENT VbLKAS_IsSuppRi "" UBYTE LKAS_subsystem_integrated_CM_boolean 0 0 0 1 ECU_ADDRESS 0xb0007436 /* @ECU_Address@VbLKAS_IsSuppRi@ */ /end MEASUREMENT
/begin MEASUREMENT VbLKAS_Intv_Request "" UBYTE LKAS_subsystem_integrated_CM_boolean 0 0 0 1 ECU_ADDRESS 0xb0007435 /* @ECU_Address@VbLKAS_Intv_Request@ */ /end MEASUREMENT
/begin MEASUREMENT VbLKAS_IsInsidePath "" UBYTE LKAS_subsystem_integrated_CM_boolean 0 0 0 1 ECU_ADDRESS 0xb0007434 /* @ECU_Address@VbLKAS_IsInsidePath@ */ /end MEASUREMENT
/begin MEASUREMENT VbLKAS_IsVlatTowardsLaneCenter "" UBYTE LKAS_subsystem_integrated_CM_boolean 0 0 0 1 ECU_ADDRESS 0xb0007433 /* @ECU_Address@VbLKAS_IsVlatTowardsLaneCenter@ */ /end MEASUREMENT
/begin MEASUREMENT VbLKAS_IsVmaxReached "" UBYTE LKAS_subsystem_integrated_CM_boolean 0 0 0 1 ECU_ADDRESS 0xb0007432 /* @ECU_Address@VbLKAS_IsVmaxReached@ */ /end MEASUREMENT
/begin MEASUREMENT VbLKAS_IsIntvCompleted "" UBYTE LKAS_subsystem_integrated_CM_boolean 0 0 0 1 ECU_ADDRESS 0xb0007431 /* @ECU_Address@VbLKAS_IsIntvCompleted@ */ /end MEASUREMENT
/begin MEASUREMENT VbLKAS_IsAbortIntv "" UBYTE LKAS_subsystem_integrated_CM_boolean 0 0 0 1 ECU_ADDRESS 0xb0007430 /* @ECU_Address@VbLKAS_IsAbortIntv@ */ /end MEASUREMENT
/begin MEASUREMENT VbLKAS_IsDelayAftAbort "" UBYTE LKAS_subsystem_integrated_CM_boolean 0 0 0 1 ECU_ADDRESS 0xb000742f /* @ECU_Address@VbLKAS_IsDelayAftAbort@ */ /end MEASUREMENT
/begin MEASUREMENT VbLKAS_Trigger_Traj_2 "" UBYTE LKAS_subsystem_integrated_CM_boolean 0 0 0 1 ECU_ADDRESS 0xb000742e /* @ECU_Address@VbLKAS_Trigger_Traj_2@ */ /end MEASUREMENT
/begin MEASUREMENT VbLKAS_Trigger_Traj_1 "" UBYTE LKAS_subsystem_integrated_CM_boolean 0 0 0 1 ECU_ADDRESS 0xb000742d /* @ECU_Address@VbLKAS_Trigger_Traj_1@ */ /end MEASUREMENT
/begin MEASUREMENT VeLKAS_IntvTyp_sLKA_IntOut "" UBYTE LKAS_subsystem_integrated_CM_EnumLKAS_IntvTyp 0 0 0 1 ECU_ADDRESS 0xb000742c /* @ECU_Address@VeLKAS_IntvTyp_sLKA_IntOut@ */ /end MEASUREMENT
/begin MEASUREMENT VeLKAS_IntvTyp_sLKA "" UBYTE LKAS_subsystem_integrated_CM_EnumLKAS_IntvTyp 0 0 0 1 ECU_ADDRESS 0xb000742b /* @ECU_Address@VeLKAS_IntvTyp_sLKA@ */ /end MEASUREMENT
/begin MEASUREMENT VeLKAS_IntvSideReq_sLKA "" UBYTE LKAS_subsystem_integrated_CM_EnumLKAS_IntvSide 0 0 0 2 ECU_ADDRESS 0xb000742a /* @ECU_Address@VeLKAS_IntvSideReq_sLKA@ */ /end MEASUREMENT
/begin MEASUREMENT VeLKAS_IntvSide_sLKA_IntOut "" UBYTE LKAS_subsystem_integrated_CM_EnumLKAS_IntvSide 0 0 0 2 ECU_ADDRESS 0xb0007429 /* @ECU_Address@VeLKAS_IntvSide_sLKA_IntOut@ */ /end MEASUREMENT
/begin MEASUREMENT VeLKAS_IntvSide_sLKA "" UBYTE LKAS_subsystem_integrated_CM_EnumLKAS_IntvSide 0 0 0 2 ECU_ADDRESS 0xb0007428 /* @ECU_Address@VeLKAS_IntvSide_sLKA@ */ /end MEASUREMENT
/begin MEASUREMENT VeLKAS_IntvMgrSt_sLKA "" UBYTE LKAS_subsystem_integrated_CM_EnumLKAS_IntvMgrSt 0 0 0 3 ECU_ADDRESS 0xb0007427 /* @ECU_Address@VeLKAS_IntvMgrSt_sLKA@ */ /end MEASUREMENT
/begin MEASUREMENT VeLKAS_CtrlRefReq_sLKA "" UBYTE LKAS_subsystem_integrated_CM_EnumLKAS_CtrlRefTypVcc 0 0 0 2 ECU_ADDRESS 0xb0007426 /* @ECU_Address@VeLKAS_CtrlRefReq_sLKA@ */ /end MEASUREMENT
/begin MEASUREMENT VeLKAS_CtrlRef_sLKA_IntOut "" UBYTE LKAS_subsystem_integrated_CM_EnumLKAS_CtrlRefTypVcc 0 0 0 2 ECU_ADDRESS 0xb0007425 /* @ECU_Address@VeLKAS_CtrlRef_sLKA_IntOut@ */ /end MEASUREMENT
/begin MEASUREMENT VeLKAS_CtrlRef_sLKA "" UBYTE LKAS_subsystem_integrated_CM_EnumLKAS_CtrlRefTypVcc 0 0 0 2 ECU_ADDRESS 0xb0007424 /* @ECU_Address@VeLKAS_CtrlRef_sLKA@ */ /end MEASUREMENT
/begin MEASUREMENT VeLKAS_LineLeftOk "" UBYTE LKAS_subsystem_integrated_CM_EnumLKAS_LaneMkrQly 0 0 0 1 ECU_ADDRESS 0xb0007423 /* @ECU_Address@VeLKAS_LineLeftOk@ */ /end MEASUREMENT
/begin MEASUREMENT VeLKAS_LineRightOK "" UBYTE LKAS_subsystem_integrated_CM_EnumLKAS_LaneMkrQly 0 0 0 1 ECU_ADDRESS 0xb0007422 /* @ECU_Address@VeLKAS_LineRightOK@ */ /end MEASUREMENT
/begin MEASUREMENT VeLKAS_SystemSt_sLKA "" UBYTE LKAS_subsystem_integrated_CM_EnumLKAS_SystemSt 0 0 0 1 ECU_ADDRESS 0xb0007421 /* @ECU_Address@VeLKAS_SystemSt_sLKA@ */ /end MEASUREMENT
/begin MEASUREMENT VeLKAS_OnStateSt_sLKA "" UBYTE LKAS_subsystem_integrated_CM_EnumLKAS_OnStateSt 0 0 0 5 ECU_ADDRESS 0xb0007420 /* @ECU_Address@VeLKAS_OnStateSt_sLKA@ */ /end MEASUREMENT
/begin MEASUREMENT VfDRIV_Steer_Torque_Rate "" FLOAT32_IEEE DRIV_subsystem_integrated_CM_single 0 0 -3.4E+38 3.4E+38 ECU_ADDRESS 0xb0005358 /* @ECU_Address@VfDRIV_Steer_Torque_Rate@ */ /end MEASUREMENT
/begin MEASUREMENT VfDRIV_yawrate "" FLOAT32_IEEE DRIV_subsystem_integrated_CM_single 0 0 -3.4E+38 3.4E+38 ECU_ADDRESS 0xb0005354 /* @ECU_Address@VfDRIV_yawrate@ */ /end MEASUREMENT
/begin MEASUREMENT VfDRIV_c1_heading "" FLOAT32_IEEE DRIV_subsystem_integrated_CM_single 0 0 -3.4E+38 3.4E+38 ECU_ADDRESS 0xb0005350 /* @ECU_Address@VfDRIV_c1_heading@ */ /end MEASUREMENT
/begin MEASUREMENT VfDRIV_steer_angle "" FLOAT32_IEEE DRIV_subsystem_integrated_CM_single 0 0 -3.4E+38 3.4E+38 ECU_ADDRESS 0xb000534c /* @ECU_Address@VfDRIV_steer_angle@ */ /end MEASUREMENT
/begin MEASUREMENT VfDRIV_SteerAngleRate "" FLOAT32_IEEE DRIV_subsystem_integrated_CM_single 0 0 -3.4E+38 3.4E+38 ECU_ADDRESS 0xb0005348 /* @ECU_Address@VfDRIV_SteerAngleRate@ */ /end MEASUREMENT
/begin MEASUREMENT VfDRIV_Steer_Torque_Filter "" FLOAT32_IEEE DRIV_subsystem_integrated_CM_single 0 0 -3.4E+38 3.4E+38 ECU_ADDRESS 0xb0005344 /* @ECU_Address@VfDRIV_Steer_Torque_Filter@ */ /end MEASUREMENT
/begin MEASUREMENT VbDRIV_Norm_driving "" UBYTE DRIV_subsystem_integrated_CM_boolean 0 0 0 1 ECU_ADDRESS 0xb0005343 /* @ECU_Address@VbDRIV_Norm_driving@ */ /end MEASUREMENT
/begin MEASUREMENT VbDRIV_Driver_Take_Over "" UBYTE DRIV_subsystem_integrated_CM_boolean 0 0 0 1 ECU_ADDRESS 0xb0005342 /* @ECU_Address@VbDRIV_Driver_Take_Over@ */ /end MEASUREMENT
/begin MEASUREMENT VbDRIV_Driver_Distracted "" UBYTE DRIV_subsystem_integrated_CM_boolean 0 0 0 1 ECU_ADDRESS 0xb0005341 /* @ECU_Address@VbDRIV_Driver_Distracted@ */ /end MEASUREMENT
/begin MEASUREMENT VbDIRV_Override_Steering "" UBYTE DRIV_subsystem_integrated_CM_boolean 0 0 0 1 ECU_ADDRESS 0xb0005340 /* @ECU_Address@VbDIRV_Override_Steering@ */ /end MEASUREMENT
/begin MEASUREMENT VbDRIV_LeftSide_LC_Req "" UBYTE DRIV_subsystem_integrated_CM_boolean 0 0 0 1 ECU_ADDRESS 0xb000533f /* @ECU_Address@VbDRIV_LeftSide_LC_Req@ */ /end MEASUREMENT
/begin MEASUREMENT VbDRIV_RightSide_LC_Req "" UBYTE DRIV_subsystem_integrated_CM_boolean 0 0 0 1 ECU_ADDRESS 0xb000533e /* @ECU_Address@VbDRIV_RightSide_LC_Req@ */ /end MEASUREMENT
/begin MEASUREMENT VbDRIV_LaneChangeReady_Req "" UBYTE DRIV_subsystem_integrated_CM_boolean 0 0 0 1 ECU_ADDRESS 0xb000533d /* @ECU_Address@VbDRIV_LaneChangeReady_Req@ */ /end MEASUREMENT
/begin MEASUREMENT VbDRIV_LaneChanging_Req "" UBYTE DRIV_subsystem_integrated_CM_boolean 0 0 0 1 ECU_ADDRESS 0xb000533c /* @ECU_Address@VbDRIV_LaneChanging_Req@ */ /end MEASUREMENT
/begin MEASUREMENT VbDRIV_LaneChangeFinish_Req "" UBYTE DRIV_subsystem_integrated_CM_boolean 0 0 0 1 ECU_ADDRESS 0xb000533b /* @ECU_Address@VbDRIV_LaneChangeFinish_Req@ */ /end MEASUREMENT
/begin MEASUREMENT VbDRIV_LC_Enable "" UBYTE DRIV_subsystem_integrated_CM_boolean 0 0 0 1 ECU_ADDRESS 0xb000533a /* @ECU_Address@VbDRIV_LC_Enable@ */ /end MEASUREMENT
/begin MEASUREMENT VbDRIV_TurnType "" UBYTE DRIV_subsystem_integrated_CM_boolean 0 0 0 1 ECU_ADDRESS 0xb0005339 /* @ECU_Address@VbDRIV_TurnType@ */ /end MEASUREMENT
/begin MEASUREMENT VbDRIV_Update_Override_Steering "" UBYTE DRIV_subsystem_integrated_CM_boolean 0 0 0 1 ECU_ADDRESS 0xb0005338 /* @ECU_Address@VbDRIV_Update_Override_Steering@ */ /end MEASUREMENT
/begin MEASUREMENT VbDRIV_LaneKeepAssist "" UBYTE DRIV_subsystem_integrated_CM_boolean 0 0 0 1 ECU_ADDRESS 0xb0005337 /* @ECU_Address@VbDRIV_LaneKeepAssist@ */ /end MEASUREMENT
/begin MEASUREMENT VbDRIV_Touched_new_lane "" UBYTE DRIV_subsystem_integrated_CM_boolean 0 0 0 1 ECU_ADDRESS 0xb0005336 /* @ECU_Address@VbDRIV_Touched_new_lane@ */ /end MEASUREMENT
/begin MEASUREMENT VeDRIV_LeftChangeLane "" UBYTE DRIV_subsystem_integrated_CM_EnumDRIV_LeftChangeLane 0 0 0 3 ECU_ADDRESS 0xb0005335 /* @ECU_Address@VeDRIV_LeftChangeLane@ */ /end MEASUREMENT
/begin MEASUREMENT VeDRIV_RightChangeLane "" UBYTE DRIV_subsystem_integrated_CM_EnumDRIV_RightChangeLane 0 0 0 3 ECU_ADDRESS 0xb0005334 /* @ECU_Address@VeDRIV_RightChangeLane@ */ /end MEASUREMENT
/begin MEASUREMENT ADCtrl_Thruput_MS "" FLOAT32_IEEE ad_ctrl_thruput_measurement_CM_ms 0 0 -3.4E+38 3.4E+38 ECU_ADDRESS 0xb000211c /* @ECU_Address@ADCtrl_Thruput_MS@ */ /end MEASUREMENT
/begin MEASUREMENT COMM_Subsystem_Intergreted_Receive_Period "" UWORD ad_ctrl_subfunction_measurement_CM_us 0 0 0 4E+9 ECU_ADDRESS 0xb0002022 /* @ECU_Address@COMM_Subsystem_Intergreted_Receive_Period@ */ /end MEASUREMENT
/begin MEASUREMENT DCSN_Subsystem_Integrated_Period "" UWORD ad_ctrl_subfunction_measurement_CM_us 0 0 0 4E+9 ECU_ADDRESS 0xb0002020 /* @ECU_Address@DCSN_Subsystem_Integrated_Period@ */ /end MEASUREMENT
/begin MEASUREMENT AEBS_Subsystem_Integrated_Period "" UWORD ad_ctrl_subfunction_measurement_CM_us 0 0 0 4E+9 ECU_ADDRESS 0xb000201e /* @ECU_Address@AEBS_Subsystem_Integrated_Period@ */ /end MEASUREMENT
/begin MEASUREMENT ACCS_Subsystem_Integrated_Period "" UWORD ad_ctrl_subfunction_measurement_CM_us 0 0 0 4E+9 ECU_ADDRESS 0xb000201c /* @ECU_Address@ACCS_Subsystem_Integrated_Period@ */ /end MEASUREMENT
/begin MEASUREMENT LCCS_Subsystem_Integrated_Period "" UWORD ad_ctrl_subfunction_measurement_CM_us 0 0 0 4E+9 ECU_ADDRESS 0xb000201a /* @ECU_Address@LCCS_Subsystem_Integrated_Period@ */ /end MEASUREMENT
/begin MEASUREMENT AEBD_Subsystem_Integrated_Period "" UWORD ad_ctrl_subfunction_measurement_CM_us 0 0 0 4E+9 ECU_ADDRESS 0xb0002012 /* @ECU_Address@AEBD_Subsystem_Integrated_Period@ */ /end MEASUREMENT
/begin MEASUREMENT LCAS_Subsystem_Integrated_Period "" UWORD ad_ctrl_subfunction_measurement_CM_us 0 0 0 4E+9 ECU_ADDRESS 0xb0002018 /* @ECU_Address@LCAS_Subsystem_Integrated_Period@ */ /end MEASUREMENT
/begin MEASUREMENT BSDS_Subsystem_Integrated_Period "" UWORD ad_ctrl_subfunction_measurement_CM_us 0 0 0 4E+9 ECU_ADDRESS 0xb000200c /* @ECU_Address@BSDS_Subsystem_Integrated_Period@ */ /end MEASUREMENT
/begin MEASUREMENT LDWS_Subsystem_Integrated_Period "" UWORD ad_ctrl_subfunction_measurement_CM_us 0 0 0 4E+9 ECU_ADDRESS 0xb0002016 /* @ECU_Address@LDWS_Subsystem_Integrated_Period@ */ /end MEASUREMENT
/begin MEASUREMENT arbt_Subsystem_Integrated_Period "" UWORD ad_ctrl_subfunction_measurement_CM_us 0 0 0 4E+9 ECU_ADDRESS 0xb0002014 /* @ECU_Address@arbt_Subsystem_Integrated_Period@ */ /end MEASUREMENT
/begin MEASUREMENT COMM_Subsystem_Integrated_Transmit_Period "" UWORD ad_ctrl_subfunction_measurement_CM_us 0 0 0 4E+9 ECU_ADDRESS 0xb0002008 /* @ECU_Address@COMM_Subsystem_Integrated_Transmit_Period@ */ /end MEASUREMENT
/begin MEASUREMENT ALCA_Subsystem_Integrated_Period "" UWORD ad_ctrl_subfunction_measurement_CM_us 0 0 0 4E+9 ECU_ADDRESS 0xb0002010 /* @ECU_Address@ALCA_Subsystem_Integrated_Period@ */ /end MEASUREMENT
/begin MEASUREMENT LKAS_Subsystem_Integrated_Period "" UWORD ad_ctrl_subfunction_measurement_CM_us 0 0 0 4E+9 ECU_ADDRESS 0xb000200e /* @ECU_Address@LKAS_Subsystem_Integrated_Period@ */ /end MEASUREMENT
/begin MEASUREMENT DRIV_Subsystem_Integrated_Period "" UWORD ad_ctrl_subfunction_measurement_CM_us 0 0 0 4E+9 ECU_ADDRESS 0xb000200a /* @ECU_Address@DRIV_Subsystem_Integrated_Period@ */ /end MEASUREMENT
/begin MEASUREMENT os_core0_tick_cnt "" ULONG ad_ctrl_thruput_measurement_CM_ms 0 0 0 3.4E+38 ECU_ADDRESS 0xb0007bc0 /* @ECU_Address@os_core0_tick_cnt@ */ /end MEASUREMENT
/begin MEASUREMENT Entry_ADCtrl_STM_Cnt "ADCtrl entry STM_0_3 counter. 1us = Entry_ADCtrl_STM_Cnt*4096.0/100" ULONG ad_ctrl_thruput_measurement_CM_ms 0 0 0 3.4E+38 ECU_ADDRESS 0xb0002128 /* @ECU_Address@Entry_ADCtrl_STM_Cnt@ */ /end MEASUREMENT
/begin MEASUREMENT Com_stRxUDPFrm17001 "UDP_COMM_Err_Info" UBYTE diag_info_monitor 0 0 0 255 ECU_ADDRESS 0xb0002028 /* @ECU_Address@Com_stRxUDPFrm17001@ */ /end MEASUREMENT
/begin MEASUREMENT diag_communication_error_codes "UDP_COMM_Err_Info" UBYTE diag_info_monitor 0 0 0 255 ARRAY_SIZE 32 ECU_ADDRESS 0xb000206c /* @ECU_Address@diag_communication_error_codes@ */ /end MEASUREMENT
/begin MEASUREMENT diag_sensor_error_codes "UDP_COMM_Err_Info" UBYTE diag_info_monitor 0 0 0 255 ARRAY_SIZE 32 ECU_ADDRESS 0xb000204c /* @ECU_Address@diag_sensor_error_codes@ */ /end MEASUREMENT
/begin MEASUREMENT diag_module_error_codes "UDP_COMM_Err_Info" UBYTE diag_info_monitor 0 0 0 255 ARRAY_SIZE 32 ECU_ADDRESS 0xb000202c /* @ECU_Address@diag_module_error_codes@ */ /end MEASUREMENT
/begin COMPU_METHOD ACCS_subsystem_integrated_CM_single_s "Q = V" RAT_FUNC "%8.6" "s" COEFFS 0 1 0 0 0 1 /end COMPU_METHOD
/begin COMPU_METHOD ACCS_subsystem_integrated_CM_single_m "Q = V" RAT_FUNC "%8.6" "m" COEFFS 0 1 0 0 0 1 /end COMPU_METHOD
/begin COMPU_METHOD ACCS_subsystem_integrated_CM_single_m_s2 "Q = V" RAT_FUNC "%8.6" "m/s2" COEFFS 0 1 0 0 0 1 /end COMPU_METHOD
/begin COMPU_METHOD ACCS_subsystem_integrated_CM_single_m_s "Q = V" RAT_FUNC "%8.6" "m/s" COEFFS 0 1 0 0 0 1 /end COMPU_METHOD
/begin COMPU_METHOD ACCS_subsystem_integrated_CM_single_deg "Q = V" RAT_FUNC "%8.6" "deg" COEFFS 0 1 0 0 0 1 /end COMPU_METHOD
/begin COMPU_METHOD LDWS_subsystem_integrated_CM_single_rad "Q = V" RAT_FUNC "%8.6" "rad" COEFFS 0 1 0 0 0 1 /end COMPU_METHOD
/begin COMPU_METHOD LDWS_subsystem_integrated_CM_single__ "Q = V" RAT_FUNC "%8.6" "��" COEFFS 0 1 0 0 0 1 /end COMPU_METHOD
/begin COMPU_METHOD LDWS_subsystem_integrated_CM_single_NM "Q = V" RAT_FUNC "%8.6" "NM" COEFFS 0 1 0 0 0 1 /end COMPU_METHOD
/begin COMPU_METHOD LDWS_subsystem_integrated_CM_single_m "Q = V" RAT_FUNC "%8.6" "m" COEFFS 0 1 0 0 0 1 /end COMPU_METHOD
/begin COMPU_METHOD LDWS_subsystem_integrated_CM_single "Q = V" RAT_FUNC "%8.6" "" COEFFS 0 1 0 0 0 1 /end COMPU_METHOD
/begin COMPU_METHOD LDWS_subsystem_integrated_CM_single_s "Q = V" RAT_FUNC "%8.6" "s" COEFFS 0 1 0 0 0 1 /end COMPU_METHOD
/begin COMPU_METHOD LDWS_subsystem_integrated_CM_single___s "Q = V" RAT_FUNC "%8.6" "��/s" COEFFS 0 1 0 0 0 1 /end COMPU_METHOD
/begin COMPU_METHOD LDWS_subsystem_integrated_CM_uint16 "Q = V" RAT_FUNC "%5.0" "" COEFFS 0 1 0 0 0 1 /end COMPU_METHOD
/begin COMPU_METHOD LDWS_subsystem_integrated_CM_uint8 "Q = V" RAT_FUNC "%3.0" "" COEFFS 0 1 0 0 0 1 /end COMPU_METHOD
/begin COMPU_METHOD LDWS_subsystem_integrated_CM_boolean "Q = V" RAT_FUNC "%1.0" "" COEFFS 0 1 0 0 0 1 /end COMPU_METHOD
/begin COMPU_METHOD AEBD_subsystem_integrated_CM_single "Q = V" RAT_FUNC "%8.6" "" COEFFS 0 1 0 0 0 1 /end COMPU_METHOD
/begin COMPU_METHOD AEBD_subsystem_integrated_CM_uint16 "Q = V" RAT_FUNC "%5.0" "" COEFFS 0 1 0 0 0 1 /end COMPU_METHOD
/begin COMPU_METHOD AEBD_subsystem_integrated_CM_uint8 "Q = V" RAT_FUNC "%3.0" "" COEFFS 0 1 0 0 0 1 /end COMPU_METHOD
/begin COMPU_METHOD AEBD_subsystem_integrated_CM_boolean "Q = V" RAT_FUNC "%1.0" "" COEFFS 0 1 0 0 0 1 /end COMPU_METHOD
/begin COMPU_METHOD ALCA_subsystem_integrated_CM_single "Q = V" RAT_FUNC "%8.6" "" COEFFS 0 1 0 0 0 1 /end COMPU_METHOD
/begin COMPU_METHOD ALCA_subsystem_integrated_CM_single_m "Q = V" RAT_FUNC "%8.6" "m" COEFFS 0 1 0 0 0 1 /end COMPU_METHOD
/begin COMPU_METHOD ALCA_subsystem_integrated_CM_single_s "Q = V" RAT_FUNC "%8.6" "s" COEFFS 0 1 0 0 0 1 /end COMPU_METHOD
/begin COMPU_METHOD ALCA_subsystem_integrated_CM_single_m_s "Q = V" RAT_FUNC "%8.6" "m/s" COEFFS 0 1 0 0 0 1 /end COMPU_METHOD
/begin COMPU_METHOD ALCA_subsystem_integrated_CM_boolean "Q = V" RAT_FUNC "%1.0" "" COEFFS 0 1 0 0 0 1 /end COMPU_METHOD
/begin COMPU_METHOD ALCA_subsystem_integrated_CM_int32 "Q = V" RAT_FUNC "%10.0" "" COEFFS 0 1 0 0 0 1 /end COMPU_METHOD
/begin COMPU_METHOD ALCA_subsystem_integrated_CM_int8 "Q = V" RAT_FUNC "%3.0" "" COEFFS 0 1 0 0 0 1 /end COMPU_METHOD
/begin COMPU_METHOD ALCA_subsystem_integrated_CM_uint8 "Q = V" RAT_FUNC "%3.0" "" COEFFS 0 1 0 0 0 1 /end COMPU_METHOD
/begin COMPU_METHOD ALCA_subsystem_integrated_CM_EnumDCSN_driving_direction "Enumerated data type: EnumDCSN_driving_direction" TAB_VERB "%0.6" "" COMPU_TAB_REF VTAB_FOR_ALCA_subsystem_integrated_CM_EnumDCSN_driving_direction /end COMPU_METHOD
/begin COMPU_METHOD ALCA_subsystem_integrated_CM_EnumALCA_state "Enumerated data type: EnumALCA_state" TAB_VERB "%0.6" "" COMPU_TAB_REF VTAB_FOR_ALCA_subsystem_integrated_CM_EnumALCA_state /end COMPU_METHOD
/begin COMPU_METHOD ALCA_subsystem_integrated_CM_EnumALCA_not_fulfill_reason "Enumerated data type: EnumALCA_not_fulfill_reason" TAB_VERB "%0.6" "" COMPU_TAB_REF VTAB_FOR_ALCA_subsystem_integrated_CM_EnumALCA_not_fulfill_reason /end COMPU_METHOD
/begin COMPU_METHOD ALCA_subsystem_integrated_CM_EnumALCA_interrupt_type "Enumerated data type: EnumALCA_interrupt_type" TAB_VERB "%0.6" "" COMPU_TAB_REF VTAB_FOR_ALCA_subsystem_integrated_CM_EnumALCA_interrupt_type /end COMPU_METHOD
/begin COMPU_METHOD ALCA_subsystem_integrated_CM_uint16 "Q = V" RAT_FUNC "%5.0" "" COEFFS 0 1 0 0 0 1 /end COMPU_METHOD
/begin COMPU_METHOD LKAS_subsystem_integrated_CM_single "Q = V" RAT_FUNC "%8.6" "" COEFFS 0 1 0 0 0 1 /end COMPU_METHOD
/begin COMPU_METHOD LKAS_subsystem_integrated_CM_single_rad "Q = V" RAT_FUNC "%8.6" "rad" COEFFS 0 1 0 0 0 1 /end COMPU_METHOD
/begin COMPU_METHOD LKAS_subsystem_integrated_CM_single_degree "Q = V" RAT_FUNC "%8.6" "degree" COEFFS 0 1 0 0 0 1 /end COMPU_METHOD
/begin COMPU_METHOD LKAS_subsystem_integrated_CM_single_N_rad "Q = V" RAT_FUNC "%8.6" "N/rad" COEFFS 0 1 0 0 0 1 /end COMPU_METHOD
/begin COMPU_METHOD LKAS_subsystem_integrated_CM_single_1_s "Q = V" RAT_FUNC "%8.6" "1/s" COEFFS 0 1 0 0 0 1 /end COMPU_METHOD
/begin COMPU_METHOD LKAS_subsystem_integrated_CM_single_m_s_2 "Q = V" RAT_FUNC "%8.6" "m/s^2" COEFFS 0 1 0 0 0 1 /end COMPU_METHOD
/begin COMPU_METHOD LKAS_subsystem_integrated_CM_single_1_m "Q = V" RAT_FUNC "%8.6" "1/m" COEFFS 0 1 0 0 0 1 /end COMPU_METHOD
/begin COMPU_METHOD LKAS_subsystem_integrated_CM_single_m "Q = V" RAT_FUNC "%8.6" "m" COEFFS 0 1 0 0 0 1 /end COMPU_METHOD
/begin COMPU_METHOD LKAS_subsystem_integrated_CM_single_m__s__3_ "Q = V" RAT_FUNC "%8.6" "m/(s^-3)" COEFFS 0 1 0 0 0 1 /end COMPU_METHOD
/begin COMPU_METHOD LKAS_subsystem_integrated_CM_single_kg "Q = V" RAT_FUNC "%8.6" "kg" COEFFS 0 1 0 0 0 1 /end COMPU_METHOD
/begin COMPU_METHOD LKAS_subsystem_integrated_CM_single_s "Q = V" RAT_FUNC "%8.6" "s" COEFFS 0 1 0 0 0 1 /end COMPU_METHOD
/begin COMPU_METHOD LKAS_subsystem_integrated_CM_single_m_s "Q = V" RAT_FUNC "%8.6" "m/s" COEFFS 0 1 0 0 0 1 /end COMPU_METHOD
/begin COMPU_METHOD LKAS_subsystem_integrated_CM_uint16 "Q = V" RAT_FUNC "%5.0" "" COEFFS 0 1 0 0 0 1 /end COMPU_METHOD
/begin COMPU_METHOD LKAS_subsystem_integrated_CM_uint16_10ms "Q = V" RAT_FUNC "%5.0" "10ms" COEFFS 0 1 0 0 0 1 /end COMPU_METHOD
/begin COMPU_METHOD LKAS_subsystem_integrated_CM_uint8 "Q = V" RAT_FUNC "%3.0" "" COEFFS 0 1 0 0 0 1 /end COMPU_METHOD
/begin COMPU_METHOD LKAS_subsystem_integrated_CM_boolean "Q = V" RAT_FUNC "%1.0" "" COEFFS 0 1 0 0 0 1 /end COMPU_METHOD
/begin COMPU_METHOD LKAS_subsystem_integrated_CM_EnumLKAS_IntvTyp "Enumerated data type: EnumLKAS_IntvTyp" TAB_VERB "%0.6" "" COMPU_TAB_REF VTAB_FOR_LKAS_subsystem_integrated_CM_EnumLKAS_IntvTyp /end COMPU_METHOD
/begin COMPU_METHOD LKAS_subsystem_integrated_CM_EnumLKAS_IntvSide "Enumerated data type: EnumLKAS_IntvSide" TAB_VERB "%0.6" "" COMPU_TAB_REF VTAB_FOR_LKAS_subsystem_integrated_CM_EnumLKAS_IntvSide /end COMPU_METHOD
/begin COMPU_METHOD LKAS_subsystem_integrated_CM_EnumLKAS_IntvMgrSt "Enumerated data type: EnumLKAS_IntvMgrSt" TAB_VERB "%0.6" "" COMPU_TAB_REF VTAB_FOR_LKAS_subsystem_integrated_CM_EnumLKAS_IntvMgrSt /end COMPU_METHOD
/begin COMPU_METHOD LKAS_subsystem_integrated_CM_EnumLKAS_CtrlRefTypVcc "Enumerated data type: EnumLKAS_CtrlRefTypVcc" TAB_VERB "%0.6" "" COMPU_TAB_REF VTAB_FOR_LKAS_subsystem_integrated_CM_EnumLKAS_CtrlRefTypVcc /end COMPU_METHOD
/begin COMPU_METHOD LKAS_subsystem_integrated_CM_EnumLKAS_LaneMkrQly "Enumerated data type: EnumLKAS_LaneMkrQly" TAB_VERB "%0.6" "" COMPU_TAB_REF VTAB_FOR_LKAS_subsystem_integrated_CM_EnumLKAS_LaneMkrQly /end COMPU_METHOD
/begin COMPU_METHOD LKAS_subsystem_integrated_CM_EnumLKAS_SystemSt "Enumerated data type: EnumLKAS_SystemSt" TAB_VERB "%0.6" "" COMPU_TAB_REF VTAB_FOR_LKAS_subsystem_integrated_CM_EnumLKAS_SystemSt /end COMPU_METHOD
/begin COMPU_METHOD LKAS_subsystem_integrated_CM_EnumLKAS_OnStateSt "Enumerated data type: EnumLKAS_OnStateSt" TAB_VERB "%0.6" "" COMPU_TAB_REF VTAB_FOR_LKAS_subsystem_integrated_CM_EnumLKAS_OnStateSt /end COMPU_METHOD
/begin COMPU_METHOD DRIV_subsystem_integrated_CM_single "Q = V" RAT_FUNC "%8.6" "" COEFFS 0 1 0 0 0 1 /end COMPU_METHOD
/begin COMPU_METHOD DRIV_subsystem_integrated_CM_uint8 "Q = V" RAT_FUNC "%3.0" "" COEFFS 0 1 0 0 0 1 /end COMPU_METHOD
/begin COMPU_METHOD DRIV_subsystem_integrated_CM_boolean "Q = V" RAT_FUNC "%1.0" "" COEFFS 0 1 0 0 0 1 /end COMPU_METHOD
/begin COMPU_METHOD DRIV_subsystem_integrated_CM_EnumDRIV_LeftChangeLane "Enumerated data type: EnumDRIV_LeftChangeLane" TAB_VERB "%0.6" "" COMPU_TAB_REF VTAB_FOR_DRIV_subsystem_integrated_CM_EnumDRIV_LeftChangeLane /end COMPU_METHOD
/begin COMPU_METHOD DRIV_subsystem_integrated_CM_EnumDRIV_RightChangeLane "Enumerated data type: EnumDRIV_RightChangeLane" TAB_VERB "%0.6" "" COMPU_TAB_REF VTAB_FOR_DRIV_subsystem_integrated_CM_EnumDRIV_RightChangeLane /end COMPU_METHOD
/begin COMPU_METHOD ad_ctrl_thruput_measurement_CM_ms "Q = V" RAT_FUNC "%8.6" "ms" COEFFS 0 1 0 0 0 1 /end COMPU_METHOD
/begin COMPU_METHOD ad_ctrl_subfunction_measurement_CM_us "Q = V" RAT_FUNC "%8.0" "us" COEFFS 0 1 0 0 0 1 /end COMPU_METHOD
/begin COMPU_METHOD diag_info_monitor "Q = V" IDENTICAL "%8.0" "" COEFFS 0 1 0 0 0 1 /end COMPU_METHOD
/begin COMPU_VTAB VTAB_FOR_ALCA_subsystem_integrated_CM_EnumDCSN_driving_direction "Enumerated data type: EnumDCSN_driving_direction" TAB_VERB 3 0 "FORWARD" 1 "LEFT" 2 "RIGHT" /end COMPU_VTAB
/begin COMPU_VTAB VTAB_FOR_ALCA_subsystem_integrated_CM_EnumALCA_state "Enumerated data type: EnumALCA_state" TAB_VERB 8 0 "ALCA_state_OFF" 1 "ALCA_state_Standby" 2 "ALCA_state_Activated" 3 "ALCA_state_Waiting" 4 "ALCA_state_Inform" 5 "ALCA_state_Finish" 6 "ALCA_state_Handover" 7 "ALCA_state_Abort" /end COMPU_VTAB
/begin COMPU_VTAB VTAB_FOR_ALCA_subsystem_integrated_CM_EnumALCA_not_fulfill_reason "Enumerated data type: EnumALCA_not_fulfill_reason" TAB_VERB 10 0 "ALCA_not_fulfill_reason_no_request" 1 "ALCA_not_fulfill_reason_no_lane" 2 "ALCA_not_fulfill_reason_mpfu_reject" 3 "ALCA_not_fulfill_reason_has_obstacle" 4 "ALCA_not_fulfill_reason_low_speed" 5 "ALCA_not_fulfill_reason_high_speed" 6 "ALCA_not_fulfill_reason_dangerous_conditions" 7 "ALCA_not_fulfill_reason_system_error" 8 "ALCA_not_fulfill_reason_too_often" 9 "ALCA_not_fulfill_reason_check_fulfilled" /end COMPU_VTAB
/begin COMPU_VTAB VTAB_FOR_ALCA_subsystem_integrated_CM_EnumALCA_interrupt_type "Enumerated data type: EnumALCA_interrupt_type" TAB_VERB 3 0 "ALCA_interrupt_type_no" 1 "ALCA_interrupt_type_driver_cancel" 2 "ALCA_interrupt_type_has_obstacle" /end COMPU_VTAB
/begin COMPU_VTAB VTAB_FOR_LKAS_subsystem_integrated_CM_EnumLKAS_IntvTyp "Enumerated data type: EnumLKAS_IntvTyp" TAB_VERB 2 0 "LKAS_NoIntvTyp" 1 "LKAS_SftyLaneKeepAid" /end COMPU_VTAB
/begin COMPU_VTAB VTAB_FOR_LKAS_subsystem_integrated_CM_EnumLKAS_IntvSide "Enumerated data type: EnumLKAS_IntvSide" TAB_VERB 3 0 "LKAS_NoIntvSide" 1 "LKAS_IntvSideLe" 2 "LKAS_IntvSideRi" /end COMPU_VTAB
/begin COMPU_VTAB VTAB_FOR_LKAS_subsystem_integrated_CM_EnumLKAS_IntvMgrSt "Enumerated data type: EnumLKAS_IntvMgrSt" TAB_VERB 4 0 "LKAS_NoIntv" 1 "LKAS_Intv" 2 "LKAS_abort" 3 "LKAS_Completed" /end COMPU_VTAB
/begin COMPU_VTAB VTAB_FOR_LKAS_subsystem_integrated_CM_EnumLKAS_CtrlRefTypVcc "Enumerated data type: EnumLKAS_CtrlRefTypVcc" TAB_VERB 3 0 "LKAS_NoRef" 1 "LKAS_LaneMkrToClsLe" 2 "LKAS_LaneMkrToClsRi" /end COMPU_VTAB
/begin COMPU_VTAB VTAB_FOR_LKAS_subsystem_integrated_CM_EnumLKAS_LaneMkrQly "Enumerated data type: EnumLKAS_LaneMkrQly" TAB_VERB 2 1 "VldForEnag" 0 "NotVld" /end COMPU_VTAB
/begin COMPU_VTAB VTAB_FOR_LKAS_subsystem_integrated_CM_EnumLKAS_SystemSt "Enumerated data type: EnumLKAS_SystemSt" TAB_VERB 2 0 "LKAS_Off" 1 "LKAS_On" /end COMPU_VTAB
/begin COMPU_VTAB VTAB_FOR_LKAS_subsystem_integrated_CM_EnumLKAS_OnStateSt "Enumerated data type: EnumLKAS_OnStateSt" TAB_VERB 6 0 "LKAS_Enabling" 1 "LKAS_Standby" 2 "LKAS_Active" 3 "LKAS_Suppressed" 4 "LKAS_completed" 5 "LKAS_aborted" /end COMPU_VTAB
/begin COMPU_VTAB VTAB_FOR_DRIV_subsystem_integrated_CM_EnumDRIV_LeftChangeLane "Enumerated data type: EnumDRIV_LeftChangeLane" TAB_VERB 4 0 "LeftLC_NOT" 1 "LeftLC_Ready" 2 "LeftLC_Ing" 3 "LeftLC_Finish" /end COMPU_VTAB
/begin COMPU_VTAB VTAB_FOR_DRIV_subsystem_integrated_CM_EnumDRIV_RightChangeLane "Enumerated data type: EnumDRIV_RightChangeLane" TAB_VERB 4 0 "RightLC_NOT" 1 "RightLC_Ready" 2 "RightLC_Ing" 3 "RightLC_Finish" /end COMPU_VTAB
/begin GROUP S6_Subsystem "LDWS_subsystem_integrated/LDWS_subsystem_integrated/Road_Enable_Estimator_LDW/Subsystem" /begin REF_CHARACTERISTIC KfLDWS_r_LaMkrQlt KfLDWS_t_LnMkrMissThrsh /end REF_CHARACTERISTIC /begin REF_MEASUREMENT VbLDWS_RdEnblLe /end REF_MEASUREMENT /end GROUP
/begin GROUP S6_Subsystem1 "LDWS_subsystem_integrated/LDWS_subsystem_integrated/Road_Enable_Estimator_LDW/Subsystem1" /begin REF_CHARACTERISTIC KfLDWS_r_LaMkrQlt KfLDWS_t_LnMkrMissThrsh /end REF_CHARACTERISTIC /begin REF_MEASUREMENT VbLDWS_RdEnblRi /end REF_MEASUREMENT /end GROUP
/begin GROUP S7_DtrmnSuppLe "LDWS_subsystem_integrated/LDWS_subsystem_integrated/SuppressionManager_LDW/DtrmnSuppLe"
 /begin REF_CHARACTERISTIC KfLDWS_Ang_SuppSteerAngThrsh KfLDWS_M_SuppTorque KfLDWS_t_SuppIndiTime KfLDWS_t_SuppSteerAngTime KfLDWS_t_SuppSteerRateTime KfLDWS_t_SuppTorqueTime KfLDWS_v_SuppSteerRateThrsh /end REF_CHARACTERISTIC
 /begin REF_MEASUREMENT VbLDWS_SuppLe /end REF_MEASUREMENT
/end GROUP
/begin GROUP S7_DtrmnSuppRi "LDWS_subsystem_integrated/LDWS_subsystem_integrated/SuppressionManager_LDW/DtrmnSuppRi"
 /begin REF_CHARACTERISTIC KfLDWS_Ang_SuppSteerAngThrsh KfLDWS_M_SuppTorque KfLDWS_t_SuppIndiTime KfLDWS_t_SuppSteerAngTime KfLDWS_t_SuppSteerRateTime KfLDWS_t_SuppTorqueTime KfLDWS_v_SuppSteerRateThrsh /end REF_CHARACTERISTIC
 /begin REF_MEASUREMENT VbLDWS_SuppRi /end REF_MEASUREMENT
/end GROUP
/begin GROUP S8_DtrmnActLe "LDWS_subsystem_integrated/LDWS_subsystem_integrated/TriggerManager_LDW/DtrmnActLe" /begin REF_CHARACTERISTIC KfLDWS_t_TLCThrsh /end REF_CHARACTERISTIC /end GROUP
/begin GROUP S8_DtrmnActRi "LDWS_subsystem_integrated/LDWS_subsystem_integrated/TriggerManager_LDW/DtrmnActRi" /begin REF_CHARACTERISTIC KfLDWS_t_TLCThrsh /end REF_CHARACTERISTIC /end GROUP
/begin GROUP S8_LanePositionConstraint "LDWS_subsystem_integrated/LDWS_subsystem_integrated/TriggerManager_LDW/LanePositionConstraint" /begin SUB_GROUP S46_DtrmnIsOnLeLine S46_DtrmnIsOnRiLine /end SUB_GROUP /end GROUP
/begin GROUP S8_LeadDirectionCondition "LDWS_subsystem_integrated/LDWS_subsystem_integrated/TriggerManager_LDW/LeadDirectionCondition" /begin REF_MEASUREMENT VbLDWS_LeadDrctn /end REF_MEASUREMENT /end GROUP
/begin GROUP S8_TTLCondition "LDWS_subsystem_integrated/LDWS_subsystem_integrated/TriggerManager_LDW/TTLCondition" /begin SUB_GROUP S48_TLC_calculation S48_v_lat_calculation /end SUB_GROUP /end GROUP
/begin GROUP S8_ThetaCalc "LDWS_subsystem_integrated/LDWS_subsystem_integrated/TriggerManager_LDW/ThetaCalc" /begin REF_CHARACTERISTIC KbLDWS_ThetaSwitch /end REF_CHARACTERISTIC /begin REF_MEASUREMENT VfLDWS_Theta /end REF_MEASUREMENT /end GROUP
/begin GROUP S8_VehicleToBdlnCalc "LDWS_subsystem_integrated/LDWS_subsystem_integrated/TriggerManager_LDW/VehicleToBdlnCalc"
 /begin REF_CHARACTERISTIC KfLDWS_Ang_BkToCnrAng KfLDWS_d_BkToFrtCnrDist KfLDWS_d_EdgBuff KfLDWS_k_CurvBuffCoe /end REF_CHARACTERISTIC
 /begin REF_MEASUREMENT VfLDWS_EdgeLaneLe VfLDWS_EdgeLaneRi /end REF_MEASUREMENT
/end GROUP
/begin GROUP S46_DtrmnIsOnLeLine "LDWS_subsystem_integrated/LDWS_subsystem_integrated/TriggerManager_LDW/LanePositionConstraint/DtrmnIsOnLeLine"
 /begin REF_CHARACTERISTIC KfLDWS_d_WarnLineLvlOne KfLDWS_d_WarnLineLvlThree KfLDWS_k_WarnLineLvlTwo /end REF_CHARACTERISTIC
 /begin REF_MEASUREMENT VbLDWS_IsOnLeLine /end REF_MEASUREMENT
/end GROUP
/begin GROUP S46_DtrmnIsOnRiLine "LDWS_subsystem_integrated/LDWS_subsystem_integrated/TriggerManager_LDW/LanePositionConstraint/DtrmnIsOnRiLine"
 /begin REF_CHARACTERISTIC KfLDWS_d_WarnLineLvlOne KfLDWS_d_WarnLineLvlThree KfLDWS_k_WarnLineLvlTwo /end REF_CHARACTERISTIC
 /begin REF_MEASUREMENT VbLDWS_IsOnRiLine /end REF_MEASUREMENT
/end GROUP
/begin GROUP S48_TLC_calculation "LDWS_subsystem_integrated/LDWS_subsystem_integrated/TriggerManager_LDW/TTLCondition/TLC_calculation" /begin REF_MEASUREMENT VfLDWS_TLCLe VfLDWS_TLCRi /end REF_MEASUREMENT /end GROUP
/begin GROUP S48_v_lat_calculation "LDWS_subsystem_integrated/LDWS_subsystem_integrated/TriggerManager_LDW/TTLCondition/v_lat_calculation" /begin REF_MEASUREMENT VfLDWS_VLatLe VfLDWS_VLatRi /end REF_MEASUREMENT /end GROUP
/begin GROUP AEBD_subsystem_integrated "AEBD_subsystem_integrated" ROOT /begin SUB_GROUP Root_AEBD_Subsystem /end SUB_GROUP /end GROUP
/begin GROUP Root_AEBD_Subsystem "AEBD_subsystem_integrated/AEBD_Subsystem"
 /begin REF_CHARACTERISTIC KbAEBD_ADCU_CANError KbAEBD_AccelerationSensorError KbAEBD_ESCError KbAEBD_ErrorClear KcAEBD_ErrorCountThrsh KfAEBD_a_AccelDeviation KfAEBD_t_WaitTimeThrsh /end REF_CHARACTERISTIC
 /begin REF_MEASUREMENT VbAEBD_AEBaError VbAEBD_AEBrequest VbAEBD_Error VbAEBD_Pedoff VbAEBD_Suppress VcAEBD_ErrorCount VfAEBD_AEB_a VfAEBD_t_DelayTime /end REF_MEASUREMENT
/end GROUP
/begin GROUP ALCA_subsystem_integrated "ALCA_subsystem_integrated" ROOT /begin SUB_GROUP Root_ALCA /end SUB_GROUP
 /begin REF_MEASUREMENT VfALCA_HasLeftLane VfALCA_HasRightLane VfALCA_ObstacleNum VfALCA_TargetLaneLength VfALCA_TargetLaneType VfALCA_TargetLaneWidth VfALCA_TargetSideLaneMarkerType VfALCA_d_EGOLaneLength VfALCA_d_EGOLaneWidth VfALCA_v_VehLonSpeed2LaneMarker /end REF_MEASUREMENT
/end GROUP
/begin GROUP Root_ALCA "ALCA_subsystem_integrated/ALCA" /begin SUB_GROUP S1_ALCA_Enabled /end SUB_GROUP
 /begin REF_MEASUREMENT VbALCA_ALCAEnableFromDCSN VbALCA_RequestOutput VeALCA_NotFulfillReasonOutput VeALCA_ReqSideOutput VeALCA_StateOutput VfALCA_FaultOutput VfALCA_v_InterruptOutput VfALCA_v_InterruptTypeOutput VfALCA_v_LateralSpeedOutput /end REF_MEASUREMENT
/end GROUP
/begin GROUP S1_ALCA_Enabled "ALCA_subsystem_integrated/ALCA/ALCA_Enabled"
 /begin SUB_GROUP S3_ALCA_CalcLateralV_ S3_ALCA_CheckLCConditions S3_ALCA_DtrmnALCAState S3_ALCA_Init_global S3_ALCA_InputDataProcess /end SUB_GROUP
 /begin REF_CHARACTERISTIC KbALCA_EnblOvrdInterruptAction KbALCA_UseNewAPI_Of_MPFU KfALCA_d_EgoVehWidth KfALCA_d_LaneWidthMax KfALCA_d_TouchedNewLaneDist KfALCA_t_LaneChangeTimeMax KfALCA_t_LaneChangeTimeMin /end REF_CHARACTERISTIC
 /begin REF_MEASUREMENT VfALCA_d_LateralDist2GoFromLCCS /end REF_MEASUREMENT
/end GROUP
/begin GROUP S3_ALCA_CalcLateralV_ "ALCA_subsystem_integrated/ALCA/ALCA_Enabled/ALCA_CalcLateralV " /begin SUB_GROUP S7_CalcLateralV_2 /end SUB_GROUP
 /begin REF_CHARACTERISTIC KfALCA_d_EnterSecondStageThrsh KfALCA_v_LateralSpeedOfSecondStage /end REF_CHARACTERISTIC
/end GROUP
/begin GROUP S3_ALCA_CheckLCConditions "ALCA_subsystem_integrated/ALCA/ALCA_Enabled/ALCA_CheckLCConditions" /begin SUB_GROUP S8_ALCA_Init_global3 S8_MonitorOBFU /end SUB_GROUP
 /begin REF_CHARACTERISTIC KbALCA_EnblCheckMPFULaneMarkerType KbALCA_EnblCheckObstacles KbALCA_EnblOvrdLaneLength KbALCA_EnblOvrdLaneWidth KbALCA_OvrdLaneChangeTime KfALCA_d_DefaultLaneLength KfALCA_d_Dist2LaneChangeFinish KfALCA_r_ComfortableVRatio KfALCA_r_EgoWidth2LaneWidthRation KfALCA_t_HoldTimeForLCAccept KfALCA_t_HoldTimeForLCComplete KfALCA_t_LaneChangeTimeMax KfALCA_v_SpeedLaneChangeEnblMax KfALCA_v_SpeedLaneChangeEnblMin KfAlCA_d_CheckObstacleDistMin KtALCA_d_RangeFrontOfCheckObstacle KtALCA_d_RangeRearOfCheckObstacle /end REF_CHARACTERISTIC
 /begin REF_MEASUREMENT VbALCA_LC_Complete VbALCA_TouchedNewLane VfALCA_d_EGOLaneCenter2Host VfALCA_d_Host2TargetLaneCenter VfALCA_d_TargetSideLaneMarker2Host VfALCA_t_LCTime /end REF_MEASUREMENT
/end GROUP
/begin GROUP S3_ALCA_DtrmnALCAState "ALCA_subsystem_integrated/ALCA/ALCA_Enabled/ALCA_DtrmnALCAState" /begin SUB_GROUP S10_ALCA_Init_global4 /end SUB_GROUP
 /begin REF_CHARACTERISTIC KbALCA_EnblInterrupt KfALCA_t_ExitFinishDelay KfALCA_t_ExitHandoverDelay KfALCA_t_ExitWaitingDelay KfALCA_t_PeriodFunctionCall KfALCA_t_WaitForDriverActionMax KtALCA_d_RangeFrontOfCheckObstacle KtALCA_d_RangeRearOfCheckObstacle /end REF_CHARACTERISTIC
 /begin REF_MEASUREMENT VbALCA_ResetLaneChangeReq VfALCA_InterruptAction /end REF_MEASUREMENT
/end GROUP
/begin GROUP S3_ALCA_Init_global "ALCA_subsystem_integrated/ALCA/ALCA_Enabled/ALCA_Init_global"
 /begin REF_CHARACTERISTIC KbALCA_EnblOvrdInterruptAction KbALCA_UseNewAPI_Of_MPFU KfALCA_d_EgoVehWidth KfALCA_d_LaneWidthMax KfALCA_d_TouchedNewLaneDist KfALCA_t_LaneChangeTimeMax KfALCA_t_LaneChangeTimeMin /end REF_CHARACTERISTIC
/end GROUP
/begin GROUP S3_ALCA_InputDataProcess "ALCA_subsystem_integrated/ALCA/ALCA_Enabled/ALCA_InputDataProcess"
 /begin SUB_GROUP S12_ALCA_Dtrm_dcsn_info S12_ALCA_Dtrm_veh_state S12_ALCA_FaultDetection S12_ALCA_Init_global2 S12_ALCA_MPFU_Montior /end SUB_GROUP
 /begin REF_CHARACTERISTIC KbALCA_EnblCheckMPFUFusionStatus KbALCA_EnblCheckTimestamp /end REF_CHARACTERISTIC
/end GROUP
/begin GROUP S7_CalcLateralV_2 "ALCA_subsystem_integrated/ALCA/ALCA_Enabled/ALCA_CalcLateralV /CalcLateralV_2"
 /begin REF_CHARACTERISTIC KbALCA_EnblCalibrateLateralSpeed KfALCA_r_OutputLarteralVRatioInterrupt KtALCA_r_LateralDist2LateralV KtALCA_r_VComfortable2VLon /end REF_CHARACTERISTIC
/end GROUP
/begin GROUP S8_ALCA_Init_global3 "ALCA_subsystem_integrated/ALCA/ALCA_Enabled/ALCA_CheckLCConditions/ALCA_Init_global3"
 /begin REF_CHARACTERISTIC KbALCA_EnblCheckMPFULaneMarkerType KbALCA_EnblCheckObstacles KbALCA_EnblOvrdLaneLength KbALCA_EnblOvrdLaneWidth KfALCA_d_DefaultLaneLength KfALCA_r_ComfortableVRatio KfALCA_r_EgoWidth2LaneWidthRation KfALCA_v_SpeedLaneChangeEnblMax KfALCA_v_SpeedLaneChangeEnblMin KfAlCA_d_CheckObstacleDistMin /end REF_CHARACTERISTIC
/end GROUP
/begin GROUP S8_MonitorOBFU "ALCA_subsystem_integrated/ALCA/ALCA_Enabled/ALCA_CheckLCConditions/MonitorOBFU"
 /begin REF_MEASUREMENT VfALCA_ObstacleCenter_x VfALCA_ObstacleCenter_y VfALCA_ObstacleHeading VfALCA_ObstacleID VfALCA_ObstacleLength VfALCA_ObstacleNearest_x VfALCA_ObstacleNearest_y VfALCA_ObstacleWidth VfALCA_v_Obstacle_Vx VfALCA_v_Obstacle_Vy /end REF_MEASUREMENT
/end GROUP
/begin GROUP S10_ALCA_Init_global4 "ALCA_subsystem_integrated/ALCA/ALCA_Enabled/ALCA_DtrmnALCAState/ALCA_Init_global4" /begin REF_CHARACTERISTIC KbALCA_EnblInterrupt /end REF_CHARACTERISTIC /end GROUP
/begin GROUP S12_ALCA_Dtrm_dcsn_info "ALCA_subsystem_integrated/ALCA/ALCA_Enabled/ALCA_InputDataProcess/ALCA_Dtrm_dcsn_info" /begin REF_CHARACTERISTIC KbALCA_EnblInterrupt /end REF_CHARACTERISTIC
 /begin REF_MEASUREMENT VbALCA_LC_CancelReq VbALCA_LC_CancelReqFromDCSN VbALCA_LC_Req VbALCA_LC_ReqFromDCSN VeALCA_ReqSide VeALCA_ReqSideFromDCSN /end REF_MEASUREMENT
/end GROUP
/begin GROUP S12_ALCA_Dtrm_veh_state "ALCA_subsystem_integrated/ALCA/ALCA_Enabled/ALCA_InputDataProcess/ALCA_Dtrm_veh_state" /begin SUB_GROUP S49_ALCA_adc_path_prediction /end SUB_GROUP /begin REF_MEASUREMENT VfALCA_v_VehSpeed VfALCA_v_VehVx VfALCA_v_VehVy /end REF_MEASUREMENT /end GROUP
/begin GROUP S12_ALCA_FaultDetection "ALCA_subsystem_integrated/ALCA/ALCA_Enabled/ALCA_InputDataProcess/ALCA_FaultDetection" /begin REF_CHARACTERISTIC KfALCA_t_TimeNReceivedThrsh /end REF_CHARACTERISTIC /begin REF_MEASUREMENT VfALCA_FaultInit /end REF_MEASUREMENT /end GROUP
/begin GROUP S12_ALCA_Init_global2 "ALCA_subsystem_integrated/ALCA/ALCA_Enabled/ALCA_InputDataProcess/ALCA_Init_global2" /begin REF_CHARACTERISTIC KbALCA_EnblCheckMPFUFusionStatus /end REF_CHARACTERISTIC /end GROUP
/begin GROUP S12_ALCA_MPFU_Montior "ALCA_subsystem_integrated/ALCA/ALCA_Enabled/ALCA_InputDataProcess/ALCA_MPFU_Montior"
 /begin REF_MEASUREMENT VfALCA_LeftDist2Host VfALCA_LeftLaneMarkerFusionStatus VfALCA_LeftLaneMarkerType VfALCA_LeftLaneMarker_C0 VfALCA_LeftLaneMarker_C1 VfALCA_LeftLaneMarker_C2 VfALCA_LeftLaneMarker_C3 VfALCA_RightDist2Host VfALCA_RightLaneMarkerFusionStatus VfALCA_RightLaneMarkerType VfALCA_RightLaneMarker_C0 VfALCA_RightLaneMarker_C1 VfALCA_RightLaneMarker_C2 VfALCA_RightLaneMarker_C3 /end REF_MEASUREMENT
/end GROUP
/begin GROUP S49_ALCA_adc_path_prediction "ALCA_subsystem_integrated/ALCA/ALCA_Enabled/ALCA_InputDataProcess/ALCA_Dtrm_veh_state/ALCA_adc_path_prediction"
 /begin REF_CHARACTERISTIC KfALCA_d_EgoVehWheelBase KfALCA_r_CoeffStrwhl2Radius KfALCA_r_EgoVehStrwhl2FrtwhlRatio /end REF_CHARACTERISTIC
/end GROUP
/begin GROUP LKAS_subsystem_integrated "LKAS_subsystem_integrated" ROOT /begin SUB_GROUP Root_LKAS_subsystem_integrated /end SUB_GROUP /end GROUP
/begin GROUP Root_LKAS_subsystem_integrated "LKAS_subsystem_integrated/LKAS_subsystem_integrated" /begin SUB_GROUP S3_ControlLayer S3_InputFusion /end SUB_GROUP /end GROUP
/begin GROUP S3_ControlLayer "LKAS_subsystem_integrated/LKAS_subsystem_integrated/ControlLayer"
 /begin SUB_GROUP S4_CreateCtrlValue S4_InterventionAbort S4_InterventionCompletion S4_InterventionManager S4_OutputManager_LKA S4_SuppressionManager_LKA S4_TriggeringSLKA /end SUB_GROUP
/end GROUP
/begin GROUP S3_InputFusion "LKAS_subsystem_integrated/LKAS_subsystem_integrated/InputFusion" /begin SUB_GROUP S5_LaneMarkerHandler S5_TrajectoryCalculation /end SUB_GROUP /end GROUP
/begin GROUP S4_CreateCtrlValue "LKAS_subsystem_integrated/LKAS_subsystem_integrated/ControlLayer/CreateCtrlValue"
 /begin SUB_GROUP S6_CtrlValueCreation S6_InputSelection S6_OffstAndVlatController S6_PathFreeze S6_SteerAngleRequest /end SUB_GROUP
/end GROUP
/begin GROUP S4_InterventionAbort "LKAS_subsystem_integrated/LKAS_subsystem_integrated/ControlLayer/InterventionAbort" /begin SUB_GROUP S8_AbortForTimeOut S8_AbortsLKA S8_DtrmnAbortDly /end SUB_GROUP /end GROUP
/begin GROUP S4_InterventionCompletion "LKAS_subsystem_integrated/LKAS_subsystem_integrated/ControlLayer/InterventionCompletion"
 /begin SUB_GROUP S9_CheckInsidePath S9_CheckVlat S9_ChecksLKACmpl S9_DtrmnPositToPath /end SUB_GROUP
/end GROUP
/begin GROUP S4_InterventionManager "LKAS_subsystem_integrated/LKAS_subsystem_integrated/ControlLayer/InterventionManager" /begin SUB_GROUP S10_FunctionActivityArbitration_ /end SUB_GROUP
 /begin REF_MEASUREMENT VeLKAS_CtrlRef_sLKA VeLKAS_IntvMgrSt_sLKA VeLKAS_IntvSide_sLKA VeLKAS_IntvTyp_sLKA VeLKAS_OnStateSt_sLKA VeLKAS_SystemSt_sLKA /end REF_MEASUREMENT
/end GROUP
/begin GROUP S4_OutputManager_LKA "LKAS_subsystem_integrated/LKAS_subsystem_integrated/ControlLayer/OutputManager_LKA" /begin SUB_GROUP S11_CreateLKADataBus /end SUB_GROUP /end GROUP
/begin GROUP S4_SuppressionManager_LKA "LKAS_subsystem_integrated/LKAS_subsystem_integrated/ControlLayer/SuppressionManager_LKA" /begin SUB_GROUP S12_sLKASuppression /end SUB_GROUP /end GROUP
/begin GROUP S4_TriggeringSLKA "LKAS_subsystem_integrated/LKAS_subsystem_integrated/ControlLayer/TriggeringSLKA"
 /begin SUB_GROUP S13_CheckPathAcceleration S13_CheckTracking S13_CheckTrajectoryInTrigZone S13_CheckVlatTowardIntvSide S13_CheckVlatWithinThreshold S13_IncreaseRobustness S13_LDW_Triggering /end SUB_GROUP
 /begin REF_CHARACTERISTIC KbLKAS_TriggerLDWSwitch /end REF_CHARACTERISTIC
 /begin REF_MEASUREMENT VbLKAS_IsTrajectoryFound /end REF_MEASUREMENT
/end GROUP
/begin GROUP S5_LaneMarkerHandler "LKAS_subsystem_integrated/LKAS_subsystem_integrated/InputFusion/LaneMarkerHandler" /begin SUB_GROUP S171_SeneorFusion S171_UpdateInternalOutput S171__ /end SUB_GROUP /end GROUP
/begin GROUP S5_TrajectoryCalculation "LKAS_subsystem_integrated/LKAS_subsystem_integrated/InputFusion/TrajectoryCalculation"
 /begin SUB_GROUP S172_CurveDetection S172_PathGeneration S172_RoadEnableEvaluation S172_VehicleStates /end SUB_GROUP
/end GROUP
/begin GROUP S6_CtrlValueCreation "LKAS_subsystem_integrated/LKAS_subsystem_integrated/ControlLayer/CreateCtrlValue/CtrlValueCreation" /begin SUB_GROUP S15_CtrlValueCreation /end SUB_GROUP /end GROUP
/begin GROUP S6_InputSelection "LKAS_subsystem_integrated/LKAS_subsystem_integrated/ControlLayer/CreateCtrlValue/InputSelection" /begin SUB_GROUP S16_OffstAndVlatCalc /end SUB_GROUP /end GROUP
/begin GROUP S6_OffstAndVlatController "LKAS_subsystem_integrated/LKAS_subsystem_integrated/ControlLayer/CreateCtrlValue/OffstAndVlatController"
 /begin REF_CHARACTERISTIC KbLKAS_TargetSwitch_Temp KfLKAS_d_OffstCtrlr_DeadZone KfLKAS_r_PGainForVlat KfLKAS_v_VlatCtrlr_DeadZone KtLKAS_r_OffstCtrlDiffGain KtLKAS_r_OffstCtrlPropGain /end REF_CHARACTERISTIC
 /begin REF_MEASUREMENT VfLKAS_Alat_Desired VfLKAS_DesiredDistToEdge VfLKAS_OffstError VfLKAS_Offst_ErrorDiff VfLKAS_TargetA VfLKAS_TargetV VfLKAS_VlatError VfLKAS_Vlat_Desired VfLKAS_Vlat_ErrorDiff VfLKAS_YawRateDesired /end REF_MEASUREMENT
/end GROUP
/begin GROUP S6_PathFreeze "LKAS_subsystem_integrated/LKAS_subsystem_integrated/ControlLayer/CreateCtrlValue/PathFreeze"
 /begin SUB_GROUP S18_FreezeCurrent_1 S18_FreezeCurrent_10 S18_FreezeCurrent_2 S18_FreezeCurrent_3 S18_FreezeCurrent_4 S18_FreezeCurrent_5 /end SUB_GROUP
/end GROUP
/begin GROUP S6_SteerAngleRequest "LKAS_subsystem_integrated/LKAS_subsystem_integrated/ControlLayer/CreateCtrlValue/SteerAngleRequest"
 /begin REF_CHARACTERISTIC KfLKAS_Ang_SteerOffset KfLKAS_C_CfForLatCtrl KfLKAS_C_CrForLatCtrl KfLKAS_d_LfForLatCtrl KfLKAS_d_LrForLatCtrl KfLKAS_k_StrAngFilt KfLKAS_m_MForLatCtrl KfLKAS_r_StrRatioForLatCtrl KtLKAS_Ang_StrAngLwrSaturation KtLKAS_Ang_StrAngUpperSaturation /end REF_CHARACTERISTIC
 /begin REF_MEASUREMENT VfLKAS_SteerAngleRequest VfLKAS_SteerAngleRequest_Saturated VfLKAS_StrAngFilted /end REF_MEASUREMENT
/end GROUP
/begin GROUP S8_AbortForTimeOut "LKAS_subsystem_integrated/LKAS_subsystem_integrated/ControlLayer/InterventionAbort/AbortForTimeOut" /begin REF_CHARACTERISTIC KfLKAS_t_MaxIntvTime /end REF_CHARACTERISTIC /end GROUP
/begin GROUP S8_AbortsLKA "LKAS_subsystem_integrated/LKAS_subsystem_integrated/ControlLayer/InterventionAbort/AbortsLKA" /begin SUB_GROUP S77_Subsystem /end SUB_GROUP /begin REF_CHARACTERISTIC KbLKAS_AbortSwitch_Temp /end REF_CHARACTERISTIC /begin REF_MEASUREMENT VbLKAS_IsAbortIntv /end REF_MEASUREMENT /end GROUP
/begin GROUP S8_DtrmnAbortDly "LKAS_subsystem_integrated/LKAS_subsystem_integrated/ControlLayer/InterventionAbort/DtrmnAbortDly" /begin SUB_GROUP S78_OffDelayBlock /end SUB_GROUP /begin REF_CHARACTERISTIC KcLKAS_CntSample KfLKAS_t_TimeDlyAbort /end REF_CHARACTERISTIC /end GROUP
/begin GROUP S9_CheckInsidePath "LKAS_subsystem_integrated/LKAS_subsystem_integrated/ControlLayer/InterventionCompletion/CheckInsidePath" /begin REF_MEASUREMENT VbLKAS_IsInsidePath /end REF_MEASUREMENT /end GROUP
/begin GROUP S9_CheckVlat "LKAS_subsystem_integrated/LKAS_subsystem_integrated/ControlLayer/InterventionCompletion/CheckVlat" /begin SUB_GROUP S88_CheckVlatTowardsLaneCenter S88_CheckVmaxReached /end SUB_GROUP /end GROUP
/begin GROUP S9_ChecksLKACmpl "LKAS_subsystem_integrated/LKAS_subsystem_integrated/ControlLayer/InterventionCompletion/ChecksLKACmpl" /begin SUB_GROUP S89_Robustness /end SUB_GROUP
 /begin REF_CHARACTERISTIC KbLKAS_UseInsidePathForCmpl_Temp KbLKAS_UseVmaxForCmpl_Temp /end REF_CHARACTERISTIC
/end GROUP
/begin GROUP S9_DtrmnPositToPath "LKAS_subsystem_integrated/LKAS_subsystem_integrated/ControlLayer/InterventionCompletion/DtrmnPositToPath" /begin REF_CHARACTERISTIC KbLKAS_NotUseOffstForCmpl_Temp /end REF_CHARACTERISTIC /end GROUP
/begin GROUP S10_FunctionActivityArbitration_ "LKAS_subsystem_integrated/LKAS_subsystem_integrated/ControlLayer/InterventionManager/FunctionActivityArbitration " /begin SUB_GROUP S104_InterventionTime /end SUB_GROUP /end GROUP
/begin GROUP S11_CreateLKADataBus "LKAS_subsystem_integrated/LKAS_subsystem_integrated/ControlLayer/OutputManager_LKA/CreateLKADataBus" /begin REF_MEASUREMENT VbLKAS_Intv_Request /end REF_MEASUREMENT /end GROUP
/begin GROUP S12_sLKASuppression "LKAS_subsystem_integrated/LKAS_subsystem_integrated/ControlLayer/SuppressionManager_LKA/sLKASuppression" /begin REF_CHARACTERISTIC KbLKAS_SuppSwitch_Temp /end REF_CHARACTERISTIC
 /begin REF_MEASUREMENT VbLKAS_DlyAftAbort VbLKAS_InnerCurvLe VbLKAS_InnerCurvRi VbLKAS_IsSuppLe VbLKAS_IsSuppRi VbLKAS_LeftChangeLane VbLKAS_NotQualDrpLeft VbLKAS_NotQualDrpRight VbLKAS_RightChangeLane /end REF_MEASUREMENT
/end GROUP
/begin GROUP S13_CheckPathAcceleration "LKAS_subsystem_integrated/LKAS_subsystem_integrated/ControlLayer/TriggeringSLKA/CheckPathAcceleration" /begin REF_CHARACTERISTIC KfLKAS_a_AMaxInPathToTrig_sLKA /end REF_CHARACTERISTIC /begin REF_MEASUREMENT VbLKAS_IsPathAccPlausible /end REF_MEASUREMENT /end GROUP
/begin GROUP S13_CheckTracking "LKAS_subsystem_integrated/LKAS_subsystem_integrated/ControlLayer/TriggeringSLKA/CheckTracking" /begin REF_MEASUREMENT VbLKAS_IsTrackingIntvSide /end REF_MEASUREMENT /end GROUP
/begin GROUP S13_CheckTrajectoryInTrigZone "LKAS_subsystem_integrated/LKAS_subsystem_integrated/ControlLayer/TriggeringSLKA/CheckTrajectoryInTrigZone" /begin REF_CHARACTERISTIC KfLKAS_j_MaxTrigJerk_sLKA KfLKAS_t_TMaxNeeded_sLKA /end REF_CHARACTERISTIC /begin REF_MEASUREMENT VbLKAS_IsTrajInTrigZone /end REF_MEASUREMENT /end GROUP
/begin GROUP S13_CheckVlatTowardIntvSide "LKAS_subsystem_integrated/LKAS_subsystem_integrated/ControlLayer/TriggeringSLKA/CheckVlatTowardIntvSide" /begin REF_MEASUREMENT VbLKAS_IsVlatTowardsIntvSide /end REF_MEASUREMENT /end GROUP
/begin GROUP S13_CheckVlatWithinThreshold "LKAS_subsystem_integrated/LKAS_subsystem_integrated/ControlLayer/TriggeringSLKA/CheckVlatWithinThreshold" /begin REF_CHARACTERISTIC KfLKAS_v_VMaxToTrigZeroPath_sLKA /end REF_CHARACTERISTIC /begin REF_MEASUREMENT VbLKAS_IsVlatOkForZeroPath /end REF_MEASUREMENT /end GROUP
/begin GROUP S13_IncreaseRobustness "LKAS_subsystem_integrated/LKAS_subsystem_integrated/ControlLayer/TriggeringSLKA/IncreaseRobustness" /begin SUB_GROUP S123_OnDelayBlock3 /end SUB_GROUP /begin REF_CHARACTERISTIC KcLKAS_CntSample KfLKAS_t_TDelayForAct_sLKA /end REF_CHARACTERISTIC /end GROUP
/begin GROUP S13_LDW_Triggering "LKAS_subsystem_integrated/LKAS_subsystem_integrated/ControlLayer/TriggeringSLKA/LDW_Triggering" /begin SUB_GROUP S124_Road_Enable_Estimator_LKA S124_TriggerManager_LKA /end SUB_GROUP /begin REF_MEASUREMENT VbLKAS_IsLDWSTriggered /end REF_MEASUREMENT /end GROUP
/begin GROUP S171__ "LKAS_subsystem_integrated/LKAS_subsystem_integrated/InputFusion/LaneMarkerHandler/ " /begin REF_CHARACTERISTIC KfLKAS_d_VehicleWheelBase KfLKAS_d_VehicleWidth /end REF_CHARACTERISTIC /end GROUP
/begin GROUP S171_SeneorFusion "LKAS_subsystem_integrated/LKAS_subsystem_integrated/InputFusion/LaneMarkerHandler/SeneorFusion"
 /begin SUB_GROUP S174_LaneMarkerHandler S174_Road_Signals S174_VehicleSelfSignalsHandler /end SUB_GROUP
/end GROUP
/begin GROUP S171_UpdateInternalOutput "LKAS_subsystem_integrated/LKAS_subsystem_integrated/InputFusion/LaneMarkerHandler/UpdateInternalOutput"
 /begin REF_MEASUREMENT VbLKAS_IsIntvCompleted_sLKA_IntOut VeLKAS_CtrlRef_sLKA_IntOut VeLKAS_IntvSide_sLKA_IntOut VeLKAS_IntvTyp_sLKA_IntOut VfLKAS_T_AftIntvStart_IntOut /end REF_MEASUREMENT
/end GROUP
/begin GROUP S172_CurveDetection "LKAS_subsystem_integrated/LKAS_subsystem_integrated/InputFusion/TrajectoryCalculation/CurveDetection" /begin SUB_GROUP S237_RELAY_INIT_3 S237_RELAY_INIT_4 /end SUB_GROUP /begin REF_CHARACTERISTIC KfLKAS_c_CurveSuppOff KfLKAS_c_CurveSuppOn /end REF_CHARACTERISTIC /end GROUP
/begin GROUP S172_PathGeneration "LKAS_subsystem_integrated/LKAS_subsystem_integrated/InputFusion/TrajectoryCalculation/PathGeneration"
 /begin SUB_GROUP S238_NoOperation1 S238_NoOperation2 S238_NoOperation3 S238_NoOperation4 S238_PathGeneration_sLKA /end SUB_GROUP
/end GROUP
/begin GROUP S172_RoadEnableEvaluation "LKAS_subsystem_integrated/LKAS_subsystem_integrated/InputFusion/TrajectoryCalculation/RoadEnableEvaluation" /begin SUB_GROUP S239_RoadEnableEvaluationSLKA /end SUB_GROUP /end GROUP
/begin GROUP S172_VehicleStates "LKAS_subsystem_integrated/LKAS_subsystem_integrated/InputFusion/TrajectoryCalculation/VehicleStates"
 /begin SUB_GROUP S240_DetermineRelativeALat S240_DetermineV_Long S240_SelectControlReference S240_SelectReference /end SUB_GROUP
 /begin REF_CHARACTERISTIC KfLKAS_d_ExtraMargin /end REF_CHARACTERISTIC
 /begin REF_MEASUREMENT VfLKAS_L_ExtraMargin_sLKA /end REF_MEASUREMENT
/end GROUP
/begin GROUP S15_CtrlValueCreation "LKAS_subsystem_integrated/LKAS_subsystem_integrated/ControlLayer/CreateCtrlValue/CtrlValueCreation/CtrlValueCreation"
 /begin SUB_GROUP S21_FreezeCurrent_1 S21_FreezeCurrent_5 S21_JerkCalc S21_TargetDistCalc_1 S21_TargetDistCalc_2 /end SUB_GROUP
 /begin REF_MEASUREMENT VbLKAS_Trigger_Traj_1 VbLKAS_Trigger_Traj_2 VfLKAS_TargetDist /end REF_MEASUREMENT
/end GROUP
/begin GROUP S16_OffstAndVlatCalc "LKAS_subsystem_integrated/LKAS_subsystem_integrated/ControlLayer/CreateCtrlValue/InputSelection/OffstAndVlatCalc" /begin REF_MEASUREMENT VfLKAS_Offst_Actual /end REF_MEASUREMENT /end GROUP
/begin GROUP S18_FreezeCurrent_1 "LKAS_subsystem_integrated/LKAS_subsystem_integrated/ControlLayer/CreateCtrlValue/PathFreeze/FreezeCurrent_1" /begin REF_MEASUREMENT VfLKAS_A0Freezed_sLKA /end REF_MEASUREMENT /end GROUP
/begin GROUP S18_FreezeCurrent_10 "LKAS_subsystem_integrated/LKAS_subsystem_integrated/ControlLayer/CreateCtrlValue/PathFreeze/FreezeCurrent_10" /begin REF_MEASUREMENT VfLKAS_Offst_start /end REF_MEASUREMENT /end GROUP
/begin GROUP S18_FreezeCurrent_2 "LKAS_subsystem_integrated/LKAS_subsystem_integrated/ControlLayer/CreateCtrlValue/PathFreeze/FreezeCurrent_2" /begin REF_MEASUREMENT VfLKAS_AmFreezed_sLKA /end REF_MEASUREMENT /end GROUP
/begin GROUP S18_FreezeCurrent_3 "LKAS_subsystem_integrated/LKAS_subsystem_integrated/ControlLayer/CreateCtrlValue/PathFreeze/FreezeCurrent_3" /begin REF_MEASUREMENT VfLKAS_AeFreezed_sLKA /end REF_MEASUREMENT /end GROUP
/begin GROUP S18_FreezeCurrent_4 "LKAS_subsystem_integrated/LKAS_subsystem_integrated/ControlLayer/CreateCtrlValue/PathFreeze/FreezeCurrent_4" /begin REF_MEASUREMENT VfLKAS_dtFreezed_sLKA /end REF_MEASUREMENT /end GROUP
/begin GROUP S18_FreezeCurrent_5 "LKAS_subsystem_integrated/LKAS_subsystem_integrated/ControlLayer/CreateCtrlValue/PathFreeze/FreezeCurrent_5" /begin REF_MEASUREMENT VfLKAS_V0Freezed_sLKA /end REF_MEASUREMENT /end GROUP
/begin GROUP S77_Subsystem "LKAS_subsystem_integrated/LKAS_subsystem_integrated/ControlLayer/InterventionAbort/AbortsLKA/Subsystem" /begin REF_MEASUREMENT VfLKAS_AbortID /end REF_MEASUREMENT /end GROUP
/begin GROUP S78_OffDelayBlock "LKAS_subsystem_integrated/LKAS_subsystem_integrated/ControlLayer/InterventionAbort/DtrmnAbortDly/OffDelayBlock" /begin REF_MEASUREMENT VbLKAS_IsDelayAftAbort /end REF_MEASUREMENT /end GROUP
/begin GROUP S88_CheckVlatTowardsLaneCenter "LKAS_subsystem_integrated/LKAS_subsystem_integrated/ControlLayer/InterventionCompletion/CheckVlat/CheckVlatTowardsLaneCenter" /begin REF_CHARACTERISTIC KfLKAS_v_VlatMinForCmpl /end REF_CHARACTERISTIC /begin REF_MEASUREMENT VbLKAS_IsVlatTowardsLaneCenter /end REF_MEASUREMENT /end GROUP
/begin GROUP S88_CheckVmaxReached "LKAS_subsystem_integrated/LKAS_subsystem_integrated/ControlLayer/InterventionCompletion/CheckVlat/CheckVmaxReached" /begin REF_CHARACTERISTIC KfLKAS_v_VlatMaxForCmpl /end REF_CHARACTERISTIC /begin REF_MEASUREMENT VbLKAS_IsVmaxReached /end REF_MEASUREMENT /end GROUP
/begin GROUP S89_Robustness "LKAS_subsystem_integrated/LKAS_subsystem_integrated/ControlLayer/InterventionCompletion/ChecksLKACmpl/Robustness" /begin SUB_GROUP S95_OnDelayBlock3 /end SUB_GROUP /begin REF_CHARACTERISTIC KcLKAS_CntSample KfLKAS_t_TDelayForCmpl_sLKA /end REF_CHARACTERISTIC /end GROUP
/begin GROUP S104_InterventionTime "LKAS_subsystem_integrated/LKAS_subsystem_integrated/ControlLayer/InterventionManager/FunctionActivityArbitration /InterventionTime" /begin SUB_GROUP S107_Subsystem /end SUB_GROUP /end GROUP
/begin GROUP S123_OnDelayBlock3 "LKAS_subsystem_integrated/LKAS_subsystem_integrated/ControlLayer/TriggeringSLKA/IncreaseRobustness/OnDelayBlock3" /begin REF_MEASUREMENT VbLKAS_IsActivated_sLKA /end REF_MEASUREMENT /end GROUP
/begin GROUP S124_Road_Enable_Estimator_LKA "LKAS_subsystem_integrated/LKAS_subsystem_integrated/ControlLayer/TriggeringSLKA/LDW_Triggering/Road_Enable_Estimator_LKA" /begin SUB_GROUP S133_Subsystem S133_Subsystem1 /end SUB_GROUP /end GROUP
/begin GROUP S124_TriggerManager_LKA "LKAS_subsystem_integrated/LKAS_subsystem_integrated/ControlLayer/TriggeringSLKA/LDW_Triggering/TriggerManager_LKA"
 /begin SUB_GROUP S134_DtrmnActLe S134_DtrmnActRi S134_LanePositionConstraint S134_VehicleToBdlnCalc /end SUB_GROUP
/end GROUP
/begin GROUP S174_LaneMarkerHandler "LKAS_subsystem_integrated/LKAS_subsystem_integrated/InputFusion/LaneMarkerHandler/SeneorFusion/LaneMarkerHandler"
 /begin SUB_GROUP S177_Check_Quality S177_LeftLaneMarker S177_RightLaneMarker /end SUB_GROUP
/end GROUP
/begin GROUP S174_Road_Signals "LKAS_subsystem_integrated/LKAS_subsystem_integrated/InputFusion/LaneMarkerHandler/SeneorFusion/Road Signals" /begin SUB_GROUP S178_DetermineLaneWidth S178_DetermineRoadCurvature /end SUB_GROUP /end GROUP
/begin GROUP S174_VehicleSelfSignalsHandler "LKAS_subsystem_integrated/LKAS_subsystem_integrated/InputFusion/LaneMarkerHandler/SeneorFusion/VehicleSelfSignalsHandler"
 /begin SUB_GROUP S179_NoOperation1 S179_NoOperation2 S179_NoOperation3 S179_NoOperation7 /end SUB_GROUP
/end GROUP
/begin GROUP S237_RELAY_INIT_3 "LKAS_subsystem_integrated/LKAS_subsystem_integrated/InputFusion/TrajectoryCalculation/CurveDetection/RELAY_INIT_3" /begin REF_MEASUREMENT VbLKAS_InnerCurvLe_sLKA /end REF_MEASUREMENT /end GROUP
/begin GROUP S237_RELAY_INIT_4 "LKAS_subsystem_integrated/LKAS_subsystem_integrated/InputFusion/TrajectoryCalculation/CurveDetection/RELAY_INIT_4" /begin REF_MEASUREMENT VbLKAS_InnerCurvRi_sLKA /end REF_MEASUREMENT /end GROUP
/begin GROUP S238_NoOperation1 "LKAS_subsystem_integrated/LKAS_subsystem_integrated/InputFusion/TrajectoryCalculation/PathGeneration/NoOperation1" /begin REF_MEASUREMENT VfLKAS_dt_sLKA /end REF_MEASUREMENT /end GROUP
/begin GROUP S238_NoOperation2 "LKAS_subsystem_integrated/LKAS_subsystem_integrated/InputFusion/TrajectoryCalculation/PathGeneration/NoOperation2" /begin REF_MEASUREMENT VfLKAS_A0_sLKA /end REF_MEASUREMENT /end GROUP
/begin GROUP S238_NoOperation3 "LKAS_subsystem_integrated/LKAS_subsystem_integrated/InputFusion/TrajectoryCalculation/PathGeneration/NoOperation3" /begin REF_MEASUREMENT VfLKAS_Am_sLKA /end REF_MEASUREMENT /end GROUP
/begin GROUP S238_NoOperation4 "LKAS_subsystem_integrated/LKAS_subsystem_integrated/InputFusion/TrajectoryCalculation/PathGeneration/NoOperation4" /begin REF_MEASUREMENT VfLKAS_Ae_sLKA /end REF_MEASUREMENT /end GROUP
/begin GROUP S238_PathGeneration_sLKA "LKAS_subsystem_integrated/LKAS_subsystem_integrated/InputFusion/TrajectoryCalculation/PathGeneration/PathGeneration_sLKA"
 /begin SUB_GROUP S259_BoundaryValues_sLKA S259_ITCWithAdditionalConditionForValidPath_sLKA S259_determine_path_sLKA /end SUB_GROUP
/end GROUP
/begin GROUP S239_RoadEnableEvaluationSLKA "LKAS_subsystem_integrated/LKAS_subsystem_integrated/InputFusion/TrajectoryCalculation/RoadEnableEvaluation/RoadEnableEvaluationSLKA" /begin SUB_GROUP S364_LaneWidthEnable S364_OnDelayBlock S364_OnDelayBlock1 /end SUB_GROUP /begin REF_CHARACTERISTIC KfLKAS_CallFreq KfLKAS_t_RoadEnblOKHoldLow /end REF_CHARACTERISTIC /begin REF_MEASUREMENT VbLKAS__RoadEnbl /end REF_MEASUREMENT /end GROUP
/begin GROUP S240_DetermineRelativeALat "LKAS_subsystem_integrated/LKAS_subsystem_integrated/InputFusion/TrajectoryCalculation/VehicleStates/DetermineRelativeALat" /begin REF_CHARACTERISTIC KbLKAS_A0Trigger_Temp KfLKAS_a_SarnOfRelALatForPahCalcn /end REF_CHARACTERISTIC
 /begin REF_MEASUREMENT VfLKAS_A_ALatRelLaneMkrLe VfLKAS_A_ALatRelLaneMkrRi VfLKAS_A_ALatRelLaneMkr_sLKA /end REF_MEASUREMENT
/end GROUP
/begin GROUP S240_DetermineV_Long "LKAS_subsystem_integrated/LKAS_subsystem_integrated/InputFusion/TrajectoryCalculation/VehicleStates/DetermineV_Long" /begin REF_MEASUREMENT VfLKAS_Vlong_sLKA /end REF_MEASUREMENT /end GROUP
/begin GROUP S240_SelectControlReference "LKAS_subsystem_integrated/LKAS_subsystem_integrated/InputFusion/TrajectoryCalculation/VehicleStates/SelectControlReference" /begin REF_MEASUREMENT VeLKAS_CtrlRefReq_sLKA /end REF_MEASUREMENT /end GROUP
/begin GROUP S240_SelectReference "LKAS_subsystem_integrated/LKAS_subsystem_integrated/InputFusion/TrajectoryCalculation/VehicleStates/SelectReference" /begin SUB_GROUP S387_DetermineInterventionSideRequest /end SUB_GROUP /begin REF_MEASUREMENT VfLKAS_L_DistToCross_sLKA VfLKAS_Vlat_sLKA /end REF_MEASUREMENT /end GROUP
/begin GROUP S21_FreezeCurrent_1 "LKAS_subsystem_integrated/LKAS_subsystem_integrated/ControlLayer/CreateCtrlValue/CtrlValueCreation/CtrlValueCreation/FreezeCurrent_1" /begin REF_MEASUREMENT VfLKAS_TargetDist_Freezed2 /end REF_MEASUREMENT /end GROUP
/begin GROUP S21_FreezeCurrent_5 "LKAS_subsystem_integrated/LKAS_subsystem_integrated/ControlLayer/CreateCtrlValue/CtrlValueCreation/CtrlValueCreation/FreezeCurrent_5" /begin REF_MEASUREMENT VfLKAS_TargetDist_Freezed1 /end REF_MEASUREMENT /end GROUP
/begin GROUP S21_JerkCalc "LKAS_subsystem_integrated/LKAS_subsystem_integrated/ControlLayer/CreateCtrlValue/CtrlValueCreation/CtrlValueCreation/JerkCalc" /begin REF_MEASUREMENT VfLKAS_Jerk1 VfLKAS_Jerk2 /end REF_MEASUREMENT /end GROUP
/begin GROUP S21_TargetDistCalc_1 "LKAS_subsystem_integrated/LKAS_subsystem_integrated/ControlLayer/CreateCtrlValue/CtrlValueCreation/CtrlValueCreation/TargetDistCalc_1"
 /begin REF_MEASUREMENT VfLKAS_TargetA_1 VfLKAS_TargetDist_1 VfLKAS_TargetV_1 VfLKAS_V0Increment /end REF_MEASUREMENT
/end GROUP
/begin GROUP S21_TargetDistCalc_2 "LKAS_subsystem_integrated/LKAS_subsystem_integrated/ControlLayer/CreateCtrlValue/CtrlValueCreation/CtrlValueCreation/TargetDistCalc_2" /begin REF_MEASUREMENT VfLKAS_TargetA_2 VfLKAS_TargetDist_2 VfLKAS_TargetV_2 /end REF_MEASUREMENT /end GROUP
/begin GROUP S95_OnDelayBlock3 "LKAS_subsystem_integrated/LKAS_subsystem_integrated/ControlLayer/InterventionCompletion/ChecksLKACmpl/Robustness/OnDelayBlock3" /begin REF_MEASUREMENT VbLKAS_IsIntvCompleted /end REF_MEASUREMENT /end GROUP
/begin GROUP S107_Subsystem "LKAS_subsystem_integrated/LKAS_subsystem_integrated/ControlLayer/InterventionManager/FunctionActivityArbitration /InterventionTime/Subsystem" /begin REF_MEASUREMENT VfLKAS_T_AftIntvStart /end REF_MEASUREMENT /end GROUP
/begin GROUP S133_Subsystem "LKAS_subsystem_integrated/LKAS_subsystem_integrated/ControlLayer/TriggeringSLKA/LDW_Triggering/Road_Enable_Estimator_LKA/Subsystem" /begin REF_CHARACTERISTIC KcLKAS_CntSample KfLKAS_r_QlyVld KfLKAS_t_LnMkrMissThrsh /end REF_CHARACTERISTIC /end GROUP
/begin GROUP S133_Subsystem1 "LKAS_subsystem_integrated/LKAS_subsystem_integrated/ControlLayer/TriggeringSLKA/LDW_Triggering/Road_Enable_Estimator_LKA/Subsystem1" /begin REF_CHARACTERISTIC KcLKAS_CntSample KfLKAS_r_QlyVld KfLKAS_t_LnMkrMissThrsh /end REF_CHARACTERISTIC /end GROUP
/begin GROUP S134_DtrmnActLe "LKAS_subsystem_integrated/LKAS_subsystem_integrated/ControlLayer/TriggeringSLKA/LDW_Triggering/TriggerManager_LKA/DtrmnActLe" /begin REF_CHARACTERISTIC KfLKAS_t_TLCThrsh /end REF_CHARACTERISTIC /end GROUP
/begin GROUP S134_DtrmnActRi "LKAS_subsystem_integrated/LKAS_subsystem_integrated/ControlLayer/TriggeringSLKA/LDW_Triggering/TriggerManager_LKA/DtrmnActRi" /begin REF_CHARACTERISTIC KfLKAS_t_TLCThrsh /end REF_CHARACTERISTIC /end GROUP
/begin GROUP S134_LanePositionConstraint "LKAS_subsystem_integrated/LKAS_subsystem_integrated/ControlLayer/TriggeringSLKA/LDW_Triggering/TriggerManager_LKA/LanePositionConstraint" /begin SUB_GROUP S144_DtrmnIsOnLeLine S144_DtrmnIsOnRiLine /end SUB_GROUP /end GROUP
/begin GROUP S134_VehicleToBdlnCalc "LKAS_subsystem_integrated/LKAS_subsystem_integrated/ControlLayer/TriggeringSLKA/LDW_Triggering/TriggerManager_LKA/VehicleToBdlnCalc"
 /begin REF_CHARACTERISTIC KfLKAS_Ang_BkToCnrAng KfLKAS_c_CurvUprBnd KfLKAS_d_BkToFrtCnrDist KfLKAS_d_EdgBuff KfLKAS_r_CurvBuffCoe /end REF_CHARACTERISTIC
/end GROUP
/begin GROUP S177_Check_Quality "LKAS_subsystem_integrated/LKAS_subsystem_integrated/InputFusion/LaneMarkerHandler/SeneorFusion/LaneMarkerHandler/Check Quality" /begin REF_CHARACTERISTIC KfLKAS_r_QlyVld /end REF_CHARACTERISTIC
 /begin REF_MEASUREMENT VbLKAS_QlyValidLe VbLKAS_QlyValidRi VfLKAS_QlyLe VfLKAS_QlyRi /end REF_MEASUREMENT
/end GROUP
/begin GROUP S177_LeftLaneMarker "LKAS_subsystem_integrated/LKAS_subsystem_integrated/InputFusion/LaneMarkerHandler/SeneorFusion/LaneMarkerHandler/LeftLaneMarker"
 /begin SUB_GROUP S181_LeftCurvStepDetection S181_LeftOffstStepDetection S181_LeftVLatStepDetection /end SUB_GROUP
 /begin REF_MEASUREMENT VeLKAS_LineLeftOk VfLAKS_LeC0 VfLAKS_LeC1 VfLKAS_L_DisToCrossLeft VfLKAS_L_OffstLeft VfLKAS_LeC2 VfLKAS_LeLength VfLKAS_V_Latleft /end REF_MEASUREMENT
/end GROUP
/begin GROUP S177_RightLaneMarker "LKAS_subsystem_integrated/LKAS_subsystem_integrated/InputFusion/LaneMarkerHandler/SeneorFusion/LaneMarkerHandler/RightLaneMarker"
 /begin SUB_GROUP S182_LeftVLatStepDetection S182_RightCurvStepDetection S182_RightOffstStepDetection /end SUB_GROUP
 /begin REF_MEASUREMENT VeLKAS_LineRightOK VfLKAS_Heading VfLKAS_L_DistToCrossRight VfLKAS_OffstRi_sLKA VfLKAS_RiC0 VfLKAS_RiC1 VfLKAS_RiC2 VfLKAS_Ri_Length VfLKAS_VLatRight /end REF_MEASUREMENT
/end GROUP
/begin GROUP S178_DetermineLaneWidth "LKAS_subsystem_integrated/LKAS_subsystem_integrated/InputFusion/LaneMarkerHandler/SeneorFusion/Road Signals/DetermineLaneWidth" /begin REF_MEASUREMENT VfLKAS_LaneWidth /end REF_MEASUREMENT /end GROUP
/begin GROUP S178_DetermineRoadCurvature "LKAS_subsystem_integrated/LKAS_subsystem_integrated/InputFusion/LaneMarkerHandler/SeneorFusion/Road Signals/DetermineRoadCurvature" /begin REF_MEASUREMENT VfLKAS_Cr_Road /end REF_MEASUREMENT /end GROUP
/begin GROUP S179_NoOperation1 "LKAS_subsystem_integrated/LKAS_subsystem_integrated/InputFusion/LaneMarkerHandler/SeneorFusion/VehicleSelfSignalsHandler/NoOperation1" /begin REF_MEASUREMENT VfLKAS_Velocity_x /end REF_MEASUREMENT /end GROUP
/begin GROUP S179_NoOperation2 "LKAS_subsystem_integrated/LKAS_subsystem_integrated/InputFusion/LaneMarkerHandler/SeneorFusion/VehicleSelfSignalsHandler/NoOperation2" /begin REF_MEASUREMENT VfLKAS_yaw_rate_utm /end REF_MEASUREMENT /end GROUP
/begin GROUP S179_NoOperation3 "LKAS_subsystem_integrated/LKAS_subsystem_integrated/InputFusion/LaneMarkerHandler/SeneorFusion/VehicleSelfSignalsHandler/NoOperation3" /begin REF_MEASUREMENT VfLKAS_Acceleration_x /end REF_MEASUREMENT /end GROUP
/begin GROUP S179_NoOperation7 "LKAS_subsystem_integrated/LKAS_subsystem_integrated/InputFusion/LaneMarkerHandler/SeneorFusion/VehicleSelfSignalsHandler/NoOperation7" /begin REF_MEASUREMENT VfLKAS_Acce_y /end REF_MEASUREMENT /end GROUP
/begin GROUP S259_BoundaryValues_sLKA "LKAS_subsystem_integrated/LKAS_subsystem_integrated/InputFusion/TrajectoryCalculation/PathGeneration/PathGeneration_sLKA/BoundaryValues_sLKA"
 /begin SUB_GROUP S260_DetermineEndOffst S260_Determine_alat_0 S260_Determine_vlat_0 S260_LimitWhenCloseToMarker /end SUB_GROUP
/end GROUP
/begin GROUP S259_ITCWithAdditionalConditionForValidPath_sLKA "LKAS_subsystem_integrated/LKAS_subsystem_integrated/InputFusion/TrajectoryCalculation/PathGeneration/PathGeneration_sLKA/ITCWithAdditionalConditionForValidPath_sLKA" /begin SUB_GROUP S261_DetermineSingleSidedTrajectoryWithModTraj /end SUB_GROUP /begin REF_CHARACTERISTIC KfLKAS_d_PosVal /end REF_CHARACTERISTIC /end GROUP
/begin GROUP S259_determine_path_sLKA "LKAS_subsystem_integrated/LKAS_subsystem_integrated/InputFusion/TrajectoryCalculation/PathGeneration/PathGeneration_sLKA/determine_path_sLKA" /begin REF_MEASUREMENT VfLKAS_TimeNeeded_sLKA /end REF_MEASUREMENT /end GROUP
/begin GROUP S364_LaneWidthEnable "LKAS_subsystem_integrated/LKAS_subsystem_integrated/InputFusion/TrajectoryCalculation/RoadEnableEvaluation/RoadEnableEvaluationSLKA/LaneWidthEnable" /begin SUB_GROUP S367_SR_FF_INIT_1 /end SUB_GROUP
 /begin REF_CHARACTERISTIC KfLKAS_d_MaxEnblLaneWidth KfLKAS_d_MinDisLaneWidthMargin KfLKAS_d_MinEnblLaneWidthMargin /end REF_CHARACTERISTIC
/end GROUP
/begin GROUP S364_OnDelayBlock "LKAS_subsystem_integrated/LKAS_subsystem_integrated/InputFusion/TrajectoryCalculation/RoadEnableEvaluation/RoadEnableEvaluationSLKA/OnDelayBlock" /begin REF_MEASUREMENT VbLKAS_RoadEnblLe /end REF_MEASUREMENT /end GROUP
/begin GROUP S364_OnDelayBlock1 "LKAS_subsystem_integrated/LKAS_subsystem_integrated/InputFusion/TrajectoryCalculation/RoadEnableEvaluation/RoadEnableEvaluationSLKA/OnDelayBlock1" /begin REF_MEASUREMENT VbLKAS_RoadEnblRi /end REF_MEASUREMENT /end GROUP
/begin GROUP S387_DetermineInterventionSideRequest "LKAS_subsystem_integrated/LKAS_subsystem_integrated/InputFusion/TrajectoryCalculation/VehicleStates/SelectReference/DetermineInterventionSideRequest" /begin REF_MEASUREMENT VeLKAS_IntvSideReq_sLKA /end REF_MEASUREMENT /end GROUP
/begin GROUP S144_DtrmnIsOnLeLine "LKAS_subsystem_integrated/LKAS_subsystem_integrated/ControlLayer/TriggeringSLKA/LDW_Triggering/TriggerManager_LKA/LanePositionConstraint/DtrmnIsOnLeLine"
 /begin REF_CHARACTERISTIC KfLKAS_d_WarnLineLvlOne KfLKAS_d_WarnLineLvlThree KfLKAS_r_WarnLineLvlTwo /end REF_CHARACTERISTIC
/end GROUP
/begin GROUP S144_DtrmnIsOnRiLine "LKAS_subsystem_integrated/LKAS_subsystem_integrated/ControlLayer/TriggeringSLKA/LDW_Triggering/TriggerManager_LKA/LanePositionConstraint/DtrmnIsOnRiLine"
 /begin REF_CHARACTERISTIC KfLKAS_d_WarnLineLvlOne KfLKAS_d_WarnLineLvlThree KfLKAS_r_WarnLineLvlTwo /end REF_CHARACTERISTIC
/end GROUP
/begin GROUP S181_LeftCurvStepDetection "LKAS_subsystem_integrated/LKAS_subsystem_integrated/InputFusion/LaneMarkerHandler/SeneorFusion/LaneMarkerHandler/LeftLaneMarker/LeftCurvStepDetection" /begin SUB_GROUP S188_CheckForStep /end SUB_GROUP /begin REF_CHARACTERISTIC KfLKAS_c_MaxCurvStep /end REF_CHARACTERISTIC /end GROUP
/begin GROUP S181_LeftOffstStepDetection "LKAS_subsystem_integrated/LKAS_subsystem_integrated/InputFusion/LaneMarkerHandler/SeneorFusion/LaneMarkerHandler/LeftLaneMarker/LeftOffstStepDetection" /begin SUB_GROUP S189_CheckForStep /end SUB_GROUP /begin REF_CHARACTERISTIC KfLKAS_d_MaxOffstStep /end REF_CHARACTERISTIC /end GROUP
/begin GROUP S181_LeftVLatStepDetection "LKAS_subsystem_integrated/LKAS_subsystem_integrated/InputFusion/LaneMarkerHandler/SeneorFusion/LaneMarkerHandler/LeftLaneMarker/LeftVLatStepDetection" /begin SUB_GROUP S190_CheckForStep /end SUB_GROUP /begin REF_CHARACTERISTIC KfLKAS_v_MaxStepForVLat /end REF_CHARACTERISTIC /end GROUP
/begin GROUP S182_LeftVLatStepDetection "LKAS_subsystem_integrated/LKAS_subsystem_integrated/InputFusion/LaneMarkerHandler/SeneorFusion/LaneMarkerHandler/RightLaneMarker/LeftVLatStepDetection" /begin SUB_GROUP S204_CheckForStep /end SUB_GROUP /begin REF_CHARACTERISTIC KfLKAS_v_MaxStepForVLat /end REF_CHARACTERISTIC /end GROUP
/begin GROUP S182_RightCurvStepDetection "LKAS_subsystem_integrated/LKAS_subsystem_integrated/InputFusion/LaneMarkerHandler/SeneorFusion/LaneMarkerHandler/RightLaneMarker/RightCurvStepDetection" /begin SUB_GROUP S213_CheckForStep /end SUB_GROUP /begin REF_CHARACTERISTIC KfLKAS_c_MaxCurvStep /end REF_CHARACTERISTIC /end GROUP
/begin GROUP S182_RightOffstStepDetection "LKAS_subsystem_integrated/LKAS_subsystem_integrated/InputFusion/LaneMarkerHandler/SeneorFusion/LaneMarkerHandler/RightLaneMarker/RightOffstStepDetection" /begin SUB_GROUP S214_CheckForStep /end SUB_GROUP /begin REF_CHARACTERISTIC KfLKAS_d_MaxOffstStep /end REF_CHARACTERISTIC /end GROUP
/begin GROUP S260_DetermineEndOffst "LKAS_subsystem_integrated/LKAS_subsystem_integrated/InputFusion/TrajectoryCalculation/PathGeneration/PathGeneration_sLKA/BoundaryValues_sLKA/DetermineEndOffst" /begin REF_CHARACTERISTIC KfLKAS_d_OffsAtMinDeltaPos /end REF_CHARACTERISTIC /begin REF_MEASUREMENT VfLKAS_end_offst_sLKA /end REF_MEASUREMENT /end GROUP
/begin GROUP S260_Determine_alat_0 "LKAS_subsystem_integrated/LKAS_subsystem_integrated/InputFusion/TrajectoryCalculation/PathGeneration/PathGeneration_sLKA/BoundaryValues_sLKA/Determine_alat_0" /begin REF_MEASUREMENT VfLKAS_alat_0 /end REF_MEASUREMENT /end GROUP
/begin GROUP S260_Determine_vlat_0 "LKAS_subsystem_integrated/LKAS_subsystem_integrated/InputFusion/TrajectoryCalculation/PathGeneration/PathGeneration_sLKA/BoundaryValues_sLKA/Determine_vlat_0" /begin REF_MEASUREMENT VfLKAS_vlat_0 /end REF_MEASUREMENT /end GROUP
/begin GROUP S260_LimitWhenCloseToMarker "LKAS_subsystem_integrated/LKAS_subsystem_integrated/InputFusion/TrajectoryCalculation/PathGeneration/PathGeneration_sLKA/BoundaryValues_sLKA/LimitWhenCloseToMarker" /begin REF_CHARACTERISTIC KfLKAS_d_MinDeltaPosFirst KfLKAS_d_MinDeltaPosSec /end REF_CHARACTERISTIC /begin REF_MEASUREMENT VbLKAS_zero_trajectory_found VfLKAS_delta_pos_sLKA /end REF_MEASUREMENT /end GROUP
/begin GROUP S261_DetermineSingleSidedTrajectoryWithModTraj "LKAS_subsystem_integrated/LKAS_subsystem_integrated/InputFusion/TrajectoryCalculation/PathGeneration/PathGeneration_sLKA/ITCWithAdditionalConditionForValidPath_sLKA/DetermineSingleSidedTrajectoryWithModTraj" /begin SUB_GROUP S270_CalculateAm S270_CalculateDt S270_CalculateTrajectory /end SUB_GROUP /end GROUP
/begin GROUP S367_SR_FF_INIT_1 "LKAS_subsystem_integrated/LKAS_subsystem_integrated/InputFusion/TrajectoryCalculation/RoadEnableEvaluation/RoadEnableEvaluationSLKA/LaneWidthEnable/SR_FF_INIT_1" /begin REF_MEASUREMENT VbLKAS_LaneWidthEnbl /end REF_MEASUREMENT /end GROUP
/begin GROUP S188_CheckForStep "LKAS_subsystem_integrated/LKAS_subsystem_integrated/InputFusion/LaneMarkerHandler/SeneorFusion/LaneMarkerHandler/LeftLaneMarker/LeftCurvStepDetection/CheckForStep" /begin REF_MEASUREMENT VbLKAS_LeftCurvStep /end REF_MEASUREMENT /end GROUP
/begin GROUP S189_CheckForStep "LKAS_subsystem_integrated/LKAS_subsystem_integrated/InputFusion/LaneMarkerHandler/SeneorFusion/LaneMarkerHandler/LeftLaneMarker/LeftOffstStepDetection/CheckForStep" /begin REF_MEASUREMENT VbLKAS_LeftOffstStep /end REF_MEASUREMENT /end GROUP
/begin GROUP S190_CheckForStep "LKAS_subsystem_integrated/LKAS_subsystem_integrated/InputFusion/LaneMarkerHandler/SeneorFusion/LaneMarkerHandler/LeftLaneMarker/LeftVLatStepDetection/CheckForStep" /begin REF_MEASUREMENT VbLKAS_LeftVLatStep /end REF_MEASUREMENT /end GROUP
/begin GROUP S204_CheckForStep "LKAS_subsystem_integrated/LKAS_subsystem_integrated/InputFusion/LaneMarkerHandler/SeneorFusion/LaneMarkerHandler/RightLaneMarker/LeftVLatStepDetection/CheckForStep" /begin REF_MEASUREMENT VbLKAS_RightVlatStep /end REF_MEASUREMENT /end GROUP
/begin GROUP S213_CheckForStep "LKAS_subsystem_integrated/LKAS_subsystem_integrated/InputFusion/LaneMarkerHandler/SeneorFusion/LaneMarkerHandler/RightLaneMarker/RightCurvStepDetection/CheckForStep" /begin REF_MEASUREMENT VbLKAS_RightCurvStep /end REF_MEASUREMENT /end GROUP
/begin GROUP S214_CheckForStep "LKAS_subsystem_integrated/LKAS_subsystem_integrated/InputFusion/LaneMarkerHandler/SeneorFusion/LaneMarkerHandler/RightLaneMarker/RightOffstStepDetection/CheckForStep" /begin REF_MEASUREMENT VbLKAS_RightOffstStep /end REF_MEASUREMENT /end GROUP
/begin GROUP S270_CalculateAm "LKAS_subsystem_integrated/LKAS_subsystem_integrated/InputFusion/TrajectoryCalculation/PathGeneration/PathGeneration_sLKA/ITCWithAdditionalConditionForValidPath_sLKA/DetermineSingleSidedTrajectoryWithModTraj/CalculateAm" /begin SUB_GROUP S275_get_roots /end SUB_GROUP /end GROUP
/begin GROUP S270_CalculateDt "LKAS_subsystem_integrated/LKAS_subsystem_integrated/InputFusion/TrajectoryCalculation/PathGeneration/PathGeneration_sLKA/ITCWithAdditionalConditionForValidPath_sLKA/DetermineSingleSidedTrajectoryWithModTraj/CalculateDt" /begin REF_MEASUREMENT VfLKAS_dt1 VfLKAS_dt2 /end REF_MEASUREMENT /end GROUP
/begin GROUP S270_CalculateTrajectory "LKAS_subsystem_integrated/LKAS_subsystem_integrated/InputFusion/TrajectoryCalculation/PathGeneration/PathGeneration_sLKA/ITCWithAdditionalConditionForValidPath_sLKA/DetermineSingleSidedTrajectoryWithModTraj/CalculateTrajectory" /begin SUB_GROUP S277_IfSolutionFoundForAm /end SUB_GROUP
 /begin REF_MEASUREMENT VbLKAS_TrajectoryFound_sLKA VfLKAS_JerkNeeded_sLkA VfLKAS_LatAccNeeded_sLKA /end REF_MEASUREMENT
/end GROUP
/begin GROUP S275_get_roots "LKAS_subsystem_integrated/LKAS_subsystem_integrated/InputFusion/TrajectoryCalculation/PathGeneration/PathGeneration_sLKA/ITCWithAdditionalConditionForValidPath_sLKA/DetermineSingleSidedTrajectoryWithModTraj/CalculateAm/get_roots" /begin SUB_GROUP S280_QuadraticEquationSolver /end SUB_GROUP /end GROUP
/begin GROUP S277_IfSolutionFoundForAm "LKAS_subsystem_integrated/LKAS_subsystem_integrated/InputFusion/TrajectoryCalculation/PathGeneration/PathGeneration_sLKA/ITCWithAdditionalConditionForValidPath_sLKA/DetermineSingleSidedTrajectoryWithModTraj/CalculateTrajectory/IfSolutionFoundForAm"
 /begin SUB_GROUP S305_CalculateTrajectoryForFirstAmRoot S305_CalculateTrajectoryForSecondAmRoot /end SUB_GROUP
/end GROUP
/begin GROUP S280_QuadraticEquationSolver "LKAS_subsystem_integrated/LKAS_subsystem_integrated/InputFusion/TrajectoryCalculation/PathGeneration/PathGeneration_sLKA/ITCWithAdditionalConditionForValidPath_sLKA/DetermineSingleSidedTrajectoryWithModTraj/CalculateAm/get_roots/QuadraticEquationSolver" /begin REF_MEASUREMENT VbLKAS_SolutionFoundForAm VfLKAS_Am1 VfLKAS_Am2 /end REF_MEASUREMENT /end GROUP
/begin GROUP S305_CalculateTrajectoryForFirstAmRoot "LKAS_subsystem_integrated/LKAS_subsystem_integrated/InputFusion/TrajectoryCalculation/PathGeneration/PathGeneration_sLKA/ITCWithAdditionalConditionForValidPath_sLKA/DetermineSingleSidedTrajectoryWithModTraj/CalculateTrajectory/IfSolutionFoundForAm/CalculateTrajectoryForFirstAmRoot" /begin SUB_GROUP S307_calc_end_pos S307_calc_end_vlat /end SUB_GROUP
 /begin REF_MEASUREMENT VbLKAS_FirstEndPositionOK VbLKAS_FirstEndVLatOK VbLKAS_TrajectoryFoundAm1 /end REF_MEASUREMENT
/end GROUP
/begin GROUP S305_CalculateTrajectoryForSecondAmRoot "LKAS_subsystem_integrated/LKAS_subsystem_integrated/InputFusion/TrajectoryCalculation/PathGeneration/PathGeneration_sLKA/ITCWithAdditionalConditionForValidPath_sLKA/DetermineSingleSidedTrajectoryWithModTraj/CalculateTrajectory/IfSolutionFoundForAm/CalculateTrajectoryForSecondAmRoot" /begin SUB_GROUP S308_calc_end_pos S308_calc_end_vlat /end SUB_GROUP
 /begin REF_MEASUREMENT VbLKAS_SecEndPositionOK VbLKAS_SecEndVLatOK VbLKAS_TrajectoryFoundAm2 /end REF_MEASUREMENT
/end GROUP
/begin GROUP S307_calc_end_pos "LKAS_subsystem_integrated/LKAS_subsystem_integrated/InputFusion/TrajectoryCalculation/PathGeneration/PathGeneration_sLKA/ITCWithAdditionalConditionForValidPath_sLKA/DetermineSingleSidedTrajectoryWithModTraj/CalculateTrajectory/IfSolutionFoundForAm/CalculateTrajectoryForFirstAmRoot/calc_end_pos" /begin REF_MEASUREMENT VfLKAS_FirstEndPos /end REF_MEASUREMENT /end GROUP
/begin GROUP S307_calc_end_vlat "LKAS_subsystem_integrated/LKAS_subsystem_integrated/InputFusion/TrajectoryCalculation/PathGeneration/PathGeneration_sLKA/ITCWithAdditionalConditionForValidPath_sLKA/DetermineSingleSidedTrajectoryWithModTraj/CalculateTrajectory/IfSolutionFoundForAm/CalculateTrajectoryForFirstAmRoot/calc_end_vlat" /begin REF_MEASUREMENT VfLKAS_FirstEndVlat /end REF_MEASUREMENT /end GROUP
/begin GROUP S308_calc_end_pos "LKAS_subsystem_integrated/LKAS_subsystem_integrated/InputFusion/TrajectoryCalculation/PathGeneration/PathGeneration_sLKA/ITCWithAdditionalConditionForValidPath_sLKA/DetermineSingleSidedTrajectoryWithModTraj/CalculateTrajectory/IfSolutionFoundForAm/CalculateTrajectoryForSecondAmRoot/calc_end_pos" /begin REF_MEASUREMENT VfLKAS_SecEndPos /end REF_MEASUREMENT /end GROUP
/begin GROUP S308_calc_end_vlat "LKAS_subsystem_integrated/LKAS_subsystem_integrated/InputFusion/TrajectoryCalculation/PathGeneration/PathGeneration_sLKA/ITCWithAdditionalConditionForValidPath_sLKA/DetermineSingleSidedTrajectoryWithModTraj/CalculateTrajectory/IfSolutionFoundForAm/CalculateTrajectoryForSecondAmRoot/calc_end_vlat" /begin REF_MEASUREMENT VfLKAS_SecEndVlat /end REF_MEASUREMENT /end GROUP
/begin GROUP DRIV_subsystem_integrated "DRIV_subsystem_integrated" ROOT /begin SUB_GROUP Root_DRIV_ /end SUB_GROUP /end GROUP
/begin GROUP Root_DRIV_ "DRIV_subsystem_integrated/DRIV "
 /begin SUB_GROUP S1_CheckDRIV_SignalInput S1_CheckDRIV_SignalOutput S1_DtrmnDRIV_RunStatus /end SUB_GROUP
/end GROUP
/begin GROUP S1_CheckDRIV_SignalInput "DRIV_subsystem_integrated/DRIV /CheckDRIV_SignalInput"
 /begin SUB_GROUP S3_Fault_Detection S3_Subsystem S3_Subsystem1 S3_adc_path_prediction /end SUB_GROUP
 /begin REF_MEASUREMENT VfDRIV_steer_angle /end REF_MEASUREMENT
/end GROUP
/begin GROUP S1_CheckDRIV_SignalOutput "DRIV_subsystem_integrated/DRIV /CheckDRIV_SignalOutput" /begin REF_CHARACTERISTIC KbDRIV_DRIVEnable /end REF_CHARACTERISTIC /end GROUP
/begin GROUP S1_DtrmnDRIV_RunStatus "DRIV_subsystem_integrated/DRIV /DtrmnDRIV_RunStatus" /begin SUB_GROUP S5_DtrmnDRIV_OvrdButtonStatus S5_DtrmnDRIV_OvrdSteerStatus /end SUB_GROUP /begin REF_CHARACTERISTIC KbDRIV_Default_EnableAutoDrive /end REF_CHARACTERISTIC /end GROUP
/begin GROUP S3_Fault_Detection "DRIV_subsystem_integrated/DRIV /CheckDRIV_SignalInput/Fault Detection"
 /begin REF_CHARACTERISTIC KfDRIV_t_TimeEGMOReceivedThrsh KfDRIV_t_TimeMPFUReceivedThrsh KfDRIV_t_TimeOBFUNReceivedThrsh /end REF_CHARACTERISTIC
/end GROUP
/begin GROUP S3_Subsystem "DRIV_subsystem_integrated/DRIV /CheckDRIV_SignalInput/Subsystem" /begin REF_CHARACTERISTIC kfDRIV_k_FilterGain /end REF_CHARACTERISTIC /begin REF_MEASUREMENT VfDRIV_Steer_Torque_Filter /end REF_MEASUREMENT /end GROUP
/begin GROUP S3_Subsystem1 "DRIV_subsystem_integrated/DRIV /CheckDRIV_SignalInput/Subsystem1" /begin REF_CHARACTERISTIC kfDRIV_t_PeriodFunctionCall /end REF_CHARACTERISTIC /begin REF_MEASUREMENT VfDRIV_SteerAngleRate /end REF_MEASUREMENT /end GROUP
/begin GROUP S3_adc_path_prediction "DRIV_subsystem_integrated/DRIV /CheckDRIV_SignalInput/adc_path_prediction"
 /begin REF_CHARACTERISTIC KfDRIV_CoeffStrwhl2Radius KfDRIV_Veh_Strwhl2FrtwhlRatio KfDRIV_Veh_WheelBase /end REF_CHARACTERISTIC
/end GROUP
/begin GROUP S5_DtrmnDRIV_OvrdButtonStatus "DRIV_subsystem_integrated/DRIV /DtrmnDRIV_RunStatus/DtrmnDRIV_OvrdButtonStatus" /begin REF_CHARACTERISTIC kfDRIV_DelayLoopGain kfDRIV_t_PeriodFunctionCall /end REF_CHARACTERISTIC /end GROUP
/begin GROUP S5_DtrmnDRIV_OvrdSteerStatus "DRIV_subsystem_integrated/DRIV /DtrmnDRIV_RunStatus/DtrmnDRIV_OvrdSteerStatus"
 /begin SUB_GROUP S29_DtrmnDRIV_LaneChange_Judge S29_DtrmnDRIV_OverrideSteering /end SUB_GROUP
/end GROUP
/begin GROUP S29_DtrmnDRIV_LaneChange_Judge "DRIV_subsystem_integrated/DRIV /DtrmnDRIV_RunStatus/DtrmnDRIV_OvrdSteerStatus/DtrmnDRIV_LaneChange_Judge" /begin SUB_GROUP S37_DRIV_Enable S37_DRIV_OverrideSteerDefaultData /end SUB_GROUP /begin REF_CHARACTERISTIC KfDRIV_d_TouchedNewLaneDist KfDRIV_w_LaneWidthMax /end REF_CHARACTERISTIC /end GROUP
/begin GROUP S29_DtrmnDRIV_OverrideSteering "DRIV_subsystem_integrated/DRIV /DtrmnDRIV_RunStatus/DtrmnDRIV_OvrdSteerStatus/DtrmnDRIV_OverrideSteering"
 /begin SUB_GROUP S38_driver_Normal_driving S38_driver_distracted S38_driver_take_over /end SUB_GROUP
 /begin REF_MEASUREMENT VbDIRV_Override_Steering /end REF_MEASUREMENT
/end GROUP
/begin GROUP S37_DRIV_Enable "DRIV_subsystem_integrated/DRIV /DtrmnDRIV_RunStatus/DtrmnDRIV_OvrdSteerStatus/DtrmnDRIV_LaneChange_Judge/DRIV_Enable"
 /begin SUB_GROUP S39_CheckLCLogiCondition S39_CheckLCProcess S39_DtrmnDRIV_OverrideSteerStatus /end SUB_GROUP
/end GROUP
/begin GROUP S37_DRIV_OverrideSteerDefaultData "DRIV_subsystem_integrated/DRIV /DtrmnDRIV_RunStatus/DtrmnDRIV_OvrdSteerStatus/DtrmnDRIV_LaneChange_Judge/DRIV_OverrideSteerDefaultData"
 /begin REF_CHARACTERISTIC KbDRIV_Default_LaneKeepAssist KbDRIV_Default_Override_Steering /end REF_CHARACTERISTIC
/end GROUP
/begin GROUP S38_driver_Normal_driving "DRIV_subsystem_integrated/DRIV /DtrmnDRIV_RunStatus/DtrmnDRIV_OvrdSteerStatus/DtrmnDRIV_OverrideSteering/driver_Normal_driving"
 /begin REF_CHARACTERISTIC kfDRIV_M_TorqueOverrideThreshold kfDRIV_TorqueRateThreshold kfDRIV_t_PeriodFunctionCall /end REF_CHARACTERISTIC
 /begin REF_MEASUREMENT VbDRIV_Norm_driving VfDRIV_Steer_Torque_Rate /end REF_MEASUREMENT
/end GROUP
/begin GROUP S38_driver_distracted "DRIV_subsystem_integrated/DRIV /DtrmnDRIV_RunStatus/DtrmnDRIV_OvrdSteerStatus/DtrmnDRIV_OverrideSteering/driver_distracted"
 /begin REF_CHARACTERISTIC KfDRIV_t_WaitTimeDriverDistracted kfDRIV_M_TorqueOverrideThreshold_Auto kfDRIV_M_TorqueThreshold_Distracted /end REF_CHARACTERISTIC
 /begin REF_MEASUREMENT VbDRIV_Driver_Distracted /end REF_MEASUREMENT
/end GROUP
/begin GROUP S38_driver_take_over "DRIV_subsystem_integrated/DRIV /DtrmnDRIV_RunStatus/DtrmnDRIV_OvrdSteerStatus/DtrmnDRIV_OverrideSteering/driver_take_over"
 /begin REF_CHARACTERISTIC kfDRIV_M_TorqueOverrideThreshold_ACC kfDRIV_M_TorqueOverrideThreshold_LCC /end REF_CHARACTERISTIC
 /begin REF_MEASUREMENT VbDRIV_Driver_Take_Over /end REF_MEASUREMENT
/end GROUP
/begin GROUP S39_CheckLCLogiCondition "DRIV_subsystem_integrated/DRIV /DtrmnDRIV_RunStatus/DtrmnDRIV_OvrdSteerStatus/DtrmnDRIV_LaneChange_Judge/DRIV_Enable/CheckLCLogiCondition" /begin SUB_GROUP S41_CheckTurntype S41_lc_side_estimate /end SUB_GROUP /begin REF_MEASUREMENT VbDRIV_LC_Enable VfDRIV_yawrate /end REF_MEASUREMENT /end GROUP
/begin GROUP S39_CheckLCProcess "DRIV_subsystem_integrated/DRIV /DtrmnDRIV_RunStatus/DtrmnDRIV_OvrdSteerStatus/DtrmnDRIV_LaneChange_Judge/DRIV_Enable/CheckLCProcess"
 /begin SUB_GROUP S42_CheckLCFinish S42_CheckLCIng S42_CheckLCReady S42_Subsystem /end SUB_GROUP
 /begin REF_MEASUREMENT VbDRIV_Touched_new_lane VfDRIV_c1_heading /end REF_MEASUREMENT
/end GROUP
/begin GROUP S39_DtrmnDRIV_OverrideSteerStatus "DRIV_subsystem_integrated/DRIV /DtrmnDRIV_RunStatus/DtrmnDRIV_OvrdSteerStatus/DtrmnDRIV_LaneChange_Judge/DRIV_Enable/DtrmnDRIV_OverrideSteerStatus" /begin SUB_GROUP S43_DRIV_Out /end SUB_GROUP
 /begin REF_MEASUREMENT VbDRIV_LaneKeepAssist VeDRIV_LeftChangeLane VeDRIV_RightChangeLane /end REF_MEASUREMENT
/end GROUP
/begin GROUP S41_CheckTurntype "DRIV_subsystem_integrated/DRIV /DtrmnDRIV_RunStatus/DtrmnDRIV_OvrdSteerStatus/DtrmnDRIV_LaneChange_Judge/DRIV_Enable/CheckLCLogiCondition/CheckTurntype" /begin REF_MEASUREMENT VbDRIV_TurnType /end REF_MEASUREMENT /end GROUP
/begin GROUP S41_lc_side_estimate "DRIV_subsystem_integrated/DRIV /DtrmnDRIV_RunStatus/DtrmnDRIV_OvrdSteerStatus/DtrmnDRIV_LaneChange_Judge/DRIV_Enable/CheckLCLogiCondition/lc_side_estimate"
 /begin REF_CHARACTERISTIC kfDRIV_SteerAngleThreshold kfDRIV_t_TurnLightLeftOn_Time kfDRIV_t_TurnLightRightOn_Time /end REF_CHARACTERISTIC
 /begin REF_MEASUREMENT VbDRIV_LeftSide_LC_Req VbDRIV_RightSide_LC_Req /end REF_MEASUREMENT
/end GROUP
/begin GROUP S42_CheckLCFinish "DRIV_subsystem_integrated/DRIV /DtrmnDRIV_RunStatus/DtrmnDRIV_OvrdSteerStatus/DtrmnDRIV_LaneChange_Judge/DRIV_Enable/CheckLCProcess/CheckLCFinish"
 /begin REF_CHARACTERISTIC KfDRIV_d_Dist2LaneChangeFinish KfDRIV_t_WaitTimeLaneChangeFinish /end REF_CHARACTERISTIC
/end GROUP
/begin GROUP S42_CheckLCIng "DRIV_subsystem_integrated/DRIV /DtrmnDRIV_RunStatus/DtrmnDRIV_OvrdSteerStatus/DtrmnDRIV_LaneChange_Judge/DRIV_Enable/CheckLCProcess/CheckLCIng" /begin REF_CHARACTERISTIC kfDRIV_YawRateThreshold2 kfDRIV_c1_threshold /end REF_CHARACTERISTIC /end GROUP
/begin GROUP S42_CheckLCReady "DRIV_subsystem_integrated/DRIV /DtrmnDRIV_RunStatus/DtrmnDRIV_OvrdSteerStatus/DtrmnDRIV_LaneChange_Judge/DRIV_Enable/CheckLCProcess/CheckLCReady"
 /begin REF_CHARACTERISTIC kfDRIV_SteerAngleRateThreshold kfDRIV_TorqueRate_LC_Threshold kfDRIV_YawRateThreshold kfDRIV_t_PeriodFunctionCall kfDRIV_t_TurnLightOn_Time /end REF_CHARACTERISTIC
/end GROUP
/begin GROUP S42_Subsystem "DRIV_subsystem_integrated/DRIV /DtrmnDRIV_RunStatus/DtrmnDRIV_OvrdSteerStatus/DtrmnDRIV_LaneChange_Judge/DRIV_Enable/CheckLCProcess/Subsystem"
 /begin REF_MEASUREMENT VbDRIV_LaneChangeFinish_Req VbDRIV_LaneChangeReady_Req VbDRIV_LaneChanging_Req /end REF_MEASUREMENT
/end GROUP
/begin GROUP S43_DRIV_Out "DRIV_subsystem_integrated/DRIV /DtrmnDRIV_RunStatus/DtrmnDRIV_OvrdSteerStatus/DtrmnDRIV_LaneChange_Judge/DRIV_Enable/DtrmnDRIV_OverrideSteerStatus/DRIV_Out" /begin REF_CHARACTERISTIC KbDRIV_Update_Override_Steering /end REF_CHARACTERISTIC /begin REF_MEASUREMENT VbDRIV_Update_Override_Steering /end REF_MEASUREMENT /end GROUP
/begin GROUP bsw_critical_variable "bsw_critical_variable" ROOT /begin SUB_GROUP BSW_Thruput_Measure /end SUB_GROUP /end GROUP
/begin GROUP BSW_Thruput_Measure "BSW_Thruput_Measure" /begin REF_MEASUREMENT ADCtrl_Thruput_MS os_core0_tick_cnt /end REF_MEASUREMENT /end GROUP
/begin GROUP UDP_COMM_Err_Info "UDP_COMM_Err_Info"
 /begin REF_MEASUREMENT Com_stRxUDPFrm17001 diag_communication_error_codes diag_sensor_error_codes diag_module_error_codes /end REF_MEASUREMENT
/end GROUP
/end MODULE
/end PROJECT
