ASAP2_VERSION 1 60
/begin PROJECT hj_adcu "_default_ProjectLongIdentifier"
/begin HEADER "_default_HeaderComment" PROJECT_NO _default_ProjectNr /end HEADER
/begin MODULE _default_ModuleName "_default_ModuleLongIdentifier"
/begin MOD_COMMON "_default_ModCommonComment" DEPOSIT ABSOLUTE BYTE_ORDER MSB_LAST ALIGNMENT_BYTE 1 ALIGNMENT_WORD 2 ALIGNMENT_LONG 4 ALIGNMENT_FLOAT32_IEEE 4 ALIGNMENT_FLOAT64_IEEE 4 /end MOD_COMMON
/begin MOD_COMMON "Mod Common Comment Here" BYTE_ORDER MSB_LAST /end MOD_COMMON
/begin RECORD_LAYOUT Scalar_BOOLEAN FNC_VALUES 1 UBYTE COLUMN_DIR DIRECT /end RECORD_LAYOUT
/begin RECORD_LAYOUT Scalar_UBYTE FNC_VALUES 1 UBYTE COLUMN_DIR DIRECT /end RECORD_LAYOUT
/begin RECORD_LAYOUT Scalar_BYTE FNC_VALUES 1 SBYTE COLUMN_DIR DIRECT /end RECORD_LAYOUT
/begin RECORD_LAYOUT Scalar_UWORD FNC_VALUES 1 UWORD COLUMN_DIR DIRECT /end RECORD_LAYOUT
/begin RECORD_LAYOUT Scalar_LONG FNC_VALUES 1 SLONG COLUMN_DIR DIRECT /end RECORD_LAYOUT
/begin RECORD_LAYOUT Scalar_FLOAT32_IEEE FNC_VALUES 1 FLOAT32_IEEE COLUMN_DIR DIRECT /end RECORD_LAYOUT
/begin RECORD_LAYOUT Lookup1D_FLOAT32_IEEE FNC_VALUES 1 FLOAT32_IEEE COLUMN_DIR DIRECT /end RECORD_LAYOUT
/begin RECORD_LAYOUT Lookup1D_X_FLOAT32_IEEE AXIS_PTS_X 1 FLOAT32_IEEE INDEX_INCR DIRECT /end RECORD_LAYOUT
/begin RECORD_LAYOUT Lookup2D_X_BOOLEAN AXIS_PTS_X 1 UBYTE INDEX_INCR DIRECT /end RECORD_LAYOUT
/begin RECORD_LAYOUT Lookup2D_UBYTE FNC_VALUES 1 UBYTE COLUMN_DIR DIRECT /end RECORD_LAYOUT
/begin RECORD_LAYOUT Lookup2D_X_UBYTE AXIS_PTS_X 1 UBYTE INDEX_INCR DIRECT /end RECORD_LAYOUT
/begin RECORD_LAYOUT Lookup2D_BYTE FNC_VALUES 1 SBYTE COLUMN_DIR DIRECT /end RECORD_LAYOUT
/begin RECORD_LAYOUT Lookup2D_X_BYTE AXIS_PTS_X 1 SBYTE INDEX_INCR DIRECT /end RECORD_LAYOUT
/begin RECORD_LAYOUT Lookup2D_UWORD FNC_VALUES 1 UWORD COLUMN_DIR DIRECT /end RECORD_LAYOUT
/begin RECORD_LAYOUT Lookup2D_X_UWORD AXIS_PTS_X 1 UWORD INDEX_INCR DIRECT /end RECORD_LAYOUT
/begin RECORD_LAYOUT Lookup2D_WORD FNC_VALUES 1 SWORD COLUMN_DIR DIRECT /end RECORD_LAYOUT
/begin RECORD_LAYOUT Lookup2D_X_WORD AXIS_PTS_X 1 SWORD INDEX_INCR DIRECT /end RECORD_LAYOUT
/begin RECORD_LAYOUT Lookup2D_ULONG FNC_VALUES 1 ULONG COLUMN_DIR DIRECT /end RECORD_LAYOUT
/begin RECORD_LAYOUT Lookup2D_X_ULONG AXIS_PTS_X 1 ULONG INDEX_INCR DIRECT /end RECORD_LAYOUT
/begin RECORD_LAYOUT Lookup2D_LONG FNC_VALUES 1 SLONG COLUMN_DIR DIRECT /end RECORD_LAYOUT
/begin RECORD_LAYOUT Lookup2D_X_LONG AXIS_PTS_X 1 SLONG INDEX_INCR DIRECT /end RECORD_LAYOUT
/begin RECORD_LAYOUT Lookup2D_FLOAT32_IEEE FNC_VALUES 1 FLOAT32_IEEE COLUMN_DIR DIRECT /end RECORD_LAYOUT
/begin RECORD_LAYOUT Lookup2D_X_FLOAT32_IEEE AXIS_PTS_X 1 FLOAT32_IEEE INDEX_INCR DIRECT /end RECORD_LAYOUT
/begin RECORD_LAYOUT Lookup2D_FLOAT64_IEEE FNC_VALUES 1 FLOAT64_IEEE COLUMN_DIR DIRECT /end RECORD_LAYOUT
/begin RECORD_LAYOUT Lookup2D_X_FLOAT64_IEEE AXIS_PTS_X 1 FLOAT64_IEEE INDEX_INCR DIRECT /end RECORD_LAYOUT
/begin CHARACTERISTIC KtACCS_t_CalOpenAccelForStopFrmDCSN "Want how long to stop the vehicle" CURVE 0x70100028 /* @ECU_Address@KtACCS_t_CalOpenAccelForStopFrmDCSN@ */ Lookup1D_FLOAT32_IEEE 0 ACCS_subsystem_integrated_CM_single_s 0.0 1200.0
 /begin AXIS_DESCR COM_AXIS NO_INPUT_QUANTITY ACCS_subsystem_integrated_CM_single_m 6 0.0 200.0 AXIS_PTS_REF KtACCS_AXIS_OpenAccelStop_StopDis /end AXIS_DESCR
/end CHARACTERISTIC
/begin CHARACTERISTIC KtACCS_a_OpenAccel_SpeedCtrl "This is open acceleration table under speed control mode,it is the function of speed error" CURVE 0x701009ac /* @ECU_Address@KtACCS_a_OpenAccel_SpeedCtrl@ */ Lookup1D_FLOAT32_IEEE 0 ACCS_subsystem_integrated_CM_single_m_s2 -4.0 4.0
 /begin AXIS_DESCR COM_AXIS NO_INPUT_QUANTITY ACCS_subsystem_integrated_CM_single_m_s 7 -30.0 30.0 AXIS_PTS_REF KtACCS_AXIS_OpenAccelSpedCtrl_SpedErr /end AXIS_DESCR
/end CHARACTERISTIC
/begin CHARACTERISTIC KtACCS_a_OpenAccel_LowSpeedCtrl "his is open acceleration table under low speed control mode,it is the function of speed error" CURVE 0x701009c8 /* @ECU_Address@KtACCS_a_OpenAccel_LowSpeedCtrl@ */ Lookup1D_FLOAT32_IEEE 0 ACCS_subsystem_integrated_CM_single_m_s2 -4.0 4.0
 /begin AXIS_DESCR COM_AXIS NO_INPUT_QUANTITY ACCS_subsystem_integrated_CM_single_m_s 7 -45.0 45.0 AXIS_PTS_REF KtACCS_AXIS_OpenAccelLowSpedCtrl_SpedErr /end AXIS_DESCR
/end CHARACTERISTIC
/begin CHARACTERISTIC KtACCS_a_OpenAccel_Launch "This is open acceleration table under launch control mode,it is the function of Ego current speed" CURVE 0x701009e4 /* @ECU_Address@KtACCS_a_OpenAccel_Launch@ */ Lookup1D_FLOAT32_IEEE 0 ACCS_subsystem_integrated_CM_single_m_s2 -4.0 4.0
 /begin AXIS_DESCR COM_AXIS NO_INPUT_QUANTITY ACCS_subsystem_integrated_CM_single_m_s 6 0.0 50.0 AXIS_PTS_REF KtACCS_AXIS_OpenAccelLaunch_CurSpd /end AXIS_DESCR
/end CHARACTERISTIC
/begin CHARACTERISTIC KtACCS_a_StopStatus_Accel "When KbACCS_UseStopStatus_Accel=true, accel will be form this cal during status is Stop.This cal is the function of pitch" CURVE 0x70100984 /* @ECU_Address@KtACCS_a_StopStatus_Accel@ */ Lookup1D_FLOAT32_IEEE 0 ACCS_subsystem_integrated_CM_single_m_s2 -4.0 0.0
 /begin AXIS_DESCR COM_AXIS NO_INPUT_QUANTITY ACCS_subsystem_integrated_CM_single_deg 10 0.0 90.0 AXIS_PTS_REF KtACCS_AXIS_StopStatus_Accel_Pitch /end AXIS_DESCR
/end CHARACTERISTIC
/begin CHARACTERISTIC KfDCSN_M_adm_temp_steering_ovrd_torque "The torque for driver to override." VALUE 0x70101a0c /* @ECU_Address@KfDCSN_M_adm_temp_steering_ovrd_torque@ */ Scalar_FLOAT32_IEEE 0 DCSN_subsystem_integrated_CM_single_nm -3.4E+38 3.4E+38 /end CHARACTERISTIC
/begin CHARACTERISTIC KfDCSN_M_adm_temp_steering_resume_torque "The torque for driver to override." VALUE 0x70101a08 /* @ECU_Address@KfDCSN_M_adm_temp_steering_resume_torque@ */ Scalar_FLOAT32_IEEE 0 DCSN_subsystem_integrated_CM_single_nm -3.4E+38 3.4E+38 /end CHARACTERISTIC
/begin CHARACTERISTIC KfDCSN_d_Thrsh_request_stop "The maximal distance between vehicle and stop line before sending stop request." VALUE 0x70101a04 /* @ECU_Address@KfDCSN_d_Thrsh_request_stop@ */ Scalar_FLOAT32_IEEE 0 DCSN_subsystem_integrated_CM_single_m 0.0 1000.0 /end CHARACTERISTIC
/begin CHARACTERISTIC KfDCSN_d_rearaxle_frontbump "The distance between rear axle and front bumper" VALUE 0x70101a00 /* @ECU_Address@KfDCSN_d_rearaxle_frontbump@ */ Scalar_FLOAT32_IEEE 0 DCSN_subsystem_integrated_CM_single_m 0.0 100.0 /end CHARACTERISTIC
/begin CHARACTERISTIC KfDCSN_d_stop_cleared_Thrsh "The extra distance vehicle has to move before receiving new stop request" VALUE 0x701019fc /* @ECU_Address@KfDCSN_d_stop_cleared_Thrsh@ */ Scalar_FLOAT32_IEEE 0 DCSN_subsystem_integrated_CM_single_m 0.0 100.0 /end CHARACTERISTIC
/begin CHARACTERISTIC KfDCSN_d_stop_close_Thrsh "The threshold whether stop distance is calculated by vehicle speed." VALUE 0x701019f8 /* @ECU_Address@KfDCSN_d_stop_close_Thrsh@ */ Scalar_FLOAT32_IEEE 0 DCSN_subsystem_integrated_CM_single_m 0.0 100.0 /end CHARACTERISTIC
/begin CHARACTERISTIC KfDCSN_d_stop_distance_buffer "The buffer between vehicle and stop destination" VALUE 0x701019f4 /* @ECU_Address@KfDCSN_d_stop_distance_buffer@ */ Scalar_FLOAT32_IEEE 0 DCSN_subsystem_integrated_CM_single_m 0.0 100.0 /end CHARACTERISTIC
/begin CHARACTERISTIC KfDCSN_d_stop_finished_dis "When ACC finished stop request, the maximal distance between stop point and ego vehicle.
      If the stop distance is larger than the value, the stop request will not be cleared." VALUE 0x701019f0 /* @ECU_Address@KfDCSN_d_stop_finished_dis@ */ Scalar_FLOAT32_IEEE 0 DCSN_subsystem_integrated_CM_single_m 0.0 100.0 /end CHARACTERISTIC
/begin CHARACTERISTIC KfDCSN_d_stop_s_distance_man_value "manual stop control distance, valid only when KbDCSN_stop_man_enbl = true" VALUE 0x701019ec /* @ECU_Address@KfDCSN_d_stop_s_distance_man_value@ */ Scalar_FLOAT32_IEEE 0 DCSN_subsystem_integrated_CM_single_m -3.4E+38 3.4E+38 /end CHARACTERISTIC
/begin CHARACTERISTIC KfDCSN_d_stop_unsuccess_Thrsh "The maximal distance from vehicle to stop line if vehicle had passed the stop line. This will regard current stop action as an unsuccessful stop." VALUE 0x701019e8 /* @ECU_Address@KfDCSN_d_stop_unsuccess_Thrsh@ */ Scalar_FLOAT32_IEEE 0 DCSN_subsystem_integrated_CM_single_m 0.0 100.0 /end CHARACTERISTIC
/begin CHARACTERISTIC KfDCSN_t_autodrive_control_mode_delay "the time that the system keeps sending activating request" VALUE 0x701019d8 /* @ECU_Address@KfDCSN_t_autodrive_control_mode_delay@ */ Scalar_FLOAT32_IEEE 0 DCSN_subsystem_integrated_CM_single_s -3.4E+38 3.4E+38 /end CHARACTERISTIC
/begin CHARACTERISTIC KfDCSN_t_sample_time "DCSN calculation sample time" VALUE 0x701019c0 /* @ECU_Address@KfDCSN_t_sample_time@ */ Scalar_FLOAT32_IEEE 0 DCSN_subsystem_integrated_CM_single_s -3.4E+38 3.4E+38 /end CHARACTERISTIC
/begin CHARACTERISTIC KfDCSN_t_stop_req_hold "When stop is finished, the stop request will be held for seconds. " VALUE 0x701019bc /* @ECU_Address@KfDCSN_t_stop_req_hold@ */ Scalar_FLOAT32_IEEE 0 DCSN_subsystem_integrated_CM_single_s -3.4E+38 3.4E+38 /end CHARACTERISTIC
/begin CHARACTERISTIC KfDCSN_t_usr_change_lane_delay "The time delay between usr command and actual change lane action" VALUE 0x701019b8 /* @ECU_Address@KfDCSN_t_usr_change_lane_delay@ */ Scalar_FLOAT32_IEEE 0 DCSN_subsystem_integrated_CM_single_s -3.4E+38 3.4E+38 /end CHARACTERISTIC
/begin CHARACTERISTIC KbDCSN_adm_BrkPressDeactivateEnabled "0 = cannot activate when BrkPed is pressed
      1 = can activate when BrkPed is pressed" VALUE 0x70101986 /* @ECU_Address@KbDCSN_adm_BrkPressDeactivateEnabled@ */ Scalar_BOOLEAN 0 DCSN_subsystem_integrated_CM_boolean 0 1 /end CHARACTERISTIC
/begin CHARACTERISTIC KtLCCS_k_LanemarkMergeCoef "Lane marker merging filter coef." CURVE 0x70101c14 /* @ECU_Address@KtLCCS_k_LanemarkMergeCoef@ */ Lookup1D_FLOAT32_IEEE 0 LCCS_subsystem_integrated_CM_single 0.001 1.0
 /begin AXIS_DESCR COM_AXIS VfLCCS_left_lanemark_switch_time LCCS_subsystem_integrated_CM_single_s 21 0.0 10.0 AXIS_PTS_REF KtLCCS_AXIS_lanemark_switch_time /end AXIS_DESCR
/end CHARACTERISTIC
/begin CHARACTERISTIC KtLCCS_d_lookahead_distance "Vehicle lookahead distance." MAP 0x70101d64 /* @ECU_Address@KtLCCS_d_lookahead_distance@ */ Lookup2D_FLOAT32_IEEE 0 LCCS_subsystem_integrated_CM_single_m -3.4E+38 3.4E+38
 /begin AXIS_DESCR COM_AXIS VfLCCS_linear_velocity LCCS_subsystem_integrated_CM_single 21 -3.4E+38 3.4E+38 AXIS_PTS_REF KtLCCS_AXIS_vehicle_speed /end AXIS_DESCR
 /begin AXIS_DESCR COM_AXIS NO_INPUT_QUANTITY LCCS_subsystem_integrated_CM_single 5 -3.4E+38 3.4E+38 AXIS_PTS_REF KtLCCS_AXIS_route_curvature /end AXIS_DESCR
/end CHARACTERISTIC
/begin CHARACTERISTIC KtLCCS_r_RollCorrectionForHeading "Correction factor for vehicle heading based vehicle roll angle." CURVE 0x70101b18 /* @ECU_Address@KtLCCS_r_RollCorrectionForHeading@ */ Lookup1D_FLOAT32_IEEE 0 LCCS_subsystem_integrated_CM_single -3.4E+38 3.4E+38
 /begin AXIS_DESCR COM_AXIS VfLCCS_linear_velocity LCCS_subsystem_integrated_CM_single 21 -3.4E+38 3.4E+38 AXIS_PTS_REF KtLCCS_AXIS_vehicle_speed /end AXIS_DESCR
/end CHARACTERISTIC
/begin CHARACTERISTIC KtLCCS_Ang_steering_angle_reentry_zone "Steering angle delta limit for re-engage control. Unit: degree." CURVE 0x70101ff0 /* @ECU_Address@KtLCCS_Ang_steering_angle_reentry_zone@ */ Lookup1D_FLOAT32_IEEE 0 LCCS_subsystem_integrated_CM_single -3.4E+38 3.4E+38
 /begin AXIS_DESCR COM_AXIS VfLCCS_linear_velocity LCCS_subsystem_integrated_CM_single 21 -3.4E+38 3.4E+38 AXIS_PTS_REF KtLCCS_AXIS_vehicle_speed /end AXIS_DESCR
/end CHARACTERISTIC
/begin CHARACTERISTIC KtLCCS_heading_err_correction "Correction for heading error." CURVE 0x70101d10 /* @ECU_Address@KtLCCS_heading_err_correction@ */ Lookup1D_FLOAT32_IEEE 0 LCCS_subsystem_integrated_CM_single -3.4E+38 3.4E+38
 /begin AXIS_DESCR COM_AXIS NO_INPUT_QUANTITY LCCS_subsystem_integrated_CM_single_rad 21 0.0 0.1 AXIS_PTS_REF KtLCCS_AXIS_heading_error /end AXIS_DESCR
/end CHARACTERISTIC
/begin CHARACTERISTIC KtLCCS_heading_err_gain_scheduler "Gain for heading error scheduler." CURVE 0x70101cbc /* @ECU_Address@KtLCCS_heading_err_gain_scheduler@ */ Lookup1D_FLOAT32_IEEE 0 LCCS_subsystem_integrated_CM_single -3.4E+38 3.4E+38
 /begin AXIS_DESCR COM_AXIS NO_INPUT_QUANTITY LCCS_subsystem_integrated_CM_single 21 -3.4E+38 3.4E+38 AXIS_PTS_REF KtLCCS_AXIS_vehicle_speed /end AXIS_DESCR
/end CHARACTERISTIC
/begin CHARACTERISTIC KtLCCS_heading_err_rate_correction "Correction for heading error rate." CURVE 0x70101c68 /* @ECU_Address@KtLCCS_heading_err_rate_correction@ */ Lookup1D_FLOAT32_IEEE 0 LCCS_subsystem_integrated_CM_single -3.4E+38 3.4E+38
 /begin AXIS_DESCR COM_AXIS NO_INPUT_QUANTITY LCCS_subsystem_integrated_CM_single 21 -3.4E+38 3.4E+38 AXIS_PTS_REF KtLCCS_AXIS_vehicle_speed /end AXIS_DESCR
/end CHARACTERISTIC
/begin CHARACTERISTIC KtLCCS_lat_err_gain_scheduler "Gain for lateral error scheduler." CURVE 0x70101bc0 /* @ECU_Address@KtLCCS_lat_err_gain_scheduler@ */ Lookup1D_FLOAT32_IEEE 0 LCCS_subsystem_integrated_CM_single -3.4E+38 3.4E+38
 /begin AXIS_DESCR COM_AXIS NO_INPUT_QUANTITY LCCS_subsystem_integrated_CM_single 21 -3.4E+38 3.4E+38 AXIS_PTS_REF KtLCCS_AXIS_vehicle_speed /end AXIS_DESCR
/end CHARACTERISTIC
/begin CHARACTERISTIC KtLCCS_lateral_err_rate_correction "Correction for lateral error rate." CURVE 0x70101b6c /* @ECU_Address@KtLCCS_lateral_err_rate_correction@ */ Lookup1D_FLOAT32_IEEE 0 LCCS_subsystem_integrated_CM_single -1.0 1.0
 /begin AXIS_DESCR COM_AXIS NO_INPUT_QUANTITY LCCS_subsystem_integrated_CM_single 21 -3.4E+38 3.4E+38 AXIS_PTS_REF KtLCCS_AXIS_vehicle_speed /end AXIS_DESCR
/end CHARACTERISTIC
/begin CHARACTERISTIC KtLCCS_slowpath_steer_I_gain "Gain for slowpath steer I part." CURVE 0x70101ac4 /* @ECU_Address@KtLCCS_slowpath_steer_I_gain@ */ Lookup1D_FLOAT32_IEEE 0 LCCS_subsystem_integrated_CM_single -3.4E+38 3.4E+38
 /begin AXIS_DESCR COM_AXIS NO_INPUT_QUANTITY LCCS_subsystem_integrated_CM_single 21 -3.4E+38 3.4E+38 AXIS_PTS_REF KtLCCS_AXIS_vehicle_speed /end AXIS_DESCR
/end CHARACTERISTIC
/begin CHARACTERISTIC KtLCCS_slowpath_steer_P_gain "Gain for slowpath steer P part." CURVE 0x70101a70 /* @ECU_Address@KtLCCS_slowpath_steer_P_gain@ */ Lookup1D_FLOAT32_IEEE 0 LCCS_subsystem_integrated_CM_single -3.4E+38 3.4E+38
 /begin AXIS_DESCR COM_AXIS NO_INPUT_QUANTITY LCCS_subsystem_integrated_CM_single 21 -3.4E+38 3.4E+38 AXIS_PTS_REF KtLCCS_AXIS_vehicle_speed /end AXIS_DESCR
/end CHARACTERISTIC
/begin CHARACTERISTIC KtLCCS_t_lateral_oscillation_period "THe control period of lateral oscillation." CURVE 0x70101a1c /* @ECU_Address@KtLCCS_t_lateral_oscillation_period@ */ Lookup1D_FLOAT32_IEEE 0 LCCS_subsystem_integrated_CM_single_s 0.0 10.0
 /begin AXIS_DESCR COM_AXIS NO_INPUT_QUANTITY LCCS_subsystem_integrated_CM_single 21 -3.4E+38 3.4E+38 AXIS_PTS_REF KtLCCS_AXIS_vehicle_speed /end AXIS_DESCR
/end CHARACTERISTIC
/begin CHARACTERISTIC KtLCCS_Ang_steering_angle_max "Absolute maximum steering wheel angle. Unit: degree." CURVE 0x70102044 /* @ECU_Address@KtLCCS_Ang_steering_angle_max@ */ Lookup1D_FLOAT32_IEEE 0 LCCS_subsystem_integrated_CM_single -3.4E+38 3.4E+38
 /begin AXIS_DESCR COM_AXIS VfLCCS_linear_velocity LCCS_subsystem_integrated_CM_single 21 -3.4E+38 3.4E+38 AXIS_PTS_REF KtLCCS_AXIS_vehicle_speed /end AXIS_DESCR
/end CHARACTERISTIC
/begin CHARACTERISTIC KtLCCS_Ang_steering_angle_step "Desired steering wheel angle moving step per second. Unit: degree/s." CURVE 0x70101f9c /* @ECU_Address@KtLCCS_Ang_steering_angle_step@ */ Lookup1D_FLOAT32_IEEE 0 LCCS_subsystem_integrated_CM_single -3.4E+38 3.4E+38
 /begin AXIS_DESCR COM_AXIS VfLCCS_linear_velocity LCCS_subsystem_integrated_CM_single 21 -3.4E+38 3.4E+38 AXIS_PTS_REF KtLCCS_AXIS_vehicle_speed /end AXIS_DESCR
/end CHARACTERISTIC
/begin CHARACTERISTIC KtLCCS_Ang_steering_angle_step_engaging "Desired steering wheel angle moving step per second, when engaging steering control. Unit: degree/s." CURVE 0x70101f48 /* @ECU_Address@KtLCCS_Ang_steering_angle_step_engaging@ */ Lookup1D_FLOAT32_IEEE 0 LCCS_subsystem_integrated_CM_single -3.4E+38 3.4E+38
 /begin AXIS_DESCR COM_AXIS VfLCCS_linear_velocity LCCS_subsystem_integrated_CM_single 21 -3.4E+38 3.4E+38 AXIS_PTS_REF KtLCCS_AXIS_vehicle_speed /end AXIS_DESCR
/end CHARACTERISTIC
/begin CHARACTERISTIC KfLCCS_Ang_RollCorrectionMax "Max roll correction for heading." VALUE 0x7010221c /* @ECU_Address@KfLCCS_Ang_RollCorrectionMax@ */ Scalar_FLOAT32_IEEE 0 LCCS_subsystem_integrated_CM_single_rad 0.0 0.005 /end CHARACTERISTIC
/begin CHARACTERISTIC KfLCCS_Ang_slowpath_steer_limit "Slowpath adjuct limit for front wheel angle. Unit: rad." VALUE 0x70102218 /* @ECU_Address@KfLCCS_Ang_slowpath_steer_limit@ */ Scalar_FLOAT32_IEEE 0 LCCS_subsystem_integrated_CM_single -3.4E+38 3.4E+38 /end CHARACTERISTIC
/begin CHARACTERISTIC KfLCCS_Ang_steering_center_position "Steering wheel center position. Unit: degree." VALUE 0x70102214 /* @ECU_Address@KfLCCS_Ang_steering_center_position@ */ Scalar_FLOAT32_IEEE 0 LCCS_subsystem_integrated_CM_single -3.4E+38 3.4E+38 /end CHARACTERISTIC
/begin CHARACTERISTIC KfLCCS_LanemarkerQualityThrsh "Lane marker quality thresh, below which that lane marker is not utilized.
      " VALUE 0x70102210 /* @ECU_Address@KfLCCS_LanemarkerQualityThrsh@ */ Scalar_FLOAT32_IEEE 0 LCCS_subsystem_integrated_CM_single -3.4E+38 3.4E+38 /end CHARACTERISTIC
/begin CHARACTERISTIC KfLCCS_WeightMatrixStates_R "Regulator matrix for LQR solver.
      " VALUE 0x7010220c /* @ECU_Address@KfLCCS_WeightMatrixStates_R@ */ Scalar_FLOAT32_IEEE 0 LCCS_subsystem_integrated_CM_single -3.4E+38 3.4E+38 /end CHARACTERISTIC
/begin CHARACTERISTIC KfLCCS_a_max_lat_acc "Max acceptable lateral acceleration. Unit: m/s^2." VALUE 0x70102208 /* @ECU_Address@KfLCCS_a_max_lat_acc@ */ Scalar_FLOAT32_IEEE 0 LCCS_subsystem_integrated_CM_single -3.4E+38 3.4E+38 /end CHARACTERISTIC
/begin CHARACTERISTIC KfLCCS_cf "Corning stiffness for front wheel.
      " VALUE 0x70102204 /* @ECU_Address@KfLCCS_cf@ */ Scalar_FLOAT32_IEEE 0 LCCS_subsystem_integrated_CM_single -3.4E+38 3.4E+38 /end CHARACTERISTIC
/begin CHARACTERISTIC KfLCCS_cr "Corning stiffness for rear wheel.
      " VALUE 0x70102200 /* @ECU_Address@KfLCCS_cr@ */ Scalar_FLOAT32_IEEE 0 LCCS_subsystem_integrated_CM_single -3.4E+38 3.4E+38 /end CHARACTERISTIC
/begin CHARACTERISTIC KfLCCS_d_LateralErrorDeadBand "Lateral error deadband for slowpath I term." VALUE 0x701021fc /* @ECU_Address@KfLCCS_d_LateralErrorDeadBand@ */ Scalar_FLOAT32_IEEE 0 LCCS_subsystem_integrated_CM_single_m 0.0 0.1 /end CHARACTERISTIC
/begin CHARACTERISTIC KfLCCS_d_NudgeSafetyZone "Inlane nudge safety margin between vehicle body and lane marker.
      " VALUE 0x701021f8 /* @ECU_Address@KfLCCS_d_NudgeSafetyZone@ */ Scalar_FLOAT32_IEEE 0 LCCS_subsystem_integrated_CM_single_m 0.1 1.0 /end CHARACTERISTIC
/begin CHARACTERISTIC KfLCCS_d_ValidLaneWidthLimit "" VALUE 0x701021f4 /* @ECU_Address@KfLCCS_d_ValidLaneWidthLimit@ */ Scalar_FLOAT32_IEEE 0 LCCS_subsystem_integrated_CM_single_m -3.4E+38 3.4E+38 /end CHARACTERISTIC
/begin CHARACTERISTIC KfLCCS_d_VehicleWidth "Vehicle width." VALUE 0x701021f0 /* @ECU_Address@KfLCCS_d_VehicleWidth@ */ Scalar_FLOAT32_IEEE 0 LCCS_subsystem_integrated_CM_single_m 1.0 3.0 /end CHARACTERISTIC
/begin CHARACTERISTIC KfLCCS_d_lf "Distance between center of mass and front axle.
      " VALUE 0x701021ec /* @ECU_Address@KfLCCS_d_lf@ */ Scalar_FLOAT32_IEEE 0 LCCS_subsystem_integrated_CM_single_m -3.4E+38 3.4E+38 /end CHARACTERISTIC
/begin CHARACTERISTIC KfLCCS_d_lr "Distance between center of mass and rear axle.
      " VALUE 0x701021e8 /* @ECU_Address@KfLCCS_d_lr@ */ Scalar_FLOAT32_IEEE 0 LCCS_subsystem_integrated_CM_single_m -3.4E+38 3.4E+38 /end CHARACTERISTIC
/begin CHARACTERISTIC KfLCCS_d_min_turn_radius "Minimum turn radius at lowest speed.
      " VALUE 0x701021e4 /* @ECU_Address@KfLCCS_d_min_turn_radius@ */ Scalar_FLOAT32_IEEE 0 LCCS_subsystem_integrated_CM_single_m -3.4E+38 3.4E+38 /end CHARACTERISTIC
/begin CHARACTERISTIC KfLCCS_eps "Tolerance for LQR solver.
      " VALUE 0x701021e0 /* @ECU_Address@KfLCCS_eps@ */ Scalar_FLOAT32_IEEE 0 LCCS_subsystem_integrated_CM_single -3.4E+38 3.4E+38 /end CHARACTERISTIC
/begin CHARACTERISTIC KfLCCS_heading_error_rate_limit "High limit for calculated heading error rate.
      " VALUE 0x701021dc /* @ECU_Address@KfLCCS_heading_error_rate_limit@ */ Scalar_FLOAT32_IEEE 0 LCCS_subsystem_integrated_CM_single -3.4E+38 3.4E+38 /end CHARACTERISTIC
/begin CHARACTERISTIC KfLCCS_iz "Vehicle yaw inertia around -Z- axis.
      " VALUE 0x701021d8 /* @ECU_Address@KfLCCS_iz@ */ Scalar_FLOAT32_IEEE 0 LCCS_subsystem_integrated_CM_single -3.4E+38 3.4E+38 /end CHARACTERISTIC
/begin CHARACTERISTIC KfLCCS_mass "Vehicle mass.
      " VALUE 0x701021d4 /* @ECU_Address@KfLCCS_mass@ */ Scalar_FLOAT32_IEEE 0 LCCS_subsystem_integrated_CM_single_kg -3.4E+38 3.4E+38 /end CHARACTERISTIC
/begin CHARACTERISTIC KfLCCS_r_MaxLateralSpeedPortion "The maximum ratio of lateral speed over vehicle speed." VALUE 0x701021d0 /* @ECU_Address@KfLCCS_r_MaxLateralSpeedPortion@ */ Scalar_FLOAT32_IEEE 0 LCCS_subsystem_integrated_CM_single -3.4E+38 3.4E+38 /end CHARACTERISTIC
/begin CHARACTERISTIC KfLCCS_r_UpdateStanleyK "Correction factor for LQR sover result when using stanley mode." VALUE 0x701021cc /* @ECU_Address@KfLCCS_r_UpdateStanleyK@ */ Scalar_FLOAT32_IEEE 0 LCCS_subsystem_integrated_CM_single -3.4E+38 3.4E+38 /end CHARACTERISTIC
/begin CHARACTERISTIC KfLCCS_r_shift_speed_gain "Lateral distance to go multiply by thisgain to calculate lateral shift speed." VALUE 0x701021c8 /* @ECU_Address@KfLCCS_r_shift_speed_gain@ */ Scalar_FLOAT32_IEEE 0 LCCS_subsystem_integrated_CM_single -3.4E+38 3.4E+38 /end CHARACTERISTIC
/begin CHARACTERISTIC KfLCCS_r_steering_rate_forward_gain "Steering wheel turning speed gain when moving to forward direction." VALUE 0x701021c4 /* @ECU_Address@KfLCCS_r_steering_rate_forward_gain@ */ Scalar_FLOAT32_IEEE 0 LCCS_subsystem_integrated_CM_single -3.4E+38 3.4E+38 /end CHARACTERISTIC
/begin CHARACTERISTIC KfLCCS_r_veh_strwhl_2_frtwhl_ratio "The gear ratio between steering wheel angle and front wheel angle." VALUE 0x701021c0 /* @ECU_Address@KfLCCS_r_veh_strwhl_2_frtwhl_ratio@ */ Scalar_FLOAT32_IEEE 0 LCCS_subsystem_integrated_CM_single -3.4E+38 3.4E+38 /end CHARACTERISTIC
/begin CHARACTERISTIC KfLCCS_r_velocity_y_correction "Correction for linear velocity in Y direction." VALUE 0x701021bc /* @ECU_Address@KfLCCS_r_velocity_y_correction@ */ Scalar_FLOAT32_IEEE 0 LCCS_subsystem_integrated_CM_single -1.0 1.0 /end CHARACTERISTIC
/begin CHARACTERISTIC KfLCCS_t_RollOscillationPeriod "Vehicle roll value oscillation period." VALUE 0x701021b8 /* @ECU_Address@KfLCCS_t_RollOscillationPeriod@ */ Scalar_FLOAT32_IEEE 0 LCCS_subsystem_integrated_CM_single_s 1.0 10.0 /end CHARACTERISTIC
/begin CHARACTERISTIC KfLCCS_t_SampleTime "Base control loop time.
      " VALUE 0x701021b4 /* @ECU_Address@KfLCCS_t_SampleTime@ */ Scalar_FLOAT32_IEEE 0 LCCS_subsystem_integrated_CM_single_s 0.01 0.1 /end CHARACTERISTIC
/begin CHARACTERISTIC KfLCCS_t_lateral_movement_delay "When vehicle is moving, and steering control is active, lateral movement will be enabled after this time delay." VALUE 0x701021b0 /* @ECU_Address@KfLCCS_t_lateral_movement_delay@ */ Scalar_FLOAT32_IEEE 0 LCCS_subsystem_integrated_CM_single_s -3.4E+38 3.4E+38 /end CHARACTERISTIC
/begin CHARACTERISTIC KfLCCS_v_shift_speed_high_limit "Lateral shift speed high limit." VALUE 0x701021ac /* @ECU_Address@KfLCCS_v_shift_speed_high_limit@ */ Scalar_FLOAT32_IEEE 0 LCCS_subsystem_integrated_CM_single_m_s -3.4E+38 3.4E+38 /end CHARACTERISTIC
/begin CHARACTERISTIC KfLCCS_v_shift_speed_low_limit "Lateral shift speed low limit." VALUE 0x701021a8 /* @ECU_Address@KfLCCS_v_shift_speed_low_limit@ */ Scalar_FLOAT32_IEEE 0 LCCS_subsystem_integrated_CM_single_m_s -3.4E+38 3.4E+38 /end CHARACTERISTIC
/begin CHARACTERISTIC KtLCCS_WeightMatrixInputs_Q "Q matrix for LQR solver." VAL_BLK 0x70101f08 /* @ECU_Address@KtLCCS_WeightMatrixInputs_Q@ */ Scalar_FLOAT32_IEEE 0 LCCS_subsystem_integrated_CM_single -3.4E+38 3.4E+38 NUMBER 16 /end CHARACTERISTIC
/begin CHARACTERISTIC KcLCCS_HeadingErrorRateSmooth "This number of heading error samples are used to calculate heading error rate.
      " VALUE 0x70101a18 /* @ECU_Address@KcLCCS_HeadingErrorRateSmooth@ */ Scalar_LONG 0 LCCS_subsystem_integrated_CM_int32 1.0 50.0 /end CHARACTERISTIC
/begin CHARACTERISTIC KbLCCS_UsePurePursuit "True: Use lookahead point to calculate target driving direction." VALUE 0x70101a17 /* @ECU_Address@KbLCCS_UsePurePursuit@ */ Scalar_BOOLEAN 0 LCCS_subsystem_integrated_CM_boolean 0 1 /end CHARACTERISTIC
/begin CHARACTERISTIC KbLCCS_WheelEncoderReady "Indicator for wheel encoder system ready." VALUE 0x70101a16 /* @ECU_Address@KbLCCS_WheelEncoderReady@ */ Scalar_BOOLEAN 0 LCCS_subsystem_integrated_CM_boolean 0 1 /end CHARACTERISTIC
/begin CHARACTERISTIC KbLCCS_inlane_nudge_request_SLEW "Calibration switch to SLEW inlane nudge request." VALUE 0x70101a15 /* @ECU_Address@KbLCCS_inlane_nudge_request_SLEW@ */ Scalar_BOOLEAN 0 LCCS_subsystem_integrated_CM_boolean 0 1 /end CHARACTERISTIC
/begin CHARACTERISTIC KbLCCS_inlane_nudge_request_value "Inlane nudge request value in SLEW mode." VALUE 0x70101a14 /* @ECU_Address@KbLCCS_inlane_nudge_request_value@ */ Scalar_BOOLEAN 0 LCCS_subsystem_integrated_CM_boolean 0 1 /end CHARACTERISTIC
/begin CHARACTERISTIC KbLCCS_lane_change_request_SLEW "Calibration switch to SLEW lane change request." VALUE 0x70101a13 /* @ECU_Address@KbLCCS_lane_change_request_SLEW@ */ Scalar_BOOLEAN 0 LCCS_subsystem_integrated_CM_boolean 0 1 /end CHARACTERISTIC
/begin CHARACTERISTIC KbLCCS_lane_change_request_value "Lane change request value in SLEW mode." VALUE 0x70101a12 /* @ECU_Address@KbLCCS_lane_change_request_value@ */ Scalar_BOOLEAN 0 LCCS_subsystem_integrated_CM_boolean 0 1 /end CHARACTERISTIC
/begin CHARACTERISTIC KbLCCS_lane_change_source_ALCA "Lane change request source is ALCA." VALUE 0x70101a11 /* @ECU_Address@KbLCCS_lane_change_source_ALCA@ */ Scalar_BOOLEAN 0 LCCS_subsystem_integrated_CM_boolean 0 1 /end CHARACTERISTIC
/begin CHARACTERISTIC KeLCCS_shifting_direction_value "Shifting direction value in SLEW mode." VALUE 0x70101a10 /* @ECU_Address@KeLCCS_shifting_direction_value@ */ Scalar_UBYTE 0 LCCS_subsystem_integrated_CM_EnumDCSN_driving_direction 0 2 /end CHARACTERISTIC
/begin CHARACTERISTIC KfLCWS_c_DisbleCurveThrshMax "" VALUE 0x7010228c /* @ECU_Address@KfLCWS_c_DisbleCurveThrshMax@ */ Scalar_FLOAT32_IEEE 0 LCWS_subsystem_integrated_CM_single 0.001 0.1 /end CHARACTERISTIC
/begin CHARACTERISTIC KfLCWS_c_EnbleCurveThrshMax "" VALUE 0x70102288 /* @ECU_Address@KfLCWS_c_EnbleCurveThrshMax@ */ Scalar_FLOAT32_IEEE 0 LCWS_subsystem_integrated_CM_single 0.001 0.1 /end CHARACTERISTIC
/begin CHARACTERISTIC KfLCWS_d_BSDLargerZone_BackDis "" VALUE 0x70102284 /* @ECU_Address@KfLCWS_d_BSDLargerZone_BackDis@ */ Scalar_FLOAT32_IEEE 0 LCWS_subsystem_integrated_CM_single 3.0 30.0 /end CHARACTERISTIC
/begin CHARACTERISTIC KfLCWS_d_BSDLargerZone_FrontDis "" VALUE 0x70102280 /* @ECU_Address@KfLCWS_d_BSDLargerZone_FrontDis@ */ Scalar_FLOAT32_IEEE 0 LCWS_subsystem_integrated_CM_single -1.0 2.0 /end CHARACTERISTIC
/begin CHARACTERISTIC KfLCWS_d_BSDLargerZone_NearDis "" VALUE 0x7010227c /* @ECU_Address@KfLCWS_d_BSDLargerZone_NearDis@ */ Scalar_FLOAT32_IEEE 0 LCWS_subsystem_integrated_CM_single -0.5 0.5 /end CHARACTERISTIC
/begin CHARACTERISTIC KfLCWS_d_BSDZone_BackDis "" VALUE 0x70102278 /* @ECU_Address@KfLCWS_d_BSDZone_BackDis@ */ Scalar_FLOAT32_IEEE 0 LCWS_subsystem_integrated_CM_single 3.0 30.0 /end CHARACTERISTIC
/begin CHARACTERISTIC KfLCWS_d_BSDZone_Eye95Dis "" VALUE 0x70102274 /* @ECU_Address@KfLCWS_d_BSDZone_Eye95Dis@ */ Scalar_FLOAT32_IEEE 0 LCWS_subsystem_integrated_CM_single 0.0 5.0 /end CHARACTERISTIC
/begin CHARACTERISTIC KfLCWS_d_BSDZone_FarDis "" VALUE 0x70102270 /* @ECU_Address@KfLCWS_d_BSDZone_FarDis@ */ Scalar_FLOAT32_IEEE 0 LCWS_subsystem_integrated_CM_single 3.0 6.0 /end CHARACTERISTIC
/begin CHARACTERISTIC KfLCWS_d_BSDZone_FrontDis "" VALUE 0x7010226c /* @ECU_Address@KfLCWS_d_BSDZone_FrontDis@ */ Scalar_FLOAT32_IEEE 0 LCWS_subsystem_integrated_CM_single -1.0 2.0 /end CHARACTERISTIC
/begin CHARACTERISTIC KfLCWS_d_BSDZone_NearDis "" VALUE 0x70102268 /* @ECU_Address@KfLCWS_d_BSDZone_NearDis@ */ Scalar_FLOAT32_IEEE 0 LCWS_subsystem_integrated_CM_single -0.5 0.5 /end CHARACTERISTIC
/begin CHARACTERISTIC KfLCWS_d_CVLargerZone_FrontDis "" VALUE 0x70102264 /* @ECU_Address@KfLCWS_d_CVLargerZone_FrontDis@ */ Scalar_FLOAT32_IEEE 0 LCWS_subsystem_integrated_CM_single 0.0 3.0 /end CHARACTERISTIC
/begin CHARACTERISTIC KfLCWS_d_CVZone_FrontDis "" VALUE 0x70102260 /* @ECU_Address@KfLCWS_d_CVZone_FrontDis@ */ Scalar_FLOAT32_IEEE 0 LCWS_subsystem_integrated_CM_single 0.0 3.0 /end CHARACTERISTIC
/begin CHARACTERISTIC KfLCWS_d_NearDisHiLevel "" VALUE 0x7010225c /* @ECU_Address@KfLCWS_d_NearDisHiLevel@ */ Scalar_FLOAT32_IEEE 0 LCWS_subsystem_integrated_CM_single 0.0 1.0 /end CHARACTERISTIC
/begin CHARACTERISTIC KfLCWS_d_VehLenth "" VALUE 0x70102258 /* @ECU_Address@KfLCWS_d_VehLenth@ */ Scalar_FLOAT32_IEEE 0 LCWS_subsystem_integrated_CM_single 0.0 20.0 /end CHARACTERISTIC
/begin CHARACTERISTIC KfLCWS_d_VehWidth "" VALUE 0x70102254 /* @ECU_Address@KfLCWS_d_VehWidth@ */ Scalar_FLOAT32_IEEE 0 LCWS_subsystem_integrated_CM_single 0.0 10.0 /end CHARACTERISTIC
/begin CHARACTERISTIC KfLCWS_r_ObtWidthProportion "" VALUE 0x70102250 /* @ECU_Address@KfLCWS_r_ObtWidthProportion@ */ Scalar_FLOAT32_IEEE 0 LCWS_subsystem_integrated_CM_single 0.0 1.0 /end CHARACTERISTIC
/begin CHARACTERISTIC KfLCWS_t_TTCLargerThrsh_LowLevel "" VALUE 0x7010224c /* @ECU_Address@KfLCWS_t_TTCLargerThrsh_LowLevel@ */ Scalar_FLOAT32_IEEE 0 LCWS_subsystem_integrated_CM_single 3.0 7.5 /end CHARACTERISTIC
/begin CHARACTERISTIC KfLCWS_t_TTCThrshHiLevel "" VALUE 0x70102248 /* @ECU_Address@KfLCWS_t_TTCThrshHiLevel@ */ Scalar_FLOAT32_IEEE 0 LCWS_subsystem_integrated_CM_single 0.0 3.5 /end CHARACTERISTIC
/begin CHARACTERISTIC KfLCWS_t_TTCThrshLowLevel "" VALUE 0x70102244 /* @ECU_Address@KfLCWS_t_TTCThrshLowLevel@ */ Scalar_FLOAT32_IEEE 0 LCWS_subsystem_integrated_CM_single 3.0 7.5 /end CHARACTERISTIC
/begin CHARACTERISTIC KfLCWS_v_DisbleVehSpdThrshHi "" VALUE 0x70102240 /* @ECU_Address@KfLCWS_v_DisbleVehSpdThrshHi@ */ Scalar_FLOAT32_IEEE 0 LCWS_subsystem_integrated_CM_single 0.0 100.0 /end CHARACTERISTIC
/begin CHARACTERISTIC KfLCWS_v_DisbleVehSpdThrshLo "" VALUE 0x7010223c /* @ECU_Address@KfLCWS_v_DisbleVehSpdThrshLo@ */ Scalar_FLOAT32_IEEE 0 LCWS_subsystem_integrated_CM_single -5.0 20.0 /end CHARACTERISTIC
/begin CHARACTERISTIC KfLCWS_v_EnbleVehSpdThrshHi "" VALUE 0x70102238 /* @ECU_Address@KfLCWS_v_EnbleVehSpdThrshHi@ */ Scalar_FLOAT32_IEEE 0 LCWS_subsystem_integrated_CM_single 0.0 100.0 /end CHARACTERISTIC
/begin CHARACTERISTIC KfLCWS_v_EnbleVehSpdThrshLo "" VALUE 0x70102234 /* @ECU_Address@KfLCWS_v_EnbleVehSpdThrshLo@ */ Scalar_FLOAT32_IEEE 0 LCWS_subsystem_integrated_CM_single -5.0 20.0 /end CHARACTERISTIC
/begin CHARACTERISTIC KfLCWS_v_LatSpdThr "" VALUE 0x70102230 /* @ECU_Address@KfLCWS_v_LatSpdThr@ */ Scalar_FLOAT32_IEEE 0 LCWS_subsystem_integrated_CM_single_m_s 0.0 20.0 /end CHARACTERISTIC
/begin CHARACTERISTIC KfLCWS_v_OncomRelSpdThrshHi_in "" VALUE 0x7010222c /* @ECU_Address@KfLCWS_v_OncomRelSpdThrshHi_in@ */ Scalar_FLOAT32_IEEE 0 LCWS_subsystem_integrated_CM_single 0.0 30.0 /end CHARACTERISTIC
/begin CHARACTERISTIC KfLCWS_v_OncomRelSpdThrshHi_out "" VALUE 0x70102228 /* @ECU_Address@KfLCWS_v_OncomRelSpdThrshHi_out@ */ Scalar_FLOAT32_IEEE 0 LCWS_subsystem_integrated_CM_single 0.0 30.0 /end CHARACTERISTIC
/begin CHARACTERISTIC KfLCWS_d_BSDLargerZone_FarDis "" VALUE 0x70102224 /* @ECU_Address@KfLCWS_d_BSDLargerZone_FarDis@ */ Scalar_BYTE 0 LCWS_subsystem_integrated_CM_int8 3.0 6.0 /end CHARACTERISTIC
/begin CHARACTERISTIC KbLCWS_ObtFilter "" VALUE 0x70102223 /* @ECU_Address@KbLCWS_ObtFilter@ */ Scalar_BOOLEAN 0 LCWS_subsystem_integrated_CM_boolean 0.0 1.0 /end CHARACTERISTIC
/begin CHARACTERISTIC KbLCWS_ObtStaticIn "" VALUE 0x70102222 /* @ECU_Address@KbLCWS_ObtStaticIn@ */ Scalar_BOOLEAN 0 LCWS_subsystem_integrated_CM_boolean 0.0 1.0 /end CHARACTERISTIC
/begin CHARACTERISTIC KbLCWS_Switch "" VALUE 0x70102221 /* @ECU_Address@KbLCWS_Switch@ */ Scalar_BOOLEAN 0 LCWS_subsystem_integrated_CM_boolean 0.0 1.0 /end CHARACTERISTIC
/begin CHARACTERISTIC KbLCWS_curve "" VALUE 0x70102220 /* @ECU_Address@KbLCWS_curve@ */ Scalar_BOOLEAN 0 LCWS_subsystem_integrated_CM_boolean 0.0 1.0 /end CHARACTERISTIC
/begin CHARACTERISTIC KfLDWS_Ang_BkToCnrAng "The angle X axis and the line connecting center of rear axle and front tire." VALUE 0x701022f8 /* @ECU_Address@KfLDWS_Ang_BkToCnrAng@ */ Scalar_FLOAT32_IEEE 0 LDWS_subsystem_integrated_CM_single_rad 0.0 1.5707963267948966 /end CHARACTERISTIC
/begin CHARACTERISTIC KfLDWS_Ang_SuppSteerAngThrsh "The suppression threshold for Steer Angle" VALUE 0x701022f4 /* @ECU_Address@KfLDWS_Ang_SuppSteerAngThrsh@ */ Scalar_FLOAT32_IEEE 0 LDWS_subsystem_integrated_CM_single__ 0.0 360.0 /end CHARACTERISTIC
/begin CHARACTERISTIC KfLDWS_M_SuppTorque "The torque limit that could be treated as suppression" VALUE 0x701022f0 /* @ECU_Address@KfLDWS_M_SuppTorque@ */ Scalar_FLOAT32_IEEE 0 LDWS_subsystem_integrated_CM_single_NM 0.0 10.0 /end CHARACTERISTIC
/begin CHARACTERISTIC KfLDWS_c_CurvLwrBnd "The curvature upper bound for ODD" VALUE 0x701022ec /* @ECU_Address@KfLDWS_c_CurvLwrBnd@ */ Scalar_FLOAT32_IEEE 0 LDWS_subsystem_integrated_CM_single_1_m 0.0 0.01 /end CHARACTERISTIC
/begin CHARACTERISTIC KfLDWS_c_CurvUprBnd "The curvature lower bound for ODD" VALUE 0x701022e8 /* @ECU_Address@KfLDWS_c_CurvUprBnd@ */ Scalar_FLOAT32_IEEE 0 LDWS_subsystem_integrated_CM_single_1_m 0.0 0.01 /end CHARACTERISTIC
/begin CHARACTERISTIC KfLDWS_d_BkToFrtCnrDist "The distance between one fo the front tires to the center of rear axle." VALUE 0x701022e4 /* @ECU_Address@KfLDWS_d_BkToFrtCnrDist@ */ Scalar_FLOAT32_IEEE 0 LDWS_subsystem_integrated_CM_single_m 0.0 20.0 /end CHARACTERISTIC
/begin CHARACTERISTIC KfLDWS_d_EdgBuff "The edge buffer that added to the calcualted distance to lane markers" VALUE 0x701022e0 /* @ECU_Address@KfLDWS_d_EdgBuff@ */ Scalar_FLOAT32_IEEE 0 LDWS_subsystem_integrated_CM_single_m -2.0 2.0 /end CHARACTERISTIC
/begin CHARACTERISTIC KfLDWS_d_LnWidthLwrBnd "The lane width lower bound for ODD" VALUE 0x701022dc /* @ECU_Address@KfLDWS_d_LnWidthLwrBnd@ */ Scalar_FLOAT32_IEEE 0 LDWS_subsystem_integrated_CM_single_m 0.0 10.0 /end CHARACTERISTIC
/begin CHARACTERISTIC KfLDWS_d_LnWidthUprBnd "The lane width upper bound for ODD" VALUE 0x701022d8 /* @ECU_Address@KfLDWS_d_LnWidthUprBnd@ */ Scalar_FLOAT32_IEEE 0 LDWS_subsystem_integrated_CM_single_m 0.0 10.0 /end CHARACTERISTIC
/begin CHARACTERISTIC KfLDWS_d_WarnLineLvlOne "When vehicle speed is higher than 1.0m/s, the earliest warning line shall be placed no more than 1.5m inside the lane boundary." VALUE 0x701022d4 /* @ECU_Address@KfLDWS_d_WarnLineLvlOne@ */ Scalar_FLOAT32_IEEE 0 LDWS_subsystem_integrated_CM_single_m 0.0 1.5 /end CHARACTERISTIC
/begin CHARACTERISTIC KfLDWS_d_WarnLineLvlThree "When vehicle speed is not higher than 0.5 m/s, the earliest warning line shall be placed no more than 0.75m inside the lane boundary." VALUE 0x701022d0 /* @ECU_Address@KfLDWS_d_WarnLineLvlThree@ */ Scalar_FLOAT32_IEEE 0 LDWS_subsystem_integrated_CM_single_m 0.0 0.75 /end CHARACTERISTIC
/begin CHARACTERISTIC KfLDWS_k_CurvBuffCoe "The coefficient that multiples the distance to lanemarker when the vehicle is driving under large curavture." VALUE 0x701022cc /* @ECU_Address@KfLDWS_k_CurvBuffCoe@ */ Scalar_FLOAT32_IEEE 0 LDWS_subsystem_integrated_CM_single 0.0 2.0 /end CHARACTERISTIC
/begin CHARACTERISTIC KfLDWS_k_WarnLineLvlTwo "When vehicle speed is higher than 0.5m/s but not  higher than 1.0m/s, the earliest warning line shall be placed no more than 1.5*Va m inside the lane boundary" VALUE 0x701022c8 /* @ECU_Address@KfLDWS_k_WarnLineLvlTwo@ */ Scalar_FLOAT32_IEEE 0 LDWS_subsystem_integrated_CM_single 0.0 1.5 /end CHARACTERISTIC
/begin CHARACTERISTIC KfLDWS_t_TLCThrsh "Time to lane crossing threshold" VALUE 0x701022c4 /* @ECU_Address@KfLDWS_t_TLCThrsh@ */ Scalar_FLOAT32_IEEE 0 LDWS_subsystem_integrated_CM_single_s 0.0 2.0 /end CHARACTERISTIC
/begin CHARACTERISTIC KfLDWS_v_SpdLwrBnd "The speed lower bound for ODD" VALUE 0x701022c0 /* @ECU_Address@KfLDWS_v_SpdLwrBnd@ */ Scalar_FLOAT32_IEEE 0 LDWS_subsystem_integrated_CM_single_m_s 0.0 55.0 /end CHARACTERISTIC
/begin CHARACTERISTIC KfLDWS_v_SpdUprBnd "The speed upper bound for ODD" VALUE 0x701022bc /* @ECU_Address@KfLDWS_v_SpdUprBnd@ */ Scalar_FLOAT32_IEEE 0 LDWS_subsystem_integrated_CM_single_m_s 0.0 55.0 /end CHARACTERISTIC
/begin CHARACTERISTIC KfLDWS_v_SuppSteerRateThrsh "The suppression threshold for Steer Rate" VALUE 0x701022b8 /* @ECU_Address@KfLDWS_v_SuppSteerRateThrsh@ */ Scalar_FLOAT32_IEEE 0 LDWS_subsystem_integrated_CM_single___s 0.0 360.0 /end CHARACTERISTIC
/begin CHARACTERISTIC KcLDWS_CntSample "The sample time that state machine uses in a loop." VALUE 0x701022b6 /* @ECU_Address@KcLDWS_CntSample@ */ Scalar_UWORD 0 LDWS_subsystem_integrated_CM_uint16 1.0 10.0 /end CHARACTERISTIC
/begin CHARACTERISTIC KfLDWS_t_CntMaxWarnHold "The maximum time that a warning satte is allowed to last" VALUE 0x701022b4 /* @ECU_Address@KfLDWS_t_CntMaxWarnHold@ */ Scalar_UWORD 0 LDWS_subsystem_integrated_CM_uint16 0.0 1000.0 /end CHARACTERISTIC
/begin CHARACTERISTIC KfLDWS_t_CntMinWarnHold "The minimum time that a warning state shall last." VALUE 0x701022b2 /* @ECU_Address@KfLDWS_t_CntMinWarnHold@ */ Scalar_UWORD 0 LDWS_subsystem_integrated_CM_uint16 0.0 1000.0 /end CHARACTERISTIC
/begin CHARACTERISTIC KfLDWS_t_CntOnHold "The bouncing time that avoids wrong trigger." VALUE 0x701022b0 /* @ECU_Address@KfLDWS_t_CntOnHold@ */ Scalar_UWORD 0 LDWS_subsystem_integrated_CM_uint16 0.0 1000.0 /end CHARACTERISTIC
/begin CHARACTERISTIC KfLDWS_t_CurvNotValidTime "The time that Enabling Manager uses to reset condition for curvature" VALUE 0x701022ae /* @ECU_Address@KfLDWS_t_CurvNotValidTime@ */ Scalar_UWORD 0 LDWS_subsystem_integrated_CM_uint16 0.0 1000.0 /end CHARACTERISTIC
/begin CHARACTERISTIC KfLDWS_t_CurvValidTime "The time that Enabling Manager uses to set condition for curvature" VALUE 0x701022ac /* @ECU_Address@KfLDWS_t_CurvValidTime@ */ Scalar_UWORD 0 LDWS_subsystem_integrated_CM_uint16 0.0 1000.0 /end CHARACTERISTIC
/begin CHARACTERISTIC KfLDWS_t_LnMkrMissThrsh "The maximum time that a lane marker could termporarily go missing" VALUE 0x701022aa /* @ECU_Address@KfLDWS_t_LnMkrMissThrsh@ */ Scalar_UWORD 0 LDWS_subsystem_integrated_CM_uint16 0.0 1000.0 /end CHARACTERISTIC
/begin CHARACTERISTIC KfLDWS_t_LnMkrNotValidTime "The time that Enabling Manager uses set condion for lane marker" VALUE 0x701022a8 /* @ECU_Address@KfLDWS_t_LnMkrNotValidTime@ */ Scalar_UWORD 0 LDWS_subsystem_integrated_CM_uint16 0.0 1000.0 /end CHARACTERISTIC
/begin CHARACTERISTIC KfLDWS_t_LnMkrValidTime "The time that Enabling Manager uses reset condition for lane marker" VALUE 0x701022a6 /* @ECU_Address@KfLDWS_t_LnMkrValidTime@ */ Scalar_UWORD 0 LDWS_subsystem_integrated_CM_uint16 0.0 1000.0 /end CHARACTERISTIC
/begin CHARACTERISTIC KfLDWS_t_LnWidthNotValidTime "The time that Enabling Manager uses to reset condition for lane width" VALUE 0x701022a4 /* @ECU_Address@KfLDWS_t_LnWidthNotValidTime@ */ Scalar_UWORD 0 LDWS_subsystem_integrated_CM_uint16 0.0 1000.0 /end CHARACTERISTIC
/begin CHARACTERISTIC KfLDWS_t_LnWidthValidTime "The time that enabling manager uses to set condition for lane width" VALUE 0x701022a2 /* @ECU_Address@KfLDWS_t_LnWidthValidTime@ */ Scalar_UWORD 0 LDWS_subsystem_integrated_CM_uint16 0.0 1000.0 /end CHARACTERISTIC
/begin CHARACTERISTIC KfLDWS_t_SpdRngNotValidTime "The time that enabling manager uses to reset condition for speed range" VALUE 0x701022a0 /* @ECU_Address@KfLDWS_t_SpdRngNotValidTime@ */ Scalar_UWORD 0 LDWS_subsystem_integrated_CM_uint16 0.0 1000.0 /end CHARACTERISTIC
/begin CHARACTERISTIC KfLDWS_t_SpdRngValidTime "The time that enabling manager uses to set condtion for speed range" VALUE 0x7010229e /* @ECU_Address@KfLDWS_t_SpdRngValidTime@ */ Scalar_UWORD 0 LDWS_subsystem_integrated_CM_uint16 0.0 1000.0 /end CHARACTERISTIC
/begin CHARACTERISTIC KfLDWS_t_SuppIndiTime "The time that indicator could be treated as suppression" VALUE 0x7010229c /* @ECU_Address@KfLDWS_t_SuppIndiTime@ */ Scalar_UWORD 0 LDWS_subsystem_integrated_CM_uint16 0.0 1000.0 /end CHARACTERISTIC
/begin CHARACTERISTIC KfLDWS_t_SuppSteerAngTime "The time that steer angle could be treated as suppression" VALUE 0x7010229a /* @ECU_Address@KfLDWS_t_SuppSteerAngTime@ */ Scalar_UWORD 0 LDWS_subsystem_integrated_CM_uint16 0.0 1000.0 /end CHARACTERISTIC
/begin CHARACTERISTIC KfLDWS_t_SuppSteerRateTime "The time that steer rate could be treated as suppression" VALUE 0x70102298 /* @ECU_Address@KfLDWS_t_SuppSteerRateTime@ */ Scalar_UWORD 0 LDWS_subsystem_integrated_CM_uint16 0.0 1000.0 /end CHARACTERISTIC
/begin CHARACTERISTIC KfLDWS_t_SuppTorqueTime "The time that steer toque could be treated as suppression" VALUE 0x70102296 /* @ECU_Address@KfLDWS_t_SuppTorqueTime@ */ Scalar_UWORD 0 LDWS_subsystem_integrated_CM_uint16 0.0 1000.0 /end CHARACTERISTIC
/begin CHARACTERISTIC KfLDWS_r_LaMkrQlt "Lane marker quality threshold" VALUE 0x70102295 /* @ECU_Address@KfLDWS_r_LaMkrQlt@ */ Scalar_UBYTE 0 LDWS_subsystem_integrated_CM_uint8 0.0 100.0 /end CHARACTERISTIC
/begin CHARACTERISTIC KbLDWS_EnableSwitch "" VALUE 0x70102294 /* @ECU_Address@KbLDWS_EnableSwitch@ */ Scalar_BOOLEAN 0 LDWS_subsystem_integrated_CM_boolean 0.0 1.0 /end CHARACTERISTIC
/begin CHARACTERISTIC KbLDWS_SuppLeSwitch "" VALUE 0x70102293 /* @ECU_Address@KbLDWS_SuppLeSwitch@ */ Scalar_BOOLEAN 0 LDWS_subsystem_integrated_CM_boolean 0.0 1.0 /end CHARACTERISTIC
/begin CHARACTERISTIC KbLDWS_SuppRiSwitch "" VALUE 0x70102292 /* @ECU_Address@KbLDWS_SuppRiSwitch@ */ Scalar_BOOLEAN 0 LDWS_subsystem_integrated_CM_boolean 0.0 1.0 /end CHARACTERISTIC
/begin CHARACTERISTIC KbLDWS_ThetaSwitch "" VALUE 0x70102291 /* @ECU_Address@KbLDWS_ThetaSwitch@ */ Scalar_BOOLEAN 0 LDWS_subsystem_integrated_CM_boolean 0.0 1.0 /end CHARACTERISTIC
/begin CHARACTERISTIC KbLDWS_WarnAllowed "A swicth that enable the state machine" VALUE 0x70102290 /* @ECU_Address@KbLDWS_WarnAllowed@ */ Scalar_BOOLEAN 0 LDWS_subsystem_integrated_CM_boolean 0.0 1.0 /end CHARACTERISTIC
/begin CHARACTERISTIC KfAEBD_a_AccelDeviation "" VALUE 0x7010122c /* @ECU_Address@KfAEBD_a_AccelDeviation@ */ Scalar_FLOAT32_IEEE 0 AEBD_subsystem_integrated_CM_single 0.0 10.0 /end CHARACTERISTIC
/begin CHARACTERISTIC KcAEBD_ErrorCountThrsh "" VALUE 0x7010122a /* @ECU_Address@KcAEBD_ErrorCountThrsh@ */ Scalar_UWORD 0 AEBD_subsystem_integrated_CM_uint16 0.0 65535.0 /end CHARACTERISTIC
/begin CHARACTERISTIC KfAEBD_t_WaitTimeThrsh "" VALUE 0x70101228 /* @ECU_Address@KfAEBD_t_WaitTimeThrsh@ */ Scalar_UBYTE 0 AEBD_subsystem_integrated_CM_uint8 0.0 200.0 /end CHARACTERISTIC
/begin CHARACTERISTIC KbAEBD_ADCU_CANError "" VALUE 0x70101227 /* @ECU_Address@KbAEBD_ADCU_CANError@ */ Scalar_BOOLEAN 0 AEBD_subsystem_integrated_CM_boolean 0.0 1.0 /end CHARACTERISTIC
/begin CHARACTERISTIC KbAEBD_AccelerationSensorError "" VALUE 0x70101226 /* @ECU_Address@KbAEBD_AccelerationSensorError@ */ Scalar_BOOLEAN 0 AEBD_subsystem_integrated_CM_boolean 0.0 1.0 /end CHARACTERISTIC
/begin CHARACTERISTIC KbAEBD_ESCError "" VALUE 0x70101225 /* @ECU_Address@KbAEBD_ESCError@ */ Scalar_BOOLEAN 0 AEBD_subsystem_integrated_CM_boolean 0.0 1.0 /end CHARACTERISTIC
/begin CHARACTERISTIC KbAEBD_ErrorClear "" VALUE 0x70101224 /* @ECU_Address@KbAEBD_ErrorClear@ */ Scalar_BOOLEAN 0 AEBD_subsystem_integrated_CM_boolean 0.0 1.0 /end CHARACTERISTIC
/begin CHARACTERISTIC KfALCA_d_DefaultLaneLength "" VALUE 0x70101824 /* @ECU_Address@KfALCA_d_DefaultLaneLength@ */ Scalar_FLOAT32_IEEE 0 ALCA_subsystem_integrated_CM_single_m 30.0 90.0 /end CHARACTERISTIC
/begin CHARACTERISTIC KfALCA_d_Dist2LaneChangeFinish "Max distance for determine lane change finished." VALUE 0x70101820 /* @ECU_Address@KfALCA_d_Dist2LaneChangeFinish@ */ Scalar_FLOAT32_IEEE 0 ALCA_subsystem_integrated_CM_single_m 0.1 3.75 /end CHARACTERISTIC
/begin CHARACTERISTIC KfALCA_d_EgoVehWheelBase "" VALUE 0x7010181c /* @ECU_Address@KfALCA_d_EgoVehWheelBase@ */ Scalar_FLOAT32_IEEE 0 ALCA_subsystem_integrated_CM_single_m -3.4E+38 3.4E+38 /end CHARACTERISTIC
/begin CHARACTERISTIC KfALCA_d_EgoVehWidth "The width of EGO." VALUE 0x70101818 /* @ECU_Address@KfALCA_d_EgoVehWidth@ */ Scalar_FLOAT32_IEEE 0 ALCA_subsystem_integrated_CM_single_m 1.5 5.0 /end CHARACTERISTIC
/begin CHARACTERISTIC KfALCA_d_EnterSecondStageThrsh "" VALUE 0x70101814 /* @ECU_Address@KfALCA_d_EnterSecondStageThrsh@ */ Scalar_FLOAT32_IEEE 0 ALCA_subsystem_integrated_CM_single_m 0.0 3.0 /end CHARACTERISTIC
/begin CHARACTERISTIC KfALCA_d_LaneWidthMax "Max width of lane." VALUE 0x70101810 /* @ECU_Address@KfALCA_d_LaneWidthMax@ */ Scalar_FLOAT32_IEEE 0 ALCA_subsystem_integrated_CM_single_m 0.1 4.0 /end CHARACTERISTIC
/begin CHARACTERISTIC KfALCA_d_TouchedNewLaneDist "Min jump distance for touched new lane." VALUE 0x7010180c /* @ECU_Address@KfALCA_d_TouchedNewLaneDist@ */ Scalar_FLOAT32_IEEE 0 ALCA_subsystem_integrated_CM_single_m 0.0 3.75 /end CHARACTERISTIC
/begin CHARACTERISTIC KfALCA_r_CoeffStrwhl2Radius "" VALUE 0x70101808 /* @ECU_Address@KfALCA_r_CoeffStrwhl2Radius@ */ Scalar_FLOAT32_IEEE 0 ALCA_subsystem_integrated_CM_single -3.4E+38 3.4E+38 /end CHARACTERISTIC
/begin CHARACTERISTIC KfALCA_r_EgoVehStrwhl2FrtwhlRatio "" VALUE 0x70101804 /* @ECU_Address@KfALCA_r_EgoVehStrwhl2FrtwhlRatio@ */ Scalar_FLOAT32_IEEE 0 ALCA_subsystem_integrated_CM_single -3.4E+38 3.4E+38 /end CHARACTERISTIC
/begin CHARACTERISTIC KfALCA_r_EgoWidth2LaneWidthRation "Target lane width must > ego_veh_width * KfALCA_r_EgoWidth2LaneWidthRation." VALUE 0x70101800 /* @ECU_Address@KfALCA_r_EgoWidth2LaneWidthRation@ */ Scalar_FLOAT32_IEEE 0 ALCA_subsystem_integrated_CM_single 1.0 3.0 /end CHARACTERISTIC
/begin CHARACTERISTIC KfALCA_r_OutputLarteralVRatio "" VALUE 0x701017fc /* @ECU_Address@KfALCA_r_OutputLarteralVRatio@ */ Scalar_FLOAT32_IEEE 0 ALCA_subsystem_integrated_CM_single 0.1 5.0 /end CHARACTERISTIC
/begin CHARACTERISTIC KfALCA_t_ExitFinishDelay "The time of wait for exit Finish state (Cooling time)." VALUE 0x701017f8 /* @ECU_Address@KfALCA_t_ExitFinishDelay@ */ Scalar_FLOAT32_IEEE 0 ALCA_subsystem_integrated_CM_single_s 0.1 3.0 /end CHARACTERISTIC
/begin CHARACTERISTIC KfALCA_t_ExitWaittingDelay "The time of wait for exit Waitting state. ALCA will inform some info to driver In Waitting state." VALUE 0x701017f4 /* @ECU_Address@KfALCA_t_ExitWaittingDelay@ */ Scalar_FLOAT32_IEEE 0 ALCA_subsystem_integrated_CM_single_s 0.1 8.0 /end CHARACTERISTIC
/begin CHARACTERISTIC KfALCA_t_HoldTimeForComplete "" VALUE 0x701017f0 /* @ECU_Address@KfALCA_t_HoldTimeForComplete@ */ Scalar_FLOAT32_IEEE 0 ALCA_subsystem_integrated_CM_single_s 0.1 6.0 /end CHARACTERISTIC
/begin CHARACTERISTIC KfALCA_t_LaneChangeTimeMax "Max time of lane change (s)." VALUE 0x701017ec /* @ECU_Address@KfALCA_t_LaneChangeTimeMax@ */ Scalar_FLOAT32_IEEE 0 ALCA_subsystem_integrated_CM_single_s 2.0 16.0 /end CHARACTERISTIC
/begin CHARACTERISTIC KfALCA_t_LaneChangeTimeMin "Min time of lane change (s)." VALUE 0x701017e8 /* @ECU_Address@KfALCA_t_LaneChangeTimeMin@ */ Scalar_FLOAT32_IEEE 0 ALCA_subsystem_integrated_CM_single_s 2.0 16.0 /end CHARACTERISTIC
/begin CHARACTERISTIC KfALCA_t_PeriodFunctionCall "The time of Period-Function-Call." VALUE 0x701017e4 /* @ECU_Address@KfALCA_t_PeriodFunctionCall@ */ Scalar_FLOAT32_IEEE 0 ALCA_subsystem_integrated_CM_single_s 0.01 1.0 /end CHARACTERISTIC
/begin CHARACTERISTIC KfALCA_t_TimeNReceivedThrsh "The threshold of time that not received OBFU/MPFU/EGMO data." VALUE 0x701017e0 /* @ECU_Address@KfALCA_t_TimeNReceivedThrsh@ */ Scalar_FLOAT32_IEEE 0 ALCA_subsystem_integrated_CM_single_s 0.1 1.0 /end CHARACTERISTIC
/begin CHARACTERISTIC KfALCA_t_WaitForDriverActionMax "The time of wait for driver`s commond in Inform state." VALUE 0x701017dc /* @ECU_Address@KfALCA_t_WaitForDriverActionMax@ */ Scalar_FLOAT32_IEEE 0 ALCA_subsystem_integrated_CM_single_s 0.0 6.0 /end CHARACTERISTIC
/begin CHARACTERISTIC KfALCA_v_LateralSpeedOfSecondStage "" VALUE 0x701017d8 /* @ECU_Address@KfALCA_v_LateralSpeedOfSecondStage@ */ Scalar_FLOAT32_IEEE 0 ALCA_subsystem_integrated_CM_single 0.0 3.0 /end CHARACTERISTIC
/begin CHARACTERISTIC KfALCA_v_SpeedLaneChangeEnblMax "The veh_speed threshold for lane change enable. (high)" VALUE 0x701017d4 /* @ECU_Address@KfALCA_v_SpeedLaneChangeEnblMax@ */ Scalar_FLOAT32_IEEE 0 ALCA_subsystem_integrated_CM_single_m_s 0.0 33.0 /end CHARACTERISTIC
/begin CHARACTERISTIC KfALCA_v_SpeedLaneChangeEnblMin "The veh_speed threshold for lane change enable. (low)" VALUE 0x701017d0 /* @ECU_Address@KfALCA_v_SpeedLaneChangeEnblMin@ */ Scalar_FLOAT32_IEEE 0 ALCA_subsystem_integrated_CM_single_m_s -1.0 22.0 /end CHARACTERISTIC
/begin CHARACTERISTIC KfAlCA_d_CheckOBFUForwardDistMax "Max forward distance for check obstacles." VALUE 0x701017cc /* @ECU_Address@KfAlCA_d_CheckOBFUForwardDistMax@ */ Scalar_FLOAT32_IEEE 0 ALCA_subsystem_integrated_CM_single_m 0.0 1000.0 /end CHARACTERISTIC
/begin CHARACTERISTIC KbALCA_ChanggLaneCancelReqOvrd "" VALUE 0x701017c8 /* @ECU_Address@KbALCA_ChanggLaneCancelReqOvrd@ */ Scalar_BOOLEAN 0 ALCA_subsystem_integrated_CM_boolean 0 1 /end CHARACTERISTIC
/begin CHARACTERISTIC KbALCA_ChanggLaneReqOvrd "" VALUE 0x701017c7 /* @ECU_Address@KbALCA_ChanggLaneReqOvrd@ */ Scalar_BOOLEAN 0 ALCA_subsystem_integrated_CM_boolean 0 1 /end CHARACTERISTIC
/begin CHARACTERISTIC KbALCA_EnblCheckMPFUFusionStatus "Enable check MPFU fusion status." VALUE 0x701017c6 /* @ECU_Address@KbALCA_EnblCheckMPFUFusionStatus@ */ Scalar_BOOLEAN 0 ALCA_subsystem_integrated_CM_boolean 0 1 /end CHARACTERISTIC
/begin CHARACTERISTIC KbALCA_EnblCheckMPFULaneMarkerType "Enable check MPFU lane marker type." VALUE 0x701017c5 /* @ECU_Address@KbALCA_EnblCheckMPFULaneMarkerType@ */ Scalar_BOOLEAN 0 ALCA_subsystem_integrated_CM_boolean 0 1 /end CHARACTERISTIC
/begin CHARACTERISTIC KbALCA_EnblCheckObstacles "" VALUE 0x701017c4 /* @ECU_Address@KbALCA_EnblCheckObstacles@ */ Scalar_BOOLEAN 0 ALCA_subsystem_integrated_CM_boolean 0 1 /end CHARACTERISTIC
/begin CHARACTERISTIC KbALCA_EnblCheckTimestamp "Enable check timestamp of MPFU/EGMO/OBFU." VALUE 0x701017c3 /* @ECU_Address@KbALCA_EnblCheckTimestamp@ */ Scalar_BOOLEAN 0 ALCA_subsystem_integrated_CM_boolean 0 1 /end CHARACTERISTIC
/begin CHARACTERISTIC KbALCA_EnblOvrdLaneLength "" VALUE 0x701017c2 /* @ECU_Address@KbALCA_EnblOvrdLaneLength@ */ Scalar_BOOLEAN 0 ALCA_subsystem_integrated_CM_boolean 0 1 /end CHARACTERISTIC
/begin CHARACTERISTIC KbALCA_EnblOvrdReqFromECSN "" VALUE 0x701017c1 /* @ECU_Address@KbALCA_EnblOvrdReqFromECSN@ */ Scalar_BOOLEAN 0 ALCA_subsystem_integrated_CM_boolean 0 1 /end CHARACTERISTIC
/begin CHARACTERISTIC KeALCA_ChangeLaneReqSideOvrd "" VALUE 0x701017c0 /* @ECU_Address@KeALCA_ChangeLaneReqSideOvrd@ */ Scalar_UBYTE 0 ALCA_subsystem_integrated_CM_EnumDCSN_driving_direction 0 2 /end CHARACTERISTIC
/begin AXIS_PTS KtACCS_AXIS_OpenAccelStop_StopDis "The axis for the calibration KtACCS_t_CalOpenAccelForStopFrmDCSN" 0x70100ebc /* @ECU_Address@KtACCS_AXIS_OpenAccelStop_StopDis@ */ NO_INPUT_QUANTITY Lookup1D_X_FLOAT32_IEEE 0 ACCS_subsystem_integrated_CM_single_m 6 0.0 200.0 /end AXIS_PTS
/begin AXIS_PTS KtACCS_AXIS_OpenAccelSpedCtrl_SpedErr "This is speed error axis for KtACCS_OpenAccel_SpeedCtrl" 0x70100ed4 /* @ECU_Address@KtACCS_AXIS_OpenAccelSpedCtrl_SpedErr@ */ NO_INPUT_QUANTITY Lookup1D_X_FLOAT32_IEEE 0 ACCS_subsystem_integrated_CM_single_m_s 7 -30.0 30.0 /end AXIS_PTS
/begin AXIS_PTS KtACCS_AXIS_OpenAccelLowSpedCtrl_SpedErr "This is speed error axis for KtACCS_a_OpenAccel_LowSpeedCtrl" 0x70100ef0 /* @ECU_Address@KtACCS_AXIS_OpenAccelLowSpedCtrl_SpedErr@ */ NO_INPUT_QUANTITY Lookup1D_X_FLOAT32_IEEE 0 ACCS_subsystem_integrated_CM_single_m_s 7 -45.0 45.0 /end AXIS_PTS
/begin AXIS_PTS KtACCS_AXIS_OpenAccelLaunch_CurSpd "This is vehcile speed axis for KtACCS_OpenAccel_Launch" 0x70100f0c /* @ECU_Address@KtACCS_AXIS_OpenAccelLaunch_CurSpd@ */ NO_INPUT_QUANTITY Lookup1D_X_FLOAT32_IEEE 0 ACCS_subsystem_integrated_CM_single_m_s 6 0.0 50.0 /end AXIS_PTS
/begin AXIS_PTS KtACCS_AXIS_StopStatus_Accel_Pitch "This is Pitch axis for KtACCS_StopStatus_Accel" 0x70100e24 /* @ECU_Address@KtACCS_AXIS_StopStatus_Accel_Pitch@ */ NO_INPUT_QUANTITY Lookup1D_X_FLOAT32_IEEE 0 ACCS_subsystem_integrated_CM_single_deg 10 0.0 90.0 /end AXIS_PTS
/begin AXIS_PTS KtLCCS_AXIS_lanemark_switch_time "Lane marker switch time." 0x70102100 /* @ECU_Address@KtLCCS_AXIS_lanemark_switch_time@ */ VfLCCS_left_lanemark_switch_time Lookup1D_X_FLOAT32_IEEE 0 LCCS_subsystem_integrated_CM_single_s 21 0.0 10.0 /end AXIS_PTS
/begin AXIS_PTS KtLCCS_AXIS_route_curvature "Curvature axis." 0x701020ec /* @ECU_Address@KtLCCS_AXIS_route_curvature@ */ NO_INPUT_QUANTITY Lookup2D_X_FLOAT32_IEEE 0 LCCS_subsystem_integrated_CM_single 5 -3.4E+38 3.4E+38 /end AXIS_PTS
/begin AXIS_PTS KtLCCS_AXIS_vehicle_speed "Vehicle speed axis." 0x70102098 /* @ECU_Address@KtLCCS_AXIS_vehicle_speed@ */ VfLCCS_linear_velocity Lookup2D_X_FLOAT32_IEEE 0 LCCS_subsystem_integrated_CM_single 21 -3.4E+38 3.4E+38 /end AXIS_PTS
/begin AXIS_PTS KtLCCS_AXIS_heading_error "AXIS for heading error." 0x70102154 /* @ECU_Address@KtLCCS_AXIS_heading_error@ */ NO_INPUT_QUANTITY Lookup1D_X_FLOAT32_IEEE 0 LCCS_subsystem_integrated_CM_single_rad 21 0.0 0.1 /end AXIS_PTS
/begin MEASUREMENT VfDCSN_raw_stop_line_distance "The raw stop line distance from mpfu" FLOAT32_IEEE DCSN_subsystem_integrated_CM_single_m 0 0 -3.4E+38 3.4E+38 ECU_ADDRESS 0x70004190 /* @ECU_Address@VfDCSN_raw_stop_line_distance@ */ /end MEASUREMENT
/begin MEASUREMENT VfDCSN_C_cond_act_time "The time count from driver presses activate switch and release the brake pedal.
      Valid when driver want to activate autodrive when brake or gas pedal pressed." UWORD DCSN_subsystem_integrated_CM_uint16 0 0 0 65535 ECU_ADDRESS 0x7000417c /* @ECU_Address@VfDCSN_C_cond_act_time@ */ /end MEASUREMENT
/begin MEASUREMENT VfDCSN_mpfu_num_stop_lines "The number of input numbers of stop lines from mpfu" UBYTE DCSN_subsystem_integrated_CM_uint8 0 0 0 255 ECU_ADDRESS 0x7000417a /* @ECU_Address@VfDCSN_mpfu_num_stop_lines@ */ /end MEASUREMENT
/begin MEASUREMENT VbDCSN_CL_delay_finished "Change lane request confirmed.
      Delay finished." UBYTE DCSN_subsystem_integrated_CM_boolean 0 0 0 1 ECU_ADDRESS 0x70004178 /* @ECU_Address@VbDCSN_CL_delay_finished@ */ /end MEASUREMENT
/begin MEASUREMENT VbDCSN_num_stop_lines_isNaN "The output stop lines number from mpfu" UBYTE DCSN_subsystem_integrated_CM_boolean 0 0 0 1 ECU_ADDRESS 0x70004177 /* @ECU_Address@VbDCSN_num_stop_lines_isNaN@ */ /end MEASUREMENT
/begin MEASUREMENT VbDCSN_has_valid_stop_line "0 = no valid stop line
      1 = has valid stop line" UBYTE DCSN_subsystem_integrated_CM_boolean 0 0 0 1 ECU_ADDRESS 0x70004176 /* @ECU_Address@VbDCSN_has_valid_stop_line@ */ /end MEASUREMENT
/begin MEASUREMENT VbDCSN_stop_line_distance_isNaN "0 = distance from stop line is valid
      1 = distance from stop line is NaN" UBYTE DCSN_subsystem_integrated_CM_boolean 0 0 0 1 ECU_ADDRESS 0x70004175 /* @ECU_Address@VbDCSN_stop_line_distance_isNaN@ */ /end MEASUREMENT
/begin MEASUREMENT VbDCSN_raw_stop_finished "The raw signal:
      Whether ACCS has finished stop request before the stop line." UBYTE DCSN_subsystem_integrated_CM_boolean 0 0 0 1 ECU_ADDRESS 0x70004173 /* @ECU_Address@VbDCSN_raw_stop_finished@ */ /end MEASUREMENT
/begin MEASUREMENT VbDCSN_hold_stop_finished "The time hold signal:
      Whether ACCS has finished stop request before the stop line." UBYTE DCSN_subsystem_integrated_CM_boolean 0 0 0 1 ECU_ADDRESS 0x70004172 /* @ECU_Address@VbDCSN_hold_stop_finished@ */ /end MEASUREMENT
/begin MEASUREMENT VbDCSN_raw_stop_finished_late "The raw signal:
      Whether ACCS has finished stop request after the stop line." UBYTE DCSN_subsystem_integrated_CM_boolean 0 0 0 1 ECU_ADDRESS 0x70004171 /* @ECU_Address@VbDCSN_raw_stop_finished_late@ */ /end MEASUREMENT
/begin MEASUREMENT VbDCSN_should_send_stop_req "0 = should not send stop req
      1 = should send stop req" UBYTE DCSN_subsystem_integrated_CM_boolean 0 0 0 1 ECU_ADDRESS 0x7000416f /* @ECU_Address@VbDCSN_should_send_stop_req@ */ /end MEASUREMENT
/begin MEASUREMENT VbDCSN_stop_line_is_close "0 = stop line is far
      1 = stop line is close and will be updated by vehicle speed" UBYTE DCSN_subsystem_integrated_CM_boolean 0 0 0 1 ECU_ADDRESS 0x7000416e /* @ECU_Address@VbDCSN_stop_line_is_close@ */ /end MEASUREMENT
/begin MEASUREMENT VbDCSN_stop_unsuccess "Whether the ego vehicle failed to stop for this stop request" UBYTE DCSN_subsystem_integrated_CM_boolean 0 0 0 1 ECU_ADDRESS 0x7000416d /* @ECU_Address@VbDCSN_stop_unsuccess@ */ /end MEASUREMENT
/begin MEASUREMENT VbDCSN_num_lanes_isNaN "Whether lanes number from mpfu is NaN" UBYTE DCSN_subsystem_integrated_CM_boolean 0 0 0 1 ECU_ADDRESS 0x7000416a /* @ECU_Address@VbDCSN_num_lanes_isNaN@ */ /end MEASUREMENT
/begin MEASUREMENT VbDCSN_stop_line_input_isNaN "0 = input is valid
      1 = input is NaN" UBYTE DCSN_subsystem_integrated_CM_boolean 0 0 0 1 ECU_ADDRESS 0x70004162 /* @ECU_Address@VbDCSN_stop_line_input_isNaN@ */ /end MEASUREMENT
/begin MEASUREMENT VeDCSN_CL_req_side_pre "0 = FORWARD
      1 = LEFT
      2 = RIGHT" UBYTE DCSN_subsystem_integrated_CM_EnumDCSN_driving_direction 0 0 0 2 ECU_ADDRESS 0x70004147 /* @ECU_Address@VeDCSN_CL_req_side_pre@ */ /end MEASUREMENT
/begin MEASUREMENT VeDCSN_stop_request_mode "0 = NotEnabled
      1 = WaitForValidStopLine
      2 = CheckStopCond
      3 = SendStopReqEgmoDis
      4 = UpdateStopDis
      5 = HoldForStopLineUpdate" UBYTE DCSN_subsystem_integrated_CM_EnumDCSN_stop_request_mode 0 0 0 5 ECU_ADDRESS 0x7000413c /* @ECU_Address@VeDCSN_stop_request_mode@ */ /end MEASUREMENT
/begin MEASUREMENT VfLCCS_timestamp_EGMO "Timestamp of EGMO interface." FLOAT64_IEEE LCCS_subsystem_integrated_CM_double_s 0 0 -1.7E+308 1.7E+308 ECU_ADDRESS 0xb0004734 /* @ECU_Address@VfLCCS_timestamp_EGMO@ */ /end MEASUREMENT
/begin MEASUREMENT VfLCCS_timestamp_MPFU "Timestamp of MPFU interface." FLOAT64_IEEE LCCS_subsystem_integrated_CM_double_s 0 0 -1.7E+308 1.7E+308 ECU_ADDRESS 0xb000472c /* @ECU_Address@VfLCCS_timestamp_MPFU@ */ /end MEASUREMENT
/begin MEASUREMENT VfLCCS_steering_angle_diff_abs "Steering angle delta absolute value." FLOAT32_IEEE LCCS_subsystem_integrated_CM_single 0 0 -3.4E+38 3.4E+38 ECU_ADDRESS 0xb0004728 /* @ECU_Address@VfLCCS_steering_angle_diff_abs@ */ /end MEASUREMENT
/begin MEASUREMENT VfLCCS_veh_roll_utm "Roll value from UTM coordinates." FLOAT32_IEEE LCCS_subsystem_integrated_CM_single_rad 0 0 -3.4E+38 3.4E+38 ECU_ADDRESS 0xb0004724 /* @ECU_Address@VfLCCS_veh_roll_utm@ */ /end MEASUREMENT
/begin MEASUREMENT VfLCCS_linear_velocity "Linear velocity." FLOAT32_IEEE LCCS_subsystem_integrated_CM_single 0 0 -3.4E+38 3.4E+38 ECU_ADDRESS 0xb0004720 /* @ECU_Address@VfLCCS_linear_velocity@ */ /end MEASUREMENT
/begin MEASUREMENT VfLCCS_veh_heading_rel "Slip angle of center of mass." FLOAT32_IEEE LCCS_subsystem_integrated_CM_single 0 0 -3.4E+38 3.4E+38 ECU_ADDRESS 0xb000471c /* @ECU_Address@VfLCCS_veh_heading_rel@ */ /end MEASUREMENT
/begin MEASUREMENT VfLCCS_velocity_rel_y "Longitudinal speed Vy." FLOAT32_IEEE LCCS_subsystem_integrated_CM_single 0 0 -3.4E+38 3.4E+38 ECU_ADDRESS 0xb0004718 /* @ECU_Address@VfLCCS_velocity_rel_y@ */ /end MEASUREMENT
/begin MEASUREMENT VfLCCS_velocity_rel_x "Lateral speed Vx." FLOAT32_IEEE LCCS_subsystem_integrated_CM_single 0 0 -3.4E+38 3.4E+38 ECU_ADDRESS 0xb0004714 /* @ECU_Address@VfLCCS_velocity_rel_x@ */ /end MEASUREMENT
/begin MEASUREMENT VfLCCS_VCU1_ICPV_StrAngle "Steering wheel angle from CAN." FLOAT32_IEEE LCCS_subsystem_integrated_CM_single 0 0 -3.4E+38 3.4E+38 ECU_ADDRESS 0xb0004710 /* @ECU_Address@VfLCCS_VCU1_ICPV_StrAngle@ */ /end MEASUREMENT
/begin MEASUREMENT VfLCCS_lateral_v_from_ALCA "ALCA requested lateral speed to shift lane center." FLOAT32_IEEE LCCS_subsystem_integrated_CM_single_m_s 0 0 -3.4E+38 3.4E+38 ECU_ADDRESS 0xb000470c /* @ECU_Address@VfLCCS_lateral_v_from_ALCA@ */ /end MEASUREMENT
/begin MEASUREMENT VfLCCS_veh_heading_utm "Slip angle of center of mass." FLOAT32_IEEE LCCS_subsystem_integrated_CM_single 0 0 -3.4E+38 3.4E+38 ECU_ADDRESS 0xb0004708 /* @ECU_Address@VfLCCS_veh_heading_utm@ */ /end MEASUREMENT
/begin MEASUREMENT VfLCCS_lookahead_distance "Lookahead distance." FLOAT32_IEEE LCCS_subsystem_integrated_CM_single 0 0 -3.4E+38 3.4E+38 ECU_ADDRESS 0xb0004704 /* @ECU_Address@VfLCCS_lookahead_distance@ */ /end MEASUREMENT
/begin MEASUREMENT VfLCCS_veh_frtwhl_angle_act "Vehicle front wheel angle actual value." FLOAT32_IEEE LCCS_subsystem_integrated_CM_single 0 0 -3.4E+38 3.4E+38 ECU_ADDRESS 0xb0004700 /* @ECU_Address@VfLCCS_veh_frtwhl_angle_act@ */ /end MEASUREMENT
/begin MEASUREMENT VfLCCS_raw_lane_width "Raw lane width." FLOAT32_IEEE LCCS_subsystem_integrated_CM_single 0 0 -3.4E+38 3.4E+38 ECU_ADDRESS 0xb00046fc /* @ECU_Address@VfLCCS_raw_lane_width@ */ /end MEASUREMENT
/begin MEASUREMENT VaLCCS_raw_left_lanemark "Raw left lanemark." FLOAT32_IEEE LCCS_subsystem_integrated_CM_single 0 0 -3.4E+38 3.4E+38 ARRAY_SIZE 6 ECU_ADDRESS 0xb00046e4 /* @ECU_Address@VaLCCS_raw_left_lanemark@ */ /end MEASUREMENT
/begin MEASUREMENT VaLCCS_raw_right_lanemark "Raw right lanemark." FLOAT32_IEEE LCCS_subsystem_integrated_CM_single 0 0 -3.4E+38 3.4E+38 ARRAY_SIZE 6 ECU_ADDRESS 0xb00046cc /* @ECU_Address@VaLCCS_raw_right_lanemark@ */ /end MEASUREMENT
/begin MEASUREMENT VfLCCS_smoothed_lane_width "Smoothed lane width." FLOAT32_IEEE LCCS_subsystem_integrated_CM_single 0 0 -3.4E+38 3.4E+38 ECU_ADDRESS 0xb00046c8 /* @ECU_Address@VfLCCS_smoothed_lane_width@ */ /end MEASUREMENT
/begin MEASUREMENT VfLCCS_left_lanemark_confidence "" FLOAT32_IEEE LCCS_subsystem_integrated_CM_single 0 0 -3.4E+38 3.4E+38 ECU_ADDRESS 0xb00046c4 /* @ECU_Address@VfLCCS_left_lanemark_confidence@ */ /end MEASUREMENT
/begin MEASUREMENT VfLCCS_right_lanemark_confidence "" FLOAT32_IEEE LCCS_subsystem_integrated_CM_single 0 0 -3.4E+38 3.4E+38 ECU_ADDRESS 0xb00046c0 /* @ECU_Address@VfLCCS_right_lanemark_confidence@ */ /end MEASUREMENT
/begin MEASUREMENT VaLCCS_virtual_left_lanemark "Virtual left lanemark." FLOAT32_IEEE LCCS_subsystem_integrated_CM_single 0 0 -3.4E+38 3.4E+38 ARRAY_SIZE 4 ECU_ADDRESS 0xb00046b0 /* @ECU_Address@VaLCCS_virtual_left_lanemark@ */ /end MEASUREMENT
/begin MEASUREMENT VaLCCS_virtual_right_lanemark "Virtual right lanemark." FLOAT32_IEEE LCCS_subsystem_integrated_CM_single 0 0 -3.4E+38 3.4E+38 ARRAY_SIZE 4 ECU_ADDRESS 0xb00046a0 /* @ECU_Address@VaLCCS_virtual_right_lanemark@ */ /end MEASUREMENT
/begin MEASUREMENT VfLCCS_c0_scaling "c0 scaling factor against lane width." FLOAT32_IEEE LCCS_subsystem_integrated_CM_single 0 0 -3.4E+38 3.4E+38 ECU_ADDRESS 0xb000469c /* @ECU_Address@VfLCCS_c0_scaling@ */ /end MEASUREMENT
/begin MEASUREMENT VfLCCS_target_lateral_shift_width "Target shift width for lane change or inlane nudge." FLOAT32_IEEE LCCS_subsystem_integrated_CM_single 0 0 -3.4E+38 3.4E+38 ECU_ADDRESS 0xb0004698 /* @ECU_Address@VfLCCS_target_lateral_shift_width@ */ /end MEASUREMENT
/begin MEASUREMENT VfLCCS_lateral_shift_step "Lane change or nudge shift lateral distance step." FLOAT32_IEEE LCCS_subsystem_integrated_CM_single 0 0 -3.4E+38 3.4E+38 ECU_ADDRESS 0xb0004694 /* @ECU_Address@VfLCCS_lateral_shift_step@ */ /end MEASUREMENT
/begin MEASUREMENT VfLCCS_lateral_dist_to_go "Lateral distance from shifted lane center to target lane center." FLOAT32_IEEE LCCS_subsystem_integrated_CM_single_m 0 0 -3.4E+38 3.4E+38 ECU_ADDRESS 0xb0004690 /* @ECU_Address@VfLCCS_lateral_dist_to_go@ */ /end MEASUREMENT
/begin MEASUREMENT VfLCCS_lateral_shift_width "Lane change or inlane nudge lateral shift width, which is an offset to raw lane center." FLOAT32_IEEE LCCS_subsystem_integrated_CM_single 0 0 -3.4E+38 3.4E+38 ECU_ADDRESS 0xb000468c /* @ECU_Address@VfLCCS_lateral_shift_width@ */ /end MEASUREMENT
/begin MEASUREMENT VaLCCS_shifted_lane_center_line "Shifted lane center line." FLOAT32_IEEE LCCS_subsystem_integrated_CM_single 0 0 -3.4E+38 3.4E+38 ARRAY_SIZE 4 ECU_ADDRESS 0xb000467c /* @ECU_Address@VaLCCS_shifted_lane_center_line@ */ /end MEASUREMENT
/begin MEASUREMENT VfLCCS_frtwhl_angle_step_limit "Front wheel angle step limit." FLOAT32_IEEE LCCS_subsystem_integrated_CM_single 0 0 -3.4E+38 3.4E+38 ECU_ADDRESS 0xb0004678 /* @ECU_Address@VfLCCS_frtwhl_angle_step_limit@ */ /end MEASUREMENT
/begin MEASUREMENT VfLCCS_frtwhl_angle_limit_manual "Front wheel angle limit manual." FLOAT32_IEEE LCCS_subsystem_integrated_CM_single 0 0 -3.4E+38 3.4E+38 ECU_ADDRESS 0xb0004674 /* @ECU_Address@VfLCCS_frtwhl_angle_limit_manual@ */ /end MEASUREMENT
/begin MEASUREMENT VfLCCS_veh_frtwhl_angle_des_ramped "Vehicle front wheel angle desired value ramped." FLOAT32_IEEE LCCS_subsystem_integrated_CM_single 0 0 -3.4E+38 3.4E+38 ECU_ADDRESS 0xb0004670 /* @ECU_Address@VfLCCS_veh_frtwhl_angle_des_ramped@ */ /end MEASUREMENT
/begin MEASUREMENT VfLCCS_veh_strwhl_angle_des "Desired steering wheel angle." FLOAT32_IEEE LCCS_subsystem_integrated_CM_single 0 0 -3.4E+38 3.4E+38 ECU_ADDRESS 0xb000466c /* @ECU_Address@VfLCCS_veh_strwhl_angle_des@ */ /end MEASUREMENT
/begin MEASUREMENT VfLCCS_steer_angle_feedback "Steer angle feedback." FLOAT32_IEEE LCCS_subsystem_integrated_CM_single 0 0 -3.4E+38 3.4E+38 ECU_ADDRESS 0xb0004668 /* @ECU_Address@VfLCCS_steer_angle_feedback@ */ /end MEASUREMENT
/begin MEASUREMENT VfLCCS_slowpath_steer_P "Slowpath steer P part." FLOAT32_IEEE LCCS_subsystem_integrated_CM_single 0 0 -3.4E+38 3.4E+38 ECU_ADDRESS 0xb0004664 /* @ECU_Address@VfLCCS_slowpath_steer_P@ */ /end MEASUREMENT
/begin MEASUREMENT VfLCCS_slowpath_steer_I "Slowpath steer I part." FLOAT32_IEEE LCCS_subsystem_integrated_CM_single 0 0 -3.4E+38 3.4E+38 ECU_ADDRESS 0xb0004660 /* @ECU_Address@VfLCCS_slowpath_steer_I@ */ /end MEASUREMENT
/begin MEASUREMENT VfLCCS_slowpath_steer_PI "Slowpath steer PI part." FLOAT32_IEEE LCCS_subsystem_integrated_CM_single 0 0 -3.4E+38 3.4E+38 ECU_ADDRESS 0xb000465c /* @ECU_Address@VfLCCS_slowpath_steer_PI@ */ /end MEASUREMENT
/begin MEASUREMENT VfLCCS_frtwhl_angle_limit_lat_acc "Front wheel angle limit lat acc." FLOAT32_IEEE LCCS_subsystem_integrated_CM_single 0 0 -3.4E+38 3.4E+38 ECU_ADDRESS 0xb0004658 /* @ECU_Address@VfLCCS_frtwhl_angle_limit_lat_acc@ */ /end MEASUREMENT
/begin MEASUREMENT VfLCCS_veh_frtwhl_angle_des "Vehicle front wheel angle desired value raw." FLOAT32_IEEE LCCS_subsystem_integrated_CM_single 0 0 -3.4E+38 3.4E+38 ECU_ADDRESS 0xb0004654 /* @ECU_Address@VfLCCS_veh_frtwhl_angle_des@ */ /end MEASUREMENT
/begin MEASUREMENT VfLCCS_heading_error_contribution "Heading error contribution." FLOAT32_IEEE LCCS_subsystem_integrated_CM_single 0 0 -3.4E+38 3.4E+38 ECU_ADDRESS 0xb0004650 /* @ECU_Address@VfLCCS_heading_error_contribution@ */ /end MEASUREMENT
/begin MEASUREMENT VfLCCS_heading_error_rate_contribution "Heading error rate contribution." FLOAT32_IEEE LCCS_subsystem_integrated_CM_single 0 0 -3.4E+38 3.4E+38 ECU_ADDRESS 0xb000464c /* @ECU_Address@VfLCCS_heading_error_rate_contribution@ */ /end MEASUREMENT
/begin MEASUREMENT VfLCCS_lateral_error_contribution "Lateral error contribution." FLOAT32_IEEE LCCS_subsystem_integrated_CM_single 0 0 -3.4E+38 3.4E+38 ECU_ADDRESS 0xb0004648 /* @ECU_Address@VfLCCS_lateral_error_contribution@ */ /end MEASUREMENT
/begin MEASUREMENT VfLCCS_lateral_error_rate_contribution "Lateral error rate contribution." FLOAT32_IEEE LCCS_subsystem_integrated_CM_single 0 0 -3.4E+38 3.4E+38 ECU_ADDRESS 0xb0004644 /* @ECU_Address@VfLCCS_lateral_error_rate_contribution@ */ /end MEASUREMENT
/begin MEASUREMENT VfLCCS_left_lanemark_switch_time "Left lanemark switch time." FLOAT32_IEEE LCCS_subsystem_integrated_CM_single 0 0 -3.4E+38 3.4E+38 ECU_ADDRESS 0xb0004640 /* @ECU_Address@VfLCCS_left_lanemark_switch_time@ */ /end MEASUREMENT
/begin MEASUREMENT VaLCCS_final_left_lanemark "Final left lanemarker." FLOAT32_IEEE LCCS_subsystem_integrated_CM_single 0 0 -3.4E+38 3.4E+38 ARRAY_SIZE 4 ECU_ADDRESS 0xb0004630 /* @ECU_Address@VaLCCS_final_left_lanemark@ */ /end MEASUREMENT
/begin MEASUREMENT VfLCCS_right_lanemark_switch_time "Right lanemark switch time." FLOAT32_IEEE LCCS_subsystem_integrated_CM_single 0 0 -3.4E+38 3.4E+38 ECU_ADDRESS 0xb000462c /* @ECU_Address@VfLCCS_right_lanemark_switch_time@ */ /end MEASUREMENT
/begin MEASUREMENT VaLCCS_final_right_lanemark "Final right lanemarker." FLOAT32_IEEE LCCS_subsystem_integrated_CM_single 0 0 -3.4E+38 3.4E+38 ARRAY_SIZE 4 ECU_ADDRESS 0xb000461c /* @ECU_Address@VaLCCS_final_right_lanemark@ */ /end MEASUREMENT
/begin MEASUREMENT VaLCCS_raw_lane_center_line "Raw lane center line." FLOAT32_IEEE LCCS_subsystem_integrated_CM_single 0 0 -3.4E+38 3.4E+38 ARRAY_SIZE 4 ECU_ADDRESS 0xb000460c /* @ECU_Address@VaLCCS_raw_lane_center_line@ */ /end MEASUREMENT
/begin MEASUREMENT VaLCCS_com_point "Center of mass position." FLOAT32_IEEE LCCS_subsystem_integrated_CM_single 0 0 -3.4E+38 3.4E+38 ARRAY_SIZE 3 ECU_ADDRESS 0xb0004600 /* @ECU_Address@VaLCCS_com_point@ */ /end MEASUREMENT
/begin MEASUREMENT VaLCCS_preview_proj_point "Lookahead point projection position." FLOAT32_IEEE LCCS_subsystem_integrated_CM_single 0 0 -3.4E+38 3.4E+38 ARRAY_SIZE 3 ECU_ADDRESS 0xb00045f4 /* @ECU_Address@VaLCCS_preview_proj_point@ */ /end MEASUREMENT
/begin MEASUREMENT VfLCCS_lookahead_angle "Lookahead angle." FLOAT32_IEEE LCCS_subsystem_integrated_CM_single 0 0 -3.4E+38 3.4E+38 ECU_ADDRESS 0xb00045f0 /* @ECU_Address@VfLCCS_lookahead_angle@ */ /end MEASUREMENT
/begin MEASUREMENT VaLCCS_com_proj_point "Center of mass projection point position." FLOAT32_IEEE LCCS_subsystem_integrated_CM_single 0 0 -3.4E+38 3.4E+38 ARRAY_SIZE 3 ECU_ADDRESS 0xb00045e4 /* @ECU_Address@VaLCCS_com_proj_point@ */ /end MEASUREMENT
/begin MEASUREMENT VfLCCS_lateral_error "Lateral error." FLOAT32_IEEE LCCS_subsystem_integrated_CM_single 0 0 -3.4E+38 3.4E+38 ECU_ADDRESS 0xb00045e0 /* @ECU_Address@VfLCCS_lateral_error@ */ /end MEASUREMENT
/begin MEASUREMENT VfLCCS_lateral_error_rate "Lateral error rate." FLOAT32_IEEE LCCS_subsystem_integrated_CM_single 0 0 -3.4E+38 3.4E+38 ECU_ADDRESS 0xb00045dc /* @ECU_Address@VfLCCS_lateral_error_rate@ */ /end MEASUREMENT
/begin MEASUREMENT VfLCCS_heading_error_rate "Heading error rate." FLOAT32_IEEE LCCS_subsystem_integrated_CM_single 0 0 -3.4E+38 3.4E+38 ECU_ADDRESS 0xb00045d8 /* @ECU_Address@VfLCCS_heading_error_rate@ */ /end MEASUREMENT
/begin MEASUREMENT VfLCCS_heading_error "Heading error." FLOAT32_IEEE LCCS_subsystem_integrated_CM_single 0 0 -3.4E+38 3.4E+38 ECU_ADDRESS 0xb00045d4 /* @ECU_Address@VfLCCS_heading_error@ */ /end MEASUREMENT
/begin MEASUREMENT VfLCCS_preview_curvature "The lane center curvature of preview projection point." FLOAT32_IEEE LCCS_subsystem_integrated_CM_single 0 0 -3.4E+38 3.4E+38 ECU_ADDRESS 0xb00045d0 /* @ECU_Address@VfLCCS_preview_curvature@ */ /end MEASUREMENT
/begin MEASUREMENT VcLCCS_VCU1_ICPV_EPSMODE "EPS control mode feedback." UBYTE LCCS_subsystem_integrated_CM_uint8 0 0 0 255 ECU_ADDRESS 0xb00045cc /* @ECU_Address@VcLCCS_VCU1_ICPV_EPSMODE@ */ /end MEASUREMENT
/begin MEASUREMENT VfLCCS_num_lane_markers "" UBYTE LCCS_subsystem_integrated_CM_uint8 0 0 0 255 ECU_ADDRESS 0xb00045cb /* @ECU_Address@VfLCCS_num_lane_markers@ */ /end MEASUREMENT
/begin MEASUREMENT VcLCCS_num_iteration "" UBYTE LCCS_subsystem_integrated_CM_uint8 0 0 0 255 ECU_ADDRESS 0xb00045ca /* @ECU_Address@VcLCCS_num_iteration@ */ /end MEASUREMENT
/begin MEASUREMENT VbLCCS_steering_control_active "Steering control active." UBYTE LCCS_subsystem_integrated_CM_boolean 0 0 0 1 ECU_ADDRESS 0xb00045c9 /* @ECU_Address@VbLCCS_steering_control_active@ */ /end MEASUREMENT
/begin MEASUREMENT VbLCCS_LCC_ReadyToEngage "LCC ReadyToEngage." UBYTE LCCS_subsystem_integrated_CM_boolean 0 0 0 1 ECU_ADDRESS 0xb00045c8 /* @ECU_Address@VbLCCS_LCC_ReadyToEngage@ */ /end MEASUREMENT
/begin MEASUREMENT VbLCCS_steering_control_stable "Steering control stable." UBYTE LCCS_subsystem_integrated_CM_boolean 0 0 0 1 ECU_ADDRESS 0xb00045c7 /* @ECU_Address@VbLCCS_steering_control_stable@ */ /end MEASUREMENT
/begin MEASUREMENT VbLCCS_steering_control_engaged "Steering control engaged." UBYTE LCCS_subsystem_integrated_CM_boolean 0 0 0 1 ECU_ADDRESS 0xb00045c6 /* @ECU_Address@VbLCCS_steering_control_engaged@ */ /end MEASUREMENT
/begin MEASUREMENT VbLCCS_lateral_movement_enabled "Flag to indicate lateral movement is allowed." UBYTE LCCS_subsystem_integrated_CM_boolean 0 0 0 1 ECU_ADDRESS 0xb00045c5 /* @ECU_Address@VbLCCS_lateral_movement_enabled@ */ /end MEASUREMENT
/begin MEASUREMENT VbLCCS_input_isNaN_EGMO "" UBYTE LCCS_subsystem_integrated_CM_boolean 0 0 0 1 ECU_ADDRESS 0xb00045c4 /* @ECU_Address@VbLCCS_input_isNaN_EGMO@ */ /end MEASUREMENT
/begin MEASUREMENT VbLCCS_input_isNaN_COMM "" UBYTE LCCS_subsystem_integrated_CM_boolean 0 0 0 1 ECU_ADDRESS 0xb00045c3 /* @ECU_Address@VbLCCS_input_isNaN_COMM@ */ /end MEASUREMENT
/begin MEASUREMENT VbLCCS_lane_change_request "" UBYTE LCCS_subsystem_integrated_CM_boolean 0 0 0 1 ECU_ADDRESS 0xb00045c2 /* @ECU_Address@VbLCCS_lane_change_request@ */ /end MEASUREMENT
/begin MEASUREMENT VbLCCS_inlane_nudge_request "Inlane nudge request." UBYTE LCCS_subsystem_integrated_CM_boolean 0 0 0 1 ECU_ADDRESS 0xb00045c1 /* @ECU_Address@VbLCCS_inlane_nudge_request@ */ /end MEASUREMENT
/begin MEASUREMENT VbLCCS_input_isNaN_DCSN "" UBYTE LCCS_subsystem_integrated_CM_boolean 0 0 0 1 ECU_ADDRESS 0xb00045c0 /* @ECU_Address@VbLCCS_input_isNaN_DCSN@ */ /end MEASUREMENT
/begin MEASUREMENT VbLCCS_lcc_feature_enable "" UBYTE LCCS_subsystem_integrated_CM_boolean 0 0 0 1 ECU_ADDRESS 0xb00045bf /* @ECU_Address@VbLCCS_lcc_feature_enable@ */ /end MEASUREMENT
/begin MEASUREMENT VbLCCS_steer_control_enable "LCC is allowed by decision module." UBYTE LCCS_subsystem_integrated_CM_boolean 0 0 0 1 ECU_ADDRESS 0xb00045be /* @ECU_Address@VbLCCS_steer_control_enable@ */ /end MEASUREMENT
/begin MEASUREMENT VbLCCS_input_isNaN_ALCA "" UBYTE LCCS_subsystem_integrated_CM_boolean 0 0 0 1 ECU_ADDRESS 0xb00045bd /* @ECU_Address@VbLCCS_input_isNaN_ALCA@ */ /end MEASUREMENT
/begin MEASUREMENT VbLCCS_input_isNaN_MPFU "" UBYTE LCCS_subsystem_integrated_CM_boolean 0 0 0 1 ECU_ADDRESS 0xb00045bc /* @ECU_Address@VbLCCS_input_isNaN_MPFU@ */ /end MEASUREMENT
/begin MEASUREMENT VbLCCS_left_lanemark_valid "Left lanemark valid." UBYTE LCCS_subsystem_integrated_CM_boolean 0 0 0 1 ECU_ADDRESS 0xb00045bb /* @ECU_Address@VbLCCS_left_lanemark_valid@ */ /end MEASUREMENT
/begin MEASUREMENT VbLCCS_right_lanemark_valid "Right lanemark valid." UBYTE LCCS_subsystem_integrated_CM_boolean 0 0 0 1 ECU_ADDRESS 0xb00045ba /* @ECU_Address@VbLCCS_right_lanemark_valid@ */ /end MEASUREMENT
/begin MEASUREMENT VbLCCS_both_lanemark_available "" UBYTE LCCS_subsystem_integrated_CM_boolean 0 0 0 1 ECU_ADDRESS 0xb00045b9 /* @ECU_Address@VbLCCS_both_lanemark_available@ */ /end MEASUREMENT
/begin MEASUREMENT VbLCCS_shifting_in_progress "Flag to indicate lateral shifting is in progress." UBYTE LCCS_subsystem_integrated_CM_boolean 0 0 0 1 ECU_ADDRESS 0xb00045b8 /* @ECU_Address@VbLCCS_shifting_in_progress@ */ /end MEASUREMENT
/begin MEASUREMENT VbLCCS_touched_new_lane "Flag to to indicate that ego car has crossed lane marker." UBYTE LCCS_subsystem_integrated_CM_boolean 0 0 0 1 ECU_ADDRESS 0xb00045b7 /* @ECU_Address@VbLCCS_touched_new_lane@ */ /end MEASUREMENT
/begin MEASUREMENT VeLCCS_shifting_direction_raw "Inlane nudge or lane change shifting_direction. 1 = left. 2 = right." UBYTE LCCS_subsystem_integrated_CM_EnumDCSN_driving_direction 0 0 0 2 ECU_ADDRESS 0xb00045b6 /* @ECU_Address@VeLCCS_shifting_direction_raw@ */ /end MEASUREMENT
/begin MEASUREMENT VeLCCS_shifting_direction_final "Inlane nudge or lane change shifting_direction." UBYTE LCCS_subsystem_integrated_CM_EnumDCSN_driving_direction 0 0 0 2 ECU_ADDRESS 0xb00045b5 /* @ECU_Address@VeLCCS_shifting_direction_final@ */ /end MEASUREMENT
/begin MEASUREMENT VeLCCS_valid_lane_marker "Valid lane marker. 0 = LCCS_NoLane; 1 = LCCS_LeftLane; 2 = LCCS_RightLane; 3 = BothLane." UBYTE LCCS_subsystem_integrated_CM_EnumLCCS_ValidLane 0 0 0 3 ECU_ADDRESS 0xb00045b4 /* @ECU_Address@VeLCCS_valid_lane_marker@ */ /end MEASUREMENT
/begin MEASUREMENT VfLCWS_curvature "" FLOAT32_IEEE LCWS_subsystem_integrated_CM_single 0 0 -3.4E+38 3.4E+38 ECU_ADDRESS 0xb0005100 /* @ECU_Address@VfLCWS_curvature@ */ /end MEASUREMENT
/begin MEASUREMENT VfLCWS_speed_in "" FLOAT32_IEEE LCWS_subsystem_integrated_CM_single 0 0 -3.4E+38 3.4E+38 ECU_ADDRESS 0xb00050fc /* @ECU_Address@VfLCWS_speed_in@ */ /end MEASUREMENT
/begin MEASUREMENT VaLCWS_Obt "" FLOAT32_IEEE LCWS_subsystem_integrated_CM_single 0 0 -3.4E+38 3.4E+38 ARRAY_SIZE 33 ECU_ADDRESS 0xb0005078 /* @ECU_Address@VaLCWS_Obt@ */ /end MEASUREMENT
/begin MEASUREMENT VaLCWS_x_in "" FLOAT32_IEEE LCWS_subsystem_integrated_CM_single 0 0 -3.4E+38 3.4E+38 ARRAY_SIZE 10 ECU_ADDRESS 0xb0005050 /* @ECU_Address@VaLCWS_x_in@ */ /end MEASUREMENT
/begin MEASUREMENT VaLCWS_y_in "" FLOAT32_IEEE LCWS_subsystem_integrated_CM_single 0 0 -3.4E+38 3.4E+38 ARRAY_SIZE 10 ECU_ADDRESS 0xb0005028 /* @ECU_Address@VaLCWS_y_in@ */ /end MEASUREMENT
/begin MEASUREMENT VaLCWS_heading_in "" FLOAT32_IEEE LCWS_subsystem_integrated_CM_single 0 0 -3.4E+38 3.4E+38 ARRAY_SIZE 10 ECU_ADDRESS 0xb0005000 /* @ECU_Address@VaLCWS_heading_in@ */ /end MEASUREMENT
/begin MEASUREMENT VaLCWS_Vx_in "" FLOAT32_IEEE LCWS_subsystem_integrated_CM_single 0 0 -3.4E+38 3.4E+38 ARRAY_SIZE 10 ECU_ADDRESS 0xb0004fd8 /* @ECU_Address@VaLCWS_Vx_in@ */ /end MEASUREMENT
/begin MEASUREMENT VaLCWS_Vy_in "" FLOAT32_IEEE LCWS_subsystem_integrated_CM_single 0 0 -3.4E+38 3.4E+38 ARRAY_SIZE 10 ECU_ADDRESS 0xb0004fb0 /* @ECU_Address@VaLCWS_Vy_in@ */ /end MEASUREMENT
/begin MEASUREMENT VaLCWS_obt_lenth_in "" FLOAT32_IEEE LCWS_subsystem_integrated_CM_single 0 0 -3.4E+38 3.4E+38 ARRAY_SIZE 10 ECU_ADDRESS 0xb0004f88 /* @ECU_Address@VaLCWS_obt_lenth_in@ */ /end MEASUREMENT
/begin MEASUREMENT VaLCWS_obt_width_in "" FLOAT32_IEEE LCWS_subsystem_integrated_CM_single 0 0 -3.4E+38 3.4E+38 ARRAY_SIZE 10 ECU_ADDRESS 0xb0004f60 /* @ECU_Address@VaLCWS_obt_width_in@ */ /end MEASUREMENT
/begin MEASUREMENT VaLCWS_nearest_point_rel_x_in "" FLOAT32_IEEE LCWS_subsystem_integrated_CM_single 0 0 -3.4E+38 3.4E+38 ARRAY_SIZE 10 ECU_ADDRESS 0xb0004f38 /* @ECU_Address@VaLCWS_nearest_point_rel_x_in@ */ /end MEASUREMENT
/begin MEASUREMENT VaLCWS_nearest_point_rel_y_in "" FLOAT32_IEEE LCWS_subsystem_integrated_CM_single 0 0 -3.4E+38 3.4E+38 ARRAY_SIZE 10 ECU_ADDRESS 0xb0004f10 /* @ECU_Address@VaLCWS_nearest_point_rel_y_in@ */ /end MEASUREMENT
/begin MEASUREMENT VaLCWS_id_in "" SLONG LCWS_subsystem_integrated_CM_int32 0 0 -2147483648 2147483647 ARRAY_SIZE 10 ECU_ADDRESS 0xb0004ee8 /* @ECU_Address@VaLCWS_id_in@ */ /end MEASUREMENT
/begin MEASUREMENT ViLCWS_bswR_ID "" SLONG LCWS_subsystem_integrated_CM_int32 0 0 -2147483648 2147483647 ECU_ADDRESS 0xb0004ee4 /* @ECU_Address@ViLCWS_bswR_ID@ */ /end MEASUREMENT
/begin MEASUREMENT ViLCWS_cvwR_ID "" SLONG LCWS_subsystem_integrated_CM_int32 0 0 -2147483648 2147483647 ECU_ADDRESS 0xb0004ee0 /* @ECU_Address@ViLCWS_cvwR_ID@ */ /end MEASUREMENT
/begin MEASUREMENT ViLCWS_bswL_ID "" SLONG LCWS_subsystem_integrated_CM_int32 0 0 -2147483648 2147483647 ECU_ADDRESS 0xb0004edc /* @ECU_Address@ViLCWS_bswL_ID@ */ /end MEASUREMENT
/begin MEASUREMENT ViLCWS_cvwL_ID "" SLONG LCWS_subsystem_integrated_CM_int32 0 0 -2147483648 2147483647 ECU_ADDRESS 0xb0004ed8 /* @ECU_Address@ViLCWS_cvwL_ID@ */ /end MEASUREMENT
/begin MEASUREMENT VnLCWS_num_L "" UWORD LCWS_subsystem_integrated_CM_uint16 0 0 0 65535 ECU_ADDRESS 0xb0004ed6 /* @ECU_Address@VnLCWS_num_L@ */ /end MEASUREMENT
/begin MEASUREMENT VnLCWS_num_R "" UWORD LCWS_subsystem_integrated_CM_uint16 0 0 0 65535 ECU_ADDRESS 0xb0004ed4 /* @ECU_Address@VnLCWS_num_R@ */ /end MEASUREMENT
/begin MEASUREMENT VnLCWS_num_in "" UWORD LCWS_subsystem_integrated_CM_uint16 0 0 0 65535 ECU_ADDRESS 0xb0004ed2 /* @ECU_Address@VnLCWS_num_in@ */ /end MEASUREMENT
/begin MEASUREMENT VeLCWS_active_status "" SWORD LCWS_subsystem_integrated_CM_EnumLCWS_Active_Status 0 0 0 3 ECU_ADDRESS 0xb0004ed0 /* @ECU_Address@VeLCWS_active_status@ */ /end MEASUREMENT
/begin MEASUREMENT VeLCWS_right_warning_status_out "" SWORD LCWS_subsystem_integrated_CM_EnumLCWS_Warning_Status 0 0 0 2 ECU_ADDRESS 0xb0004ece /* @ECU_Address@VeLCWS_right_warning_status_out@ */ /end MEASUREMENT
/begin MEASUREMENT VeLCWS_left_warning_status_out "" SWORD LCWS_subsystem_integrated_CM_EnumLCWS_Warning_Status 0 0 0 2 ECU_ADDRESS 0xb0004ecc /* @ECU_Address@VeLCWS_left_warning_status_out@ */ /end MEASUREMENT
/begin MEASUREMENT VeLCWS_right_warning_status "" SWORD LCWS_subsystem_integrated_CM_EnumLCWS_Warning_Status 0 0 0 2 ECU_ADDRESS 0xb0004eca /* @ECU_Address@VeLCWS_right_warning_status@ */ /end MEASUREMENT
/begin MEASUREMENT VeLCWS_left_warning_status "" SWORD LCWS_subsystem_integrated_CM_EnumLCWS_Warning_Status 0 0 0 2 ECU_ADDRESS 0xb0004ec8 /* @ECU_Address@VeLCWS_left_warning_status@ */ /end MEASUREMENT
/begin MEASUREMENT ViLCWS_bswLL "" SWORD LCWS_subsystem_integrated_CM_EnumLCWS_warningArea 0 0 0 4 ECU_ADDRESS 0xb0004ec6 /* @ECU_Address@ViLCWS_bswLL@ */ /end MEASUREMENT
/begin MEASUREMENT VaLCWS_position_zone_in "" SBYTE LCWS_subsystem_integrated_CM_int8 0 0 -128 127 ARRAY_SIZE 10 ECU_ADDRESS 0xb0004ebb /* @ECU_Address@VaLCWS_position_zone_in@ */ /end MEASUREMENT
/begin MEASUREMENT VaLCWS_orientation_in "" SBYTE LCWS_subsystem_integrated_CM_int8 0 0 -128 127 ARRAY_SIZE 10 ECU_ADDRESS 0xb0004eb1 /* @ECU_Address@VaLCWS_orientation_in@ */ /end MEASUREMENT
/begin MEASUREMENT VaLCWS_motion_status_in "" SBYTE LCWS_subsystem_integrated_CM_int8 0 0 -128 127 ARRAY_SIZE 10 ECU_ADDRESS 0xb0004ea7 /* @ECU_Address@VaLCWS_motion_status_in@ */ /end MEASUREMENT
/begin MEASUREMENT VfLCWS_gear_in "" UBYTE LCWS_subsystem_integrated_CM_uint8 0 0 0 255 ECU_ADDRESS 0xb0004ea6 /* @ECU_Address@VfLCWS_gear_in@ */ /end MEASUREMENT
/begin MEASUREMENT VaLCWS_type "" UBYTE LCWS_subsystem_integrated_CM_uint8 0 0 0 255 ARRAY_SIZE 10 ECU_ADDRESS 0xb0004e9c /* @ECU_Address@VaLCWS_type@ */ /end MEASUREMENT
/begin MEASUREMENT ViLCWS_bswR "" UBYTE LCWS_subsystem_integrated_CM_uint8 0 0 0 255 ECU_ADDRESS 0xb0004e9b /* @ECU_Address@ViLCWS_bswR@ */ /end MEASUREMENT
/begin MEASUREMENT ViLCWS_cvwR "" UBYTE LCWS_subsystem_integrated_CM_uint8 0 0 0 255 ECU_ADDRESS 0xb0004e9a /* @ECU_Address@ViLCWS_cvwR@ */ /end MEASUREMENT
/begin MEASUREMENT ViLCWS_bswL "" UBYTE LCWS_subsystem_integrated_CM_uint8 0 0 0 255 ECU_ADDRESS 0xb0004e99 /* @ECU_Address@ViLCWS_bswL@ */ /end MEASUREMENT
/begin MEASUREMENT ViLCWS_cvwL "" UBYTE LCWS_subsystem_integrated_CM_uint8 0 0 0 255 ECU_ADDRESS 0xb0004e98 /* @ECU_Address@ViLCWS_cvwL@ */ /end MEASUREMENT
/begin MEASUREMENT VfLDWS_SteerAngleRate "" FLOAT32_IEEE LDWS_subsystem_integrated_CM_single 0 0 -3.4E+38 3.4E+38 ECU_ADDRESS 0xb0005214 /* @ECU_Address@VfLDWS_SteerAngleRate@ */ /end MEASUREMENT
/begin MEASUREMENT VfLDWS_BackToRiDist "The distacne bewteen center of rear axle and right lane marker" FLOAT32_IEEE LDWS_subsystem_integrated_CM_single 0 0 -3.4E+38 3.4E+38 ECU_ADDRESS 0xb0005210 /* @ECU_Address@VfLDWS_BackToRiDist@ */ /end MEASUREMENT
/begin MEASUREMENT VfLDWS_Theta "The angle between linear velocity and heading" FLOAT32_IEEE LDWS_subsystem_integrated_CM_single 0 0 -3.4E+38 3.4E+38 ECU_ADDRESS 0xb000520c /* @ECU_Address@VfLDWS_Theta@ */ /end MEASUREMENT
/begin MEASUREMENT VfLDWS_Vx "The value of Vx" FLOAT32_IEEE LDWS_subsystem_integrated_CM_single 0 0 -3.4E+38 3.4E+38 ECU_ADDRESS 0xb0005208 /* @ECU_Address@VfLDWS_Vx@ */ /end MEASUREMENT
/begin MEASUREMENT VfLDWS_Vy "The value of Vy" FLOAT32_IEEE LDWS_subsystem_integrated_CM_single 0 0 -3.4E+38 3.4E+38 ECU_ADDRESS 0xb0005204 /* @ECU_Address@VfLDWS_Vy@ */ /end MEASUREMENT
/begin MEASUREMENT VfLDWS_VLatLe "" FLOAT32_IEEE LDWS_subsystem_integrated_CM_single 0 0 -3.4E+38 3.4E+38 ECU_ADDRESS 0xb0005200 /* @ECU_Address@VfLDWS_VLatLe@ */ /end MEASUREMENT
/begin MEASUREMENT VfLDWS_EdgeLaneLe "The vertical distacne between left front wheel and left lane marker" FLOAT32_IEEE LDWS_subsystem_integrated_CM_single 0 0 -3.4E+38 3.4E+38 ECU_ADDRESS 0xb00051fc /* @ECU_Address@VfLDWS_EdgeLaneLe@ */ /end MEASUREMENT
/begin MEASUREMENT VfLDWS_TLCLe "The time to collision of left side" FLOAT32_IEEE LDWS_subsystem_integrated_CM_single 0 0 -3.4E+38 3.4E+38 ECU_ADDRESS 0xb00051f8 /* @ECU_Address@VfLDWS_TLCLe@ */ /end MEASUREMENT
/begin MEASUREMENT VfLDWS_EdgeLaneRi "The vertical distacne between right front wheel and right lane marker" FLOAT32_IEEE LDWS_subsystem_integrated_CM_single 0 0 -3.4E+38 3.4E+38 ECU_ADDRESS 0xb00051f4 /* @ECU_Address@VfLDWS_EdgeLaneRi@ */ /end MEASUREMENT
/begin MEASUREMENT VfLDWS_VLatRi "" FLOAT32_IEEE LDWS_subsystem_integrated_CM_single 0 0 -3.4E+38 3.4E+38 ECU_ADDRESS 0xb00051f0 /* @ECU_Address@VfLDWS_VLatRi@ */ /end MEASUREMENT
/begin MEASUREMENT VfLDWS_TLCRi "The time to collision of right side" FLOAT32_IEEE LDWS_subsystem_integrated_CM_single 0 0 -3.4E+38 3.4E+38 ECU_ADDRESS 0xb00051ec /* @ECU_Address@VfLDWS_TLCRi@ */ /end MEASUREMENT
/begin MEASUREMENT VfLDWS_SteerAngle "The vehicle's steering angle" FLOAT32_IEEE LDWS_subsystem_integrated_CM_single 0 0 -3.4E+38 3.4E+38 ECU_ADDRESS 0xb00051e8 /* @ECU_Address@VfLDWS_SteerAngle@ */ /end MEASUREMENT
/begin MEASUREMENT VfLDWS_SteerTorque "" FLOAT32_IEEE LDWS_subsystem_integrated_CM_single 0 0 -3.4E+38 3.4E+38 ECU_ADDRESS 0xb00051e4 /* @ECU_Address@VfLDWS_SteerTorque@ */ /end MEASUREMENT
/begin MEASUREMENT VfLDWS_Curvature "" FLOAT32_IEEE LDWS_subsystem_integrated_CM_single 0 0 -3.4E+38 3.4E+38 ECU_ADDRESS 0xb00051e0 /* @ECU_Address@VfLDWS_Curvature@ */ /end MEASUREMENT
/begin MEASUREMENT VfLDWS_LeC0Filtd "The C0 coefficient of left lane marker after filtering" FLOAT32_IEEE LDWS_subsystem_integrated_CM_single 0 0 -3.4E+38 3.4E+38 ECU_ADDRESS 0xb00051dc /* @ECU_Address@VfLDWS_LeC0Filtd@ */ /end MEASUREMENT
/begin MEASUREMENT VfLDWS_RiC0Filtd "The C0 coefficient of right lane marker after filtering" FLOAT32_IEEE LDWS_subsystem_integrated_CM_single 0 0 -3.4E+38 3.4E+38 ECU_ADDRESS 0xb00051d8 /* @ECU_Address@VfLDWS_RiC0Filtd@ */ /end MEASUREMENT
/begin MEASUREMENT VfLDWS_LeC1Filtd "The C1 coefficient of left lane marker after filtering" FLOAT32_IEEE LDWS_subsystem_integrated_CM_single 0 0 -3.4E+38 3.4E+38 ECU_ADDRESS 0xb00051d4 /* @ECU_Address@VfLDWS_LeC1Filtd@ */ /end MEASUREMENT
/begin MEASUREMENT VfLDWS_RiC1Filtd "The C1 coefficient of right lane marker after filtering" FLOAT32_IEEE LDWS_subsystem_integrated_CM_single 0 0 -3.4E+38 3.4E+38 ECU_ADDRESS 0xb00051d0 /* @ECU_Address@VfLDWS_RiC1Filtd@ */ /end MEASUREMENT
/begin MEASUREMENT VfLDWS_BackToLeDist "The distacne bewteen center of rear axle and left lane marker" FLOAT32_IEEE LDWS_subsystem_integrated_CM_single 0 0 -3.4E+38 3.4E+38 ECU_ADDRESS 0xb00051cc /* @ECU_Address@VfLDWS_BackToLeDist@ */ /end MEASUREMENT
/begin MEASUREMENT VfLDWS_LeIndicatorSt "The status of right indicator" UBYTE LDWS_subsystem_integrated_CM_uint8 0 0 0 255 ECU_ADDRESS 0xb00051c8 /* @ECU_Address@VfLDWS_LeIndicatorSt@ */ /end MEASUREMENT
/begin MEASUREMENT VfLDWS_RiIndicatorSt "The status of right indicator" UBYTE LDWS_subsystem_integrated_CM_uint8 0 0 0 255 ECU_ADDRESS 0xb00051c7 /* @ECU_Address@VfLDWS_RiIndicatorSt@ */ /end MEASUREMENT
/begin MEASUREMENT VbLDWS_IsOnLeLine "The vehicle is on left lane marker or not" UBYTE LDWS_subsystem_integrated_CM_boolean 0 0 0 1 ECU_ADDRESS 0xb00051c6 /* @ECU_Address@VbLDWS_IsOnLeLine@ */ /end MEASUREMENT
/begin MEASUREMENT VbLDWS_LeadDrctn "The heading of vehicle is left or right. True is on left, fale is on right." UBYTE LDWS_subsystem_integrated_CM_boolean 0 0 0 1 ECU_ADDRESS 0xb00051c5 /* @ECU_Address@VbLDWS_LeadDrctn@ */ /end MEASUREMENT
/begin MEASUREMENT VbLDWS_ActLeLDW "The left LDW is whether trggered or not" UBYTE LDWS_subsystem_integrated_CM_boolean 0 0 0 1 ECU_ADDRESS 0xb00051c4 /* @ECU_Address@VbLDWS_ActLeLDW@ */ /end MEASUREMENT
/begin MEASUREMENT VbLDWS_IsOnRiLine "The vehicle is on right lane marker or not" UBYTE LDWS_subsystem_integrated_CM_boolean 0 0 0 1 ECU_ADDRESS 0xb00051c3 /* @ECU_Address@VbLDWS_IsOnRiLine@ */ /end MEASUREMENT
/begin MEASUREMENT VbLDWS_ActRiLDW "The right LDW is whether triggered or not" UBYTE LDWS_subsystem_integrated_CM_boolean 0 0 0 1 ECU_ADDRESS 0xb00051c2 /* @ECU_Address@VbLDWS_ActRiLDW@ */ /end MEASUREMENT
/begin MEASUREMENT VbLDWS_SuppLe "The left LDW is whether suppressed or not" UBYTE LDWS_subsystem_integrated_CM_boolean 0 0 0 1 ECU_ADDRESS 0xb00051c1 /* @ECU_Address@VbLDWS_SuppLe@ */ /end MEASUREMENT
/begin MEASUREMENT VbLDWS_SuppRi "The right LDW is whether suppressed or not" UBYTE LDWS_subsystem_integrated_CM_boolean 0 0 0 1 ECU_ADDRESS 0xb00051c0 /* @ECU_Address@VbLDWS_SuppRi@ */ /end MEASUREMENT
/begin MEASUREMENT VbLDWS_RdEnblLe "The left Lane Marker is whether enabled or not" UBYTE LDWS_subsystem_integrated_CM_boolean 0 0 0 1 ECU_ADDRESS 0xb00051bf /* @ECU_Address@VbLDWS_RdEnblLe@ */ /end MEASUREMENT
/begin MEASUREMENT VbLDWS_RdEnblRi "The right Lane Marker is whether enabled or not" UBYTE LDWS_subsystem_integrated_CM_boolean 0 0 0 1 ECU_ADDRESS 0xb00051be /* @ECU_Address@VbLDWS_RdEnblRi@ */ /end MEASUREMENT
/begin MEASUREMENT VbLDWS_WrnSt "The warning is whether issued or not" UBYTE LDWS_subsystem_integrated_CM_boolean 0 0 0 1 ECU_ADDRESS 0xb00051bd /* @ECU_Address@VbLDWS_WrnSt@ */ /end MEASUREMENT
/begin MEASUREMENT VbLDWS_EnabledLDW "The system is whether enabled or not" UBYTE LDWS_subsystem_integrated_CM_boolean 0 0 0 1 ECU_ADDRESS 0xb00051bc /* @ECU_Address@VbLDWS_EnabledLDW@ */ /end MEASUREMENT
/begin MEASUREMENT VbLDWS_SpdRngValid "The ODD of speed range is whether fullfiled" UBYTE LDWS_subsystem_integrated_CM_boolean 0 0 0 1 ECU_ADDRESS 0xb00051bb /* @ECU_Address@VbLDWS_SpdRngValid@ */ /end MEASUREMENT
/begin MEASUREMENT VbLDWS_CurvValid "The ODD of lane curvature is whether fullfiled" UBYTE LDWS_subsystem_integrated_CM_boolean 0 0 0 1 ECU_ADDRESS 0xb00051ba /* @ECU_Address@VbLDWS_CurvValid@ */ /end MEASUREMENT
/begin MEASUREMENT VbLDWS_WidthValid "The ODD of lane width is whether fullfiled" UBYTE LDWS_subsystem_integrated_CM_boolean 0 0 0 1 ECU_ADDRESS 0xb00051b9 /* @ECU_Address@VbLDWS_WidthValid@ */ /end MEASUREMENT
/begin MEASUREMENT VbLDWS_LnMkrValid "The ODD of lane marker is whether fullfiled" UBYTE LDWS_subsystem_integrated_CM_boolean 0 0 0 1 ECU_ADDRESS 0xb00051b8 /* @ECU_Address@VbLDWS_LnMkrValid@ */ /end MEASUREMENT
/begin MEASUREMENT VeLDWS_LaDetecSt "" UBYTE LDWS_subsystem_integrated_CM_EnumLDWS_la_detec_st 0 0 0 3 ECU_ADDRESS 0xb00051b7 /* @ECU_Address@VeLDWS_LaDetecSt@ */ /end MEASUREMENT
/begin MEASUREMENT VeLDWS_WrnSd "" UBYTE LDWS_subsystem_integrated_CM_EnumLDWS_warn_side 0 0 0 2 ECU_ADDRESS 0xb00051b6 /* @ECU_Address@VeLDWS_WrnSd@ */ /end MEASUREMENT
/begin MEASUREMENT VeLDWS_SysSt "" UBYTE LDWS_subsystem_integrated_CM_EnumLDWS_system_st 0 0 0 2 ECU_ADDRESS 0xb00051b5 /* @ECU_Address@VeLDWS_SysSt@ */ /end MEASUREMENT
/begin MEASUREMENT VeLDWS_OnStateSt "" UBYTE LDWS_subsystem_integrated_CM_EnumLDWS_on_state_st 0 0 0 3 ECU_ADDRESS 0xb00051b4 /* @ECU_Address@VeLDWS_OnStateSt@ */ /end MEASUREMENT
/begin MEASUREMENT VfAEBD_AEB_a "" FLOAT32_IEEE AEBD_subsystem_integrated_CM_single 0 0 -3.4E+38 3.4E+38 ECU_ADDRESS 0xb00024ec /* @ECU_Address@VfAEBD_AEB_a@ */ /end MEASUREMENT
/begin MEASUREMENT VcAEBD_ErrorCount "" UWORD AEBD_subsystem_integrated_CM_uint16 0 0 0 65535 ECU_ADDRESS 0xb00024ea /* @ECU_Address@VcAEBD_ErrorCount@ */ /end MEASUREMENT
/begin MEASUREMENT VfAEBD_t_DelayTime "" UBYTE AEBD_subsystem_integrated_CM_uint8 0 0 0 255 ECU_ADDRESS 0xb00024e9 /* @ECU_Address@VfAEBD_t_DelayTime@ */ /end MEASUREMENT
/begin MEASUREMENT VbAEBD_Error "" UBYTE AEBD_subsystem_integrated_CM_boolean 0 0 0 1 ECU_ADDRESS 0xb00024e8 /* @ECU_Address@VbAEBD_Error@ */ /end MEASUREMENT
/begin MEASUREMENT VbAEBD_Suppress "" UBYTE AEBD_subsystem_integrated_CM_boolean 0 0 0 1 ECU_ADDRESS 0xb00024e7 /* @ECU_Address@VbAEBD_Suppress@ */ /end MEASUREMENT
/begin MEASUREMENT VbAEBD_Pedoff "" UBYTE AEBD_subsystem_integrated_CM_boolean 0 0 0 1 ECU_ADDRESS 0xb00024e6 /* @ECU_Address@VbAEBD_Pedoff@ */ /end MEASUREMENT
/begin MEASUREMENT VbAEBD_AEBaError "" UBYTE AEBD_subsystem_integrated_CM_boolean 0 0 0 1 ECU_ADDRESS 0xb00024e5 /* @ECU_Address@VbAEBD_AEBaError@ */ /end MEASUREMENT
/begin MEASUREMENT VbAEBD_AEBrequest "" UBYTE AEBD_subsystem_integrated_CM_boolean 0 0 0 1 ECU_ADDRESS 0xb00024e4 /* @ECU_Address@VbAEBD_AEBrequest@ */ /end MEASUREMENT
/begin MEASUREMENT VfALCA_v_LateralSpeedOutput "ALCA outpurt." FLOAT32_IEEE ALCA_subsystem_integrated_CM_single_m_s 0 0 -3.4E+38 3.4E+38 ECU_ADDRESS 0xb0002e2c /* @ECU_Address@VfALCA_v_LateralSpeedOutput@ */ /end MEASUREMENT
/begin MEASUREMENT VfALCA_d_LateralDist2GoFromLCCS "Larteral distance to go from LCCS." FLOAT32_IEEE ALCA_subsystem_integrated_CM_single_m 0 0 -3.4E+38 3.4E+38 ECU_ADDRESS 0xb0002e28 /* @ECU_Address@VfALCA_d_LateralDist2GoFromLCCS@ */ /end MEASUREMENT
/begin MEASUREMENT VfALCA_LeftLaneMarker_C0 "" FLOAT32_IEEE ALCA_subsystem_integrated_CM_single 0 0 -3.4E+38 3.4E+38 ECU_ADDRESS 0xb0002e24 /* @ECU_Address@VfALCA_LeftLaneMarker_C0@ */ /end MEASUREMENT
/begin MEASUREMENT VfALCA_LeftLaneMarker_C1 "" FLOAT32_IEEE ALCA_subsystem_integrated_CM_single 0 0 -3.4E+38 3.4E+38 ECU_ADDRESS 0xb0002e20 /* @ECU_Address@VfALCA_LeftLaneMarker_C1@ */ /end MEASUREMENT
/begin MEASUREMENT VfALCA_LeftLaneMarker_C2 "" FLOAT32_IEEE ALCA_subsystem_integrated_CM_single 0 0 -3.4E+38 3.4E+38 ECU_ADDRESS 0xb0002e1c /* @ECU_Address@VfALCA_LeftLaneMarker_C2@ */ /end MEASUREMENT
/begin MEASUREMENT VfALCA_LeftLaneMarker_C3 "" FLOAT32_IEEE ALCA_subsystem_integrated_CM_single 0 0 -3.4E+38 3.4E+38 ECU_ADDRESS 0xb0002e18 /* @ECU_Address@VfALCA_LeftLaneMarker_C3@ */ /end MEASUREMENT
/begin MEASUREMENT VfALCA_LeftDist2Host "Distance-to-host of left lane marker." FLOAT32_IEEE ALCA_subsystem_integrated_CM_single_m 0 0 -3.4E+38 3.4E+38 ECU_ADDRESS 0xb0002e14 /* @ECU_Address@VfALCA_LeftDist2Host@ */ /end MEASUREMENT
/begin MEASUREMENT VfALCA_RightLaneMarker_C0 "" FLOAT32_IEEE ALCA_subsystem_integrated_CM_single 0 0 -3.4E+38 3.4E+38 ECU_ADDRESS 0xb0002e10 /* @ECU_Address@VfALCA_RightLaneMarker_C0@ */ /end MEASUREMENT
/begin MEASUREMENT VfALCA_RightLaneMarker_C1 "" FLOAT32_IEEE ALCA_subsystem_integrated_CM_single 0 0 -3.4E+38 3.4E+38 ECU_ADDRESS 0xb0002e0c /* @ECU_Address@VfALCA_RightLaneMarker_C1@ */ /end MEASUREMENT
/begin MEASUREMENT VfALCA_RightLaneMarker_C2 "" FLOAT32_IEEE ALCA_subsystem_integrated_CM_single 0 0 -3.4E+38 3.4E+38 ECU_ADDRESS 0xb0002e08 /* @ECU_Address@VfALCA_RightLaneMarker_C2@ */ /end MEASUREMENT
/begin MEASUREMENT VfALCA_RightLaneMarker_C3 "" FLOAT32_IEEE ALCA_subsystem_integrated_CM_single 0 0 -3.4E+38 3.4E+38 ECU_ADDRESS 0xb0002e04 /* @ECU_Address@VfALCA_RightLaneMarker_C3@ */ /end MEASUREMENT
/begin MEASUREMENT VfALCA_RightDist2Host "Distance-to-host of right lane marker." FLOAT32_IEEE ALCA_subsystem_integrated_CM_single_m 0 0 -3.4E+38 3.4E+38 ECU_ADDRESS 0xb0002e00 /* @ECU_Address@VfALCA_RightDist2Host@ */ /end MEASUREMENT
/begin MEASUREMENT VfALCA_v_VehSpeed "Speed of ego veh." FLOAT32_IEEE ALCA_subsystem_integrated_CM_single_m_s 0 0 -3.4E+38 3.4E+38 ECU_ADDRESS 0xb0002dfc /* @ECU_Address@VfALCA_v_VehSpeed@ */ /end MEASUREMENT
/begin MEASUREMENT VfALCA_v_VehVx "Speed of ego veh." FLOAT32_IEEE ALCA_subsystem_integrated_CM_single_m_s 0 0 -3.4E+38 3.4E+38 ECU_ADDRESS 0xb0002df8 /* @ECU_Address@VfALCA_v_VehVx@ */ /end MEASUREMENT
/begin MEASUREMENT VfALCA_v_VehVy "Speed of ego veh." FLOAT32_IEEE ALCA_subsystem_integrated_CM_single_m_s 0 0 -3.4E+38 3.4E+38 ECU_ADDRESS 0xb0002df4 /* @ECU_Address@VfALCA_v_VehVy@ */ /end MEASUREMENT
/begin MEASUREMENT VfALCA_ObstacleNearest_x "" FLOAT32_IEEE ALCA_subsystem_integrated_CM_single 0 0 -3.4E+38 3.4E+38 ECU_ADDRESS 0xb0002df0 /* @ECU_Address@VfALCA_ObstacleNearest_x@ */ /end MEASUREMENT
/begin MEASUREMENT VfALCA_ObstacleNearest_y "" FLOAT32_IEEE ALCA_subsystem_integrated_CM_single 0 0 -3.4E+38 3.4E+38 ECU_ADDRESS 0xb0002dec /* @ECU_Address@VfALCA_ObstacleNearest_y@ */ /end MEASUREMENT
/begin MEASUREMENT VfALCA_ObstacleCenter_x "" FLOAT32_IEEE ALCA_subsystem_integrated_CM_single 0 0 -3.4E+38 3.4E+38 ECU_ADDRESS 0xb0002de8 /* @ECU_Address@VfALCA_ObstacleCenter_x@ */ /end MEASUREMENT
/begin MEASUREMENT VfALCA_v_Obstacle_Vx "" FLOAT32_IEEE ALCA_subsystem_integrated_CM_single_m_s 0 0 -3.4E+38 3.4E+38 ECU_ADDRESS 0xb0002de4 /* @ECU_Address@VfALCA_v_Obstacle_Vx@ */ /end MEASUREMENT
/begin MEASUREMENT VfALCA_v_Obstacle_Vy "" FLOAT32_IEEE ALCA_subsystem_integrated_CM_single_m_s 0 0 -3.4E+38 3.4E+38 ECU_ADDRESS 0xb0002de0 /* @ECU_Address@VfALCA_v_Obstacle_Vy@ */ /end MEASUREMENT
/begin MEASUREMENT VfALCA_ObstacleCenter_y "" FLOAT32_IEEE ALCA_subsystem_integrated_CM_single 0 0 -3.4E+38 3.4E+38 ECU_ADDRESS 0xb0002ddc /* @ECU_Address@VfALCA_ObstacleCenter_y@ */ /end MEASUREMENT
/begin MEASUREMENT VfALCA_ObstacleLength "" FLOAT32_IEEE ALCA_subsystem_integrated_CM_single_m 0 0 -3.4E+38 3.4E+38 ECU_ADDRESS 0xb0002dd8 /* @ECU_Address@VfALCA_ObstacleLength@ */ /end MEASUREMENT
/begin MEASUREMENT VfALCA_ObstacleWidth "" FLOAT32_IEEE ALCA_subsystem_integrated_CM_single_m 0 0 -3.4E+38 3.4E+38 ECU_ADDRESS 0xb0002dd4 /* @ECU_Address@VfALCA_ObstacleWidth@ */ /end MEASUREMENT
/begin MEASUREMENT VfALCA_ObstacleHeading "" FLOAT32_IEEE ALCA_subsystem_integrated_CM_single 0 0 -3.4E+38 3.4E+38 ECU_ADDRESS 0xb0002dd0 /* @ECU_Address@VfALCA_ObstacleHeading@ */ /end MEASUREMENT
/begin MEASUREMENT VfALCA_d_Host2TargetLaneCenter "Distance of ost to target lane center." FLOAT32_IEEE ALCA_subsystem_integrated_CM_single_m 0 0 -3.4E+38 3.4E+38 ECU_ADDRESS 0xb0002dcc /* @ECU_Address@VfALCA_d_Host2TargetLaneCenter@ */ /end MEASUREMENT
/begin MEASUREMENT VfALCA_d_EGOLaneCenter2Host "Distance of ost to ego lane center." FLOAT32_IEEE ALCA_subsystem_integrated_CM_single_m 0 0 -3.4E+38 3.4E+38 ECU_ADDRESS 0xb0002dc8 /* @ECU_Address@VfALCA_d_EGOLaneCenter2Host@ */ /end MEASUREMENT
/begin MEASUREMENT VfALCA_d_TargetSideLaneMarker2Host "Distance of host to request-side-lane-marker." FLOAT32_IEEE ALCA_subsystem_integrated_CM_single_m 0 0 -3.4E+38 3.4E+38 ECU_ADDRESS 0xb0002dc4 /* @ECU_Address@VfALCA_d_TargetSideLaneMarker2Host@ */ /end MEASUREMENT
/begin MEASUREMENT VfALCA_t_LCTime "" FLOAT32_IEEE ALCA_subsystem_integrated_CM_single_s 0 0 -3.4E+38 3.4E+38 ECU_ADDRESS 0xb0002dc0 /* @ECU_Address@VfALCA_t_LCTime@ */ /end MEASUREMENT
/begin MEASUREMENT VfALCA_ObstacleID "" SLONG ALCA_subsystem_integrated_CM_int32 0 0 -2147483648 2147483647 ECU_ADDRESS 0xb0002dbc /* @ECU_Address@VfALCA_ObstacleID@ */ /end MEASUREMENT
/begin MEASUREMENT VfALCA_LeftLaneMarkerFusionStatus "Left Lane Marker`s Fusion Status" SBYTE ALCA_subsystem_integrated_CM_int8 0 0 -128 127 ECU_ADDRESS 0xb0002dbb /* @ECU_Address@VfALCA_LeftLaneMarkerFusionStatus@ */ /end MEASUREMENT
/begin MEASUREMENT VfALCA_LeftLaneMarkerType "Left Lane Marker`s type." SBYTE ALCA_subsystem_integrated_CM_int8 0 0 -128 127 ECU_ADDRESS 0xb0002dba /* @ECU_Address@VfALCA_LeftLaneMarkerType@ */ /end MEASUREMENT
/begin MEASUREMENT VfALCA_RightLaneMarkerFusionStatus "Right Lane Marker`s Fusion Status" SBYTE ALCA_subsystem_integrated_CM_int8 0 0 -128 127 ECU_ADDRESS 0xb0002db9 /* @ECU_Address@VfALCA_RightLaneMarkerFusionStatus@ */ /end MEASUREMENT
/begin MEASUREMENT VfALCA_RightLaneMarkerType "Right Lane Marker`s  type" SBYTE ALCA_subsystem_integrated_CM_int8 0 0 -128 127 ECU_ADDRESS 0xb0002db8 /* @ECU_Address@VfALCA_RightLaneMarkerType@ */ /end MEASUREMENT
/begin MEASUREMENT VfALCA_FaultOutput "ALCA outpurt." UBYTE ALCA_subsystem_integrated_CM_uint8 0 0 0 255 ECU_ADDRESS 0xb0002db7 /* @ECU_Address@VfALCA_FaultOutput@ */ /end MEASUREMENT
/begin MEASUREMENT VfALCA_FaultInit "Fault before outpurt." UBYTE ALCA_subsystem_integrated_CM_uint8 0 0 0 255 ECU_ADDRESS 0xb0002db6 /* @ECU_Address@VfALCA_FaultInit@ */ /end MEASUREMENT
/begin MEASUREMENT VbALCA_ALCAEnableFromDCSN "ALCA enable from Dcsn." UBYTE ALCA_subsystem_integrated_CM_boolean 0 0 0 1 ECU_ADDRESS 0xb0002db5 /* @ECU_Address@VbALCA_ALCAEnableFromDCSN@ */ /end MEASUREMENT
/begin MEASUREMENT VbALCA_RequestOutput "ALCA outpurt." UBYTE ALCA_subsystem_integrated_CM_boolean 0 0 0 1 ECU_ADDRESS 0xb0002db4 /* @ECU_Address@VbALCA_RequestOutput@ */ /end MEASUREMENT
/begin MEASUREMENT VbALCA_LC_ReqFromDCSN "Lane change from DCSN." UBYTE ALCA_subsystem_integrated_CM_boolean 0 0 0 1 ECU_ADDRESS 0xb0002db3 /* @ECU_Address@VbALCA_LC_ReqFromDCSN@ */ /end MEASUREMENT
/begin MEASUREMENT VbALCA_LC_CancelReqFromDCSN "Lane change cancel request from DCSN." UBYTE ALCA_subsystem_integrated_CM_boolean 0 0 0 1 ECU_ADDRESS 0xb0002db2 /* @ECU_Address@VbALCA_LC_CancelReqFromDCSN@ */ /end MEASUREMENT
/begin MEASUREMENT VbALCA_LC_Req "Lane change from DCSN." UBYTE ALCA_subsystem_integrated_CM_boolean 0 0 0 1 ECU_ADDRESS 0xb0002db1 /* @ECU_Address@VbALCA_LC_Req@ */ /end MEASUREMENT
/begin MEASUREMENT VbALCA_LC_CancelReq "Lane change cancel request from DCSN." UBYTE ALCA_subsystem_integrated_CM_boolean 0 0 0 1 ECU_ADDRESS 0xb0002db0 /* @ECU_Address@VbALCA_LC_CancelReq@ */ /end MEASUREMENT
/begin MEASUREMENT VbALCA_ResetLaneChangeReq "Reset lane change request from DCSN." UBYTE ALCA_subsystem_integrated_CM_boolean 0 0 0 1 ECU_ADDRESS 0xb0002daf /* @ECU_Address@VbALCA_ResetLaneChangeReq@ */ /end MEASUREMENT
/begin MEASUREMENT VbALCA_LC_Complete "Lane change complete flag." UBYTE ALCA_subsystem_integrated_CM_boolean 0 0 0 1 ECU_ADDRESS 0xb0002dae /* @ECU_Address@VbALCA_LC_Complete@ */ /end MEASUREMENT
/begin MEASUREMENT VbALCA_TouchedNewLane "Has touched new lane." UBYTE ALCA_subsystem_integrated_CM_boolean 0 0 0 1 ECU_ADDRESS 0xb0002dad /* @ECU_Address@VbALCA_TouchedNewLane@ */ /end MEASUREMENT
/begin MEASUREMENT VeALCA_ReqSideOutput "ALCA outpurt." UBYTE ALCA_subsystem_integrated_CM_EnumDCSN_driving_direction 0 0 0 2 ECU_ADDRESS 0xb0002dac /* @ECU_Address@VeALCA_ReqSideOutput@ */ /end MEASUREMENT
/begin MEASUREMENT VeALCA_ReqSideFromDCSN "Request side from DCSN." UBYTE ALCA_subsystem_integrated_CM_EnumDCSN_driving_direction 0 0 0 2 ECU_ADDRESS 0xb0002dab /* @ECU_Address@VeALCA_ReqSideFromDCSN@ */ /end MEASUREMENT
/begin MEASUREMENT VeALCA_ReqSide "Request side from DCSN." UBYTE ALCA_subsystem_integrated_CM_EnumDCSN_driving_direction 0 0 0 2 ECU_ADDRESS 0xb0002daa /* @ECU_Address@VeALCA_ReqSide@ */ /end MEASUREMENT
/begin MEASUREMENT VeALCA_StateOutput "ALCA outpurt." UBYTE ALCA_subsystem_integrated_CM_EnumALCA_state 0 0 0 7 ECU_ADDRESS 0xb0002da9 /* @ECU_Address@VeALCA_StateOutput@ */ /end MEASUREMENT
/begin MEASUREMENT VeALCA_NotFulfillReasonOutput "ALCA outpurt." UBYTE ALCA_subsystem_integrated_CM_EnumALCA_not_fulfill_reason 0 0 0 9 ECU_ADDRESS 0xb0002da8 /* @ECU_Address@VeALCA_NotFulfillReasonOutput@ */ /end MEASUREMENT
/begin MEASUREMENT VfALCA_TargetLaneLength "" FLOAT32_IEEE ALCA_subsystem_integrated_CM_single 0 0 -3.4E+38 3.4E+38 ECU_ADDRESS 0xb0002da4 /* @ECU_Address@VfALCA_TargetLaneLength@ */ /end MEASUREMENT
/begin MEASUREMENT VfALCA_TargetLaneWidth "" FLOAT32_IEEE ALCA_subsystem_integrated_CM_single 0 0 -3.4E+38 3.4E+38 ECU_ADDRESS 0xb0002da0 /* @ECU_Address@VfALCA_TargetLaneWidth@ */ /end MEASUREMENT
/begin MEASUREMENT VfALCA_d_EGOLaneLength "Length of ego lane." FLOAT32_IEEE ALCA_subsystem_integrated_CM_single_m 0 0 -3.4E+38 3.4E+38 ECU_ADDRESS 0xb0002d9c /* @ECU_Address@VfALCA_d_EGOLaneLength@ */ /end MEASUREMENT
/begin MEASUREMENT VfALCA_TargetLaneType "" SBYTE ALCA_subsystem_integrated_CM_int8 0 0 -128 127 ECU_ADDRESS 0xb0002d9b /* @ECU_Address@VfALCA_TargetLaneType@ */ /end MEASUREMENT
/begin MEASUREMENT VfALCA_TargetSideLaneMarkerType "" SBYTE ALCA_subsystem_integrated_CM_int8 0 0 -128 127 ECU_ADDRESS 0xb0002d9a /* @ECU_Address@VfALCA_TargetSideLaneMarkerType@ */ /end MEASUREMENT
/begin MEASUREMENT VfALCA_HasLeftLane "Has left lane." UBYTE ALCA_subsystem_integrated_CM_boolean 0 0 0 1 ECU_ADDRESS 0xb0002d99 /* @ECU_Address@VfALCA_HasLeftLane@ */ /end MEASUREMENT
/begin MEASUREMENT VfALCA_HasRightLane "Has right lane." UBYTE ALCA_subsystem_integrated_CM_boolean 0 0 0 1 ECU_ADDRESS 0xb0002d98 /* @ECU_Address@VfALCA_HasRightLane@ */ /end MEASUREMENT
/begin MEASUREMENT ADCtrl_Thruput_MS "" FLOAT32_IEEE ad_ctrl_thruput_measurement_CM_ms 0 0 -3.4E+38 3.4E+38 ECU_ADDRESS 0xb00052cc /* @ECU_Address@ADCtrl_Thruput_MS@ */ /end MEASUREMENT
/begin MEASUREMENT COMM_Subsystem_Intergreted_Receive_Period "" ULONG ad_ctrl_subfunction_measurement_CM_us 0 0 0 4E+9 ECU_ADDRESS 0xb0005248 /* @ECU_Address@COMM_Subsystem_Intergreted_Receive_Period@ */ /end MEASUREMENT
/begin MEASUREMENT DCSN_Subsystem_Integrated_Period "" ULONG ad_ctrl_subfunction_measurement_CM_us 0 0 0 4E+9 ECU_ADDRESS 0xb0005244 /* @ECU_Address@DCSN_Subsystem_Integrated_Period@ */ /end MEASUREMENT
/begin MEASUREMENT AEBS_Subsystem_Integrated_Period "" ULONG ad_ctrl_subfunction_measurement_CM_us 0 0 0 4E+9 ECU_ADDRESS 0xb0005240 /* @ECU_Address@AEBS_Subsystem_Integrated_Period@ */ /end MEASUREMENT
/begin MEASUREMENT ACCS_Subsystem_Integrated_Period "" ULONG ad_ctrl_subfunction_measurement_CM_us 0 0 0 4E+9 ECU_ADDRESS 0xb000523c /* @ECU_Address@ACCS_Subsystem_Integrated_Period@ */ /end MEASUREMENT
/begin MEASUREMENT LCCS_Subsystem_Integrated_Period "" ULONG ad_ctrl_subfunction_measurement_CM_us 0 0 0 4E+9 ECU_ADDRESS 0xb0005238 /* @ECU_Address@LCCS_Subsystem_Integrated_Period@ */ /end MEASUREMENT
/begin MEASUREMENT AEBD_Subsystem_Integrated_Period "" ULONG ad_ctrl_subfunction_measurement_CM_us 0 0 0 4E+9 ECU_ADDRESS 0xb0005228 /* @ECU_Address@AEBD_Subsystem_Integrated_Period@ */ /end MEASUREMENT
/begin MEASUREMENT LCWS_Subsystem_Integrated_Period "" ULONG ad_ctrl_subfunction_measurement_CM_us 0 0 0 4E+9 ECU_ADDRESS 0xb0005234 /* @ECU_Address@LCWS_Subsystem_Integrated_Period@ */ /end MEASUREMENT
/begin MEASUREMENT LDWS_Subsystem_Integrated_Period "" ULONG ad_ctrl_subfunction_measurement_CM_us 0 0 0 4E+9 ECU_ADDRESS 0xb0005230 /* @ECU_Address@LDWS_Subsystem_Integrated_Period@ */ /end MEASUREMENT
/begin MEASUREMENT arbt_Subsystem_Integrated_Period "" ULONG ad_ctrl_subfunction_measurement_CM_us 0 0 0 4E+9 ECU_ADDRESS 0xb000522c /* @ECU_Address@arbt_Subsystem_Integrated_Period@ */ /end MEASUREMENT
/begin MEASUREMENT COMM_Subsystem_Integrated_Transmit_Period "" ULONG ad_ctrl_subfunction_measurement_CM_us 0 0 0 4E+9 ECU_ADDRESS 0xb0005220 /* @ECU_Address@COMM_Subsystem_Integrated_Transmit_Period@ */ /end MEASUREMENT
/begin MEASUREMENT ALCA_Subsystem_Integrated_Period "" ULONG ad_ctrl_subfunction_measurement_CM_us 0 0 0 4E+9 ECU_ADDRESS 0xb0005224 /* @ECU_Address@ALCA_Subsystem_Integrated_Period@ */ /end MEASUREMENT
/begin MEASUREMENT os_core0_tick_cnt "" ULONG ad_ctrl_thruput_measurement_CM_ms 0 0 0 3.4E+38 ECU_ADDRESS 0xb00079e8 /* @ECU_Address@os_core0_tick_cnt@ */ /end MEASUREMENT
/begin MEASUREMENT Entry_ADCtrl_STM_Cnt "ADCtrl entry STM_0_3 counter. 1us = Entry_ADCtrl_STM_Cnt*4096.0/100" ULONG ad_ctrl_thruput_measurement_CM_ms 0 0 0 3.4E+38 ECU_ADDRESS 0xb00052d8 /* @ECU_Address@Entry_ADCtrl_STM_Cnt@ */ /end MEASUREMENT
/begin COMPU_METHOD ACCS_subsystem_integrated_CM_single_s "Q = V" RAT_FUNC "%8.6" "s" COEFFS 0 1 0 0 0 1 /end COMPU_METHOD
/begin COMPU_METHOD ACCS_subsystem_integrated_CM_single_m "Q = V" RAT_FUNC "%8.6" "m" COEFFS 0 1 0 0 0 1 /end COMPU_METHOD
/begin COMPU_METHOD ACCS_subsystem_integrated_CM_single_m_s2 "Q = V" RAT_FUNC "%8.6" "m/s2" COEFFS 0 1 0 0 0 1 /end COMPU_METHOD
/begin COMPU_METHOD ACCS_subsystem_integrated_CM_single_m_s "Q = V" RAT_FUNC "%8.6" "m/s" COEFFS 0 1 0 0 0 1 /end COMPU_METHOD
/begin COMPU_METHOD ACCS_subsystem_integrated_CM_single_deg "Q = V" RAT_FUNC "%8.6" "deg" COEFFS 0 1 0 0 0 1 /end COMPU_METHOD
/begin COMPU_METHOD DCSN_subsystem_integrated_CM_single_nm "Q = V" RAT_FUNC "%8.6" "nm" COEFFS 0 1 0 0 0 1 /end COMPU_METHOD
/begin COMPU_METHOD DCSN_subsystem_integrated_CM_single_m "Q = V" RAT_FUNC "%8.6" "m" COEFFS 0 1 0 0 0 1 /end COMPU_METHOD
/begin COMPU_METHOD DCSN_subsystem_integrated_CM_single_s "Q = V" RAT_FUNC "%8.6" "s" COEFFS 0 1 0 0 0 1 /end COMPU_METHOD
/begin COMPU_METHOD DCSN_subsystem_integrated_CM_uint8 "Q = V" RAT_FUNC "%3.0" "" COEFFS 0 1 0 0 0 1 /end COMPU_METHOD
/begin COMPU_METHOD DCSN_subsystem_integrated_CM_boolean "Q = V" RAT_FUNC "%1.0" "" COEFFS 0 1 0 0 0 1 /end COMPU_METHOD
/begin COMPU_METHOD DCSN_subsystem_integrated_CM_uint16 "Q = V" RAT_FUNC "%5.0" "" COEFFS 0 1 0 0 0 1 /end COMPU_METHOD
/begin COMPU_METHOD DCSN_subsystem_integrated_CM_EnumDCSN_driving_direction "Enumerated data type: EnumDCSN_driving_direction" TAB_VERB "%0.6" "" COMPU_TAB_REF VTAB_FOR_DCSN_subsystem_integrated_CM_EnumDCSN_driving_direction /end COMPU_METHOD
/begin COMPU_METHOD DCSN_subsystem_integrated_CM_EnumDCSN_stop_request_mode "Enumerated data type: EnumDCSN_stop_request_mode" TAB_VERB "%0.6" "" COMPU_TAB_REF VTAB_FOR_DCSN_subsystem_integrated_CM_EnumDCSN_stop_request_mode /end COMPU_METHOD
/begin COMPU_METHOD LCCS_subsystem_integrated_CM_single "Q = V" RAT_FUNC "%8.6" "" COEFFS 0 1 0 0 0 1 /end COMPU_METHOD
/begin COMPU_METHOD LCCS_subsystem_integrated_CM_single_s "Q = V" RAT_FUNC "%8.6" "s" COEFFS 0 1 0 0 0 1 /end COMPU_METHOD
/begin COMPU_METHOD LCCS_subsystem_integrated_CM_single_m "Q = V" RAT_FUNC "%8.6" "m" COEFFS 0 1 0 0 0 1 /end COMPU_METHOD
/begin COMPU_METHOD LCCS_subsystem_integrated_CM_single_rad "Q = V" RAT_FUNC "%8.6" "rad" COEFFS 0 1 0 0 0 1 /end COMPU_METHOD
/begin COMPU_METHOD LCCS_subsystem_integrated_CM_single_kg "Q = V" RAT_FUNC "%8.6" "kg" COEFFS 0 1 0 0 0 1 /end COMPU_METHOD
/begin COMPU_METHOD LCCS_subsystem_integrated_CM_single_m_s "Q = V" RAT_FUNC "%8.6" "m/s" COEFFS 0 1 0 0 0 1 /end COMPU_METHOD
/begin COMPU_METHOD LCCS_subsystem_integrated_CM_int32 "Q = V" RAT_FUNC "%10.0" "" COEFFS 0 1 0 0 0 1 /end COMPU_METHOD
/begin COMPU_METHOD LCCS_subsystem_integrated_CM_boolean "Q = V" RAT_FUNC "%1.0" "" COEFFS 0 1 0 0 0 1 /end COMPU_METHOD
/begin COMPU_METHOD LCCS_subsystem_integrated_CM_EnumDCSN_driving_direction "Enumerated data type: EnumDCSN_driving_direction" TAB_VERB "%0.6" "" COMPU_TAB_REF VTAB_FOR_LCCS_subsystem_integrated_CM_EnumDCSN_driving_direction /end COMPU_METHOD
/begin COMPU_METHOD LCCS_subsystem_integrated_CM_double_s "Q = V" RAT_FUNC "%15.10" "s" COEFFS 0 1 0 0 0 1 /end COMPU_METHOD
/begin COMPU_METHOD LCCS_subsystem_integrated_CM_uint8 "Q = V" RAT_FUNC "%3.0" "" COEFFS 0 1 0 0 0 1 /end COMPU_METHOD
/begin COMPU_METHOD LCCS_subsystem_integrated_CM_EnumLCCS_ValidLane "Enumerated data type: EnumLCCS_ValidLane" TAB_VERB "%0.6" "" COMPU_TAB_REF VTAB_FOR_LCCS_subsystem_integrated_CM_EnumLCCS_ValidLane /end COMPU_METHOD
/begin COMPU_METHOD LCWS_subsystem_integrated_CM_single "Q = V" RAT_FUNC "%8.6" "" COEFFS 0 1 0 0 0 1 /end COMPU_METHOD
/begin COMPU_METHOD LCWS_subsystem_integrated_CM_single_m_s "Q = V" RAT_FUNC "%8.6" "m/s" COEFFS 0 1 0 0 0 1 /end COMPU_METHOD
/begin COMPU_METHOD LCWS_subsystem_integrated_CM_int8 "Q = V" RAT_FUNC "%3.0" "" COEFFS 0 1 0 0 0 1 /end COMPU_METHOD
/begin COMPU_METHOD LCWS_subsystem_integrated_CM_boolean "Q = V" RAT_FUNC "%1.0" "" COEFFS 0 1 0 0 0 1 /end COMPU_METHOD
/begin COMPU_METHOD LCWS_subsystem_integrated_CM_int32 "Q = V" RAT_FUNC "%10.0" "" COEFFS 0 1 0 0 0 1 /end COMPU_METHOD
/begin COMPU_METHOD LCWS_subsystem_integrated_CM_uint16 "Q = V" RAT_FUNC "%5.0" "" COEFFS 0 1 0 0 0 1 /end COMPU_METHOD
/begin COMPU_METHOD LCWS_subsystem_integrated_CM_EnumLCWS_Active_Status "Enumerated data type: EnumLCWS_Active_Status" TAB_VERB "%0.6" "" COMPU_TAB_REF VTAB_FOR_LCWS_subsystem_integrated_CM_EnumLCWS_Active_Status /end COMPU_METHOD
/begin COMPU_METHOD LCWS_subsystem_integrated_CM_EnumLCWS_Warning_Status "Enumerated data type: EnumLCWS_Warning_Status" TAB_VERB "%0.6" "" COMPU_TAB_REF VTAB_FOR_LCWS_subsystem_integrated_CM_EnumLCWS_Warning_Status /end COMPU_METHOD
/begin COMPU_METHOD LCWS_subsystem_integrated_CM_EnumLCWS_warningArea "Enumerated data type: EnumLCWS_warningArea" TAB_VERB "%0.6" "" COMPU_TAB_REF VTAB_FOR_LCWS_subsystem_integrated_CM_EnumLCWS_warningArea /end COMPU_METHOD
/begin COMPU_METHOD LCWS_subsystem_integrated_CM_uint8 "Q = V" RAT_FUNC "%3.0" "" COEFFS 0 1 0 0 0 1 /end COMPU_METHOD
/begin COMPU_METHOD LDWS_subsystem_integrated_CM_single_rad "Q = V" RAT_FUNC "%8.6" "rad" COEFFS 0 1 0 0 0 1 /end COMPU_METHOD
/begin COMPU_METHOD LDWS_subsystem_integrated_CM_single__ "Q = V" RAT_FUNC "%8.6" "��" COEFFS 0 1 0 0 0 1 /end COMPU_METHOD
/begin COMPU_METHOD LDWS_subsystem_integrated_CM_single_NM "Q = V" RAT_FUNC "%8.6" "NM" COEFFS 0 1 0 0 0 1 /end COMPU_METHOD
/begin COMPU_METHOD LDWS_subsystem_integrated_CM_single_1_m "Q = V" RAT_FUNC "%8.6" "1/m" COEFFS 0 1 0 0 0 1 /end COMPU_METHOD
/begin COMPU_METHOD LDWS_subsystem_integrated_CM_single_m "Q = V" RAT_FUNC "%8.6" "m" COEFFS 0 1 0 0 0 1 /end COMPU_METHOD
/begin COMPU_METHOD LDWS_subsystem_integrated_CM_single "Q = V" RAT_FUNC "%8.6" "" COEFFS 0 1 0 0 0 1 /end COMPU_METHOD
/begin COMPU_METHOD LDWS_subsystem_integrated_CM_single_s "Q = V" RAT_FUNC "%8.6" "s" COEFFS 0 1 0 0 0 1 /end COMPU_METHOD
/begin COMPU_METHOD LDWS_subsystem_integrated_CM_single_m_s "Q = V" RAT_FUNC "%8.6" "m/s" COEFFS 0 1 0 0 0 1 /end COMPU_METHOD
/begin COMPU_METHOD LDWS_subsystem_integrated_CM_single___s "Q = V" RAT_FUNC "%8.6" "��/s" COEFFS 0 1 0 0 0 1 /end COMPU_METHOD
/begin COMPU_METHOD LDWS_subsystem_integrated_CM_uint16 "Q = V" RAT_FUNC "%5.0" "" COEFFS 0 1 0 0 0 1 /end COMPU_METHOD
/begin COMPU_METHOD LDWS_subsystem_integrated_CM_uint8 "Q = V" RAT_FUNC "%3.0" "" COEFFS 0 1 0 0 0 1 /end COMPU_METHOD
/begin COMPU_METHOD LDWS_subsystem_integrated_CM_boolean "Q = V" RAT_FUNC "%1.0" "" COEFFS 0 1 0 0 0 1 /end COMPU_METHOD
/begin COMPU_METHOD LDWS_subsystem_integrated_CM_EnumLDWS_la_detec_st "Enumerated data type: EnumLDWS_la_detec_st" TAB_VERB "%0.6" "" COMPU_TAB_REF VTAB_FOR_LDWS_subsystem_integrated_CM_EnumLDWS_la_detec_st /end COMPU_METHOD
/begin COMPU_METHOD LDWS_subsystem_integrated_CM_EnumLDWS_warn_side "Enumerated data type: EnumLDWS_warn_side" TAB_VERB "%0.6" "" COMPU_TAB_REF VTAB_FOR_LDWS_subsystem_integrated_CM_EnumLDWS_warn_side /end COMPU_METHOD
/begin COMPU_METHOD LDWS_subsystem_integrated_CM_EnumLDWS_system_st "Enumerated data type: EnumLDWS_system_st" TAB_VERB "%0.6" "" COMPU_TAB_REF VTAB_FOR_LDWS_subsystem_integrated_CM_EnumLDWS_system_st /end COMPU_METHOD
/begin COMPU_METHOD LDWS_subsystem_integrated_CM_EnumLDWS_on_state_st "Enumerated data type: EnumLDWS_on_state_st" TAB_VERB "%0.6" "" COMPU_TAB_REF VTAB_FOR_LDWS_subsystem_integrated_CM_EnumLDWS_on_state_st /end COMPU_METHOD
/begin COMPU_METHOD AEBD_subsystem_integrated_CM_single "Q = V" RAT_FUNC "%8.6" "" COEFFS 0 1 0 0 0 1 /end COMPU_METHOD
/begin COMPU_METHOD AEBD_subsystem_integrated_CM_uint16 "Q = V" RAT_FUNC "%5.0" "" COEFFS 0 1 0 0 0 1 /end COMPU_METHOD
/begin COMPU_METHOD AEBD_subsystem_integrated_CM_uint8 "Q = V" RAT_FUNC "%3.0" "" COEFFS 0 1 0 0 0 1 /end COMPU_METHOD
/begin COMPU_METHOD AEBD_subsystem_integrated_CM_boolean "Q = V" RAT_FUNC "%1.0" "" COEFFS 0 1 0 0 0 1 /end COMPU_METHOD
/begin COMPU_METHOD ALCA_subsystem_integrated_CM_single_m "Q = V" RAT_FUNC "%8.6" "m" COEFFS 0 1 0 0 0 1 /end COMPU_METHOD
/begin COMPU_METHOD ALCA_subsystem_integrated_CM_single "Q = V" RAT_FUNC "%8.6" "" COEFFS 0 1 0 0 0 1 /end COMPU_METHOD
/begin COMPU_METHOD ALCA_subsystem_integrated_CM_single_s "Q = V" RAT_FUNC "%8.6" "s" COEFFS 0 1 0 0 0 1 /end COMPU_METHOD
/begin COMPU_METHOD ALCA_subsystem_integrated_CM_single_m_s "Q = V" RAT_FUNC "%8.6" "m/s" COEFFS 0 1 0 0 0 1 /end COMPU_METHOD
/begin COMPU_METHOD ALCA_subsystem_integrated_CM_boolean "Q = V" RAT_FUNC "%1.0" "" COEFFS 0 1 0 0 0 1 /end COMPU_METHOD
/begin COMPU_METHOD ALCA_subsystem_integrated_CM_EnumDCSN_driving_direction "Enumerated data type: EnumDCSN_driving_direction" TAB_VERB "%0.6" "" COMPU_TAB_REF VTAB_FOR_ALCA_subsystem_integrated_CM_EnumDCSN_driving_direction /end COMPU_METHOD
/begin COMPU_METHOD ALCA_subsystem_integrated_CM_int32 "Q = V" RAT_FUNC "%10.0" "" COEFFS 0 1 0 0 0 1 /end COMPU_METHOD
/begin COMPU_METHOD ALCA_subsystem_integrated_CM_int8 "Q = V" RAT_FUNC "%3.0" "" COEFFS 0 1 0 0 0 1 /end COMPU_METHOD
/begin COMPU_METHOD ALCA_subsystem_integrated_CM_uint8 "Q = V" RAT_FUNC "%3.0" "" COEFFS 0 1 0 0 0 1 /end COMPU_METHOD
/begin COMPU_METHOD ALCA_subsystem_integrated_CM_EnumALCA_state "Enumerated data type: EnumALCA_state" TAB_VERB "%0.6" "" COMPU_TAB_REF VTAB_FOR_ALCA_subsystem_integrated_CM_EnumALCA_state /end COMPU_METHOD
/begin COMPU_METHOD ALCA_subsystem_integrated_CM_EnumALCA_not_fulfill_reason "Enumerated data type: EnumALCA_not_fulfill_reason" TAB_VERB "%0.6" "" COMPU_TAB_REF VTAB_FOR_ALCA_subsystem_integrated_CM_EnumALCA_not_fulfill_reason /end COMPU_METHOD
/begin COMPU_METHOD ad_ctrl_thruput_measurement_CM_ms "Q = V" RAT_FUNC "%8.6" "ms" COEFFS 0 1 0 0 0 1 /end COMPU_METHOD
/begin COMPU_METHOD ad_ctrl_subfunction_measurement_CM_us "Q = V" RAT_FUNC "%8.0" "us" COEFFS 0 1 0 0 0 1 /end COMPU_METHOD
/begin COMPU_VTAB VTAB_FOR_DCSN_subsystem_integrated_CM_EnumDCSN_driving_direction "Enumerated data type: EnumDCSN_driving_direction" TAB_VERB 3 0 "FORWARD" 1 "LEFT" 2 "RIGHT" /end COMPU_VTAB
/begin COMPU_VTAB VTAB_FOR_DCSN_subsystem_integrated_CM_EnumDCSN_stop_request_mode "Enumerated data type: EnumDCSN_stop_request_mode" TAB_VERB 6 0 "NotEnabled" 1 "WaitForValidStopLine" 2 "CheckStopCond" 3 "SendStopReqMpfuDis" 4 "UpdateStopDis" 5 "HoldForStopLineUpdate" /end COMPU_VTAB
/begin COMPU_VTAB VTAB_FOR_LCCS_subsystem_integrated_CM_EnumDCSN_driving_direction "Enumerated data type: EnumDCSN_driving_direction" TAB_VERB 3 0 "FORWARD" 1 "LEFT" 2 "RIGHT" /end COMPU_VTAB
/begin COMPU_VTAB VTAB_FOR_LCCS_subsystem_integrated_CM_EnumLCCS_ValidLane "Enumerated data type: EnumLCCS_ValidLane" TAB_VERB 4 0 "LCCS_NoLane" 1 "LCCS_LeftLane" 2 "LCCS_RightLane" 3 "LCCS_BothLane" /end COMPU_VTAB
/begin COMPU_VTAB VTAB_FOR_LCWS_subsystem_integrated_CM_EnumLCWS_Active_Status "Enumerated data type: EnumLCWS_Active_Status" TAB_VERB 4 0 "LCWS_OFF" 1 "LCWS_PASSIVE" 2 "LCWS_INACTIVE" 3 "LCWS_ACTIVE" /end COMPU_VTAB
/begin COMPU_VTAB VTAB_FOR_LCWS_subsystem_integrated_CM_EnumLCWS_Warning_Status "Enumerated data type: EnumLCWS_Warning_Status" TAB_VERB 3 0 "LCWS_NO_WARNING" 1 "LCWS_WARNING_LOW_LEVEL" 2 "LCWS_WARNING_HIGH_LEVEL" /end COMPU_VTAB
/begin COMPU_VTAB VTAB_FOR_LCWS_subsystem_integrated_CM_EnumLCWS_warningArea "Enumerated data type: EnumLCWS_warningArea" TAB_VERB 5 0 "WARNING_HLEVEL_AREA" 1 "WARNING_S_AREA" 2 "WARNING_L_AREA" 3 "MAY_WARNING_AREA" 4 "NO_WARNING_AREA" /end COMPU_VTAB
/begin COMPU_VTAB VTAB_FOR_LDWS_subsystem_integrated_CM_EnumLDWS_la_detec_st "Enumerated data type: EnumLDWS_la_detec_st" TAB_VERB 4 3 "LDWS_BothAvl" 1 "LDWS_LeAvl" 2 "LDWS_RiAvl" 0 "LDWS_NotAvl" /end COMPU_VTAB
/begin COMPU_VTAB VTAB_FOR_LDWS_subsystem_integrated_CM_EnumLDWS_warn_side "Enumerated data type: EnumLDWS_warn_side" TAB_VERB 3 1 "LDWS_WarnLe" 2 "LDWS_WarnRi" 0 "LDWS_NoWarn" /end COMPU_VTAB
/begin COMPU_VTAB VTAB_FOR_LDWS_subsystem_integrated_CM_EnumLDWS_system_st "Enumerated data type: EnumLDWS_system_st" TAB_VERB 3 0 "LDWS_Off" 1 "LDWS_On" 2 "LDWS_Error" /end COMPU_VTAB
/begin COMPU_VTAB VTAB_FOR_LDWS_subsystem_integrated_CM_EnumLDWS_on_state_st "Enumerated data type: EnumLDWS_on_state_st" TAB_VERB 4 0 "LDWS_Enabling" 1 "LDWS_Standby" 2 "LDWS_Active" 3 "LDWS_Passive" /end COMPU_VTAB
/begin COMPU_VTAB VTAB_FOR_ALCA_subsystem_integrated_CM_EnumDCSN_driving_direction "Enumerated data type: EnumDCSN_driving_direction" TAB_VERB 3 0 "FORWARD" 1 "LEFT" 2 "RIGHT" /end COMPU_VTAB
/begin COMPU_VTAB VTAB_FOR_ALCA_subsystem_integrated_CM_EnumALCA_state "Enumerated data type: EnumALCA_state" TAB_VERB 8 0 "ALCA_state_OFF" 1 "ALCA_state_Standby" 2 "ALCA_state_Activated" 3 "ALCA_state_Waitting" 4 "ALCA_state_Inform" 5 "ALCA_state_Finish" 6 "ALCA_state_Handover" 7 "ALCA_state_Abort" /end COMPU_VTAB
/begin COMPU_VTAB VTAB_FOR_ALCA_subsystem_integrated_CM_EnumALCA_not_fulfill_reason "Enumerated data type: EnumALCA_not_fulfill_reason" TAB_VERB 10 0 "ALCA_not_fulfill_reason_no_request" 1 "ALCA_not_fulfill_reason_no_lane" 2 "ALCA_not_fulfill_reason_mpfu_reject" 3 "ALCA_not_fulfill_reason_has_obstacle" 4 "ALCA_not_fulfill_reason_low_speed" 5 "ALCA_not_fulfill_reason_high_speed" 6 "ALCA_not_fulfill_reason_dangerous_conditions" 7 "ALCA_not_fulfill_reason_system_error" 8 "ALCA_not_fulfill_reason_too_often" 9 "ALCA_not_fulfill_reason_check_fulfilled" /end COMPU_VTAB
/begin GROUP S9_Subsystem "DCSN_subsystem_integrated/DtrmnDCSN_Integrated/DtrmnDCSN_ADM/DtrmnDCSN_DRIVIintentionSimu/Subsystem" /begin REF_CHARACTERISTIC KfDCSN_M_adm_temp_steering_ovrd_torque /end REF_CHARACTERISTIC /end GROUP
/begin GROUP S9_Subsystem1 "DCSN_subsystem_integrated/DtrmnDCSN_Integrated/DtrmnDCSN_ADM/DtrmnDCSN_DRIVIintentionSimu/Subsystem1" /begin REF_CHARACTERISTIC KfDCSN_M_adm_temp_steering_resume_torque /end REF_CHARACTERISTIC /end GROUP
/begin GROUP S35_DtrmnDCSN_AutodriveActDelay "DCSN_subsystem_integrated/DtrmnDCSN_Integrated/DtrmnDCSN_EnablingManager/DtrmnDCSN_AutoDriveModeManager/DtrmnDCSN_AutodriveActDelay" /begin REF_CHARACTERISTIC KfDCSN_t_autodrive_control_mode_delay /end REF_CHARACTERISTIC /end GROUP
/begin GROUP S50_CalcDCSN_RawStopDistance "DCSN_subsystem_integrated/DtrmnDCSN_Integrated/DtrmnDCSN_TrafficDecider/CalcDCSN_StopRequest/CalcDCSN_RawStopDistance" /begin SUB_GROUP S64_select_stop_line_distance /end SUB_GROUP
 /begin REF_MEASUREMENT VbDCSN_has_valid_stop_line VbDCSN_stop_line_distance_isNaN VbDCSN_stop_line_input_isNaN VfDCSN_raw_stop_line_distance /end REF_MEASUREMENT
/end GROUP
/begin GROUP S50_CalcDCSN_SLEWStopDistance "DCSN_subsystem_integrated/DtrmnDCSN_Integrated/DtrmnDCSN_TrafficDecider/CalcDCSN_StopRequest/CalcDCSN_SLEWStopDistance" /begin SUB_GROUP S65_Subsystem /end SUB_GROUP /end GROUP
/begin GROUP S50_CalcDCSN_StopReasonDistance "DCSN_subsystem_integrated/DtrmnDCSN_Integrated/DtrmnDCSN_TrafficDecider/CalcDCSN_StopRequest/CalcDCSN_StopReasonDistance"
 /begin SUB_GROUP S66_CheckDCSN_VariableTimeHold S66_CheckDCSN_VariableTimeHold1 /end SUB_GROUP
 /begin REF_CHARACTERISTIC KfDCSN_d_Thrsh_request_stop KfDCSN_d_stop_cleared_Thrsh KfDCSN_d_stop_close_Thrsh KfDCSN_d_stop_finished_dis KfDCSN_d_stop_unsuccess_Thrsh KfDCSN_t_sample_time /end REF_CHARACTERISTIC
 /begin REF_MEASUREMENT VbDCSN_raw_stop_finished VbDCSN_raw_stop_finished_late VbDCSN_should_send_stop_req VbDCSN_stop_line_is_close VbDCSN_stop_unsuccess VeDCSN_stop_request_mode /end REF_MEASUREMENT
/end GROUP
/begin GROUP S52_CheckDCSN_num_lanes_isNaN "DCSN_subsystem_integrated/DtrmnDCSN_Integrated/DtrmnDCSN_TrafficDecider/CvrtDCSN_DataSelector/CheckDCSN_num_lanes_isNaN" /begin REF_MEASUREMENT VbDCSN_num_lanes_isNaN /end REF_MEASUREMENT /end GROUP
/begin GROUP S52_CheckDCSN_num_stop_lines_isNaN "DCSN_subsystem_integrated/DtrmnDCSN_Integrated/DtrmnDCSN_TrafficDecider/CvrtDCSN_DataSelector/CheckDCSN_num_stop_lines_isNaN" /begin REF_MEASUREMENT VbDCSN_num_stop_lines_isNaN VfDCSN_mpfu_num_stop_lines /end REF_MEASUREMENT /end GROUP
/begin GROUP S53_DtrmnDCSN_UsrChangeLaneReq "DCSN_subsystem_integrated/DtrmnDCSN_Integrated/DtrmnDCSN_TrafficDecider/DtrmnDCSN_ChangeLaneReq/DtrmnDCSN_UsrChangeLaneReq" /begin SUB_GROUP S87_CvrtDCSN_DataConvert /end SUB_GROUP /begin REF_CHARACTERISTIC KfDCSN_t_usr_change_lane_delay /end REF_CHARACTERISTIC /begin REF_MEASUREMENT VbDCSN_CL_delay_finished /end REF_MEASUREMENT /end GROUP
/begin GROUP S12_DtrmnDCSN_BrakePressed "DCSN_subsystem_integrated/DtrmnDCSN_Integrated/DtrmnDCSN_ADM/DtrmnDCSN_ADMMainManager/CheckDCSN_VehicleStateCheck/DtrmnDCSN_BrakePressed" /begin REF_CHARACTERISTIC KbDCSN_adm_BrkPressDeactivateEnabled /end REF_CHARACTERISTIC /end GROUP
/begin GROUP S12_DtrmnDCSN_FawAutodriveMode "DCSN_subsystem_integrated/DtrmnDCSN_Integrated/DtrmnDCSN_ADM/DtrmnDCSN_ADMMainManager/CheckDCSN_VehicleStateCheck/DtrmnDCSN_FawAutodriveMode" /begin REF_CHARACTERISTIC KbDCSN_adm_BrkPressDeactivateEnabled /end REF_CHARACTERISTIC /end GROUP
/begin GROUP S14_CvrtDCSN_DataConvert "DCSN_subsystem_integrated/DtrmnDCSN_Integrated/DtrmnDCSN_ADM/DtrmnDCSN_ADMMainManager/DtrmnDCSN_CondActivation/CvrtDCSN_DataConvert" /begin REF_MEASUREMENT VfDCSN_C_cond_act_time /end REF_MEASUREMENT /end GROUP
/begin GROUP S64_select_stop_line_distance "DCSN_subsystem_integrated/DtrmnDCSN_Integrated/DtrmnDCSN_TrafficDecider/CalcDCSN_StopRequest/CalcDCSN_RawStopDistance/select_stop_line_distance" /begin SUB_GROUP S70_CheckDCSN_stop_line_distance_isNAN /end SUB_GROUP /end GROUP
/begin GROUP S65_Subsystem "DCSN_subsystem_integrated/DtrmnDCSN_Integrated/DtrmnDCSN_TrafficDecider/CalcDCSN_StopRequest/CalcDCSN_SLEWStopDistance/Subsystem" /begin REF_CHARACTERISTIC KfDCSN_d_stop_s_distance_man_value KfDCSN_t_sample_time /end REF_CHARACTERISTIC /end GROUP
/begin GROUP S66_CheckDCSN_VariableTimeHold "DCSN_subsystem_integrated/DtrmnDCSN_Integrated/DtrmnDCSN_TrafficDecider/CalcDCSN_StopRequest/CalcDCSN_StopReasonDistance/CheckDCSN_VariableTimeHold" /begin REF_CHARACTERISTIC KfDCSN_t_stop_req_hold /end REF_CHARACTERISTIC /begin REF_MEASUREMENT VbDCSN_hold_stop_finished /end REF_MEASUREMENT /end GROUP
/begin GROUP S66_CheckDCSN_VariableTimeHold1 "DCSN_subsystem_integrated/DtrmnDCSN_Integrated/DtrmnDCSN_TrafficDecider/CalcDCSN_StopRequest/CalcDCSN_StopReasonDistance/CheckDCSN_VariableTimeHold1" /begin REF_CHARACTERISTIC KfDCSN_t_stop_req_hold /end REF_CHARACTERISTIC /end GROUP
/begin GROUP S87_CvrtDCSN_DataConvert "DCSN_subsystem_integrated/DtrmnDCSN_Integrated/DtrmnDCSN_TrafficDecider/DtrmnDCSN_ChangeLaneReq/DtrmnDCSN_UsrChangeLaneReq/CvrtDCSN_DataConvert" /begin REF_MEASUREMENT VeDCSN_CL_req_side_pre /end REF_MEASUREMENT /end GROUP
/begin GROUP S70_CheckDCSN_stop_line_distance_isNAN "DCSN_subsystem_integrated/DtrmnDCSN_Integrated/DtrmnDCSN_TrafficDecider/CalcDCSN_StopRequest/CalcDCSN_RawStopDistance/select_stop_line_distance/CheckDCSN_stop_line_distance_isNAN" /begin REF_CHARACTERISTIC KfDCSN_d_rearaxle_frontbump KfDCSN_d_stop_distance_buffer /end REF_CHARACTERISTIC /end GROUP
/begin GROUP LCCS_subsystem_integrated "LCCS_subsystem_integrated" ROOT /begin SUB_GROUP Root_LCCS /end SUB_GROUP /end GROUP
/begin GROUP Root_LCCS "LCCS_subsystem_integrated/LCCS"
 /begin SUB_GROUP S1_CalcLCCS_compute_lateral_errors S1_CalcLCCS_lane_center_discretize S1_CalcLCCS_lane_center_line S1_CalcLCCS_lateral_control_main S1_CalcLCCS_lateral_shift_width S1_CalcLCCS_virtual_lane_marker S1_DtrmnLCCS_sensor_signal_processing S1_DtrmnLCCS_sensor_signal_rationality S1_DtrmnLCCS_steering_control_output /end SUB_GROUP
/end GROUP
/begin GROUP S1_CalcLCCS_compute_lateral_errors "LCCS_subsystem_integrated/LCCS/CalcLCCS_compute_lateral_errors"
 /begin SUB_GROUP S2_center_of_mass_projection S2_compute_lateral_errors S2_preview_point_projection /end SUB_GROUP
/end GROUP
/begin GROUP S1_CalcLCCS_lane_center_discretize "LCCS_subsystem_integrated/LCCS/CalcLCCS_lane_center_discretize" /begin REF_CHARACTERISTIC KfLCCS_d_lr /end REF_CHARACTERISTIC /end GROUP
/begin GROUP S1_CalcLCCS_lane_center_line "LCCS_subsystem_integrated/LCCS/CalcLCCS_lane_center_line" /begin REF_CHARACTERISTIC KfLCCS_t_SampleTime KtLCCS_k_LanemarkMergeCoef /end REF_CHARACTERISTIC
 /begin REF_MEASUREMENT VaLCCS_final_left_lanemark VaLCCS_final_right_lanemark VaLCCS_raw_lane_center_line VbLCCS_touched_new_lane VfLCCS_left_lanemark_switch_time VfLCCS_right_lanemark_switch_time /end REF_MEASUREMENT
/end GROUP
/begin GROUP S1_CalcLCCS_lateral_control_main "LCCS_subsystem_integrated/LCCS/CalcLCCS_lateral_control_main" /begin SUB_GROUP S5_lateral_control S5_steering_wheel_angle /end SUB_GROUP /end GROUP
/begin GROUP S1_CalcLCCS_lateral_shift_width "LCCS_subsystem_integrated/LCCS/CalcLCCS_lateral_shift_width" /begin SUB_GROUP S6_CalcLCCS_target_shift_width /end SUB_GROUP
 /begin REF_CHARACTERISTIC KbLCCS_lane_change_source_ALCA KfLCCS_r_MaxLateralSpeedPortion KfLCCS_r_shift_speed_gain KfLCCS_t_SampleTime KfLCCS_v_shift_speed_high_limit KfLCCS_v_shift_speed_low_limit /end REF_CHARACTERISTIC
 /begin REF_MEASUREMENT VaLCCS_shifted_lane_center_line VbLCCS_shifting_in_progress VeLCCS_shifting_direction_final VfLCCS_lateral_dist_to_go VfLCCS_lateral_shift_step VfLCCS_lateral_shift_width /end REF_MEASUREMENT
/end GROUP
/begin GROUP S1_CalcLCCS_virtual_lane_marker "LCCS_subsystem_integrated/LCCS/CalcLCCS_virtual_lane_marker" /begin SUB_GROUP S7_1st_order_filter /end SUB_GROUP
 /begin REF_CHARACTERISTIC KfLCCS_LanemarkerQualityThrsh KfLCCS_d_ValidLaneWidthLimit KfLCCS_t_SampleTime /end REF_CHARACTERISTIC
 /begin REF_MEASUREMENT VaLCCS_virtual_left_lanemark VaLCCS_virtual_right_lanemark VbLCCS_both_lanemark_available VbLCCS_left_lanemark_valid VbLCCS_right_lanemark_valid VeLCCS_valid_lane_marker VfLCCS_c0_scaling VfLCCS_left_lanemark_confidence VfLCCS_right_lanemark_confidence /end REF_MEASUREMENT
/end GROUP
/begin GROUP S1_DtrmnLCCS_sensor_signal_processing "LCCS_subsystem_integrated/LCCS/DtrmnLCCS_sensor_signal_processing" /begin SUB_GROUP S8_check_signal_isNan10 /end SUB_GROUP
 /begin REF_CHARACTERISTIC KfLCCS_Ang_steering_center_position KfLCCS_r_veh_strwhl_2_frtwhl_ratio KtLCCS_d_lookahead_distance /end REF_CHARACTERISTIC
 /begin REF_MEASUREMENT VaLCCS_raw_left_lanemark VaLCCS_raw_right_lanemark VbLCCS_input_isNaN_MPFU VfLCCS_lookahead_distance VfLCCS_raw_lane_width VfLCCS_timestamp_MPFU VfLCCS_veh_frtwhl_angle_act /end REF_MEASUREMENT
/end GROUP
/begin GROUP S1_DtrmnLCCS_sensor_signal_rationality "LCCS_subsystem_integrated/LCCS/DtrmnLCCS_sensor_signal_rationality"
 /begin SUB_GROUP S9_CalcLCCS_moving_mean_roll S9_check_signal_isNan S9_check_signal_isNan10 S9_check_signal_isNan12 S9_check_signal_isNan14 S9_check_signal_isNan15 S9_check_signal_isNan2 S9_check_signal_isNan6 S9_check_signal_isNan8 S9_check_signal_isNan9 /end SUB_GROUP
 /begin REF_CHARACTERISTIC KbLCCS_WheelEncoderReady KbLCCS_inlane_nudge_request_SLEW KbLCCS_inlane_nudge_request_value KbLCCS_lane_change_request_SLEW KbLCCS_lane_change_request_value KbLCCS_lane_change_source_ALCA KeLCCS_shifting_direction_value KfLCCS_Ang_RollCorrectionMax KfLCCS_r_velocity_y_correction KtLCCS_r_RollCorrectionForHeading /end REF_CHARACTERISTIC
 /begin REF_MEASUREMENT VbLCCS_inlane_nudge_request VbLCCS_input_isNaN_ALCA VbLCCS_input_isNaN_COMM VbLCCS_input_isNaN_DCSN VbLCCS_input_isNaN_EGMO VbLCCS_lane_change_request VeLCCS_shifting_direction_raw VfLCCS_timestamp_EGMO VfLCCS_veh_heading_rel VfLCCS_velocity_rel_y /end REF_MEASUREMENT
/end GROUP
/begin GROUP S1_DtrmnLCCS_steering_control_output "LCCS_subsystem_integrated/LCCS/DtrmnLCCS_steering_control_output" /begin SUB_GROUP S10_steering_control_machine /end SUB_GROUP /begin REF_CHARACTERISTIC KtLCCS_Ang_steering_angle_reentry_zone /end REF_CHARACTERISTIC /begin REF_MEASUREMENT VbLCCS_LCC_ReadyToEngage VfLCCS_steering_angle_diff_abs /end REF_MEASUREMENT /end GROUP
/begin GROUP S2_center_of_mass_projection "LCCS_subsystem_integrated/LCCS/CalcLCCS_compute_lateral_errors/center_of_mass_projection" /begin REF_CHARACTERISTIC KfLCCS_d_lr /end REF_CHARACTERISTIC /begin REF_MEASUREMENT VaLCCS_com_point VaLCCS_com_proj_point /end REF_MEASUREMENT /end GROUP
/begin GROUP S2_compute_lateral_errors "LCCS_subsystem_integrated/LCCS/CalcLCCS_compute_lateral_errors/compute_lateral_errors"
 /begin REF_CHARACTERISTIC KcLCCS_HeadingErrorRateSmooth KfLCCS_heading_error_rate_limit KfLCCS_t_SampleTime /end REF_CHARACTERISTIC
 /begin REF_MEASUREMENT VfLCCS_heading_error VfLCCS_heading_error_rate VfLCCS_lateral_error VfLCCS_lateral_error_rate VfLCCS_lookahead_angle VfLCCS_preview_curvature /end REF_MEASUREMENT
/end GROUP
/begin GROUP S2_preview_point_projection "LCCS_subsystem_integrated/LCCS/CalcLCCS_compute_lateral_errors/preview_point_projection" /begin REF_CHARACTERISTIC KfLCCS_d_lr /end REF_CHARACTERISTIC /begin REF_MEASUREMENT VaLCCS_preview_proj_point /end REF_MEASUREMENT /end GROUP
/begin GROUP S5_lateral_control "LCCS_subsystem_integrated/LCCS/CalcLCCS_lateral_control_main/lateral_control" /begin SUB_GROUP S53_slowpath_steer_PI /end SUB_GROUP
 /begin REF_CHARACTERISTIC KbLCCS_UsePurePursuit KfLCCS_Ang_slowpath_steer_limit KfLCCS_WeightMatrixStates_R KfLCCS_a_max_lat_acc KfLCCS_cf KfLCCS_cr KfLCCS_d_lf KfLCCS_d_lr KfLCCS_d_min_turn_radius KfLCCS_eps KfLCCS_iz KfLCCS_mass KfLCCS_r_UpdateStanleyK KtLCCS_WeightMatrixInputs_Q KtLCCS_heading_err_correction KtLCCS_heading_err_gain_scheduler KtLCCS_heading_err_rate_correction KtLCCS_lat_err_gain_scheduler KtLCCS_lateral_err_rate_correction KtLCCS_slowpath_steer_I_gain KtLCCS_slowpath_steer_P_gain KtLCCS_t_lateral_oscillation_period /end REF_CHARACTERISTIC
 /begin REF_MEASUREMENT VcLCCS_num_iteration VfLCCS_frtwhl_angle_limit_lat_acc VfLCCS_heading_error_contribution VfLCCS_heading_error_rate_contribution VfLCCS_lateral_error_contribution VfLCCS_lateral_error_rate_contribution VfLCCS_steer_angle_feedback VfLCCS_veh_frtwhl_angle_des /end REF_MEASUREMENT
/end GROUP
/begin GROUP S5_steering_wheel_angle "LCCS_subsystem_integrated/LCCS/CalcLCCS_lateral_control_main/steering_wheel_angle" /begin SUB_GROUP S54_angular_vel_limit /end SUB_GROUP /end GROUP
/begin GROUP S6_CalcLCCS_target_shift_width "LCCS_subsystem_integrated/LCCS/CalcLCCS_lateral_shift_width/CalcLCCS_target_shift_width" /begin REF_CHARACTERISTIC KfLCCS_d_NudgeSafetyZone KfLCCS_d_VehicleWidth /end REF_CHARACTERISTIC /begin REF_MEASUREMENT VfLCCS_target_lateral_shift_width /end REF_MEASUREMENT /end GROUP
/begin GROUP S7_1st_order_filter "LCCS_subsystem_integrated/LCCS/CalcLCCS_virtual_lane_marker/1st order filter" /begin REF_MEASUREMENT VfLCCS_smoothed_lane_width /end REF_MEASUREMENT /end GROUP
/begin GROUP S8_check_signal_isNan10 "LCCS_subsystem_integrated/LCCS/DtrmnLCCS_sensor_signal_processing/check_signal_isNan10" /begin REF_MEASUREMENT VfLCCS_num_lane_markers /end REF_MEASUREMENT /end GROUP
/begin GROUP S9_CalcLCCS_moving_mean_roll "LCCS_subsystem_integrated/LCCS/DtrmnLCCS_sensor_signal_rationality/CalcLCCS_moving_mean_roll" /begin REF_CHARACTERISTIC KfLCCS_t_RollOscillationPeriod KfLCCS_t_SampleTime /end REF_CHARACTERISTIC /end GROUP
/begin GROUP S9_check_signal_isNan "LCCS_subsystem_integrated/LCCS/DtrmnLCCS_sensor_signal_rationality/check_signal_isNan" /begin REF_MEASUREMENT VfLCCS_linear_velocity /end REF_MEASUREMENT /end GROUP
/begin GROUP S9_check_signal_isNan10 "LCCS_subsystem_integrated/LCCS/DtrmnLCCS_sensor_signal_rationality/check_signal_isNan10" /begin REF_MEASUREMENT VfLCCS_veh_heading_utm /end REF_MEASUREMENT /end GROUP
/begin GROUP S9_check_signal_isNan12 "LCCS_subsystem_integrated/LCCS/DtrmnLCCS_sensor_signal_rationality/check_signal_isNan12" /begin REF_MEASUREMENT VbLCCS_lcc_feature_enable /end REF_MEASUREMENT /end GROUP
/begin GROUP S9_check_signal_isNan14 "LCCS_subsystem_integrated/LCCS/DtrmnLCCS_sensor_signal_rationality/check_signal_isNan14" /begin REF_MEASUREMENT VfLCCS_lateral_v_from_ALCA /end REF_MEASUREMENT /end GROUP
/begin GROUP S9_check_signal_isNan15 "LCCS_subsystem_integrated/LCCS/DtrmnLCCS_sensor_signal_rationality/check_signal_isNan15" /begin REF_MEASUREMENT VfLCCS_veh_roll_utm /end REF_MEASUREMENT /end GROUP
/begin GROUP S9_check_signal_isNan2 "LCCS_subsystem_integrated/LCCS/DtrmnLCCS_sensor_signal_rationality/check_signal_isNan2" /begin REF_MEASUREMENT VfLCCS_velocity_rel_x /end REF_MEASUREMENT /end GROUP
/begin GROUP S9_check_signal_isNan6 "LCCS_subsystem_integrated/LCCS/DtrmnLCCS_sensor_signal_rationality/check_signal_isNan6" /begin REF_MEASUREMENT VbLCCS_steer_control_enable /end REF_MEASUREMENT /end GROUP
/begin GROUP S9_check_signal_isNan8 "LCCS_subsystem_integrated/LCCS/DtrmnLCCS_sensor_signal_rationality/check_signal_isNan8" /begin REF_MEASUREMENT VcLCCS_VCU1_ICPV_EPSMODE /end REF_MEASUREMENT /end GROUP
/begin GROUP S9_check_signal_isNan9 "LCCS_subsystem_integrated/LCCS/DtrmnLCCS_sensor_signal_rationality/check_signal_isNan9" /begin REF_MEASUREMENT VfLCCS_VCU1_ICPV_StrAngle /end REF_MEASUREMENT /end GROUP
/begin GROUP S10_steering_control_machine "LCCS_subsystem_integrated/LCCS/DtrmnLCCS_steering_control_output/steering_control_machine" /begin REF_CHARACTERISTIC KfLCCS_t_SampleTime KfLCCS_t_lateral_movement_delay /end REF_CHARACTERISTIC
 /begin REF_MEASUREMENT VbLCCS_lateral_movement_enabled VbLCCS_steering_control_active VbLCCS_steering_control_engaged VbLCCS_steering_control_stable /end REF_MEASUREMENT
/end GROUP
/begin GROUP S53_slowpath_steer_PI "LCCS_subsystem_integrated/LCCS/CalcLCCS_lateral_control_main/lateral_control/slowpath_steer_PI" /begin REF_CHARACTERISTIC KfLCCS_d_LateralErrorDeadBand KfLCCS_t_SampleTime /end REF_CHARACTERISTIC
 /begin REF_MEASUREMENT VfLCCS_slowpath_steer_I VfLCCS_slowpath_steer_P VfLCCS_slowpath_steer_PI /end REF_MEASUREMENT
/end GROUP
/begin GROUP S54_angular_vel_limit "LCCS_subsystem_integrated/LCCS/CalcLCCS_lateral_control_main/steering_wheel_angle/angular_vel_limit"
 /begin SUB_GROUP S76_frontwheel_2_steeringwheel S76_rate_limit S76_steering_angle_limit /end SUB_GROUP
/end GROUP
/begin GROUP S76_frontwheel_2_steeringwheel "LCCS_subsystem_integrated/LCCS/CalcLCCS_lateral_control_main/steering_wheel_angle/angular_vel_limit/frontwheel_2_steeringwheel"
 /begin REF_CHARACTERISTIC KfLCCS_Ang_steering_center_position KfLCCS_r_veh_strwhl_2_frtwhl_ratio /end REF_CHARACTERISTIC
 /begin REF_MEASUREMENT VfLCCS_veh_strwhl_angle_des /end REF_MEASUREMENT
/end GROUP
/begin GROUP S76_rate_limit "LCCS_subsystem_integrated/LCCS/CalcLCCS_lateral_control_main/steering_wheel_angle/angular_vel_limit/rate_limit" /begin REF_CHARACTERISTIC KfLCCS_r_steering_rate_forward_gain /end REF_CHARACTERISTIC
 /begin REF_MEASUREMENT VfLCCS_frtwhl_angle_step_limit VfLCCS_veh_frtwhl_angle_des_ramped /end REF_MEASUREMENT
/end GROUP
/begin GROUP S76_steering_angle_limit "LCCS_subsystem_integrated/LCCS/CalcLCCS_lateral_control_main/steering_wheel_angle/angular_vel_limit/steering_angle_limit"
 /begin REF_CHARACTERISTIC KfLCCS_r_veh_strwhl_2_frtwhl_ratio KfLCCS_t_SampleTime KtLCCS_Ang_steering_angle_max KtLCCS_Ang_steering_angle_step KtLCCS_Ang_steering_angle_step_engaging /end REF_CHARACTERISTIC
 /begin REF_MEASUREMENT VfLCCS_frtwhl_angle_limit_manual /end REF_MEASUREMENT
/end GROUP
/begin GROUP LCWS_subsystem_integrated "LCWS_subsystem_integrated" ROOT /begin SUB_GROUP Root_LCWS_Subsystem /end SUB_GROUP /end GROUP
/begin GROUP Root_LCWS_Subsystem "LCWS_subsystem_integrated/LCWS_Subsystem"
 /begin SUB_GROUP S1_CalcLLCWEnabledSubsystem S1_CalcRLCWEnabledSubsystem S1_Dtmn_Subsystem S1_input_Subsystem S1_output_Subsystem /end SUB_GROUP
/end GROUP
/begin GROUP S1_CalcLLCWEnabledSubsystem "LCWS_subsystem_integrated/LCWS_Subsystem/CalcLLCWEnabledSubsystem"
 /begin REF_MEASUREMENT VeLCWS_left_warning_status ViLCWS_bswL ViLCWS_bswLL ViLCWS_bswL_ID ViLCWS_cvwL ViLCWS_cvwL_ID /end REF_MEASUREMENT
/end GROUP
/begin GROUP S1_CalcRLCWEnabledSubsystem "LCWS_subsystem_integrated/LCWS_Subsystem/CalcRLCWEnabledSubsystem"
 /begin REF_MEASUREMENT VeLCWS_right_warning_status ViLCWS_bswR ViLCWS_bswR_ID ViLCWS_cvwR ViLCWS_cvwR_ID /end REF_MEASUREMENT
/end GROUP
/begin GROUP S1_Dtmn_Subsystem "LCWS_subsystem_integrated/LCWS_Subsystem/Dtmn_Subsystem" /begin REF_MEASUREMENT VeLCWS_active_status /end REF_MEASUREMENT /end GROUP
/begin GROUP S1_input_Subsystem "LCWS_subsystem_integrated/LCWS_Subsystem/input_Subsystem"
 /begin SUB_GROUP S5_Calibration_Subsystem S5_CvrtInput_Subsystem S5_CvrtObtVecFunctionEnabled /end SUB_GROUP
/end GROUP
/begin GROUP S1_output_Subsystem "LCWS_subsystem_integrated/LCWS_Subsystem/output_Subsystem"
 /begin REF_MEASUREMENT VeLCWS_left_warning_status_out VeLCWS_right_warning_status_out /end REF_MEASUREMENT
/end GROUP
/begin GROUP S5_Calibration_Subsystem "LCWS_subsystem_integrated/LCWS_Subsystem/input_Subsystem/Calibration_Subsystem"
 /begin REF_CHARACTERISTIC KbLCWS_Switch KfLCWS_c_DisbleCurveThrshMax KfLCWS_c_EnbleCurveThrshMax KfLCWS_d_BSDLargerZone_BackDis KfLCWS_d_BSDLargerZone_FarDis KfLCWS_d_BSDLargerZone_FrontDis KfLCWS_d_BSDLargerZone_NearDis KfLCWS_d_BSDZone_BackDis KfLCWS_d_BSDZone_Eye95Dis KfLCWS_d_BSDZone_FarDis KfLCWS_d_BSDZone_FrontDis KfLCWS_d_BSDZone_NearDis KfLCWS_d_CVLargerZone_FrontDis KfLCWS_d_CVZone_FrontDis KfLCWS_d_NearDisHiLevel KfLCWS_d_VehLenth KfLCWS_d_VehWidth KfLCWS_r_ObtWidthProportion KfLCWS_t_TTCLargerThrsh_LowLevel KfLCWS_t_TTCThrshHiLevel KfLCWS_t_TTCThrshLowLevel KfLCWS_v_DisbleVehSpdThrshHi KfLCWS_v_DisbleVehSpdThrshLo KfLCWS_v_EnbleVehSpdThrshHi KfLCWS_v_EnbleVehSpdThrshLo KfLCWS_v_LatSpdThr KfLCWS_v_OncomRelSpdThrshHi_in KfLCWS_v_OncomRelSpdThrshHi_out /end REF_CHARACTERISTIC
/end GROUP
/begin GROUP S5_CvrtInput_Subsystem "LCWS_subsystem_integrated/LCWS_Subsystem/input_Subsystem/CvrtInput_Subsystem" /begin REF_CHARACTERISTIC KbLCWS_curve /end REF_CHARACTERISTIC /begin REF_MEASUREMENT VfLCWS_curvature VfLCWS_gear_in VfLCWS_speed_in /end REF_MEASUREMENT /end GROUP
/begin GROUP S5_CvrtObtVecFunctionEnabled "LCWS_subsystem_integrated/LCWS_Subsystem/input_Subsystem/CvrtObtVecFunctionEnabled" /begin REF_CHARACTERISTIC KbLCWS_ObtFilter KbLCWS_ObtStaticIn /end REF_CHARACTERISTIC
 /begin REF_MEASUREMENT VaLCWS_Obt VaLCWS_Vx_in VaLCWS_Vy_in VaLCWS_heading_in VaLCWS_id_in VaLCWS_motion_status_in VaLCWS_nearest_point_rel_x_in VaLCWS_nearest_point_rel_y_in VaLCWS_obt_lenth_in VaLCWS_obt_width_in VaLCWS_orientation_in VaLCWS_position_zone_in VaLCWS_type VaLCWS_x_in VaLCWS_y_in VnLCWS_num_L VnLCWS_num_R VnLCWS_num_in /end REF_MEASUREMENT
/end GROUP
/begin GROUP LDWS_subsystem_integrated "LDWS_subsystem_integrated" ROOT /begin SUB_GROUP Root_LDWS_subsystem_integrated /end SUB_GROUP /end GROUP
/begin GROUP Root_LDWS_subsystem_integrated "LDWS_subsystem_integrated/LDWS_subsystem_integrated"
 /begin SUB_GROUP S1_Derivation S1_EnablingManager S1_LnMkrFilter S1_OutputManager S1_Road_Enable_Estimator S1_SuppressionManager S1_TriggerManager S1_WarningManager /end SUB_GROUP
 /begin REF_CHARACTERISTIC KbLDWS_WarnAllowed /end REF_CHARACTERISTIC
/end GROUP
/begin GROUP S1_Derivation "LDWS_subsystem_integrated/LDWS_subsystem_integrated/Derivation" /begin REF_MEASUREMENT VfLDWS_SteerAngleRate /end REF_MEASUREMENT /end GROUP
/begin GROUP S1_EnablingManager "LDWS_subsystem_integrated/LDWS_subsystem_integrated/EnablingManager" /begin SUB_GROUP S3_ResetCondition S3_SR_FF S3_SetCondition /end SUB_GROUP
 /begin REF_CHARACTERISTIC KfLDWS_c_CurvLwrBnd KfLDWS_c_CurvUprBnd KfLDWS_d_LnWidthLwrBnd KfLDWS_d_LnWidthUprBnd KfLDWS_v_SpdLwrBnd KfLDWS_v_SpdUprBnd /end REF_CHARACTERISTIC
 /begin REF_MEASUREMENT VbLDWS_CurvValid VbLDWS_LnMkrValid VbLDWS_SpdRngValid VbLDWS_WidthValid /end REF_MEASUREMENT
/end GROUP
/begin GROUP S1_LnMkrFilter "LDWS_subsystem_integrated/LDWS_subsystem_integrated/LnMkrFilter" /begin SUB_GROUP S4_Filter_Left S4_Filter_Right /end SUB_GROUP
 /begin REF_MEASUREMENT VfLDWS_BackToLeDist VfLDWS_Curvature VfLDWS_LeC1Filtd VfLDWS_RiC1Filtd /end REF_MEASUREMENT
/end GROUP
/begin GROUP S1_OutputManager "LDWS_subsystem_integrated/LDWS_subsystem_integrated/OutputManager" /begin REF_MEASUREMENT VbLDWS_WrnSt VeLDWS_LaDetecSt VeLDWS_WrnSd /end REF_MEASUREMENT /end GROUP
/begin GROUP S1_Road_Enable_Estimator "LDWS_subsystem_integrated/LDWS_subsystem_integrated/Road_Enable_Estimator" /begin SUB_GROUP S6_Subsystem S6_Subsystem1 /end SUB_GROUP /end GROUP
/begin GROUP S1_SuppressionManager "LDWS_subsystem_integrated/LDWS_subsystem_integrated/SuppressionManager" /begin SUB_GROUP S7_DtrmnSuppLe S7_DtrmnSuppRi /end SUB_GROUP /begin REF_CHARACTERISTIC KbLDWS_SuppLeSwitch KbLDWS_SuppRiSwitch /end REF_CHARACTERISTIC
 /begin REF_MEASUREMENT VfLDWS_LeIndicatorSt VfLDWS_RiIndicatorSt VfLDWS_SteerTorque /end REF_MEASUREMENT
/end GROUP
/begin GROUP S1_TriggerManager "LDWS_subsystem_integrated/LDWS_subsystem_integrated/TriggerManager"
 /begin SUB_GROUP S8_DtrmnActLe S8_DtrmnActRi S8_LanePositionConstraint S8_LeadDirectionCondition S8_TTLCondition S8_ThetaCalc S8_VehicleToBdlnCalc /end SUB_GROUP
 /begin REF_MEASUREMENT VbLDWS_ActLeLDW VbLDWS_ActRiLDW VfLDWS_BackToRiDist VfLDWS_SteerAngle VfLDWS_Vx VfLDWS_Vy /end REF_MEASUREMENT
/end GROUP
/begin GROUP S1_WarningManager "LDWS_subsystem_integrated/LDWS_subsystem_integrated/WarningManager"
 /begin REF_CHARACTERISTIC KbLDWS_EnableSwitch KcLDWS_CntSample KfLDWS_t_CntMaxWarnHold KfLDWS_t_CntMinWarnHold KfLDWS_t_CntOnHold /end REF_CHARACTERISTIC
 /begin REF_MEASUREMENT VeLDWS_OnStateSt VeLDWS_SysSt /end REF_MEASUREMENT
/end GROUP
/begin GROUP S3_ResetCondition "LDWS_subsystem_integrated/LDWS_subsystem_integrated/EnablingManager/ResetCondition"
 /begin REF_CHARACTERISTIC KcLDWS_CntSample KfLDWS_t_CurvNotValidTime KfLDWS_t_LnMkrNotValidTime KfLDWS_t_LnWidthNotValidTime KfLDWS_t_SpdRngNotValidTime /end REF_CHARACTERISTIC
/end GROUP
/begin GROUP S3_SR_FF "LDWS_subsystem_integrated/LDWS_subsystem_integrated/EnablingManager/SR_FF" /begin REF_MEASUREMENT VbLDWS_EnabledLDW /end REF_MEASUREMENT /end GROUP
/begin GROUP S3_SetCondition "LDWS_subsystem_integrated/LDWS_subsystem_integrated/EnablingManager/SetCondition"
 /begin REF_CHARACTERISTIC KcLDWS_CntSample KfLDWS_t_CurvValidTime KfLDWS_t_LnMkrValidTime KfLDWS_t_LnWidthValidTime KfLDWS_t_SpdRngValidTime /end REF_CHARACTERISTIC
/end GROUP
/begin GROUP S4_Filter_Left "LDWS_subsystem_integrated/LDWS_subsystem_integrated/LnMkrFilter/Filter_Left" /begin REF_MEASUREMENT VfLDWS_LeC0Filtd /end REF_MEASUREMENT /end GROUP
/begin GROUP S4_Filter_Right "LDWS_subsystem_integrated/LDWS_subsystem_integrated/LnMkrFilter/Filter_Right" /begin REF_MEASUREMENT VfLDWS_RiC0Filtd /end REF_MEASUREMENT /end GROUP
/begin GROUP S6_Subsystem "LDWS_subsystem_integrated/LDWS_subsystem_integrated/Road_Enable_Estimator/Subsystem" /begin REF_CHARACTERISTIC KcLDWS_CntSample KfLDWS_r_LaMkrQlt KfLDWS_t_LnMkrMissThrsh /end REF_CHARACTERISTIC /begin REF_MEASUREMENT VbLDWS_RdEnblLe /end REF_MEASUREMENT /end GROUP
/begin GROUP S6_Subsystem1 "LDWS_subsystem_integrated/LDWS_subsystem_integrated/Road_Enable_Estimator/Subsystem1" /begin REF_CHARACTERISTIC KcLDWS_CntSample KfLDWS_r_LaMkrQlt KfLDWS_t_LnMkrMissThrsh /end REF_CHARACTERISTIC /begin REF_MEASUREMENT VbLDWS_RdEnblRi /end REF_MEASUREMENT /end GROUP
/begin GROUP S7_DtrmnSuppLe "LDWS_subsystem_integrated/LDWS_subsystem_integrated/SuppressionManager/DtrmnSuppLe"
 /begin REF_CHARACTERISTIC KcLDWS_CntSample KfLDWS_Ang_SuppSteerAngThrsh KfLDWS_M_SuppTorque KfLDWS_t_SuppIndiTime KfLDWS_t_SuppSteerAngTime KfLDWS_t_SuppSteerRateTime KfLDWS_t_SuppTorqueTime KfLDWS_v_SuppSteerRateThrsh /end REF_CHARACTERISTIC
 /begin REF_MEASUREMENT VbLDWS_SuppLe /end REF_MEASUREMENT
/end GROUP
/begin GROUP S7_DtrmnSuppRi "LDWS_subsystem_integrated/LDWS_subsystem_integrated/SuppressionManager/DtrmnSuppRi"
 /begin REF_CHARACTERISTIC KcLDWS_CntSample KfLDWS_Ang_SuppSteerAngThrsh KfLDWS_M_SuppTorque KfLDWS_t_SuppIndiTime KfLDWS_t_SuppSteerAngTime KfLDWS_t_SuppSteerRateTime KfLDWS_t_SuppTorqueTime KfLDWS_v_SuppSteerRateThrsh /end REF_CHARACTERISTIC
 /begin REF_MEASUREMENT VbLDWS_SuppRi /end REF_MEASUREMENT
/end GROUP
/begin GROUP S8_DtrmnActLe "LDWS_subsystem_integrated/LDWS_subsystem_integrated/TriggerManager/DtrmnActLe" /begin REF_CHARACTERISTIC KfLDWS_t_TLCThrsh /end REF_CHARACTERISTIC /end GROUP
/begin GROUP S8_DtrmnActRi "LDWS_subsystem_integrated/LDWS_subsystem_integrated/TriggerManager/DtrmnActRi" /begin REF_CHARACTERISTIC KfLDWS_t_TLCThrsh /end REF_CHARACTERISTIC /end GROUP
/begin GROUP S8_LanePositionConstraint "LDWS_subsystem_integrated/LDWS_subsystem_integrated/TriggerManager/LanePositionConstraint" /begin SUB_GROUP S46_DtrmnIsOnLeLine S46_DtrmnIsOnRiLine /end SUB_GROUP /end GROUP
/begin GROUP S8_LeadDirectionCondition "LDWS_subsystem_integrated/LDWS_subsystem_integrated/TriggerManager/LeadDirectionCondition" /begin REF_MEASUREMENT VbLDWS_LeadDrctn /end REF_MEASUREMENT /end GROUP
/begin GROUP S8_TTLCondition "LDWS_subsystem_integrated/LDWS_subsystem_integrated/TriggerManager/TTLCondition" /begin SUB_GROUP S48_TLC_calculation S48_v_lat_calculation /end SUB_GROUP /end GROUP
/begin GROUP S8_ThetaCalc "LDWS_subsystem_integrated/LDWS_subsystem_integrated/TriggerManager/ThetaCalc" /begin REF_CHARACTERISTIC KbLDWS_ThetaSwitch /end REF_CHARACTERISTIC /begin REF_MEASUREMENT VfLDWS_Theta /end REF_MEASUREMENT /end GROUP
/begin GROUP S8_VehicleToBdlnCalc "LDWS_subsystem_integrated/LDWS_subsystem_integrated/TriggerManager/VehicleToBdlnCalc"
 /begin REF_CHARACTERISTIC KfLDWS_Ang_BkToCnrAng KfLDWS_c_CurvUprBnd KfLDWS_d_BkToFrtCnrDist KfLDWS_d_EdgBuff KfLDWS_k_CurvBuffCoe /end REF_CHARACTERISTIC
 /begin REF_MEASUREMENT VfLDWS_EdgeLaneLe VfLDWS_EdgeLaneRi /end REF_MEASUREMENT
/end GROUP
/begin GROUP S46_DtrmnIsOnLeLine "LDWS_subsystem_integrated/LDWS_subsystem_integrated/TriggerManager/LanePositionConstraint/DtrmnIsOnLeLine"
 /begin REF_CHARACTERISTIC KfLDWS_d_WarnLineLvlOne KfLDWS_d_WarnLineLvlThree KfLDWS_k_WarnLineLvlTwo /end REF_CHARACTERISTIC
 /begin REF_MEASUREMENT VbLDWS_IsOnLeLine /end REF_MEASUREMENT
/end GROUP
/begin GROUP S46_DtrmnIsOnRiLine "LDWS_subsystem_integrated/LDWS_subsystem_integrated/TriggerManager/LanePositionConstraint/DtrmnIsOnRiLine"
 /begin REF_CHARACTERISTIC KfLDWS_d_WarnLineLvlOne KfLDWS_d_WarnLineLvlThree KfLDWS_k_WarnLineLvlTwo /end REF_CHARACTERISTIC
 /begin REF_MEASUREMENT VbLDWS_IsOnRiLine /end REF_MEASUREMENT
/end GROUP
/begin GROUP S48_TLC_calculation "LDWS_subsystem_integrated/LDWS_subsystem_integrated/TriggerManager/TTLCondition/TLC_calculation" /begin REF_MEASUREMENT VfLDWS_TLCLe VfLDWS_TLCRi /end REF_MEASUREMENT /end GROUP
/begin GROUP S48_v_lat_calculation "LDWS_subsystem_integrated/LDWS_subsystem_integrated/TriggerManager/TTLCondition/v_lat_calculation" /begin REF_MEASUREMENT VfLDWS_VLatLe VfLDWS_VLatRi /end REF_MEASUREMENT /end GROUP
/begin GROUP AEBD_subsystem_integrated "AEBD_subsystem_integrated" ROOT /begin SUB_GROUP Root_AEBD_Subsystem /end SUB_GROUP /end GROUP
/begin GROUP Root_AEBD_Subsystem "AEBD_subsystem_integrated/AEBD_Subsystem"
 /begin REF_CHARACTERISTIC KbAEBD_ADCU_CANError KbAEBD_AccelerationSensorError KbAEBD_ESCError KbAEBD_ErrorClear KcAEBD_ErrorCountThrsh KfAEBD_a_AccelDeviation KfAEBD_t_WaitTimeThrsh /end REF_CHARACTERISTIC
 /begin REF_MEASUREMENT VbAEBD_AEBaError VbAEBD_AEBrequest VbAEBD_Error VbAEBD_Pedoff VbAEBD_Suppress VcAEBD_ErrorCount VfAEBD_AEB_a VfAEBD_t_DelayTime /end REF_MEASUREMENT
/end GROUP
/begin GROUP ALCA_subsystem_integrated "ALCA_subsystem_integrated" ROOT /begin SUB_GROUP Root_ALCA /end SUB_GROUP
 /begin REF_MEASUREMENT VfALCA_HasLeftLane VfALCA_HasRightLane VfALCA_TargetLaneLength VfALCA_TargetLaneType VfALCA_TargetLaneWidth VfALCA_TargetSideLaneMarkerType VfALCA_d_EGOLaneLength /end REF_MEASUREMENT
/end GROUP
/begin GROUP Root_ALCA "ALCA_subsystem_integrated/ALCA" /begin SUB_GROUP S1_ALCA_Enabled /end SUB_GROUP
 /begin REF_MEASUREMENT VbALCA_ALCAEnableFromDCSN VbALCA_RequestOutput VeALCA_NotFulfillReasonOutput VeALCA_ReqSideOutput VeALCA_StateOutput VfALCA_FaultOutput VfALCA_v_LateralSpeedOutput /end REF_MEASUREMENT
/end GROUP
/begin GROUP S1_ALCA_Enabled "ALCA_subsystem_integrated/ALCA/ALCA_Enabled"
 /begin SUB_GROUP S3_ALCA_CalcLateralV_ S3_ALCA_CheckLCConditions S3_ALCA_DtrmnALCAState S3_ALCA_Init_global S3_ALCA_InputDataProcess /end SUB_GROUP
 /begin REF_CHARACTERISTIC KfALCA_d_EgoVehWidth KfALCA_d_LaneWidthMax KfALCA_d_TouchedNewLaneDist KfALCA_t_LaneChangeTimeMax KfALCA_t_LaneChangeTimeMin /end REF_CHARACTERISTIC
 /begin REF_MEASUREMENT VfALCA_d_LateralDist2GoFromLCCS /end REF_MEASUREMENT
/end GROUP
/begin GROUP S3_ALCA_CalcLateralV_ "ALCA_subsystem_integrated/ALCA/ALCA_Enabled/ALCA_CalcLateralV "
 /begin REF_CHARACTERISTIC KfALCA_d_EnterSecondStageThrsh KfALCA_r_OutputLarteralVRatio KfALCA_v_LateralSpeedOfSecondStage /end REF_CHARACTERISTIC
 /begin REF_MEASUREMENT VfALCA_t_LCTime /end REF_MEASUREMENT
/end GROUP
/begin GROUP S3_ALCA_CheckLCConditions "ALCA_subsystem_integrated/ALCA/ALCA_Enabled/ALCA_CheckLCConditions" /begin SUB_GROUP S8_Init_global S8_MonitorOBFU /end SUB_GROUP
 /begin REF_CHARACTERISTIC KbALCA_EnblCheckMPFULaneMarkerType KbALCA_EnblCheckObstacles KbALCA_EnblOvrdLaneLength KfALCA_d_DefaultLaneLength KfALCA_d_Dist2LaneChangeFinish KfALCA_r_EgoWidth2LaneWidthRation KfALCA_t_HoldTimeForComplete KfALCA_v_SpeedLaneChangeEnblMax KfALCA_v_SpeedLaneChangeEnblMin KfAlCA_d_CheckOBFUForwardDistMax /end REF_CHARACTERISTIC
 /begin REF_MEASUREMENT VbALCA_LC_Complete VbALCA_TouchedNewLane VfALCA_d_EGOLaneCenter2Host VfALCA_d_Host2TargetLaneCenter VfALCA_d_TargetSideLaneMarker2Host /end REF_MEASUREMENT
/end GROUP
/begin GROUP S3_ALCA_DtrmnALCAState "ALCA_subsystem_integrated/ALCA/ALCA_Enabled/ALCA_DtrmnALCAState"
 /begin REF_CHARACTERISTIC KfALCA_t_ExitFinishDelay KfALCA_t_ExitWaittingDelay KfALCA_t_PeriodFunctionCall KfALCA_t_WaitForDriverActionMax /end REF_CHARACTERISTIC
 /begin REF_MEASUREMENT VbALCA_ResetLaneChangeReq /end REF_MEASUREMENT
/end GROUP
/begin GROUP S3_ALCA_Init_global "ALCA_subsystem_integrated/ALCA/ALCA_Enabled/ALCA_Init_global"
 /begin REF_CHARACTERISTIC KfALCA_d_EgoVehWidth KfALCA_d_LaneWidthMax KfALCA_d_TouchedNewLaneDist KfALCA_t_LaneChangeTimeMax KfALCA_t_LaneChangeTimeMin /end REF_CHARACTERISTIC
/end GROUP
/begin GROUP S3_ALCA_InputDataProcess "ALCA_subsystem_integrated/ALCA/ALCA_Enabled/ALCA_InputDataProcess"
 /begin SUB_GROUP S12_DtrmALCA_dcsn_info S12_FaultDetection S12_adc_path_prediction S12_global_init /end SUB_GROUP
 /begin REF_CHARACTERISTIC KbALCA_EnblCheckMPFUFusionStatus KbALCA_EnblCheckTimestamp /end REF_CHARACTERISTIC
 /begin REF_MEASUREMENT VfALCA_LeftDist2Host VfALCA_LeftLaneMarkerFusionStatus VfALCA_LeftLaneMarkerType VfALCA_LeftLaneMarker_C0 VfALCA_LeftLaneMarker_C1 VfALCA_LeftLaneMarker_C2 VfALCA_LeftLaneMarker_C3 VfALCA_RightDist2Host VfALCA_RightLaneMarkerFusionStatus VfALCA_RightLaneMarkerType VfALCA_RightLaneMarker_C0 VfALCA_RightLaneMarker_C1 VfALCA_RightLaneMarker_C2 VfALCA_RightLaneMarker_C3 VfALCA_v_VehSpeed VfALCA_v_VehVx VfALCA_v_VehVy /end REF_MEASUREMENT
/end GROUP
/begin GROUP S8_Init_global "ALCA_subsystem_integrated/ALCA/ALCA_Enabled/ALCA_CheckLCConditions/Init_global"
 /begin REF_CHARACTERISTIC KbALCA_EnblCheckMPFULaneMarkerType KbALCA_EnblCheckObstacles KbALCA_EnblOvrdLaneLength KfALCA_d_DefaultLaneLength KfALCA_r_EgoWidth2LaneWidthRation KfALCA_v_SpeedLaneChangeEnblMax KfALCA_v_SpeedLaneChangeEnblMin KfAlCA_d_CheckOBFUForwardDistMax /end REF_CHARACTERISTIC
/end GROUP
/begin GROUP S8_MonitorOBFU "ALCA_subsystem_integrated/ALCA/ALCA_Enabled/ALCA_CheckLCConditions/MonitorOBFU"
 /begin REF_MEASUREMENT VfALCA_ObstacleCenter_x VfALCA_ObstacleCenter_y VfALCA_ObstacleHeading VfALCA_ObstacleID VfALCA_ObstacleLength VfALCA_ObstacleNearest_x VfALCA_ObstacleNearest_y VfALCA_ObstacleWidth VfALCA_v_Obstacle_Vx VfALCA_v_Obstacle_Vy /end REF_MEASUREMENT
/end GROUP
/begin GROUP S12_DtrmALCA_dcsn_info "ALCA_subsystem_integrated/ALCA/ALCA_Enabled/ALCA_InputDataProcess/DtrmALCA_dcsn_info"
 /begin REF_CHARACTERISTIC KbALCA_ChanggLaneCancelReqOvrd KbALCA_ChanggLaneReqOvrd KbALCA_EnblOvrdReqFromECSN KeALCA_ChangeLaneReqSideOvrd /end REF_CHARACTERISTIC
 /begin REF_MEASUREMENT VbALCA_LC_CancelReq VbALCA_LC_CancelReqFromDCSN VbALCA_LC_Req VbALCA_LC_ReqFromDCSN VeALCA_ReqSide VeALCA_ReqSideFromDCSN /end REF_MEASUREMENT
/end GROUP
/begin GROUP S12_FaultDetection "ALCA_subsystem_integrated/ALCA/ALCA_Enabled/ALCA_InputDataProcess/FaultDetection" /begin REF_CHARACTERISTIC KfALCA_t_TimeNReceivedThrsh /end REF_CHARACTERISTIC /begin REF_MEASUREMENT VfALCA_FaultInit /end REF_MEASUREMENT /end GROUP
/begin GROUP S12_adc_path_prediction "ALCA_subsystem_integrated/ALCA/ALCA_Enabled/ALCA_InputDataProcess/adc_path_prediction"
 /begin REF_CHARACTERISTIC KfALCA_d_EgoVehWheelBase KfALCA_r_CoeffStrwhl2Radius KfALCA_r_EgoVehStrwhl2FrtwhlRatio /end REF_CHARACTERISTIC
/end GROUP
/begin GROUP S12_global_init "ALCA_subsystem_integrated/ALCA/ALCA_Enabled/ALCA_InputDataProcess/global_init" /begin REF_CHARACTERISTIC KbALCA_EnblCheckMPFUFusionStatus /end REF_CHARACTERISTIC /end GROUP
/begin GROUP bsw_critical_variable "bsw_critical_variable" ROOT /begin SUB_GROUP BSW_Thruput_Measure /end SUB_GROUP /end GROUP
/begin GROUP BSW_Thruput_Measure "BSW_Thruput_Measure" /begin REF_MEASUREMENT ADCtrl_Thruput_MS os_core0_tick_cnt /end REF_MEASUREMENT /end GROUP
/end MODULE
/end PROJECT
