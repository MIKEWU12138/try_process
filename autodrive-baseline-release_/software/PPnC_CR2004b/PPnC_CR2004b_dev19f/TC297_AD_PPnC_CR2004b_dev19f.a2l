ASAP2_VERSION 1 60
/begin PROJECT hj_adcu "_default_ProjectLongIdentifier"
/begin HEADER "_default_HeaderComment" PROJECT_NO _default_ProjectNr /end HEADER
/begin MODULE _default_ModuleName "_default_ModuleLongIdentifier"
/begin MOD_COMMON "_default_ModCommonComment" DEPOSIT ABSOLUTE BYTE_ORDER MSB_LAST ALIGNMENT_BYTE 1 ALIGNMENT_WORD 2 ALIGNMENT_LONG 4 ALIGNMENT_FLOAT32_IEEE 4 ALIGNMENT_FLOAT64_IEEE 4 /end MOD_COMMON
/begin MOD_COMMON "Mod Common Comment Here" BYTE_ORDER MSB_LAST /end MOD_COMMON
/begin RECORD_LAYOUT Scalar_BOOLEAN FNC_VALUES 1 UBYTE COLUMN_DIR DIRECT /end RECORD_LAYOUT
/begin RECORD_LAYOUT Scalar_UBYTE FNC_VALUES 1 UBYTE COLUMN_DIR DIRECT /end RECORD_LAYOUT
/begin RECORD_LAYOUT Scalar_BYTE FNC_VALUES 1 SBYTE COLUMN_DIR DIRECT /end RECORD_LAYOUT
/begin RECORD_LAYOUT Scalar_FLOAT32_IEEE FNC_VALUES 1 FLOAT32_IEEE COLUMN_DIR DIRECT /end RECORD_LAYOUT
/begin RECORD_LAYOUT Lookup1D_BYTE FNC_VALUES 1 SBYTE COLUMN_DIR DIRECT /end RECORD_LAYOUT
/begin RECORD_LAYOUT Lookup1D_X_BYTE AXIS_PTS_X 1 SBYTE INDEX_INCR DIRECT /end RECORD_LAYOUT
/begin RECORD_LAYOUT Lookup1D_UBYTE FNC_VALUES 1 UBYTE COLUMN_DIR DIRECT /end RECORD_LAYOUT
/begin RECORD_LAYOUT Lookup1D_X_UBYTE AXIS_PTS_X 1 UBYTE INDEX_INCR DIRECT /end RECORD_LAYOUT
/begin RECORD_LAYOUT Lookup1D_UWORD FNC_VALUES 1 UWORD COLUMN_DIR DIRECT /end RECORD_LAYOUT
/begin RECORD_LAYOUT Lookup1D_X_UWORD AXIS_PTS_X 1 UWORD INDEX_INCR DIRECT /end RECORD_LAYOUT
/begin RECORD_LAYOUT Lookup1D_WORD FNC_VALUES 1 SWORD COLUMN_DIR DIRECT /end RECORD_LAYOUT
/begin RECORD_LAYOUT Lookup1D_X_WORD AXIS_PTS_X 1 SWORD INDEX_INCR DIRECT /end RECORD_LAYOUT
/begin RECORD_LAYOUT Lookup1D_FLOAT32_IEEE FNC_VALUES 1 FLOAT32_IEEE COLUMN_DIR DIRECT /end RECORD_LAYOUT
/begin RECORD_LAYOUT Lookup1D_X_FLOAT32_IEEE AXIS_PTS_X 1 FLOAT32_IEEE INDEX_INCR DIRECT /end RECORD_LAYOUT
/begin CHARACTERISTIC KtAEBS_veh_widthGain "" CURVE 0x701012a0 /* @ECU_Address@KtAEBS_veh_widthGain@ */ Lookup1D_FLOAT32_IEEE 0 AEBS_subsystem_integrated_CM_single -3.4E+38 3.4E+38
 /begin AXIS_DESCR COM_AXIS VfAEBS_veh_speed_used AEBS_subsystem_integrated_CM_single 9 -3.4E+38 3.4E+38 AXIS_PTS_REF KaAEBS_AXIS_Veh_Speed_vec /end AXIS_DESCR
/end CHARACTERISTIC
/begin CHARACTERISTIC KtAEBS_FCWL1ActiveTTCThrshld "" CURVE 0x701015dc /* @ECU_Address@KtAEBS_FCWL1ActiveTTCThrshld@ */ Lookup1D_FLOAT32_IEEE 0 AEBS_subsystem_integrated_CM_single -3.4E+38 3.4E+38
 /begin AXIS_DESCR COM_AXIS NO_INPUT_QUANTITY AEBS_subsystem_integrated_CM_single 13 -3.4E+38 3.4E+38 AXIS_PTS_REF KaAEBS_AXIS_DeltaSpeed_Vip /end AXIS_DESCR
/end CHARACTERISTIC
/begin CHARACTERISTIC KtAEBS_FCWL2ActiveTTCThrshld "" CURVE 0x701015a8 /* @ECU_Address@KtAEBS_FCWL2ActiveTTCThrshld@ */ Lookup1D_FLOAT32_IEEE 0 AEBS_subsystem_integrated_CM_single -3.4E+38 3.4E+38
 /begin AXIS_DESCR COM_AXIS NO_INPUT_QUANTITY AEBS_subsystem_integrated_CM_single 13 -3.4E+38 3.4E+38 AXIS_PTS_REF KaAEBS_AXIS_DeltaSpeed_Vip /end AXIS_DESCR
/end CHARACTERISTIC
/begin CHARACTERISTIC KtAEBS_FCWL3ActiveTTCThrshld "" CURVE 0x70101574 /* @ECU_Address@KtAEBS_FCWL3ActiveTTCThrshld@ */ Lookup1D_FLOAT32_IEEE 0 AEBS_subsystem_integrated_CM_single -3.4E+38 3.4E+38
 /begin AXIS_DESCR COM_AXIS NO_INPUT_QUANTITY AEBS_subsystem_integrated_CM_single 13 -3.4E+38 3.4E+38 AXIS_PTS_REF KaAEBS_AXIS_DeltaSpeed_Vip /end AXIS_DESCR
/end CHARACTERISTIC
/begin CHARACTERISTIC KtAEBS_a_BrakeValueLimit "" CURVE 0x701012c4 /* @ECU_Address@KtAEBS_a_BrakeValueLimit@ */ Lookup1D_FLOAT32_IEEE 0 AEBS_subsystem_integrated_CM_single -3.4E+38 3.4E+38
 /begin AXIS_DESCR COM_AXIS NO_INPUT_QUANTITY AEBS_subsystem_integrated_CM_single 10 -3.4E+38 3.4E+38 AXIS_PTS_REF KaAEBS_AXIS_Veh_Curvature_vec /end AXIS_DESCR
/end CHARACTERISTIC
/begin CHARACTERISTIC KtAEBS_PrtlBrkActiveTTCThrshld_VRU "" CURVE 0x701012ec /* @ECU_Address@KtAEBS_PrtlBrkActiveTTCThrshld_VRU@ */ Lookup1D_FLOAT32_IEEE 0 AEBS_subsystem_integrated_CM_single -3.4E+38 3.4E+38
 /begin AXIS_DESCR COM_AXIS NO_INPUT_QUANTITY AEBS_subsystem_integrated_CM_single 13 -3.4E+38 3.4E+38 AXIS_PTS_REF KaAEBS_AXIS_DeltaSpeed_Vip /end AXIS_DESCR
/end CHARACTERISTIC
/begin CHARACTERISTIC KtAEBS_PrtlBrkActiveTTCThrshld "" CURVE 0x70101320 /* @ECU_Address@KtAEBS_PrtlBrkActiveTTCThrshld@ */ Lookup1D_FLOAT32_IEEE 0 AEBS_subsystem_integrated_CM_single -3.4E+38 3.4E+38
 /begin AXIS_DESCR COM_AXIS NO_INPUT_QUANTITY AEBS_subsystem_integrated_CM_single 13 -3.4E+38 3.4E+38 AXIS_PTS_REF KaAEBS_AXIS_DeltaSpeed_Vip /end AXIS_DESCR
/end CHARACTERISTIC
/begin CHARACTERISTIC KtAEBS_PreBrkActiveTTCThrshld_VRU "" CURVE 0x70101354 /* @ECU_Address@KtAEBS_PreBrkActiveTTCThrshld_VRU@ */ Lookup1D_FLOAT32_IEEE 0 AEBS_subsystem_integrated_CM_single -3.4E+38 3.4E+38
 /begin AXIS_DESCR COM_AXIS NO_INPUT_QUANTITY AEBS_subsystem_integrated_CM_single 13 -3.4E+38 3.4E+38 AXIS_PTS_REF KaAEBS_AXIS_DeltaSpeed_Vip /end AXIS_DESCR
/end CHARACTERISTIC
/begin CHARACTERISTIC KtAEBS_PreBrkActiveTTCThrshld "" CURVE 0x70101388 /* @ECU_Address@KtAEBS_PreBrkActiveTTCThrshld@ */ Lookup1D_FLOAT32_IEEE 0 AEBS_subsystem_integrated_CM_single -3.4E+38 3.4E+38
 /begin AXIS_DESCR COM_AXIS NO_INPUT_QUANTITY AEBS_subsystem_integrated_CM_single 13 -3.4E+38 3.4E+38 AXIS_PTS_REF KaAEBS_AXIS_DeltaSpeed_Vip /end AXIS_DESCR
/end CHARACTERISTIC
/begin CHARACTERISTIC KtAEBS_LateralBuffer_Bicycle "" CURVE 0x70101548 /* @ECU_Address@KtAEBS_LateralBuffer_Bicycle@ */ Lookup1D_FLOAT32_IEEE 0 AEBS_subsystem_integrated_CM_single -3.4E+38 3.4E+38
 /begin AXIS_DESCR COM_AXIS NO_INPUT_QUANTITY AEBS_subsystem_integrated_CM_single 11 -3.4E+38 3.4E+38 AXIS_PTS_REF KaAEBS_AXIS_NearestPointX_vec /end AXIS_DESCR
/end CHARACTERISTIC
/begin CHARACTERISTIC KtAEBS_LateralBuffer_Motor "" CURVE 0x7010151c /* @ECU_Address@KtAEBS_LateralBuffer_Motor@ */ Lookup1D_FLOAT32_IEEE 0 AEBS_subsystem_integrated_CM_single -3.4E+38 3.4E+38
 /begin AXIS_DESCR COM_AXIS NO_INPUT_QUANTITY AEBS_subsystem_integrated_CM_single 11 -3.4E+38 3.4E+38 AXIS_PTS_REF KaAEBS_AXIS_NearestPointX_vec /end AXIS_DESCR
/end CHARACTERISTIC
/begin CHARACTERISTIC KtAEBS_LateralBuffer_Other "" CURVE 0x701014f0 /* @ECU_Address@KtAEBS_LateralBuffer_Other@ */ Lookup1D_FLOAT32_IEEE 0 AEBS_subsystem_integrated_CM_single -3.4E+38 3.4E+38
 /begin AXIS_DESCR COM_AXIS NO_INPUT_QUANTITY AEBS_subsystem_integrated_CM_single 11 -3.4E+38 3.4E+38 AXIS_PTS_REF KaAEBS_AXIS_NearestPointX_vec /end AXIS_DESCR
/end CHARACTERISTIC
/begin CHARACTERISTIC KtAEBS_LateralBuffer_Pedstrn "" CURVE 0x701014c4 /* @ECU_Address@KtAEBS_LateralBuffer_Pedstrn@ */ Lookup1D_FLOAT32_IEEE 0 AEBS_subsystem_integrated_CM_single -3.4E+38 3.4E+38
 /begin AXIS_DESCR COM_AXIS NO_INPUT_QUANTITY AEBS_subsystem_integrated_CM_single 11 -3.4E+38 3.4E+38 AXIS_PTS_REF KaAEBS_AXIS_NearestPointX_vec /end AXIS_DESCR
/end CHARACTERISTIC
/begin CHARACTERISTIC KtAEBS_LateralBuffer_Vehicle "" CURVE 0x70101498 /* @ECU_Address@KtAEBS_LateralBuffer_Vehicle@ */ Lookup1D_FLOAT32_IEEE 0 AEBS_subsystem_integrated_CM_single -3.4E+38 3.4E+38
 /begin AXIS_DESCR COM_AXIS NO_INPUT_QUANTITY AEBS_subsystem_integrated_CM_single 11 -3.4E+38 3.4E+38 AXIS_PTS_REF KaAEBS_AXIS_NearestPointX_vec /end AXIS_DESCR
/end CHARACTERISTIC
/begin CHARACTERISTIC KtAEBS_LongBuffer_Bicycle "" CURVE 0x7010146c /* @ECU_Address@KtAEBS_LongBuffer_Bicycle@ */ Lookup1D_FLOAT32_IEEE 0 AEBS_subsystem_integrated_CM_single -3.4E+38 3.4E+38
 /begin AXIS_DESCR COM_AXIS NO_INPUT_QUANTITY AEBS_subsystem_integrated_CM_single 11 -3.4E+38 3.4E+38 AXIS_PTS_REF KaAEBS_AXIS_NearestPointY_vec /end AXIS_DESCR
/end CHARACTERISTIC
/begin CHARACTERISTIC KtAEBS_LongBuffer_Motor "" CURVE 0x70101440 /* @ECU_Address@KtAEBS_LongBuffer_Motor@ */ Lookup1D_FLOAT32_IEEE 0 AEBS_subsystem_integrated_CM_single -3.4E+38 3.4E+38
 /begin AXIS_DESCR COM_AXIS NO_INPUT_QUANTITY AEBS_subsystem_integrated_CM_single 11 -3.4E+38 3.4E+38 AXIS_PTS_REF KaAEBS_AXIS_NearestPointY_vec /end AXIS_DESCR
/end CHARACTERISTIC
/begin CHARACTERISTIC KtAEBS_LongBuffer_Other "" CURVE 0x70101414 /* @ECU_Address@KtAEBS_LongBuffer_Other@ */ Lookup1D_FLOAT32_IEEE 0 AEBS_subsystem_integrated_CM_single -3.4E+38 3.4E+38
 /begin AXIS_DESCR COM_AXIS NO_INPUT_QUANTITY AEBS_subsystem_integrated_CM_single 11 -3.4E+38 3.4E+38 AXIS_PTS_REF KaAEBS_AXIS_NearestPointY_vec /end AXIS_DESCR
/end CHARACTERISTIC
/begin CHARACTERISTIC KtAEBS_LongBuffer_Pedstrn "" CURVE 0x701013e8 /* @ECU_Address@KtAEBS_LongBuffer_Pedstrn@ */ Lookup1D_FLOAT32_IEEE 0 AEBS_subsystem_integrated_CM_single -3.4E+38 3.4E+38
 /begin AXIS_DESCR COM_AXIS NO_INPUT_QUANTITY AEBS_subsystem_integrated_CM_single 11 -3.4E+38 3.4E+38 AXIS_PTS_REF KaAEBS_AXIS_NearestPointY_vec /end AXIS_DESCR
/end CHARACTERISTIC
/begin CHARACTERISTIC KtAEBS_LongBuffer_Vehicle "" CURVE 0x701013bc /* @ECU_Address@KtAEBS_LongBuffer_Vehicle@ */ Lookup1D_FLOAT32_IEEE 0 AEBS_subsystem_integrated_CM_single -3.4E+38 3.4E+38
 /begin AXIS_DESCR COM_AXIS NO_INPUT_QUANTITY AEBS_subsystem_integrated_CM_single 11 -3.4E+38 3.4E+38 AXIS_PTS_REF KaAEBS_AXIS_NearestPointY_vec /end AXIS_DESCR
/end CHARACTERISTIC
/begin CHARACTERISTIC KfAEBS_Change_LateralPosThrsh "Object change lateral position threshold" VALUE 0x70101780 /* @ECU_Address@KfAEBS_Change_LateralPosThrsh@ */ Scalar_FLOAT32_IEEE 0 AEBS_subsystem_integrated_CM_single -3.4E+38 3.4E+38 /end CHARACTERISTIC
/begin CHARACTERISTIC KfAEBS_Change_LonglPosThrsh "Object change longitudinal position threshold" VALUE 0x7010177c /* @ECU_Address@KfAEBS_Change_LonglPosThrsh@ */ Scalar_FLOAT32_IEEE 0 AEBS_subsystem_integrated_CM_single -3.4E+38 3.4E+38 /end CHARACTERISTIC
/begin CHARACTERISTIC KfAEBS_CoeffStrwhl2Radius "When there's no EGMO, steer wheel angle is used to calculate Radius,
      Coefficent correction of radius." VALUE 0x70101778 /* @ECU_Address@KfAEBS_CoeffStrwhl2Radius@ */ Scalar_FLOAT32_IEEE 0 AEBS_subsystem_integrated_CM_single -3.4E+38 3.4E+38 /end CHARACTERISTIC
/begin CHARACTERISTIC KfAEBS_Cur_LeftTurnThrshHi "Curvature left turn threshold High" VALUE 0x70101774 /* @ECU_Address@KfAEBS_Cur_LeftTurnThrshHi@ */ Scalar_FLOAT32_IEEE 0 AEBS_subsystem_integrated_CM_single -3.4E+38 3.4E+38 /end CHARACTERISTIC
/begin CHARACTERISTIC KfAEBS_Cur_LeftTurnThrshLo "Curvature left turn threshold low" VALUE 0x70101770 /* @ECU_Address@KfAEBS_Cur_LeftTurnThrshLo@ */ Scalar_FLOAT32_IEEE 0 AEBS_subsystem_integrated_CM_single -3.4E+38 3.4E+38 /end CHARACTERISTIC
/begin CHARACTERISTIC KfAEBS_Cur_RightTurnThrshHi "Curvature right turn threshold high" VALUE 0x7010176c /* @ECU_Address@KfAEBS_Cur_RightTurnThrshHi@ */ Scalar_FLOAT32_IEEE 0 AEBS_subsystem_integrated_CM_single -3.4E+38 3.4E+38 /end CHARACTERISTIC
/begin CHARACTERISTIC KfAEBS_Cur_RightTurnThrshLo "Curvature right turn threshold low" VALUE 0x70101768 /* @ECU_Address@KfAEBS_Cur_RightTurnThrshLo@ */ Scalar_FLOAT32_IEEE 0 AEBS_subsystem_integrated_CM_single -3.4E+38 3.4E+38 /end CHARACTERISTIC
/begin CHARACTERISTIC KfAEBS_GainTHW "GainTHW" VALUE 0x70101760 /* @ECU_Address@KfAEBS_GainTHW@ */ Scalar_FLOAT32_IEEE 0 AEBS_subsystem_integrated_CM_single -3.4E+38 3.4E+38 /end CHARACTERISTIC
/begin CHARACTERISTIC KfAEBS_GainTTC "GainTTC" VALUE 0x7010175c /* @ECU_Address@KfAEBS_GainTTC@ */ Scalar_FLOAT32_IEEE 0 AEBS_subsystem_integrated_CM_single -3.4E+38 3.4E+38 /end CHARACTERISTIC
/begin CHARACTERISTIC KfAEBS_Pedstr_length_Thrsh "" VALUE 0x70101758 /* @ECU_Address@KfAEBS_Pedstr_length_Thrsh@ */ Scalar_FLOAT32_IEEE 0 AEBS_subsystem_integrated_CM_single -3.4E+38 3.4E+38 /end CHARACTERISTIC
/begin CHARACTERISTIC KfAEBS_Pedstr_width_Thrsh "" VALUE 0x70101754 /* @ECU_Address@KfAEBS_Pedstr_width_Thrsh@ */ Scalar_FLOAT32_IEEE 0 AEBS_subsystem_integrated_CM_single -3.4E+38 3.4E+38 /end CHARACTERISTIC
/begin CHARACTERISTIC KfAEBS_SpdMinOvrdAccrResetInCllsnRednByBrkg "" VALUE 0x70101750 /* @ECU_Address@KfAEBS_SpdMinOvrdAccrResetInCllsnRednByBrkg@ */ Scalar_FLOAT32_IEEE 0 AEBS_subsystem_integrated_CM_single -3.4E+38 3.4E+38 /end CHARACTERISTIC
/begin CHARACTERISTIC KfAEBS_SteerRate_Limit_hi "" VALUE 0x7010174c /* @ECU_Address@KfAEBS_SteerRate_Limit_hi@ */ Scalar_FLOAT32_IEEE 0 AEBS_subsystem_integrated_CM_single -3.4E+38 3.4E+38 /end CHARACTERISTIC
/begin CHARACTERISTIC KfAEBS_SteerRate_Limit_lo "" VALUE 0x70101748 /* @ECU_Address@KfAEBS_SteerRate_Limit_lo@ */ Scalar_FLOAT32_IEEE 0 AEBS_subsystem_integrated_CM_single -3.4E+38 3.4E+38 /end CHARACTERISTIC
/begin CHARACTERISTIC KfAEBS_Test_CeterYVIP "" VALUE 0x70101744 /* @ECU_Address@KfAEBS_Test_CeterYVIP@ */ Scalar_FLOAT32_IEEE 0 AEBS_subsystem_integrated_CM_single -3.4E+38 3.4E+38 /end CHARACTERISTIC
/begin CHARACTERISTIC KfAEBS_Test_DeltaDisVIP "" VALUE 0x70101740 /* @ECU_Address@KfAEBS_Test_DeltaDisVIP@ */ Scalar_FLOAT32_IEEE 0 AEBS_subsystem_integrated_CM_single -3.4E+38 3.4E+38 /end CHARACTERISTIC
/begin CHARACTERISTIC KfAEBS_Test_DeltaSpeedVIP "" VALUE 0x7010173c /* @ECU_Address@KfAEBS_Test_DeltaSpeedVIP@ */ Scalar_FLOAT32_IEEE 0 AEBS_subsystem_integrated_CM_single -3.4E+38 3.4E+38 /end CHARACTERISTIC
/begin CHARACTERISTIC KfAEBS_Test_IDVIP "" VALUE 0x70101738 /* @ECU_Address@KfAEBS_Test_IDVIP@ */ Scalar_FLOAT32_IEEE 0 AEBS_subsystem_integrated_CM_single -3.4E+38 3.4E+38 /end CHARACTERISTIC
/begin CHARACTERISTIC KfAEBS_Test_TTCVIP "" VALUE 0x70101734 /* @ECU_Address@KfAEBS_Test_TTCVIP@ */ Scalar_FLOAT32_IEEE 0 AEBS_subsystem_integrated_CM_single -3.4E+38 3.4E+38 /end CHARACTERISTIC
/begin CHARACTERISTIC KfAEBS_Veh_DisEnd2OC "" VALUE 0x70101730 /* @ECU_Address@KfAEBS_Veh_DisEnd2OC@ */ Scalar_FLOAT32_IEEE 0 AEBS_subsystem_integrated_CM_single -3.4E+38 3.4E+38 /end CHARACTERISTIC
/begin CHARACTERISTIC KfAEBS_Veh_DisHead2OC "" VALUE 0x7010172c /* @ECU_Address@KfAEBS_Veh_DisHead2OC@ */ Scalar_FLOAT32_IEEE 0 AEBS_subsystem_integrated_CM_single -3.4E+38 3.4E+38 /end CHARACTERISTIC
/begin CHARACTERISTIC KfAEBS_Veh_DisRear2COM "" VALUE 0x70101728 /* @ECU_Address@KfAEBS_Veh_DisRear2COM@ */ Scalar_FLOAT32_IEEE 0 AEBS_subsystem_integrated_CM_single -3.4E+38 3.4E+38 /end CHARACTERISTIC
/begin CHARACTERISTIC KfAEBS_Veh_DisRear2OC "" VALUE 0x70101724 /* @ECU_Address@KfAEBS_Veh_DisRear2OC@ */ Scalar_FLOAT32_IEEE 0 AEBS_subsystem_integrated_CM_single -3.4E+38 3.4E+38 /end CHARACTERISTIC
/begin CHARACTERISTIC KfAEBS_Veh_Length "" VALUE 0x70101720 /* @ECU_Address@KfAEBS_Veh_Length@ */ Scalar_FLOAT32_IEEE 0 AEBS_subsystem_integrated_CM_single -3.4E+38 3.4E+38 /end CHARACTERISTIC
/begin CHARACTERISTIC KfAEBS_Veh_Strwhl2FrtwhlRatio "" VALUE 0x7010171c /* @ECU_Address@KfAEBS_Veh_Strwhl2FrtwhlRatio@ */ Scalar_FLOAT32_IEEE 0 AEBS_subsystem_integrated_CM_single -3.4E+38 3.4E+38 /end CHARACTERISTIC
/begin CHARACTERISTIC KfAEBS_Veh_WheelBase "" VALUE 0x70101718 /* @ECU_Address@KfAEBS_Veh_WheelBase@ */ Scalar_FLOAT32_IEEE 0 AEBS_subsystem_integrated_CM_single -3.4E+38 3.4E+38 /end CHARACTERISTIC
/begin CHARACTERISTIC KfAEBS_Veh_Width "" VALUE 0x70101714 /* @ECU_Address@KfAEBS_Veh_Width@ */ Scalar_FLOAT32_IEEE 0 AEBS_subsystem_integrated_CM_single -3.4E+38 3.4E+38 /end CHARACTERISTIC
/begin CHARACTERISTIC KfAEBS_Veh_WidthBuffer "" VALUE 0x70101710 /* @ECU_Address@KfAEBS_Veh_WidthBuffer@ */ Scalar_FLOAT32_IEEE 0 AEBS_subsystem_integrated_CM_single -3.4E+38 3.4E+38 /end CHARACTERISTIC
/begin CHARACTERISTIC KfAEBS_VeloRectThrsdByBrkg "" VALUE 0x7010170c /* @ECU_Address@KfAEBS_VeloRectThrsdByBrkg@ */ Scalar_FLOAT32_IEEE 0 AEBS_subsystem_integrated_CM_single -3.4E+38 3.4E+38 /end CHARACTERISTIC
/begin CHARACTERISTIC KfAEBS_YawRate_Limit_hi "" VALUE 0x70101708 /* @ECU_Address@KfAEBS_YawRate_Limit_hi@ */ Scalar_FLOAT32_IEEE 0 AEBS_subsystem_integrated_CM_single -3.4E+38 3.4E+38 /end CHARACTERISTIC
/begin CHARACTERISTIC KfAEBS_YawRate_Limit_lo "" VALUE 0x70101704 /* @ECU_Address@KfAEBS_YawRate_Limit_lo@ */ Scalar_FLOAT32_IEEE 0 AEBS_subsystem_integrated_CM_single -3.4E+38 3.4E+38 /end CHARACTERISTIC
/begin CHARACTERISTIC KfAEBS_Zone_DoRbIW_x_front "" VALUE 0x70101700 /* @ECU_Address@KfAEBS_Zone_DoRbIW_x_front@ */ Scalar_FLOAT32_IEEE 0 AEBS_subsystem_integrated_CM_single -3.4E+38 3.4E+38 /end CHARACTERISTIC
/begin CHARACTERISTIC KfAEBS_Zone_DoRbIW_x_rear "" VALUE 0x701016fc /* @ECU_Address@KfAEBS_Zone_DoRbIW_x_rear@ */ Scalar_FLOAT32_IEEE 0 AEBS_subsystem_integrated_CM_single -3.4E+38 3.4E+38 /end CHARACTERISTIC
/begin CHARACTERISTIC KfAEBS_a_AreqRampRate "" VALUE 0x701016f8 /* @ECU_Address@KfAEBS_a_AreqRampRate@ */ Scalar_FLOAT32_IEEE 0 AEBS_subsystem_integrated_CM_single -3.4E+38 3.4E+38 /end CHARACTERISTIC
/begin CHARACTERISTIC KfAEBS_a_Areq_FullBrkActThrsd "Acceleration request full brake active threshold" VALUE 0x701016f4 /* @ECU_Address@KfAEBS_a_Areq_FullBrkActThrsd@ */ Scalar_FLOAT32_IEEE 0 AEBS_subsystem_integrated_CM_single -3.4E+38 3.4E+38 /end CHARACTERISTIC
/begin CHARACTERISTIC KfAEBS_a_Areq_FullBrkDeactThrsd "Acceleration request full brake dactive threshold(Full brake 
      can be deactived only in a short period)" VALUE 0x701016f0 /* @ECU_Address@KfAEBS_a_Areq_FullBrkDeactThrsd@ */ Scalar_FLOAT32_IEEE 0 AEBS_subsystem_integrated_CM_single -3.4E+38 3.4E+38 /end CHARACTERISTIC
/begin CHARACTERISTIC KfAEBS_a_Areq_ObjChangThrsd "When the object is changed, only when the new object's acceleration request
      is samller than a threshold, then, the AEB/FCW can be deactived." VALUE 0x701016ec /* @ECU_Address@KfAEBS_a_Areq_ObjChangThrsd@ */ Scalar_FLOAT32_IEEE 0 AEBS_subsystem_integrated_CM_single -3.4E+38 3.4E+38 /end CHARACTERISTIC
/begin CHARACTERISTIC KfAEBS_a_Areq_PartialBrkActThrsd "Acceleration request partial brake active threshold" VALUE 0x701016e8 /* @ECU_Address@KfAEBS_a_Areq_PartialBrkActThrsd@ */ Scalar_FLOAT32_IEEE 0 AEBS_subsystem_integrated_CM_single -3.4E+38 3.4E+38 /end CHARACTERISTIC
/begin CHARACTERISTIC KfAEBS_a_Areq_PartialBrkDeactThrsd "Acceleration request partial brake deactive threshold" VALUE 0x701016e4 /* @ECU_Address@KfAEBS_a_Areq_PartialBrkDeactThrsd@ */ Scalar_FLOAT32_IEEE 0 AEBS_subsystem_integrated_CM_single -3.4E+38 3.4E+38 /end CHARACTERISTIC
/begin CHARACTERISTIC KfAEBS_a_BrakeInit "In passensor protected stage,acceleration send at initial step" VALUE 0x701016dc /* @ECU_Address@KfAEBS_a_BrakeInit@ */ Scalar_FLOAT32_IEEE 0 AEBS_subsystem_integrated_CM_single -3.4E+38 3.4E+38 /end CHARACTERISTIC
/begin CHARACTERISTIC KfAEBS_a_BrakeMax "In passensor protected stage,acceleration send maximum" VALUE 0x701016d8 /* @ECU_Address@KfAEBS_a_BrakeMax@ */ Scalar_FLOAT32_IEEE 0 AEBS_subsystem_integrated_CM_single -3.4E+38 3.4E+38 /end CHARACTERISTIC
/begin CHARACTERISTIC KfAEBS_a_Buffer "Acceleration send buffer in distance safe" VALUE 0x701016d4 /* @ECU_Address@KfAEBS_a_Buffer@ */ Scalar_FLOAT32_IEEE 0 AEBS_subsystem_integrated_CM_single -3.4E+38 3.4E+38 /end CHARACTERISTIC
/begin CHARACTERISTIC KfAEBS_a_FullBrakeHi "Maximum decceleration send in full brake(ex. -5)" VALUE 0x701016d0 /* @ECU_Address@KfAEBS_a_FullBrakeHi@ */ Scalar_FLOAT32_IEEE 0 AEBS_subsystem_integrated_CM_single -3.4E+38 3.4E+38 /end CHARACTERISTIC
/begin CHARACTERISTIC KfAEBS_a_FullBrakeLo "Minimum decceleration send in full brake(ex. -2.5)" VALUE 0x701016cc /* @ECU_Address@KfAEBS_a_FullBrakeLo@ */ Scalar_FLOAT32_IEEE 0 AEBS_subsystem_integrated_CM_single -3.4E+38 3.4E+38 /end CHARACTERISTIC
/begin CHARACTERISTIC KfAEBS_a_ObjUrgentBrake_Thrsh "" VALUE 0x701016c8 /* @ECU_Address@KfAEBS_a_ObjUrgentBrake_Thrsh@ */ Scalar_FLOAT32_IEEE 0 AEBS_subsystem_integrated_CM_single -3.4E+38 3.4E+38 /end CHARACTERISTIC
/begin CHARACTERISTIC KfAEBS_a_PartialBrakeHi "Maximum decceleration send in partial brake(ex. -4)" VALUE 0x701016c4 /* @ECU_Address@KfAEBS_a_PartialBrakeHi@ */ Scalar_FLOAT32_IEEE 0 AEBS_subsystem_integrated_CM_single -3.4E+38 3.4E+38 /end CHARACTERISTIC
/begin CHARACTERISTIC KfAEBS_a_PartialBrakeLo "Minimum decceleration send in partial brake(ex. -2)" VALUE 0x701016c0 /* @ECU_Address@KfAEBS_a_PartialBrakeLo@ */ Scalar_FLOAT32_IEEE 0 AEBS_subsystem_integrated_CM_single -3.4E+38 3.4E+38 /end CHARACTERISTIC
/begin CHARACTERISTIC KfAEBS_d_Dis2HeadIgnoreSide "" VALUE 0x701016bc /* @ECU_Address@KfAEBS_d_Dis2HeadIgnoreSide@ */ Scalar_FLOAT32_IEEE 0 AEBS_subsystem_integrated_CM_single -3.4E+38 3.4E+38 /end CHARACTERISTIC
/begin CHARACTERISTIC KfAEBS_d_Dis_BufferTTSP "Distance Buffer when calculate TTSP lateral" VALUE 0x701016b8 /* @ECU_Address@KfAEBS_d_Dis_BufferTTSP@ */ Scalar_FLOAT32_IEEE 0 AEBS_subsystem_integrated_CM_single -3.4E+38 3.4E+38 /end CHARACTERISTIC
/begin CHARACTERISTIC KfAEBS_d_Dis_BufferTTSP_length "Distance Buffer when calculate TTSP long" VALUE 0x701016b4 /* @ECU_Address@KfAEBS_d_Dis_BufferTTSP_length@ */ Scalar_FLOAT32_IEEE 0 AEBS_subsystem_integrated_CM_single -3.4E+38 3.4E+38 /end CHARACTERISTIC
/begin CHARACTERISTIC KfAEBS_d_Dis_LateralIgnore "Distance Lateral Ignore" VALUE 0x701016b0 /* @ECU_Address@KfAEBS_d_Dis_LateralIgnore@ */ Scalar_FLOAT32_IEEE 0 AEBS_subsystem_integrated_CM_single -3.4E+38 3.4E+38 /end CHARACTERISTIC
/begin CHARACTERISTIC KfAEBS_d_Dis_Safe "Distance safe, when vehicle is stopped, the distance to obj" VALUE 0x701016ac /* @ECU_Address@KfAEBS_d_Dis_Safe@ */ Scalar_FLOAT32_IEEE 0 AEBS_subsystem_integrated_CM_single -3.4E+38 3.4E+38 /end CHARACTERISTIC
/begin CHARACTERISTIC KfAEBS_d_min_dis_swap "" VALUE 0x701016a8 /* @ECU_Address@KfAEBS_d_min_dis_swap@ */ Scalar_FLOAT32_IEEE 0 AEBS_subsystem_integrated_CM_single -3.4E+38 3.4E+38 /end CHARACTERISTIC
/begin CHARACTERISTIC KfAEBS_t_Speed_DebounceTime "Speed debounce time, used to estimate whether the vheicle is standstill" VALUE 0x701016a0 /* @ECU_Address@KfAEBS_t_Speed_DebounceTime@ */ Scalar_FLOAT32_IEEE 0 AEBS_subsystem_integrated_CM_single -3.4E+38 3.4E+38 /end CHARACTERISTIC
/begin CHARACTERISTIC KfAEBS_t_TTC_DeactiveThrsh "TTC Deactive Thrsh" VALUE 0x7010169c /* @ECU_Address@KfAEBS_t_TTC_DeactiveThrsh@ */ Scalar_FLOAT32_IEEE 0 AEBS_subsystem_integrated_CM_single -3.4E+38 3.4E+38 /end CHARACTERISTIC
/begin CHARACTERISTIC KfAEBS_t_TTC_FCWLevel1DeactThrsd "TTC_FCW Level1 Deact Thrsd" VALUE 0x70101698 /* @ECU_Address@KfAEBS_t_TTC_FCWLevel1DeactThrsd@ */ Scalar_FLOAT32_IEEE 0 AEBS_subsystem_integrated_CM_single -3.4E+38 3.4E+38 /end CHARACTERISTIC
/begin CHARACTERISTIC KfAEBS_t_TTC_FCWLevel2DeactThrsd "TTC FCW Level2 Deact Thrsd" VALUE 0x70101694 /* @ECU_Address@KfAEBS_t_TTC_FCWLevel2DeactThrsd@ */ Scalar_FLOAT32_IEEE 0 AEBS_subsystem_integrated_CM_single -3.4E+38 3.4E+38 /end CHARACTERISTIC
/begin CHARACTERISTIC KfAEBS_t_TTC_FCWLevel3DeactThrsd "TTC FCW Level3 Deact Thrsd" VALUE 0x70101690 /* @ECU_Address@KfAEBS_t_TTC_FCWLevel3DeactThrsd@ */ Scalar_FLOAT32_IEEE 0 AEBS_subsystem_integrated_CM_single -3.4E+38 3.4E+38 /end CHARACTERISTIC
/begin CHARACTERISTIC KfAEBS_t_TTC_ObjChangThrsd "" VALUE 0x7010168c /* @ECU_Address@KfAEBS_t_TTC_ObjChangThrsd@ */ Scalar_FLOAT32_IEEE 0 AEBS_subsystem_integrated_CM_single -3.4E+38 3.4E+38 /end CHARACTERISTIC
/begin CHARACTERISTIC KfAEBS_t_TTC_PartialBrkDeactiveThrsd "TTC Partial Brk Deactive Thrsd" VALUE 0x70101688 /* @ECU_Address@KfAEBS_t_TTC_PartialBrkDeactiveThrsd@ */ Scalar_FLOAT32_IEEE 0 AEBS_subsystem_integrated_CM_single -3.4E+38 3.4E+38 /end CHARACTERISTIC
/begin CHARACTERISTIC KfAEBS_t_TTC_PreBrkDeactThrsd "KfAEBS TTC PreBrk Deact Thrsd" VALUE 0x70101684 /* @ECU_Address@KfAEBS_t_TTC_PreBrkDeactThrsd@ */ Scalar_FLOAT32_IEEE 0 AEBS_subsystem_integrated_CM_single -3.4E+38 3.4E+38 /end CHARACTERISTIC
/begin CHARACTERISTIC KfAEBS_t_TimeBrakeThrsd "" VALUE 0x7010167c /* @ECU_Address@KfAEBS_t_TimeBrakeThrsd@ */ Scalar_FLOAT32_IEEE 0 AEBS_subsystem_integrated_CM_single -3.4E+38 3.4E+38 /end CHARACTERISTIC
/begin CHARACTERISTIC KfAEBS_t_Time_BrakeDelay "Time Brake Delay" VALUE 0x70101670 /* @ECU_Address@KfAEBS_t_Time_BrakeDelay@ */ Scalar_FLOAT32_IEEE 0 AEBS_subsystem_integrated_CM_single -3.4E+38 3.4E+38 /end CHARACTERISTIC
/begin CHARACTERISTIC KfAEBS_t_Time_BrakeInit "Time Brake Init" VALUE 0x7010166c /* @ECU_Address@KfAEBS_t_Time_BrakeInit@ */ Scalar_FLOAT32_IEEE 0 AEBS_subsystem_integrated_CM_single -3.4E+38 3.4E+38 /end CHARACTERISTIC
/begin CHARACTERISTIC KfAEBS_t_Time_BrakeRamp "Time Brake Ramp" VALUE 0x70101668 /* @ECU_Address@KfAEBS_t_Time_BrakeRamp@ */ Scalar_FLOAT32_IEEE 0 AEBS_subsystem_integrated_CM_single -3.4E+38 3.4E+38 /end CHARACTERISTIC
/begin CHARACTERISTIC KfAEBS_t_Time_HasNoVIPDelay "Time Has No VIP Delay" VALUE 0x70101664 /* @ECU_Address@KfAEBS_t_Time_HasNoVIPDelay@ */ Scalar_FLOAT32_IEEE 0 AEBS_subsystem_integrated_CM_single -3.4E+38 3.4E+38 /end CHARACTERISTIC
/begin CHARACTERISTIC KfAEBS_t_Time_OBFUNReceivedThrsh "OBFU not receive time out" VALUE 0x70101660 /* @ECU_Address@KfAEBS_t_Time_OBFUNReceivedThrsh@ */ Scalar_FLOAT32_IEEE 0 AEBS_subsystem_integrated_CM_single -3.4E+38 3.4E+38 /end CHARACTERISTIC
/begin CHARACTERISTIC KfAEBS_t_Time_ObjUrgentBrk "" VALUE 0x7010165c /* @ECU_Address@KfAEBS_t_Time_ObjUrgentBrk@ */ Scalar_FLOAT32_IEEE 0 AEBS_subsystem_integrated_CM_single -3.4E+38 3.4E+38 /end CHARACTERISTIC
/begin CHARACTERISTIC KfAEBS_t_Time_ResetVeloRdctThrsd "" VALUE 0x70101658 /* @ECU_Address@KfAEBS_t_Time_ResetVeloRdctThrsd@ */ Scalar_FLOAT32_IEEE 0 AEBS_subsystem_integrated_CM_single -3.4E+38 3.4E+38 /end CHARACTERISTIC
/begin CHARACTERISTIC KfAEBS_t_Time_TTCHLInhibitAEB "" VALUE 0x70101654 /* @ECU_Address@KfAEBS_t_Time_TTCHLInhibitAEB@ */ Scalar_FLOAT32_IEEE 0 AEBS_subsystem_integrated_CM_single -3.4E+38 3.4E+38 /end CHARACTERISTIC
/begin CHARACTERISTIC KfAEBS_t_Time_TwiceAEBActive "" VALUE 0x70101650 /* @ECU_Address@KfAEBS_t_Time_TwiceAEBActive@ */ Scalar_FLOAT32_IEEE 0 AEBS_subsystem_integrated_CM_single -3.4E+38 3.4E+38 /end CHARACTERISTIC
/begin CHARACTERISTIC KfAEBS_t_fb_active_delay_turn "" VALUE 0x7010164c /* @ECU_Address@KfAEBS_t_fb_active_delay_turn@ */ Scalar_FLOAT32_IEEE 0 AEBS_subsystem_integrated_CM_single -3.4E+38 3.4E+38 /end CHARACTERISTIC
/begin CHARACTERISTIC KfAEBS_t_pb_active_delay_turn "" VALUE 0x70101648 /* @ECU_Address@KfAEBS_t_pb_active_delay_turn@ */ Scalar_FLOAT32_IEEE 0 AEBS_subsystem_integrated_CM_single -3.4E+38 3.4E+38 /end CHARACTERISTIC
/begin CHARACTERISTIC KfAEBS_t_timeGap_ignore_turn "" VALUE 0x70101644 /* @ECU_Address@KfAEBS_t_timeGap_ignore_turn@ */ Scalar_FLOAT32_IEEE 0 AEBS_subsystem_integrated_CM_single -3.4E+38 3.4E+38 /end CHARACTERISTIC
/begin CHARACTERISTIC KfAEBS_v_ObjUrgentBrk_speed_Thrsh "" VALUE 0x70101640 /* @ECU_Address@KfAEBS_v_ObjUrgentBrk_speed_Thrsh@ */ Scalar_FLOAT32_IEEE 0 AEBS_subsystem_integrated_CM_single -3.4E+38 3.4E+38 /end CHARACTERISTIC
/begin CHARACTERISTIC KfAEBS_v_SpeedLLThrshOvrrd "" VALUE 0x7010163c /* @ECU_Address@KfAEBS_v_SpeedLLThrshOvrrd@ */ Scalar_FLOAT32_IEEE 0 AEBS_subsystem_integrated_CM_single -3.4E+38 3.4E+38 /end CHARACTERISTIC
/begin CHARACTERISTIC KfAEBS_v_SpeedRelLThrshOvrrd "" VALUE 0x70101638 /* @ECU_Address@KfAEBS_v_SpeedRelLThrshOvrrd@ */ Scalar_FLOAT32_IEEE 0 AEBS_subsystem_integrated_CM_single -3.4E+38 3.4E+38 /end CHARACTERISTIC
/begin CHARACTERISTIC KfAEBS_v_Speed_DeltaStStThrsh "delta speed, used to estimate whether the vheicle is standstill" VALUE 0x70101634 /* @ECU_Address@KfAEBS_v_Speed_DeltaStStThrsh@ */ Scalar_FLOAT32_IEEE 0 AEBS_subsystem_integrated_CM_single -3.4E+38 3.4E+38 /end CHARACTERISTIC
/begin CHARACTERISTIC KfAEBS_v_Speed_DeltaWExit "Delta speed warning exit, if front veh's speed is larger than ego, fornt veh can be filterd" VALUE 0x70101630 /* @ECU_Address@KfAEBS_v_Speed_DeltaWExit@ */ Scalar_FLOAT32_IEEE 0 AEBS_subsystem_integrated_CM_single -3.4E+38 3.4E+38 /end CHARACTERISTIC
/begin CHARACTERISTIC KfAEBS_v_Speed_High_InhibitAEB "" VALUE 0x7010162c /* @ECU_Address@KfAEBS_v_Speed_High_InhibitAEB@ */ Scalar_FLOAT32_IEEE 0 AEBS_subsystem_integrated_CM_single -3.4E+38 3.4E+38 /end CHARACTERISTIC
/begin CHARACTERISTIC KfAEBS_v_Speed_MaxInhibitAEB "The speed to active AEB" VALUE 0x70101628 /* @ECU_Address@KfAEBS_v_Speed_MaxInhibitAEB@ */ Scalar_FLOAT32_IEEE 0 AEBS_subsystem_integrated_CM_single -3.4E+38 3.4E+38 /end CHARACTERISTIC
/begin CHARACTERISTIC KfAEBS_v_Speed_ObjStillThrsh "Obj speed threshold to be estimated as standstill in long" VALUE 0x70101624 /* @ECU_Address@KfAEBS_v_Speed_ObjStillThrsh@ */ Scalar_FLOAT32_IEEE 0 AEBS_subsystem_integrated_CM_single -3.4E+38 3.4E+38 /end CHARACTERISTIC
/begin CHARACTERISTIC KfAEBS_v_Speed_ObjStillThrshLateral "Obj speed threshold to be estimated as standstill in lateral" VALUE 0x70101620 /* @ECU_Address@KfAEBS_v_Speed_ObjStillThrshLateral@ */ Scalar_FLOAT32_IEEE 0 AEBS_subsystem_integrated_CM_single -3.4E+38 3.4E+38 /end CHARACTERISTIC
/begin CHARACTERISTIC KfAEBS_v_Speed_StandStillThrsh "Speed, used to estimate whether the vheicle is standstill" VALUE 0x7010161c /* @ECU_Address@KfAEBS_v_Speed_StandStillThrsh@ */ Scalar_FLOAT32_IEEE 0 AEBS_subsystem_integrated_CM_single -3.4E+38 3.4E+38 /end CHARACTERISTIC
/begin CHARACTERISTIC KfAEBS_v_deltaSpeed_InhibitAEB "" VALUE 0x70101618 /* @ECU_Address@KfAEBS_v_deltaSpeed_InhibitAEB@ */ Scalar_FLOAT32_IEEE 0 AEBS_subsystem_integrated_CM_single -3.4E+38 3.4E+38 /end CHARACTERISTIC
/begin CHARACTERISTIC KfAEBS_v_isInHighSpeed_HighThrshd "" VALUE 0x70101614 /* @ECU_Address@KfAEBS_v_isInHighSpeed_HighThrshd@ */ Scalar_FLOAT32_IEEE 0 AEBS_subsystem_integrated_CM_single -3.4E+38 3.4E+38 /end CHARACTERISTIC
/begin CHARACTERISTIC KfAEBS_v_isInHighSpeed_LowThrshd "" VALUE 0x70101610 /* @ECU_Address@KfAEBS_v_isInHighSpeed_LowThrshd@ */ Scalar_FLOAT32_IEEE 0 AEBS_subsystem_integrated_CM_single -3.4E+38 3.4E+38 /end CHARACTERISTIC
/begin CHARACTERISTIC KfAEBS_VIPObsType "" VALUE 0x70101298 /* @ECU_Address@KfAEBS_VIPObsType@ */ Scalar_BYTE 0 AEBS_subsystem_integrated_CM_int8 -128 127 /end CHARACTERISTIC
/begin CHARACTERISTIC KfAEBS_AccPedelThrshOvrrd "Acc Pedel threshold when override" VALUE 0x70101297 /* @ECU_Address@KfAEBS_AccPedelThrshOvrrd@ */ Scalar_UBYTE 0 AEBS_subsystem_integrated_CM_uint8 0 255 /end CHARACTERISTIC
/begin CHARACTERISTIC KfAEBS_Gear_Value_R "Gear_Value_R" VALUE 0x70101292 /* @ECU_Address@KfAEBS_Gear_Value_R@ */ Scalar_UBYTE 0 AEBS_subsystem_integrated_CM_uint8 0 255 /end CHARACTERISTIC
/begin CHARACTERISTIC KfAEBS_LoPosValInCllsnRednByBrkg "" VALUE 0x70101291 /* @ECU_Address@KfAEBS_LoPosValInCllsnRednByBrkg@ */ Scalar_UBYTE 0 AEBS_subsystem_integrated_CM_uint8 0 255 /end CHARACTERISTIC
/begin CHARACTERISTIC KbAEBS_Active_LeftTurn "Left turn collision mitigation active" VALUE 0x70101290 /* @ECU_Address@KbAEBS_Active_LeftTurn@ */ Scalar_BOOLEAN 0 AEBS_subsystem_integrated_CM_boolean 0 1 /end CHARACTERISTIC
/begin CHARACTERISTIC KbAEBS_Active_RightTurn "Right turn collision mitigation active" VALUE 0x7010128f /* @ECU_Address@KbAEBS_Active_RightTurn@ */ Scalar_BOOLEAN 0 AEBS_subsystem_integrated_CM_boolean 0 1 /end CHARACTERISTIC
/begin CHARACTERISTIC KbAEBS_Active_Straight "Ego go straight collision mitigation active" VALUE 0x7010128e /* @ECU_Address@KbAEBS_Active_Straight@ */ Scalar_BOOLEAN 0 AEBS_subsystem_integrated_CM_boolean 0 1 /end CHARACTERISTIC
/begin CHARACTERISTIC KbAEBS_AllowOverride "Allow driver override" VALUE 0x7010128d /* @ECU_Address@KbAEBS_AllowOverride@ */ Scalar_BOOLEAN 0 AEBS_subsystem_integrated_CM_boolean 0 1 /end CHARACTERISTIC
/begin CHARACTERISTIC KbAEBS_Enable_DoRbIW "" VALUE 0x70101287 /* @ECU_Address@KbAEBS_Enable_DoRbIW@ */ Scalar_BOOLEAN 0 AEBS_subsystem_integrated_CM_boolean 0 1 /end CHARACTERISTIC
/begin CHARACTERISTIC KbAEBS_Enable_DoRbIW_LeftTurn "" VALUE 0x70101286 /* @ECU_Address@KbAEBS_Enable_DoRbIW_LeftTurn@ */ Scalar_BOOLEAN 0 AEBS_subsystem_integrated_CM_boolean 0 1 /end CHARACTERISTIC
/begin CHARACTERISTIC KbAEBS_Enable_OutputAEB "Enable output decceleration/ AEB request" VALUE 0x70101284 /* @ECU_Address@KbAEBS_Enable_OutputAEB@ */ Scalar_BOOLEAN 0 AEBS_subsystem_integrated_CM_boolean 0 1 /end CHARACTERISTIC
/begin CHARACTERISTIC KbAEBS_Enable_VRU_Protection "" VALUE 0x70101283 /* @ECU_Address@KbAEBS_Enable_VRU_Protection@ */ Scalar_BOOLEAN 0 AEBS_subsystem_integrated_CM_boolean 0 1 /end CHARACTERISTIC
/begin CHARACTERISTIC KbAEBS_FilterVehicleinSide "" VALUE 0x70101282 /* @ECU_Address@KbAEBS_FilterVehicleinSide@ */ Scalar_BOOLEAN 0 AEBS_subsystem_integrated_CM_boolean 0 1 /end CHARACTERISTIC
/begin CHARACTERISTIC KbAEBS_RedifineVIPObsType "" VALUE 0x70101281 /* @ECU_Address@KbAEBS_RedifineVIPObsType@ */ Scalar_BOOLEAN 0 AEBS_subsystem_integrated_CM_boolean 0 1 /end CHARACTERISTIC
/begin CHARACTERISTIC KbAEBS_Test_HasObsVIP "" VALUE 0x70101280 /* @ECU_Address@KbAEBS_Test_HasObsVIP@ */ Scalar_BOOLEAN 0 AEBS_subsystem_integrated_CM_boolean 0 1 /end CHARACTERISTIC
/begin CHARACTERISTIC KbAEBS_Test_Mode "" VALUE 0x7010127f /* @ECU_Address@KbAEBS_Test_Mode@ */ Scalar_BOOLEAN 0 AEBS_subsystem_integrated_CM_boolean 0 1 /end CHARACTERISTIC
/begin CHARACTERISTIC KbAEBS_Use_OBFU_Acceleration "" VALUE 0x7010127d /* @ECU_Address@KbAEBS_Use_OBFU_Acceleration@ */ Scalar_BOOLEAN 0 AEBS_subsystem_integrated_CM_boolean 0 1 /end CHARACTERISTIC
/begin CHARACTERISTIC KbAEBS_Use_OBFU_Type "" VALUE 0x7010127c /* @ECU_Address@KbAEBS_Use_OBFU_Type@ */ Scalar_BOOLEAN 0 AEBS_subsystem_integrated_CM_boolean 0 1 /end CHARACTERISTIC
/begin CHARACTERISTIC KbAEBS_use_steerAngle "" VALUE 0x7010127b /* @ECU_Address@KbAEBS_use_steerAngle@ */ Scalar_BOOLEAN 0 AEBS_subsystem_integrated_CM_boolean 0 1 /end CHARACTERISTIC
/begin CHARACTERISTIC KfAEBS_Test_CeterXVIP "" VALUE 0x70101278 /* @ECU_Address@KfAEBS_Test_CeterXVIP@ */ Scalar_BOOLEAN 0 AEBS_subsystem_integrated_CM_boolean 0 1 /end CHARACTERISTIC
/begin CHARACTERISTIC KfARBT_autohold_timeout "Unit in second" VALUE 0x7010190c /* @ECU_Address@KfARBT_autohold_timeout@ */ Scalar_FLOAT32_IEEE 0 ARBT_subsystem_integrated_CM_single_s -3.4E+38 3.4E+38 /end CHARACTERISTIC
/begin CHARACTERISTIC KfARBT_brake_req_lon_a_lowerlimit "Lower limit for brake longitudinal acceleration request output (in m/s2)" VALUE 0x70101908 /* @ECU_Address@KfARBT_brake_req_lon_a_lowerlimit@ */ Scalar_FLOAT32_IEEE 0 ARBT_subsystem_integrated_CM_single_m_s2 -3.4E+38 3.4E+38 /end CHARACTERISTIC
/begin CHARACTERISTIC KfARBT_brake_req_lon_a_upperlimit "Upper limit for brake longitudinal acceleration request output (in m/s2)" VALUE 0x70101904 /* @ECU_Address@KfARBT_brake_req_lon_a_upperlimit@ */ Scalar_FLOAT32_IEEE 0 ARBT_subsystem_integrated_CM_single_m_s2 -3.4E+38 3.4E+38 /end CHARACTERISTIC
/begin CHARACTERISTIC KfARBT_brk_ped_pos_thrsh_rec_trig "Threshold of actual brake pedal position to determine if driver is taking a hard brake" VALUE 0x70101900 /* @ECU_Address@KfARBT_brk_ped_pos_thrsh_rec_trig@ */ Scalar_FLOAT32_IEEE 0 ARBT_subsystem_integrated_CM_single__ 0.0 100.0 /end CHARACTERISTIC
/begin CHARACTERISTIC KfARBT_lon_a_thrsh_rec_trig "Threshold of longitudinal acceleration to determine if the driver is taking a hard brake" VALUE 0x701018fc /* @ECU_Address@KfARBT_lon_a_thrsh_rec_trig@ */ Scalar_FLOAT32_IEEE 0 ARBT_subsystem_integrated_CM_single_m_s2 -10.0 0.0 /end CHARACTERISTIC
/begin CHARACTERISTIC KfARBT_power_req_lon_a_lowerlimit "Lower limit for power longitudinal acceleration request output (in m/s2)" VALUE 0x701018f8 /* @ECU_Address@KfARBT_power_req_lon_a_lowerlimit@ */ Scalar_FLOAT32_IEEE 0 ARBT_subsystem_integrated_CM_single_m_s2 -3.4E+38 3.4E+38 /end CHARACTERISTIC
/begin CHARACTERISTIC KfARBT_power_req_lon_a_upperlimit "Lower limit for power longitudinal acceleration request output (in m/s2)" VALUE 0x701018f4 /* @ECU_Address@KfARBT_power_req_lon_a_upperlimit@ */ Scalar_FLOAT32_IEEE 0 ARBT_subsystem_integrated_CM_single_m_s2 -3.4E+38 3.4E+38 /end CHARACTERISTIC
/begin CHARACTERISTIC KfARBT_steer_req_strwhl_angle_lowerlimit "Lower limit for steer wheel angle output (in degrees)" VALUE 0x701018f0 /* @ECU_Address@KfARBT_steer_req_strwhl_angle_lowerlimit@ */ Scalar_FLOAT32_IEEE 0 ARBT_subsystem_integrated_CM_single_deg -3.4E+38 3.4E+38 /end CHARACTERISTIC
/begin CHARACTERISTIC KfARBT_steer_req_strwhl_angle_upperlimit "Upper limit for steer wheel angle output (in degrees)" VALUE 0x701018ec /* @ECU_Address@KfARBT_steer_req_strwhl_angle_upperlimit@ */ Scalar_FLOAT32_IEEE 0 ARBT_subsystem_integrated_CM_single_deg -3.4E+38 3.4E+38 /end CHARACTERISTIC
/begin CHARACTERISTIC KfARBT_t_false_aeb_time_gap_thrsh "Time difference allowed for AEB to be triggered earlier than the start of driver hard braking
      
      Unit in ms
      " VALUE 0x701018e8 /* @ECU_Address@KfARBT_t_false_aeb_time_gap_thrsh@ */ Scalar_FLOAT32_IEEE 0 ARBT_subsystem_integrated_CM_single_ms -3.4E+38 3.4E+38 /end CHARACTERISTIC
/begin CHARACTERISTIC KfARBT_t_hard_brake_debounce_time "Unit in ms. The debounce time to enter hard braking state" VALUE 0x701018e4 /* @ECU_Address@KfARBT_t_hard_brake_debounce_time@ */ Scalar_FLOAT32_IEEE 0 ARBT_subsystem_integrated_CM_single_ms 0.0 3.4E+38 /end CHARACTERISTIC
/begin CHARACTERISTIC KfARBT_t_hard_brake_time_out "Unit in second, time out for hard braking state" VALUE 0x701018e0 /* @ECU_Address@KfARBT_t_hard_brake_time_out@ */ Scalar_FLOAT32_IEEE 0 ARBT_subsystem_integrated_CM_single_sec 0.0 3.4E+38 /end CHARACTERISTIC
/begin CHARACTERISTIC KfARBT_t_missed_aeb_time_gap_thrsh "Time difference allowed for AEB to be triggered later than the start of driver hard braking
      
      Unit in ms
      
      " VALUE 0x701018dc /* @ECU_Address@KfARBT_t_missed_aeb_time_gap_thrsh@ */ Scalar_FLOAT32_IEEE 0 ARBT_subsystem_integrated_CM_single_ms -3.4E+38 3.4E+38 /end CHARACTERISTIC
/begin CHARACTERISTIC KfARBT_t_speed_debounce_time "" VALUE 0x701018d8 /* @ECU_Address@KfARBT_t_speed_debounce_time@ */ Scalar_FLOAT32_IEEE 0 ARBT_subsystem_integrated_CM_single -3.4E+38 3.4E+38 /end CHARACTERISTIC
/begin CHARACTERISTIC KfARBT_v_moving_speed_thrsh "" VALUE 0x701018d4 /* @ECU_Address@KfARBT_v_moving_speed_thrsh@ */ Scalar_FLOAT32_IEEE 0 ARBT_subsystem_integrated_CM_single_m_s 0.1 1.0 /end CHARACTERISTIC
/begin CHARACTERISTIC KfARBT_v_standstill_speed_thrsh "" VALUE 0x701018d0 /* @ECU_Address@KfARBT_v_standstill_speed_thrsh@ */ Scalar_FLOAT32_IEEE 0 ARBT_subsystem_integrated_CM_single_m_s 0.1 1.0 /end CHARACTERISTIC
/begin CHARACTERISTIC KbARBT_power_req_mode_man_ctrl_temp "" VALUE 0x701018cf /* @ECU_Address@KbARBT_power_req_mode_man_ctrl_temp@ */ Scalar_UBYTE 0 ARBT_subsystem_integrated_CM_uint8 0 255 /end CHARACTERISTIC
/begin CHARACTERISTIC KbARBT_SLEW_autohold_active "" VALUE 0x701018ce /* @ECU_Address@KbARBT_SLEW_autohold_active@ */ Scalar_BOOLEAN 0 ARBT_subsystem_integrated_CM_boolean 0 1 /end CHARACTERISTIC
/begin CHARACTERISTIC KbARBT_SLEW_gear_ctrl_accel_req "" VALUE 0x701018cd /* @ECU_Address@KbARBT_SLEW_gear_ctrl_accel_req@ */ Scalar_BOOLEAN 0 ARBT_subsystem_integrated_CM_boolean 0 1 /end CHARACTERISTIC
/begin CHARACTERISTIC KbARBT_gear_pos_fedbck_valid "Validity flag of gear position feedback signal.
      
      For project vehicle without gear position feedback, this calibration shall be set to 0" VALUE 0x701018cc /* @ECU_Address@KbARBT_gear_pos_fedbck_valid@ */ Scalar_BOOLEAN 0 ARBT_subsystem_integrated_CM_boolean 0 1 /end CHARACTERISTIC
/begin CHARACTERISTIC KcCOMM_BrakePedalMax "" VALUE 0x701019f4 /* @ECU_Address@KcCOMM_BrakePedalMax@ */ Scalar_FLOAT32_IEEE 0 COMM_subsystem_integrated_CM_single -3.4E+38 3.4E+38 /end CHARACTERISTIC
/begin CHARACTERISTIC KcCOMM_BrakePedalMin "" VALUE 0x701019f0 /* @ECU_Address@KcCOMM_BrakePedalMin@ */ Scalar_FLOAT32_IEEE 0 COMM_subsystem_integrated_CM_single -3.4E+38 3.4E+38 /end CHARACTERISTIC
/begin CHARACTERISTIC KcCOMM_FirstGearRatio "Gear ratio in 1st gear." VALUE 0x701019ec /* @ECU_Address@KcCOMM_FirstGearRatio@ */ Scalar_FLOAT32_IEEE 0 COMM_subsystem_integrated_CM_single -3.4E+38 3.4E+38 /end CHARACTERISTIC
/begin CHARACTERISTIC KcCOMM_GasPedalMax "" VALUE 0x701019e8 /* @ECU_Address@KcCOMM_GasPedalMax@ */ Scalar_FLOAT32_IEEE 0 COMM_subsystem_integrated_CM_single -3.4E+38 3.4E+38 /end CHARACTERISTIC
/begin CHARACTERISTIC KcCOMM_GasPedalMaxEPB "" VALUE 0x701019e4 /* @ECU_Address@KcCOMM_GasPedalMaxEPB@ */ Scalar_FLOAT32_IEEE 0 COMM_subsystem_integrated_CM_single -3.4E+38 3.4E+38 /end CHARACTERISTIC
/begin CHARACTERISTIC KcCOMM_GasPedalMin "" VALUE 0x701019e0 /* @ECU_Address@KcCOMM_GasPedalMin@ */ Scalar_FLOAT32_IEEE 0 COMM_subsystem_integrated_CM_single -3.4E+38 3.4E+38 /end CHARACTERISTIC
/begin CHARACTERISTIC KcCOMM_GasPedalMinEPB "" VALUE 0x701019dc /* @ECU_Address@KcCOMM_GasPedalMinEPB@ */ Scalar_FLOAT32_IEEE 0 COMM_subsystem_integrated_CM_single -3.4E+38 3.4E+38 /end CHARACTERISTIC
/begin CHARACTERISTIC KcCOMM_GasPedalRampEPB "" VALUE 0x701019d8 /* @ECU_Address@KcCOMM_GasPedalRampEPB@ */ Scalar_FLOAT32_IEEE 0 COMM_subsystem_integrated_CM_single -3.4E+38 3.4E+38 /end CHARACTERISTIC
/begin CHARACTERISTIC KcCOMM_Test_Checksum_0x150 "" VALUE 0x701019d4 /* @ECU_Address@KcCOMM_Test_Checksum_0x150@ */ Scalar_FLOAT32_IEEE 0 COMM_subsystem_integrated_CM_single -3.4E+38 3.4E+38 /end CHARACTERISTIC
/begin CHARACTERISTIC KcCOMM_Test_Checksum_0x151 "" VALUE 0x701019d0 /* @ECU_Address@KcCOMM_Test_Checksum_0x151@ */ Scalar_FLOAT32_IEEE 0 COMM_subsystem_integrated_CM_single -3.4E+38 3.4E+38 /end CHARACTERISTIC
/begin CHARACTERISTIC KcCOMM_Test_Cmd_AccPelPosAct "" VALUE 0x701019cc /* @ECU_Address@KcCOMM_Test_Cmd_AccPelPosAct@ */ Scalar_FLOAT32_IEEE 0 COMM_subsystem_integrated_CM_single -3.4E+38 3.4E+38 /end CHARACTERISTIC
/begin CHARACTERISTIC KcCOMM_Test_Cmd_AccPelPosActInv "" VALUE 0x701019c8 /* @ECU_Address@KcCOMM_Test_Cmd_AccPelPosActInv@ */ Scalar_FLOAT32_IEEE 0 COMM_subsystem_integrated_CM_single -3.4E+38 3.4E+38 /end CHARACTERISTIC
/begin CHARACTERISTIC KcCOMM_Test_Cmd_BrkPelPosAct "" VALUE 0x701019c4 /* @ECU_Address@KcCOMM_Test_Cmd_BrkPelPosAct@ */ Scalar_FLOAT32_IEEE 0 COMM_subsystem_integrated_CM_single -3.4E+38 3.4E+38 /end CHARACTERISTIC
/begin CHARACTERISTIC KcCOMM_Test_Cmd_BrkPelPosActInv "" VALUE 0x701019c0 /* @ECU_Address@KcCOMM_Test_Cmd_BrkPelPosActInv@ */ Scalar_FLOAT32_IEEE 0 COMM_subsystem_integrated_CM_single -3.4E+38 3.4E+38 /end CHARACTERISTIC
/begin CHARACTERISTIC KcCOMM_Test_Cmd_Checksum "" VALUE 0x701019bc /* @ECU_Address@KcCOMM_Test_Cmd_Checksum@ */ Scalar_FLOAT32_IEEE 0 COMM_subsystem_integrated_CM_single -3.4E+38 3.4E+38 /end CHARACTERISTIC
/begin CHARACTERISTIC KcCOMM_Test_Cmd_RCnt "" VALUE 0x701019b8 /* @ECU_Address@KcCOMM_Test_Cmd_RCnt@ */ Scalar_FLOAT32_IEEE 0 COMM_subsystem_integrated_CM_single -3.4E+38 3.4E+38 /end CHARACTERISTIC
/begin CHARACTERISTIC KcCOMM_Test_Cmd_StrAngle "" VALUE 0x701019b4 /* @ECU_Address@KcCOMM_Test_Cmd_StrAngle@ */ Scalar_FLOAT32_IEEE 0 COMM_subsystem_integrated_CM_single -3.4E+38 3.4E+38 /end CHARACTERISTIC
/begin CHARACTERISTIC KcCOMM_Test_Cmd_StrAngleLimit "" VALUE 0x701019b0 /* @ECU_Address@KcCOMM_Test_Cmd_StrAngleLimit@ */ Scalar_FLOAT32_IEEE 0 COMM_subsystem_integrated_CM_single -3.4E+38 3.4E+38 /end CHARACTERISTIC
/begin CHARACTERISTIC KcCOMM_Test_Cmd_StrAngleSpd "" VALUE 0x701019ac /* @ECU_Address@KcCOMM_Test_Cmd_StrAngleSpd@ */ Scalar_FLOAT32_IEEE 0 COMM_subsystem_integrated_CM_single -3.4E+38 3.4E+38 /end CHARACTERISTIC
/begin CHARACTERISTIC KcCOMM_Test_Cmd_VCUCnt "" VALUE 0x701019a8 /* @ECU_Address@KcCOMM_Test_Cmd_VCUCnt@ */ Scalar_FLOAT32_IEEE 0 COMM_subsystem_integrated_CM_single -3.4E+38 3.4E+38 /end CHARACTERISTIC
/begin CHARACTERISTIC KcCOMM_Test_Decs_Acc_Value "" VALUE 0x701019a4 /* @ECU_Address@KcCOMM_Test_Decs_Acc_Value@ */ Scalar_FLOAT32_IEEE 0 COMM_subsystem_integrated_CM_single -3.4E+38 3.4E+38 /end CHARACTERISTIC
/begin CHARACTERISTIC KcCOMM_Test_Decs_Breake_Value "" VALUE 0x701019a0 /* @ECU_Address@KcCOMM_Test_Decs_Breake_Value@ */ Scalar_FLOAT32_IEEE 0 COMM_subsystem_integrated_CM_single -3.4E+38 3.4E+38 /end CHARACTERISTIC
/begin CHARACTERISTIC KcCOMM_Test_RCnt_0x150 "" VALUE 0x7010199c /* @ECU_Address@KcCOMM_Test_RCnt_0x150@ */ Scalar_FLOAT32_IEEE 0 COMM_subsystem_integrated_CM_single -3.4E+38 3.4E+38 /end CHARACTERISTIC
/begin CHARACTERISTIC KcCOMM_Test_RCnt_0x151 "" VALUE 0x70101998 /* @ECU_Address@KcCOMM_Test_RCnt_0x151@ */ Scalar_FLOAT32_IEEE 0 COMM_subsystem_integrated_CM_single -3.4E+38 3.4E+38 /end CHARACTERISTIC
/begin CHARACTERISTIC KcCOMM_Test_Tar_Torq "" VALUE 0x70101994 /* @ECU_Address@KcCOMM_Test_Tar_Torq@ */ Scalar_FLOAT32_IEEE 0 COMM_subsystem_integrated_CM_single -3.4E+38 3.4E+38 /end CHARACTERISTIC
/begin CHARACTERISTIC KcCOMM_Test_Tar_vehiclespd "" VALUE 0x70101990 /* @ECU_Address@KcCOMM_Test_Tar_vehiclespd@ */ Scalar_FLOAT32_IEEE 0 COMM_subsystem_integrated_CM_single -3.4E+38 3.4E+38 /end CHARACTERISTIC
/begin CHARACTERISTIC KcCOMM_Test_acceleration_fb "" VALUE 0x7010198c /* @ECU_Address@KcCOMM_Test_acceleration_fb@ */ Scalar_FLOAT32_IEEE 0 COMM_subsystem_integrated_CM_single -3.4E+38 3.4E+38 /end CHARACTERISTIC
/begin CHARACTERISTIC KcCOMM_Test_cmd_VCUChecksum "" VALUE 0x70101988 /* @ECU_Address@KcCOMM_Test_cmd_VCUChecksum@ */ Scalar_FLOAT32_IEEE 0 COMM_subsystem_integrated_CM_single -3.4E+38 3.4E+38 /end CHARACTERISTIC
/begin CHARACTERISTIC KcCOMM_Test_yaw_rate_fb "" VALUE 0x70101984 /* @ECU_Address@KcCOMM_Test_yaw_rate_fb@ */ Scalar_FLOAT32_IEEE 0 COMM_subsystem_integrated_CM_single -3.4E+38 3.4E+38 /end CHARACTERISTIC
/begin CHARACTERISTIC KfACCS_d_VEH_WheelDiameter "This is whell diameter" VALUE 0x70101980 /* @ECU_Address@KfACCS_d_VEH_WheelDiameter@ */ Scalar_FLOAT32_IEEE 0 COMM_subsystem_integrated_CM_single_mm 0.0 2000.0 /end CHARACTERISTIC
/begin CHARACTERISTIC KfCOMM_Ang_VEH_AngOrigin2FrontWheel "This is the angle between origin to front axle and origin to front wheel" VALUE 0x7010197c /* @ECU_Address@KfCOMM_Ang_VEH_AngOrigin2FrontWheel@ */ Scalar_FLOAT32_IEEE 0 COMM_subsystem_integrated_CM_single_rad -3.14 3.14 /end CHARACTERISTIC
/begin CHARACTERISTIC KfCOMM_VEH_Mass "Vehicle mass" VALUE 0x70101978 /* @ECU_Address@KfCOMM_VEH_Mass@ */ Scalar_FLOAT32_IEEE 0 COMM_subsystem_integrated_CM_single_kg 0.0 100000.0 /end CHARACTERISTIC
/begin CHARACTERISTIC KfCOMM_VEH_StiffnessFront "This is cornering stiffness of front wheel" VALUE 0x70101974 /* @ECU_Address@KfCOMM_VEH_StiffnessFront@ */ Scalar_FLOAT32_IEEE 0 COMM_subsystem_integrated_CM_single_N_deg 0.0 100000.0 /end CHARACTERISTIC
/begin CHARACTERISTIC KfCOMM_VEH_StiffnessRear "This is cornering stiffness of rear wheel" VALUE 0x70101970 /* @ECU_Address@KfCOMM_VEH_StiffnessRear@ */ Scalar_FLOAT32_IEEE 0 COMM_subsystem_integrated_CM_single_N_deg 0.0 1.0E+6 /end CHARACTERISTIC
/begin CHARACTERISTIC KfCOMM_VEH_YawInertia_Z "Moment of inertia of the whole vehicle around z axis" VALUE 0x7010196c /* @ECU_Address@KfCOMM_VEH_YawInertia_Z@ */ Scalar_FLOAT32_IEEE 0 COMM_subsystem_integrated_CM_single_kg_m2 0.0 100000.0 /end CHARACTERISTIC
/begin CHARACTERISTIC KfCOMM_a_VCULongAccOffset "Offset to override Longitudinal Acceleration." VALUE 0x70101968 /* @ECU_Address@KfCOMM_a_VCULongAccOffset@ */ Scalar_FLOAT32_IEEE 0 COMM_subsystem_integrated_CM_single -3.4E+38 3.4E+38 /end CHARACTERISTIC
/begin CHARACTERISTIC KfCOMM_d_VEH_DisCentorid2Front "This is the distance between Cetroid and Front surface" VALUE 0x70101964 /* @ECU_Address@KfCOMM_d_VEH_DisCentorid2Front@ */ Scalar_FLOAT32_IEEE 0 COMM_subsystem_integrated_CM_single_mm 0.0 10000.0 /end CHARACTERISTIC
/begin CHARACTERISTIC KfCOMM_d_VEH_DisFront2Rear "This is distance between two axes" VALUE 0x70101960 /* @ECU_Address@KfCOMM_d_VEH_DisFront2Rear@ */ Scalar_FLOAT32_IEEE 0 COMM_subsystem_integrated_CM_single_mm 0.0 10000.0 /end CHARACTERISTIC
/begin CHARACTERISTIC KfCOMM_d_VEH_DisLeft2Right "This is the distance between left wheel and right wheel" VALUE 0x7010195c /* @ECU_Address@KfCOMM_d_VEH_DisLeft2Right@ */ Scalar_FLOAT32_IEEE 0 COMM_subsystem_integrated_CM_single_mm 0.0 5000.0 /end CHARACTERISTIC
/begin CHARACTERISTIC KfCOMM_d_VEH_DisOrigin2End "This is the distance between the cordinate origin and the rear surface" VALUE 0x70101958 /* @ECU_Address@KfCOMM_d_VEH_DisOrigin2End@ */ Scalar_FLOAT32_IEEE 0 COMM_subsystem_integrated_CM_single_mm 0.0 10000.0 /end CHARACTERISTIC
/begin CHARACTERISTIC KfCOMM_d_VEH_DisOrigin2FrontWheel "" VALUE 0x70101954 /* @ECU_Address@KfCOMM_d_VEH_DisOrigin2FrontWheel@ */ Scalar_FLOAT32_IEEE 0 COMM_subsystem_integrated_CM_single_mm 0.0 10000.0 /end CHARACTERISTIC
/begin CHARACTERISTIC KfCOMM_d_VEH_DisOrigin2Head "This is the distance between the coordinate origin and the front surface" VALUE 0x70101950 /* @ECU_Address@KfCOMM_d_VEH_DisOrigin2Head@ */ Scalar_FLOAT32_IEEE 0 COMM_subsystem_integrated_CM_single_mm 0.0 10000.0 /end CHARACTERISTIC
/begin CHARACTERISTIC KfCOMM_d_VEH_DisOrigin2RearAxle "This is the distance between the cordinate origin and the rear axle" VALUE 0x7010194c /* @ECU_Address@KfCOMM_d_VEH_DisOrigin2RearAxle@ */ Scalar_FLOAT32_IEEE 0 COMM_subsystem_integrated_CM_single_mm 0.0 10000.0 /end CHARACTERISTIC
/begin CHARACTERISTIC KfCOMM_d_VEH_Length "This is vehicle length" VALUE 0x70101948 /* @ECU_Address@KfCOMM_d_VEH_Length@ */ Scalar_FLOAT32_IEEE 0 COMM_subsystem_integrated_CM_single_mm 0.0 20000.0 /end CHARACTERISTIC
/begin CHARACTERISTIC KfCOMM_d_VEH_MinTurnRadius "Minimum turning radius" VALUE 0x70101944 /* @ECU_Address@KfCOMM_d_VEH_MinTurnRadius@ */ Scalar_FLOAT32_IEEE 0 COMM_subsystem_integrated_CM_single_m 0.0 30.0 /end CHARACTERISTIC
/begin CHARACTERISTIC KfCOMM_d_VEH_Width "Vehicle's width" VALUE 0x70101940 /* @ECU_Address@KfCOMM_d_VEH_Width@ */ Scalar_FLOAT32_IEEE 0 COMM_subsystem_integrated_CM_single_mm 0.0 5000.0 /end CHARACTERISTIC
/begin CHARACTERISTIC KfCOMM_r_VCULongAccSlope "Slope to override Longitudinal Acceleration." VALUE 0x7010193c /* @ECU_Address@KfCOMM_r_VCULongAccSlope@ */ Scalar_FLOAT32_IEEE 0 COMM_subsystem_integrated_CM_single -3.4E+38 3.4E+38 /end CHARACTERISTIC
/begin CHARACTERISTIC KcCOMM_Test_Cmd_ATOModEnable "" VALUE 0x7010193a /* @ECU_Address@KcCOMM_Test_Cmd_ATOModEnable@ */ Scalar_UBYTE 0 COMM_subsystem_integrated_CM_uint8 0 255 /end CHARACTERISTIC
/begin CHARACTERISTIC KcCOMM_Test_Cmd_AccPelEnable "" VALUE 0x70101939 /* @ECU_Address@KcCOMM_Test_Cmd_AccPelEnable@ */ Scalar_UBYTE 0 COMM_subsystem_integrated_CM_uint8 0 255 /end CHARACTERISTIC
/begin CHARACTERISTIC KcCOMM_Test_Cmd_BrkPelEnable "" VALUE 0x70101938 /* @ECU_Address@KcCOMM_Test_Cmd_BrkPelEnable@ */ Scalar_UBYTE 0 COMM_subsystem_integrated_CM_uint8 0 255 /end CHARACTERISTIC
/begin CHARACTERISTIC KcCOMM_Test_Cmd_ICPDTC "" VALUE 0x70101937 /* @ECU_Address@KcCOMM_Test_Cmd_ICPDTC@ */ Scalar_UBYTE 0 COMM_subsystem_integrated_CM_uint8 0 255 /end CHARACTERISTIC
/begin CHARACTERISTIC KcCOMM_Test_Cmd_TgtSft "" VALUE 0x70101936 /* @ECU_Address@KcCOMM_Test_Cmd_TgtSft@ */ Scalar_UBYTE 0 COMM_subsystem_integrated_CM_uint8 0 255 /end CHARACTERISTIC
/begin CHARACTERISTIC KcCOMM_Test_Cmd_TgtSftEnable "" VALUE 0x70101935 /* @ECU_Address@KcCOMM_Test_Cmd_TgtSftEnable@ */ Scalar_UBYTE 0 COMM_subsystem_integrated_CM_uint8 0 255 /end CHARACTERISTIC
/begin CHARACTERISTIC KcCOMM_Test_Decs_Acc_Mod "" VALUE 0x70101934 /* @ECU_Address@KcCOMM_Test_Decs_Acc_Mod@ */ Scalar_UBYTE 0 COMM_subsystem_integrated_CM_uint8 0 255 /end CHARACTERISTIC
/begin CHARACTERISTIC KcCOMM_Test_Decs_Acc_Req "" VALUE 0x70101933 /* @ECU_Address@KcCOMM_Test_Decs_Acc_Req@ */ Scalar_UBYTE 0 COMM_subsystem_integrated_CM_uint8 0 255 /end CHARACTERISTIC
/begin CHARACTERISTIC KcCOMM_Test_Over_Speed "SLEW value for Over Speed." VALUE 0x70101932 /* @ECU_Address@KcCOMM_Test_Over_Speed@ */ Scalar_UBYTE 0 COMM_subsystem_integrated_CM_uint8 0 255 /end CHARACTERISTIC
/begin CHARACTERISTIC KcCOMM_Test_SlowDown_Indication "SLEW value for SpeedUp_Indication." VALUE 0x70101931 /* @ECU_Address@KcCOMM_Test_SlowDown_Indication@ */ Scalar_UBYTE 0 COMM_subsystem_integrated_CM_uint8 0 255 /end CHARACTERISTIC
/begin CHARACTERISTIC KcCOMM_Test_SpeedUp_Indication "SLEW value for SpeedUp_Indication." VALUE 0x70101930 /* @ECU_Address@KcCOMM_Test_SpeedUp_Indication@ */ Scalar_UBYTE 0 COMM_subsystem_integrated_CM_uint8 0 255 /end CHARACTERISTIC
/begin CHARACTERISTIC KcCOMM_Test_Stop_Request "" VALUE 0x7010192f /* @ECU_Address@KcCOMM_Test_Stop_Request@ */ Scalar_UBYTE 0 COMM_subsystem_integrated_CM_uint8 0 255 /end CHARACTERISTIC
/begin CHARACTERISTIC KcCOMM_Test_XBR_EBI_Mode "" VALUE 0x7010192e /* @ECU_Address@KcCOMM_Test_XBR_EBI_Mode@ */ Scalar_UBYTE 0 COMM_subsystem_integrated_CM_uint8 0 255 /end CHARACTERISTIC
/begin CHARACTERISTIC KcCOMM_Test_XBR_Priority "" VALUE 0x7010192d /* @ECU_Address@KcCOMM_Test_XBR_Priority@ */ Scalar_UBYTE 0 COMM_subsystem_integrated_CM_uint8 0 255 /end CHARACTERISTIC
/begin CHARACTERISTIC KcCOMM_Test_driveoff_Req "" VALUE 0x7010192c /* @ECU_Address@KcCOMM_Test_driveoff_Req@ */ Scalar_UBYTE 0 COMM_subsystem_integrated_CM_uint8 0 255 /end CHARACTERISTIC
/begin CHARACTERISTIC KcCOMM_Test_mode "" VALUE 0x7010192b /* @ECU_Address@KcCOMM_Test_mode@ */ Scalar_UBYTE 0 COMM_subsystem_integrated_CM_uint8 0 255 /end CHARACTERISTIC
/begin CHARACTERISTIC KcCOMM_TorqCtrlPriority_Active "The priority of the Torque Override Control Mode send to VCU in ADV active state.
      0 - Highest priority.
      1 - High priority.
      2 - Medium priority.
      3 - Low priority." VALUE 0x7010192a /* @ECU_Address@KcCOMM_TorqCtrlPriority_Active@ */ Scalar_UBYTE 0 COMM_subsystem_integrated_CM_uint8 0 255 /end CHARACTERISTIC
/begin CHARACTERISTIC KcCOMM_TorqCtrlPriority_Default "The priority of the Torque Override Control Mode send to VCU in default state.
      0 - Highest priority.
      1 - High priority.
      2 - Medium priority.
      3 - Low priority." VALUE 0x70101929 /* @ECU_Address@KcCOMM_TorqCtrlPriority_Default@ */ Scalar_UBYTE 0 COMM_subsystem_integrated_CM_uint8 0 255 /end CHARACTERISTIC
/begin CHARACTERISTIC KcCOMM_VehicleCANbusConfig "Vehicle Platform and CAN Bus Configuration.
      1 - JAC#1;
      2 - JAC#2 or iVISTA;
      3 - ICPV;
      4 - GLB;
      5 - FAW;
      6 - HZBus;
      7 - USdemo." VALUE 0x70101928 /* @ECU_Address@KcCOMM_VehicleCANbusConfig@ */ Scalar_UBYTE 0 COMM_subsystem_integrated_CM_uint8 0 255 /end CHARACTERISTIC
/begin CHARACTERISTIC KbCOMM_Test_BckFogLamp_Req "" VALUE 0x70101927 /* @ECU_Address@KbCOMM_Test_BckFogLamp_Req@ */ Scalar_BOOLEAN 0 COMM_subsystem_integrated_CM_boolean 0 1 /end CHARACTERISTIC
/begin CHARACTERISTIC KbCOMM_Test_BrakePrechargeRequest "Test mode value for brake boost precharge request." VALUE 0x70101926 /* @ECU_Address@KbCOMM_Test_BrakePrechargeRequest@ */ Scalar_BOOLEAN 0 COMM_subsystem_integrated_CM_boolean 0 1 /end CHARACTERISTIC
/begin CHARACTERISTIC KbCOMM_Test_BrakePriorityMode "Test mode for brake request priority mode." VALUE 0x70101925 /* @ECU_Address@KbCOMM_Test_BrakePriorityMode@ */ Scalar_BOOLEAN 0 COMM_subsystem_integrated_CM_boolean 0 1 /end CHARACTERISTIC
/begin CHARACTERISTIC KbCOMM_Test_Cmd_BrakeLightReq "" VALUE 0x70101924 /* @ECU_Address@KbCOMM_Test_Cmd_BrakeLightReq@ */ Scalar_BOOLEAN 0 COMM_subsystem_integrated_CM_boolean 0 1 /end CHARACTERISTIC
/begin CHARACTERISTIC KbCOMM_Test_Cmd_EPSDir "" VALUE 0x70101923 /* @ECU_Address@KbCOMM_Test_Cmd_EPSDir@ */ Scalar_BOOLEAN 0 COMM_subsystem_integrated_CM_boolean 0 1 /end CHARACTERISTIC
/begin CHARACTERISTIC KbCOMM_Test_Decs_DippedBeam_Req "" VALUE 0x70101922 /* @ECU_Address@KbCOMM_Test_Decs_DippedBeam_Req@ */ Scalar_BOOLEAN 0 COMM_subsystem_integrated_CM_boolean 0 1 /end CHARACTERISTIC
/begin CHARACTERISTIC KbCOMM_Test_Decs_HighBeam_Req "" VALUE 0x70101921 /* @ECU_Address@KbCOMM_Test_Decs_HighBeam_Req@ */ Scalar_BOOLEAN 0 COMM_subsystem_integrated_CM_boolean 0 1 /end CHARACTERISTIC
/begin CHARACTERISTIC KbCOMM_Test_Decs_LftLmp_Req "" VALUE 0x70101920 /* @ECU_Address@KbCOMM_Test_Decs_LftLmp_Req@ */ Scalar_BOOLEAN 0 COMM_subsystem_integrated_CM_boolean 0 1 /end CHARACTERISTIC
/begin CHARACTERISTIC KbCOMM_Test_Decs_Light_Req "" VALUE 0x7010191f /* @ECU_Address@KbCOMM_Test_Decs_Light_Req@ */ Scalar_BOOLEAN 0 COMM_subsystem_integrated_CM_boolean 0 1 /end CHARACTERISTIC
/begin CHARACTERISTIC KbCOMM_Test_Decs_RihtLmp_Req "" VALUE 0x7010191e /* @ECU_Address@KbCOMM_Test_Decs_RihtLmp_Req@ */ Scalar_BOOLEAN 0 COMM_subsystem_integrated_CM_boolean 0 1 /end CHARACTERISTIC
/begin CHARACTERISTIC KbCOMM_Test_Decs_iBCM_Req "" VALUE 0x7010191d /* @ECU_Address@KbCOMM_Test_Decs_iBCM_Req@ */ Scalar_BOOLEAN 0 COMM_subsystem_integrated_CM_boolean 0 1 /end CHARACTERISTIC
/begin CHARACTERISTIC KbCOMM_Test_FrontFogLamp_Req "" VALUE 0x7010191c /* @ECU_Address@KbCOMM_Test_FrontFogLamp_Req@ */ Scalar_BOOLEAN 0 COMM_subsystem_integrated_CM_boolean 0 1 /end CHARACTERISTIC
/begin CHARACTERISTIC KbCOMM_Test_Horn_Req "" VALUE 0x7010191b /* @ECU_Address@KbCOMM_Test_Horn_Req@ */ Scalar_BOOLEAN 0 COMM_subsystem_integrated_CM_boolean 0 1 /end CHARACTERISTIC
/begin CHARACTERISTIC KbCOMM_Test_HummerSts "" VALUE 0x7010191a /* @ECU_Address@KbCOMM_Test_HummerSts@ */ Scalar_BOOLEAN 0 COMM_subsystem_integrated_CM_boolean 0 1 /end CHARACTERISTIC
/begin CHARACTERISTIC KbCOMM_Test_WarnLight_Req "" VALUE 0x70101919 /* @ECU_Address@KbCOMM_Test_WarnLight_Req@ */ Scalar_BOOLEAN 0 COMM_subsystem_integrated_CM_boolean 0 1 /end CHARACTERISTIC
/begin CHARACTERISTIC KbCOMM_VEH_UseNewConfig "This calibartion can change to a new vehicle configure which can be calibrated" VALUE 0x70101918 /* @ECU_Address@KbCOMM_VEH_UseNewConfig@ */ Scalar_BOOLEAN 0 COMM_subsystem_integrated_CM_boolean 0.0 1.0 /end CHARACTERISTIC
/begin CHARACTERISTIC KcCOMM_Test_Cmd_EPSXBW_En "" VALUE 0x70101917 /* @ECU_Address@KcCOMM_Test_Cmd_EPSXBW_En@ */ Scalar_BOOLEAN 0 COMM_subsystem_integrated_CM_boolean 0 1 /end CHARACTERISTIC
/begin CHARACTERISTIC KcCOMM_Test_Cmd_EPSXBW_En_ovr "" VALUE 0x70101916 /* @ECU_Address@KcCOMM_Test_Cmd_EPSXBW_En_ovr@ */ Scalar_BOOLEAN 0 COMM_subsystem_integrated_CM_boolean 0 1 /end CHARACTERISTIC
/begin CHARACTERISTIC KcCOMM_Test_Cmd_StrAngle_ovr "" VALUE 0x70101915 /* @ECU_Address@KcCOMM_Test_Cmd_StrAngle_ovr@ */ Scalar_BOOLEAN 0 COMM_subsystem_integrated_CM_boolean 0 1 /end CHARACTERISTIC
/begin CHARACTERISTIC KcCOMM_Test_Decs_Acc_Req_ovr "" VALUE 0x70101914 /* @ECU_Address@KcCOMM_Test_Decs_Acc_Req_ovr@ */ Scalar_BOOLEAN 0 COMM_subsystem_integrated_CM_boolean 0 1 /end CHARACTERISTIC
/begin CHARACTERISTIC KcCOMM_Test_Decs_Acc_Value_ovr "" VALUE 0x70101913 /* @ECU_Address@KcCOMM_Test_Decs_Acc_Value_ovr@ */ Scalar_BOOLEAN 0 COMM_subsystem_integrated_CM_boolean 0 1 /end CHARACTERISTIC
/begin CHARACTERISTIC KcCOMM_Test_Decs_Breake_Req "" VALUE 0x70101912 /* @ECU_Address@KcCOMM_Test_Decs_Breake_Req@ */ Scalar_BOOLEAN 0 COMM_subsystem_integrated_CM_boolean 0 1 /end CHARACTERISTIC
/begin CHARACTERISTIC KcCOMM_Test_Decs_Breake_Req_ovr "" VALUE 0x70101911 /* @ECU_Address@KcCOMM_Test_Decs_Breake_Req_ovr@ */ Scalar_BOOLEAN 0 COMM_subsystem_integrated_CM_boolean 0 1 /end CHARACTERISTIC
/begin CHARACTERISTIC KcCOMM_Test_Decs_Breake_Value_ovr "" VALUE 0x70101910 /* @ECU_Address@KcCOMM_Test_Decs_Breake_Value_ovr@ */ Scalar_BOOLEAN 0 COMM_subsystem_integrated_CM_boolean 0 1 /end CHARACTERISTIC
/begin CHARACTERISTIC KfDCSN_t_adm_temp_steering_ovrd_delay "when override conditions are met, the time to delay before exit." VALUE 0x70101a8c /* @ECU_Address@KfDCSN_t_adm_temp_steering_ovrd_delay@ */ Scalar_FLOAT32_IEEE 0 DCSN_subsystem_integrated_CM_single_s -3.4E+38 3.4E+38 /end CHARACTERISTIC
/begin CHARACTERISTIC KfDCSN_t_adm_temp_steering_resume_delay "When resume conditions are met, the time before re-engaged." VALUE 0x70101a88 /* @ECU_Address@KfDCSN_t_adm_temp_steering_resume_delay@ */ Scalar_FLOAT32_IEEE 0 DCSN_subsystem_integrated_CM_single_s -3.4E+38 3.4E+38 /end CHARACTERISTIC
/begin CHARACTERISTIC KfDCSN_t_max_time_fault_warning "allowed reaction time after fault warning and before triggering emergency stop" VALUE 0x70101a74 /* @ECU_Address@KfDCSN_t_max_time_fault_warning@ */ Scalar_FLOAT32_IEEE 0 DCSN_subsystem_integrated_CM_single_s -3.4E+38 3.4E+38 /end CHARACTERISTIC
/begin CHARACTERISTIC KfDCSN_t_max_time_to_takeover "allowed reaction time after both lane markers are missed but before autodrive exit" VALUE 0x70101a70 /* @ECU_Address@KfDCSN_t_max_time_to_takeover@ */ Scalar_FLOAT32_IEEE 0 DCSN_subsystem_integrated_CM_single_s -3.4E+38 3.4E+38 /end CHARACTERISTIC
/begin CHARACTERISTIC KfDCSN_v_adm_temp_veh_setspeed "Current vehicle acc set speed. 
      Not connect with ACCS yet" VALUE 0x70101a58 /* @ECU_Address@KfDCSN_v_adm_temp_veh_setspeed@ */ Scalar_FLOAT32_IEEE 0 DCSN_subsystem_integrated_CM_single_m_s -3.4E+38 3.4E+38 /end CHARACTERISTIC
/begin CHARACTERISTIC KfDCSN_v_setspeed_thrsh_hi "Max speed allowed by Autodrive system" VALUE 0x70101a48 /* @ECU_Address@KfDCSN_v_setspeed_thrsh_hi@ */ Scalar_FLOAT32_IEEE 0 DCSN_subsystem_integrated_CM_single_m_s -3.4E+38 3.4E+38 /end CHARACTERISTIC
/begin CHARACTERISTIC KcDCSN_t_usr_activate_cmd_send_count "send count of usr_activate_action, valid when KbDCSN_use_vehicle_activate_switch = true
      unit: seconds" VALUE 0x70101a3f /* @ECU_Address@KcDCSN_t_usr_activate_cmd_send_count@ */ Scalar_UBYTE 0 DCSN_subsystem_integrated_CM_uint8 0 255 /end CHARACTERISTIC
/begin CHARACTERISTIC KeDCSN_adm_main_mode_man_value "manual override of adm_main_mode output as uint8:
      
      0 = ADM_OFF
      1 = ADM_STANDBY
      2 = ADM_READY
      3 = ADM_ACTIVE
      4 = ADM_STEER_OVRD
      5 = ADM_TAKEOVER_WARNING
      6 = ADM_FAULT_WARNING76 = ADM_FAULT_REACTION
      8 = ADM_FAULT_DETECTED" VALUE 0x70101a3e /* @ECU_Address@KeDCSN_adm_main_mode_man_value@ */ Scalar_UBYTE 0 DCSN_subsystem_integrated_CM_uint8 0 255 /end CHARACTERISTIC
/begin CHARACTERISTIC KeDCSN_adm_temp_diag_system_fault "System faults
      0 = no fault
      1,2 = warning faults
      3,4,5 = exit faults" VALUE 0x70101a3d /* @ECU_Address@KeDCSN_adm_temp_diag_system_fault@ */ Scalar_UBYTE 0 DCSN_subsystem_integrated_CM_uint8 0 255 /end CHARACTERISTIC
/begin CHARACTERISTIC KeDCSN_usr_cmd_autodrive_activate_man "0 = Deactivate
      1 = Activate
      2 = Hold" VALUE 0x70101a34 /* @ECU_Address@KeDCSN_usr_cmd_autodrive_activate_man@ */ Scalar_UBYTE 0 DCSN_subsystem_integrated_CM_uint8 0 255 /end CHARACTERISTIC
/begin CHARACTERISTIC KbDCSN_accs_resume_man_enbl "0 = manual accs resume override disabled
      1 = manual accs resume override enabled" VALUE 0x70101a2f /* @ECU_Address@KbDCSN_accs_resume_man_enbl@ */ Scalar_BOOLEAN 0 DCSN_subsystem_integrated_CM_boolean 0 1 /end CHARACTERISTIC
/begin CHARACTERISTIC KbDCSN_accs_resume_man_value "manual change lane switch, valid only when KbDCSN_accs_resume_man_enbl = true
      Pulse signal when reverse." VALUE 0x70101a2e /* @ECU_Address@KbDCSN_accs_resume_man_value@ */ Scalar_BOOLEAN 0 DCSN_subsystem_integrated_CM_boolean 0 1 /end CHARACTERISTIC
/begin CHARACTERISTIC KbDCSN_adm_main_mode_man_ctrl "0 = manual override disabled
      1 = manual override enabled" VALUE 0x70101a2b /* @ECU_Address@KbDCSN_adm_main_mode_man_ctrl@ */ Scalar_BOOLEAN 0 DCSN_subsystem_integrated_CM_boolean 0 1 /end CHARACTERISTIC
/begin CHARACTERISTIC KbDCSN_adm_temp_stop_finished "0 = not finished
      1 = finished" VALUE 0x70101a2a /* @ECU_Address@KbDCSN_adm_temp_stop_finished@ */ Scalar_BOOLEAN 0 DCSN_subsystem_integrated_CM_boolean 0 1 /end CHARACTERISTIC
/begin CHARACTERISTIC KbDCSN_adm_temp_usr_cmd_autodrive_enabled "0 = not enabled
      1 = enabled" VALUE 0x70101a29 /* @ECU_Address@KbDCSN_adm_temp_usr_cmd_autodrive_enabled@ */ Scalar_BOOLEAN 0 DCSN_subsystem_integrated_CM_boolean 0 1 /end CHARACTERISTIC
/begin CHARACTERISTIC KbDCSN_aeb_usr_switch "AEB feature user switch" VALUE 0x70101a27 /* @ECU_Address@KbDCSN_aeb_usr_switch@ */ Scalar_BOOLEAN 0 DCSN_subsystem_integrated_CM_boolean 0 1 /end CHARACTERISTIC
/begin CHARACTERISTIC KbDCSN_fcw_usr_switch "FCW feature user switch" VALUE 0x70101a19 /* @ECU_Address@KbDCSN_fcw_usr_switch@ */ Scalar_BOOLEAN 0 DCSN_subsystem_integrated_CM_boolean 0 1 /end CHARACTERISTIC
/begin CHARACTERISTIC KbDCSN_lcw_usr_switch "LCW feature user switch" VALUE 0x70101a11 /* @ECU_Address@KbDCSN_lcw_usr_switch@ */ Scalar_BOOLEAN 0 DCSN_subsystem_integrated_CM_boolean 0 1 /end CHARACTERISTIC
/begin CHARACTERISTIC KbDCSN_ldw_usr_switch "LDW feature user switch" VALUE 0x70101a0f /* @ECU_Address@KbDCSN_ldw_usr_switch@ */ Scalar_BOOLEAN 0 DCSN_subsystem_integrated_CM_boolean 0 1 /end CHARACTERISTIC
/begin CHARACTERISTIC KbDCSN_lka_usr_switch "LKA feature user switch" VALUE 0x70101a0d /* @ECU_Address@KbDCSN_lka_usr_switch@ */ Scalar_BOOLEAN 0 DCSN_subsystem_integrated_CM_boolean 0 1 /end CHARACTERISTIC
/begin CHARACTERISTIC KbDCSN_use_EgmoLinearSpeed "0 = Use vehicle CAN velocity
      1 = Use egmo linear velocity" VALUE 0x701019ff /* @ECU_Address@KbDCSN_use_EgmoLinearSpeed@ */ Scalar_BOOLEAN 0 DCSN_subsystem_integrated_CM_boolean 0 1 /end CHARACTERISTIC
/begin CHARACTERISTIC KbDCSN_use_EgmoReadyFlag "0 = use calibration to output EGMO ready flag
      1 = use EGMO ready flag" VALUE 0x701019fe /* @ECU_Address@KbDCSN_use_EgmoReadyFlag@ */ Scalar_BOOLEAN 0 DCSN_subsystem_integrated_CM_boolean 0 1 /end CHARACTERISTIC
/begin CHARACTERISTIC KbDCSN_use_vehicle_activate_switch "0 = use calibration activate switch
      1 = use vehicle activate switch" VALUE 0x701019f8 /* @ECU_Address@KbDCSN_use_vehicle_activate_switch@ */ Scalar_BOOLEAN 0 DCSN_subsystem_integrated_CM_boolean 0 1 /end CHARACTERISTIC
/begin AXIS_PTS KaAEBS_AXIS_Veh_Speed_vec "" 0x70101788 /* @ECU_Address@KaAEBS_AXIS_Veh_Speed_vec@ */ VfAEBS_veh_speed_used Lookup1D_X_FLOAT32_IEEE 0 AEBS_subsystem_integrated_CM_single 9 -3.4E+38 3.4E+38 /end AXIS_PTS
/begin AXIS_PTS KaAEBS_AXIS_DeltaSpeed_Vip "" 0x7010182c /* @ECU_Address@KaAEBS_AXIS_DeltaSpeed_Vip@ */ NO_INPUT_QUANTITY Lookup1D_X_FLOAT32_IEEE 0 AEBS_subsystem_integrated_CM_single 13 -3.4E+38 3.4E+38 /end AXIS_PTS
/begin AXIS_PTS KaAEBS_AXIS_Veh_Curvature_vec "" 0x701017ac /* @ECU_Address@KaAEBS_AXIS_Veh_Curvature_vec@ */ NO_INPUT_QUANTITY Lookup1D_X_FLOAT32_IEEE 0 AEBS_subsystem_integrated_CM_single 10 -3.4E+38 3.4E+38 /end AXIS_PTS
/begin AXIS_PTS KaAEBS_AXIS_NearestPointX_vec "" 0x70101800 /* @ECU_Address@KaAEBS_AXIS_NearestPointX_vec@ */ NO_INPUT_QUANTITY Lookup1D_X_FLOAT32_IEEE 0 AEBS_subsystem_integrated_CM_single 11 -3.4E+38 3.4E+38 /end AXIS_PTS
/begin AXIS_PTS KaAEBS_AXIS_NearestPointY_vec "" 0x701017d4 /* @ECU_Address@KaAEBS_AXIS_NearestPointY_vec@ */ NO_INPUT_QUANTITY Lookup1D_X_FLOAT32_IEEE 0 AEBS_subsystem_integrated_CM_single 11 -3.4E+38 3.4E+38 /end AXIS_PTS
/begin MEASUREMENT VfAEBS_veh_speed_used "" FLOAT32_IEEE AEBS_subsystem_integrated_CM_single 0 0 -3.4E+38 3.4E+38 ECU_ADDRESS 0xb0002bb8 /* @ECU_Address@VfAEBS_veh_speed_used@ */ /end MEASUREMENT
/begin MEASUREMENT VfAEBS_speed_x_used "" FLOAT32_IEEE AEBS_subsystem_integrated_CM_single 0 0 -3.4E+38 3.4E+38 ECU_ADDRESS 0xb0002bb4 /* @ECU_Address@VfAEBS_speed_x_used@ */ /end MEASUREMENT
/begin MEASUREMENT VfAEBS_speed_y_used "" FLOAT32_IEEE AEBS_subsystem_integrated_CM_single 0 0 -3.4E+38 3.4E+38 ECU_ADDRESS 0xb0002bb0 /* @ECU_Address@VfAEBS_speed_y_used@ */ /end MEASUREMENT
/begin MEASUREMENT VfAEBS_veh_acc_used "" FLOAT32_IEEE AEBS_subsystem_integrated_CM_single 0 0 -3.4E+38 3.4E+38 ECU_ADDRESS 0xb0002bac /* @ECU_Address@VfAEBS_veh_acc_used@ */ /end MEASUREMENT
/begin MEASUREMENT VfAEBS_veh_cur_used "" FLOAT32_IEEE AEBS_subsystem_integrated_CM_single 0 0 -3.4E+38 3.4E+38 ECU_ADDRESS 0xb0002ba8 /* @ECU_Address@VfAEBS_veh_cur_used@ */ /end MEASUREMENT
/begin MEASUREMENT VfAEBS_obs_delta_dis "" FLOAT32_IEEE AEBS_subsystem_integrated_CM_single 0 0 -3.4E+38 3.4E+38 ARRAY_SIZE 32 ECU_ADDRESS 0xb0002b28 /* @ECU_Address@VfAEBS_obs_delta_dis@ */ /end MEASUREMENT
/begin MEASUREMENT VfAEBS_obs_delta_speed "" FLOAT32_IEEE AEBS_subsystem_integrated_CM_single 0 0 -3.4E+38 3.4E+38 ARRAY_SIZE 32 ECU_ADDRESS 0xb0002aa8 /* @ECU_Address@VfAEBS_obs_delta_speed@ */ /end MEASUREMENT
/begin MEASUREMENT VfAEBS_obs_ttc "" FLOAT32_IEEE AEBS_subsystem_integrated_CM_single 0 0 -3.4E+38 3.4E+38 ARRAY_SIZE 32 ECU_ADDRESS 0xb0002a28 /* @ECU_Address@VfAEBS_obs_ttc@ */ /end MEASUREMENT
/begin MEASUREMENT VfAEBS_obs_dis2adc_long "" FLOAT32_IEEE AEBS_subsystem_integrated_CM_single 0 0 -3.4E+38 3.4E+38 ARRAY_SIZE 32 ECU_ADDRESS 0xb00029a8 /* @ECU_Address@VfAEBS_obs_dis2adc_long@ */ /end MEASUREMENT
/begin MEASUREMENT VfAEBS_obs_dis2adc_lateral "" FLOAT32_IEEE AEBS_subsystem_integrated_CM_single 0 0 -3.4E+38 3.4E+38 ARRAY_SIZE 32 ECU_ADDRESS 0xb0002928 /* @ECU_Address@VfAEBS_obs_dis2adc_lateral@ */ /end MEASUREMENT
/begin MEASUREMENT VfAEBS_obs_v_long "" FLOAT32_IEEE AEBS_subsystem_integrated_CM_single 0 0 -3.4E+38 3.4E+38 ARRAY_SIZE 32 ECU_ADDRESS 0xb00028a8 /* @ECU_Address@VfAEBS_obs_v_long@ */ /end MEASUREMENT
/begin MEASUREMENT VfAEBS_obs_v_lateral "" FLOAT32_IEEE AEBS_subsystem_integrated_CM_single 0 0 -3.4E+38 3.4E+38 ARRAY_SIZE 32 ECU_ADDRESS 0xb0002828 /* @ECU_Address@VfAEBS_obs_v_lateral@ */ /end MEASUREMENT
/begin MEASUREMENT VfAEBS_obs_v_long_vip "" FLOAT32_IEEE AEBS_subsystem_integrated_CM_single 0 0 -3.4E+38 3.4E+38 ECU_ADDRESS 0xb0002824 /* @ECU_Address@VfAEBS_obs_v_long_vip@ */ /end MEASUREMENT
/begin MEASUREMENT VfAEBS_obs_acc_lateral_vip "" FLOAT32_IEEE AEBS_subsystem_integrated_CM_single 0 0 -3.4E+38 3.4E+38 ECU_ADDRESS 0xb0002820 /* @ECU_Address@VfAEBS_obs_acc_lateral_vip@ */ /end MEASUREMENT
/begin MEASUREMENT VfAEBS_obs_acc_long_vip "" FLOAT32_IEEE AEBS_subsystem_integrated_CM_single 0 0 -3.4E+38 3.4E+38 ECU_ADDRESS 0xb000281c /* @ECU_Address@VfAEBS_obs_acc_long_vip@ */ /end MEASUREMENT
/begin MEASUREMENT VfAEBS_obs_center_x_vip "" FLOAT32_IEEE AEBS_subsystem_integrated_CM_single 0 0 -3.4E+38 3.4E+38 ECU_ADDRESS 0xb0002818 /* @ECU_Address@VfAEBS_obs_center_x_vip@ */ /end MEASUREMENT
/begin MEASUREMENT VfAEBS_obs_center_y_vip "" FLOAT32_IEEE AEBS_subsystem_integrated_CM_single 0 0 -3.4E+38 3.4E+38 ECU_ADDRESS 0xb0002814 /* @ECU_Address@VfAEBS_obs_center_y_vip@ */ /end MEASUREMENT
/begin MEASUREMENT VfAEBS_obs_heading_VIP "" FLOAT32_IEEE AEBS_subsystem_integrated_CM_single 0 0 -3.4E+38 3.4E+38 ECU_ADDRESS 0xb0002810 /* @ECU_Address@VfAEBS_obs_heading_VIP@ */ /end MEASUREMENT
/begin MEASUREMENT VfAEBS_obs_length_VIP "" FLOAT32_IEEE AEBS_subsystem_integrated_CM_single 0 0 -3.4E+38 3.4E+38 ECU_ADDRESS 0xb000280c /* @ECU_Address@VfAEBS_obs_length_VIP@ */ /end MEASUREMENT
/begin MEASUREMENT VfAEBS_obs_width_VIP "" FLOAT32_IEEE AEBS_subsystem_integrated_CM_single 0 0 -3.4E+38 3.4E+38 ECU_ADDRESS 0xb0002808 /* @ECU_Address@VfAEBS_obs_width_VIP@ */ /end MEASUREMENT
/begin MEASUREMENT VfAEBS_obs_dis_long_VIP "" FLOAT32_IEEE AEBS_subsystem_integrated_CM_single 0 0 -3.4E+38 3.4E+38 ECU_ADDRESS 0xb0002804 /* @ECU_Address@VfAEBS_obs_dis_long_VIP@ */ /end MEASUREMENT
/begin MEASUREMENT VfAEBS_obs_dis_lateral_VIP "" FLOAT32_IEEE AEBS_subsystem_integrated_CM_single 0 0 -3.4E+38 3.4E+38 ECU_ADDRESS 0xb0002800 /* @ECU_Address@VfAEBS_obs_dis_lateral_VIP@ */ /end MEASUREMENT
/begin MEASUREMENT VfAEBS_obs_rp_vip "" FLOAT32_IEEE AEBS_subsystem_integrated_CM_single 0 0 -3.4E+38 3.4E+38 ECU_ADDRESS 0xb00027fc /* @ECU_Address@VfAEBS_obs_rp_vip@ */ /end MEASUREMENT
/begin MEASUREMENT VfAEBS_obs_ttc_vip "" FLOAT32_IEEE AEBS_subsystem_integrated_CM_single 0 0 -3.4E+38 3.4E+38 ECU_ADDRESS 0xb00027f8 /* @ECU_Address@VfAEBS_obs_ttc_vip@ */ /end MEASUREMENT
/begin MEASUREMENT VfAEBS_obs_delta_dis_vip "" FLOAT32_IEEE AEBS_subsystem_integrated_CM_single 0 0 -3.4E+38 3.4E+38 ECU_ADDRESS 0xb00027f4 /* @ECU_Address@VfAEBS_obs_delta_dis_vip@ */ /end MEASUREMENT
/begin MEASUREMENT VfAEBS_obs_delta_speed_vip "" FLOAT32_IEEE AEBS_subsystem_integrated_CM_single 0 0 -3.4E+38 3.4E+38 ECU_ADDRESS 0xb00027f0 /* @ECU_Address@VfAEBS_obs_delta_speed_vip@ */ /end MEASUREMENT
/begin MEASUREMENT VfAEBS_obs_v_lateral_vip "" FLOAT32_IEEE AEBS_subsystem_integrated_CM_single 0 0 -3.4E+38 3.4E+38 ECU_ADDRESS 0xb00027ec /* @ECU_Address@VfAEBS_obs_v_lateral_vip@ */ /end MEASUREMENT
/begin MEASUREMENT VfAEBS_Pre_BrakeActiveTTCThreshold "" FLOAT32_IEEE AEBS_subsystem_integrated_CM_single 0 0 -3.4E+38 3.4E+38 ECU_ADDRESS 0xb00027e8 /* @ECU_Address@VfAEBS_Pre_BrakeActiveTTCThreshold@ */ /end MEASUREMENT
/begin MEASUREMENT VfAEBS_Partial_BrakeActiveTTCThreshold "" FLOAT32_IEEE AEBS_subsystem_integrated_CM_single 0 0 -3.4E+38 3.4E+38 ECU_ADDRESS 0xb00027e4 /* @ECU_Address@VfAEBS_Partial_BrakeActiveTTCThreshold@ */ /end MEASUREMENT
/begin MEASUREMENT VfAEBS_v_obj_absolute_speed "" FLOAT32_IEEE AEBS_subsystem_integrated_CM_single 0 0 -3.4E+38 3.4E+38 ECU_ADDRESS 0xb00027e0 /* @ECU_Address@VfAEBS_v_obj_absolute_speed@ */ /end MEASUREMENT
/begin MEASUREMENT VfAEBS_a_obj_absolute_acc "" FLOAT32_IEEE AEBS_subsystem_integrated_CM_single 0 0 -3.4E+38 3.4E+38 ECU_ADDRESS 0xb00027dc /* @ECU_Address@VfAEBS_a_obj_absolute_acc@ */ /end MEASUREMENT
/begin MEASUREMENT VfAEBS_areq_withoutDelay_UrgentBrk "" FLOAT32_IEEE AEBS_subsystem_integrated_CM_single 0 0 -3.4E+38 3.4E+38 ECU_ADDRESS 0xb00027d8 /* @ECU_Address@VfAEBS_areq_withoutDelay_UrgentBrk@ */ /end MEASUREMENT
/begin MEASUREMENT VfAEBS_areq_withoutDelay "" FLOAT32_IEEE AEBS_subsystem_integrated_CM_single 0 0 -3.4E+38 3.4E+38 ECU_ADDRESS 0xb00027d4 /* @ECU_Address@VfAEBS_areq_withoutDelay@ */ /end MEASUREMENT
/begin MEASUREMENT VfAEBS_dis_delay "" FLOAT32_IEEE AEBS_subsystem_integrated_CM_single 0 0 -3.4E+38 3.4E+38 ECU_ADDRESS 0xb00027d0 /* @ECU_Address@VfAEBS_dis_delay@ */ /end MEASUREMENT
/begin MEASUREMENT VfAEBS_areq "" FLOAT32_IEEE AEBS_subsystem_integrated_CM_single 0 0 -3.4E+38 3.4E+38 ECU_ADDRESS 0xb00027cc /* @ECU_Address@VfAEBS_areq@ */ /end MEASUREMENT
/begin MEASUREMENT VfAEBS_AEB_acceleration_af_filter "" FLOAT32_IEEE AEBS_subsystem_integrated_CM_single 0 0 -3.4E+38 3.4E+38 ECU_ADDRESS 0xb00027c8 /* @ECU_Address@VfAEBS_AEB_acceleration_af_filter@ */ /end MEASUREMENT
/begin MEASUREMENT VfAEBS_AEB_accReq_beforeSend "" FLOAT32_IEEE AEBS_subsystem_integrated_CM_single 0 0 -3.4E+38 3.4E+38 ECU_ADDRESS 0xb00027c4 /* @ECU_Address@VfAEBS_AEB_accReq_beforeSend@ */ /end MEASUREMENT
/begin MEASUREMENT VfAEBS_FedBck_Vehspd "" FLOAT32_IEEE AEBS_subsystem_integrated_CM_single 0 0 -3.4E+38 3.4E+38 ECU_ADDRESS 0xb00027bc /* @ECU_Address@VfAEBS_FedBck_Vehspd@ */ /end MEASUREMENT
/begin MEASUREMENT VfAEBS_FedBck_AccLong "" FLOAT32_IEEE AEBS_subsystem_integrated_CM_single 0 0 -3.4E+38 3.4E+38 ECU_ADDRESS 0xb00027b8 /* @ECU_Address@VfAEBS_FedBck_AccLong@ */ /end MEASUREMENT
/begin MEASUREMENT VfAEBS_FedBck_StrAngle "" FLOAT32_IEEE AEBS_subsystem_integrated_CM_single 0 0 -3.4E+38 3.4E+38 ECU_ADDRESS 0xb00027b4 /* @ECU_Address@VfAEBS_FedBck_StrAngle@ */ /end MEASUREMENT
/begin MEASUREMENT VfAEBS_FedBck_yawRate "" FLOAT32_IEEE AEBS_subsystem_integrated_CM_single 0 0 -3.4E+38 3.4E+38 ECU_ADDRESS 0xb00027b0 /* @ECU_Address@VfAEBS_FedBck_yawRate@ */ /end MEASUREMENT
/begin MEASUREMENT VfAEBS_FedBck_AccLateral "" FLOAT32_IEEE AEBS_subsystem_integrated_CM_single 0 0 -3.4E+38 3.4E+38 ECU_ADDRESS 0xb00027ac /* @ECU_Address@VfAEBS_FedBck_AccLateral@ */ /end MEASUREMENT
/begin MEASUREMENT VfAEBS_obs_id_vip "" SLONG AEBS_subsystem_integrated_CM_int32 0 0 -2147483648 2147483647 ECU_ADDRESS 0xb0002790 /* @ECU_Address@VfAEBS_obs_id_vip@ */ /end MEASUREMENT
/begin MEASUREMENT VfAEBS_AEBS_obs_id "" SLONG AEBS_subsystem_integrated_CM_int32 0 0 -2147483648 2147483647 ECU_ADDRESS 0xb000278c /* @ECU_Address@VfAEBS_AEBS_obs_id@ */ /end MEASUREMENT
/begin MEASUREMENT VfAEBS_obs_type_vip "" SBYTE AEBS_subsystem_integrated_CM_int8 0 0 -128 127 ECU_ADDRESS 0xb0002775 /* @ECU_Address@VfAEBS_obs_type_vip@ */ /end MEASUREMENT
/begin MEASUREMENT VfAEBS_obs_position_state "" UBYTE AEBS_subsystem_integrated_CM_uint8 0 0 0 255 ARRAY_SIZE 32 ECU_ADDRESS 0xb0002755 /* @ECU_Address@VfAEBS_obs_position_state@ */ /end MEASUREMENT
/begin MEASUREMENT VfAEBS_obs_filtered_type "" UBYTE AEBS_subsystem_integrated_CM_uint8 0 0 0 255 ARRAY_SIZE 32 ECU_ADDRESS 0xb0002735 /* @ECU_Address@VfAEBS_obs_filtered_type@ */ /end MEASUREMENT
/begin MEASUREMENT VfAEBS_obs_index_vip "" UBYTE AEBS_subsystem_integrated_CM_uint8 0 0 0 255 ECU_ADDRESS 0xb0002734 /* @ECU_Address@VfAEBS_obs_index_vip@ */ /end MEASUREMENT
/begin MEASUREMENT VfAEBS_obs_position_state_vip "" UBYTE AEBS_subsystem_integrated_CM_uint8 0 0 0 255 ECU_ADDRESS 0xb0002733 /* @ECU_Address@VfAEBS_obs_position_state_vip@ */ /end MEASUREMENT
/begin MEASUREMENT VfAEBS_FCW_warn_level "" UBYTE AEBS_subsystem_integrated_CM_uint8 0 0 0 255 ECU_ADDRESS 0xb0002732 /* @ECU_Address@VfAEBS_FCW_warn_level@ */ /end MEASUREMENT
/begin MEASUREMENT VfAEBS_FedBck_Drivemode "" UBYTE AEBS_subsystem_integrated_CM_uint8 0 0 0 255 ECU_ADDRESS 0xb000272f /* @ECU_Address@VfAEBS_FedBck_Drivemode@ */ /end MEASUREMENT
/begin MEASUREMENT VfAEBS_FedBck_BrkLightState "" UBYTE AEBS_subsystem_integrated_CM_uint8 0 0 0 255 ECU_ADDRESS 0xb000272e /* @ECU_Address@VfAEBS_FedBck_BrkLightState@ */ /end MEASUREMENT
/begin MEASUREMENT VfAEBS_FedBck_BrkPedStatus "" UBYTE AEBS_subsystem_integrated_CM_uint8 0 0 0 255 ECU_ADDRESS 0xb000272d /* @ECU_Address@VfAEBS_FedBck_BrkPedStatus@ */ /end MEASUREMENT
/begin MEASUREMENT VfAEBS_FedBck_EPBstate "" UBYTE AEBS_subsystem_integrated_CM_uint8 0 0 0 255 ECU_ADDRESS 0xb000272c /* @ECU_Address@VfAEBS_FedBck_EPBstate@ */ /end MEASUREMENT
/begin MEASUREMENT VfAEBS_FedBck_GearValue "" UBYTE AEBS_subsystem_integrated_CM_uint8 0 0 0 255 ECU_ADDRESS 0xb000272b /* @ECU_Address@VfAEBS_FedBck_GearValue@ */ /end MEASUREMENT
/begin MEASUREMENT VfAEBS_FedBck_BrkPedPos "" UBYTE AEBS_subsystem_integrated_CM_uint8 0 0 0 255 ECU_ADDRESS 0xb000272a /* @ECU_Address@VfAEBS_FedBck_BrkPedPos@ */ /end MEASUREMENT
/begin MEASUREMENT VfAEBS_FedBck_AccPedPos "" UBYTE AEBS_subsystem_integrated_CM_uint8 0 0 0 255 ECU_ADDRESS 0xb0002729 /* @ECU_Address@VfAEBS_FedBck_AccPedPos@ */ /end MEASUREMENT
/begin MEASUREMENT VfAEBS_FedBck_SmallLampState "" UBYTE AEBS_subsystem_integrated_CM_uint8 0 0 0 255 ECU_ADDRESS 0xb0002728 /* @ECU_Address@VfAEBS_FedBck_SmallLampState@ */ /end MEASUREMENT
/begin MEASUREMENT VfAEBS_FedBck_LeftLampState "" UBYTE AEBS_subsystem_integrated_CM_uint8 0 0 0 255 ECU_ADDRESS 0xb0002727 /* @ECU_Address@VfAEBS_FedBck_LeftLampState@ */ /end MEASUREMENT
/begin MEASUREMENT VfAEBS_FedBck_RightLampState "" UBYTE AEBS_subsystem_integrated_CM_uint8 0 0 0 255 ECU_ADDRESS 0xb0002726 /* @ECU_Address@VfAEBS_FedBck_RightLampState@ */ /end MEASUREMENT
/begin MEASUREMENT VfAEBS_FCW_enabled "" UBYTE AEBS_subsystem_integrated_CM_boolean 0 0 0 1 ECU_ADDRESS 0xb0002725 /* @ECU_Address@VfAEBS_FCW_enabled@ */ /end MEASUREMENT
/begin MEASUREMENT VfAEBS_FCWLev1_active "" UBYTE AEBS_subsystem_integrated_CM_boolean 0 0 0 1 ECU_ADDRESS 0xb0002724 /* @ECU_Address@VfAEBS_FCWLev1_active@ */ /end MEASUREMENT
/begin MEASUREMENT VfAEBS_FCWLev1_dactive "" UBYTE AEBS_subsystem_integrated_CM_boolean 0 0 0 1 ECU_ADDRESS 0xb0002723 /* @ECU_Address@VfAEBS_FCWLev1_dactive@ */ /end MEASUREMENT
/begin MEASUREMENT VfAEBS_FCWLev2_active "" UBYTE AEBS_subsystem_integrated_CM_boolean 0 0 0 1 ECU_ADDRESS 0xb0002722 /* @ECU_Address@VfAEBS_FCWLev2_active@ */ /end MEASUREMENT
/begin MEASUREMENT VfAEBS_FCWLev2_dactive "" UBYTE AEBS_subsystem_integrated_CM_boolean 0 0 0 1 ECU_ADDRESS 0xb0002721 /* @ECU_Address@VfAEBS_FCWLev2_dactive@ */ /end MEASUREMENT
/begin MEASUREMENT VfAEBS_FCWLev3_active "" UBYTE AEBS_subsystem_integrated_CM_boolean 0 0 0 1 ECU_ADDRESS 0xb0002720 /* @ECU_Address@VfAEBS_FCWLev3_active@ */ /end MEASUREMENT
/begin MEASUREMENT VfAEBS_FCWLev3_dactive "" UBYTE AEBS_subsystem_integrated_CM_boolean 0 0 0 1 ECU_ADDRESS 0xb000271f /* @ECU_Address@VfAEBS_FCWLev3_dactive@ */ /end MEASUREMENT
/begin MEASUREMENT VfAEBS_FCW_disabled "" UBYTE AEBS_subsystem_integrated_CM_boolean 0 0 0 1 ECU_ADDRESS 0xb000271e /* @ECU_Address@VfAEBS_FCW_disabled@ */ /end MEASUREMENT
/begin MEASUREMENT VfAEBS_FCW_deacitve "" UBYTE AEBS_subsystem_integrated_CM_boolean 0 0 0 1 ECU_ADDRESS 0xb000271d /* @ECU_Address@VfAEBS_FCW_deacitve@ */ /end MEASUREMENT
/begin MEASUREMENT VbAEBS_has_obs_vip "" UBYTE AEBS_subsystem_integrated_CM_boolean 0 0 0 1 ECU_ADDRESS 0xb000271c /* @ECU_Address@VbAEBS_has_obs_vip@ */ /end MEASUREMENT
/begin MEASUREMENT VfAEBS_Obj_IsVRU "" UBYTE AEBS_subsystem_integrated_CM_boolean 0 0 0 1 ECU_ADDRESS 0xb000271b /* @ECU_Address@VfAEBS_Obj_IsVRU@ */ /end MEASUREMENT
/begin MEASUREMENT VfAEBS_use_VRU_TTC_threshold "" UBYTE AEBS_subsystem_integrated_CM_boolean 0 0 0 1 ECU_ADDRESS 0xb000271a /* @ECU_Address@VfAEBS_use_VRU_TTC_threshold@ */ /end MEASUREMENT
/begin MEASUREMENT VfAEBS_LowSpeed_InhibitAEB "" UBYTE AEBS_subsystem_integrated_CM_boolean 0 0 0 1 ECU_ADDRESS 0xb0002719 /* @ECU_Address@VfAEBS_LowSpeed_InhibitAEB@ */ /end MEASUREMENT
/begin MEASUREMENT VfAEBS_HighSpeed_InhibitAEB "" UBYTE AEBS_subsystem_integrated_CM_boolean 0 0 0 1 ECU_ADDRESS 0xb0002718 /* @ECU_Address@VfAEBS_HighSpeed_InhibitAEB@ */ /end MEASUREMENT
/begin MEASUREMENT VfAEBS_VehDeltaSpeed_InhibitAEB "" UBYTE AEBS_subsystem_integrated_CM_boolean 0 0 0 1 ECU_ADDRESS 0xb0002717 /* @ECU_Address@VfAEBS_VehDeltaSpeed_InhibitAEB@ */ /end MEASUREMENT
/begin MEASUREMENT VfAEBS_Speed_InhibitAEB "" UBYTE AEBS_subsystem_integrated_CM_boolean 0 0 0 1 ECU_ADDRESS 0xb0002716 /* @ECU_Address@VfAEBS_Speed_InhibitAEB@ */ /end MEASUREMENT
/begin MEASUREMENT VfAEBS_Gear_InhibitAEB "" UBYTE AEBS_subsystem_integrated_CM_boolean 0 0 0 1 ECU_ADDRESS 0xb0002715 /* @ECU_Address@VfAEBS_Gear_InhibitAEB@ */ /end MEASUREMENT
/begin MEASUREMENT VfAEBS_AEB_inhibit "" UBYTE AEBS_subsystem_integrated_CM_boolean 0 0 0 1 ECU_ADDRESS 0xb0002714 /* @ECU_Address@VfAEBS_AEB_inhibit@ */ /end MEASUREMENT
/begin MEASUREMENT VfAEBS_preBrake_active "" UBYTE AEBS_subsystem_integrated_CM_boolean 0 0 0 1 ECU_ADDRESS 0xb0002713 /* @ECU_Address@VfAEBS_preBrake_active@ */ /end MEASUREMENT
/begin MEASUREMENT VfAEBS_partialBrk_active "" UBYTE AEBS_subsystem_integrated_CM_boolean 0 0 0 1 ECU_ADDRESS 0xb0002712 /* @ECU_Address@VfAEBS_partialBrk_active@ */ /end MEASUREMENT
/begin MEASUREMENT VfAEBS_fullBrk_active "" UBYTE AEBS_subsystem_integrated_CM_boolean 0 0 0 1 ECU_ADDRESS 0xb0002711 /* @ECU_Address@VfAEBS_fullBrk_active@ */ /end MEASUREMENT
/begin MEASUREMENT VbAEBS_Deactive_R_NoVIP "" UBYTE AEBS_subsystem_integrated_CM_boolean 0 0 0 1 ECU_ADDRESS 0xb0002710 /* @ECU_Address@VbAEBS_Deactive_R_NoVIP@ */ /end MEASUREMENT
/begin MEASUREMENT VbAEBS_Deactive_R_VIPChanged "" UBYTE AEBS_subsystem_integrated_CM_boolean 0 0 0 1 ECU_ADDRESS 0xb000270f /* @ECU_Address@VbAEBS_Deactive_R_VIPChanged@ */ /end MEASUREMENT
/begin MEASUREMENT VfAEBS_DeniedDueToSpdRed "" UBYTE AEBS_subsystem_integrated_CM_boolean 0 0 0 1 ECU_ADDRESS 0xb000270e /* @ECU_Address@VfAEBS_DeniedDueToSpdRed@ */ /end MEASUREMENT
/begin MEASUREMENT VfAEBS_DeniedDueToTimeBrake "" UBYTE AEBS_subsystem_integrated_CM_boolean 0 0 0 1 ECU_ADDRESS 0xb000270d /* @ECU_Address@VfAEBS_DeniedDueToTimeBrake@ */ /end MEASUREMENT
/begin MEASUREMENT VfAEBS_AEB_enabled "" UBYTE AEBS_subsystem_integrated_CM_boolean 0 0 0 1 ECU_ADDRESS 0xb000270c /* @ECU_Address@VfAEBS_AEB_enabled@ */ /end MEASUREMENT
/begin MEASUREMENT VfAEBS_preBrake_dactive "" UBYTE AEBS_subsystem_integrated_CM_boolean 0 0 0 1 ECU_ADDRESS 0xb000270b /* @ECU_Address@VfAEBS_preBrake_dactive@ */ /end MEASUREMENT
/begin MEASUREMENT VfAEBS_partialBrk_dactive "" UBYTE AEBS_subsystem_integrated_CM_boolean 0 0 0 1 ECU_ADDRESS 0xb000270a /* @ECU_Address@VfAEBS_partialBrk_dactive@ */ /end MEASUREMENT
/begin MEASUREMENT VfAEBS_fullBrk_dactive "" UBYTE AEBS_subsystem_integrated_CM_boolean 0 0 0 1 ECU_ADDRESS 0xb0002709 /* @ECU_Address@VfAEBS_fullBrk_dactive@ */ /end MEASUREMENT
/begin MEASUREMENT VfAEBS_AEB_disabled "" UBYTE AEBS_subsystem_integrated_CM_boolean 0 0 0 1 ECU_ADDRESS 0xb0002708 /* @ECU_Address@VfAEBS_AEB_disabled@ */ /end MEASUREMENT
/begin MEASUREMENT VfAEBS_veh_standstill "" UBYTE AEBS_subsystem_integrated_CM_boolean 0 0 0 1 ECU_ADDRESS 0xb0002707 /* @ECU_Address@VfAEBS_veh_standstill@ */ /end MEASUREMENT
/begin MEASUREMENT VfAEBS_Vehicle_isInHighSpeed "" UBYTE AEBS_subsystem_integrated_CM_boolean 0 0 0 1 ECU_ADDRESS 0xb0002706 /* @ECU_Address@VfAEBS_Vehicle_isInHighSpeed@ */ /end MEASUREMENT
/begin MEASUREMENT VbAEBS_Deactive_R_HighTTC "" UBYTE AEBS_subsystem_integrated_CM_boolean 0 0 0 1 ECU_ADDRESS 0xb0002705 /* @ECU_Address@VbAEBS_Deactive_R_HighTTC@ */ /end MEASUREMENT
/begin MEASUREMENT VfAEBS_AEB_deactive "" UBYTE AEBS_subsystem_integrated_CM_boolean 0 0 0 1 ECU_ADDRESS 0xb0002704 /* @ECU_Address@VfAEBS_AEB_deactive@ */ /end MEASUREMENT
/begin MEASUREMENT VfAEBS_AEB_request_beforeSend "" UBYTE AEBS_subsystem_integrated_CM_boolean 0 0 0 1 ECU_ADDRESS 0xb0002703 /* @ECU_Address@VfAEBS_AEB_request_beforeSend@ */ /end MEASUREMENT
/begin MEASUREMENT VfAEBS_FCW_active_state "" UBYTE AEBS_subsystem_integrated_CM_EnumAEBS_FCWState 0 0 0 5 ECU_ADDRESS 0xb00026fa /* @ECU_Address@VfAEBS_FCW_active_state@ */ /end MEASUREMENT
/begin MEASUREMENT VeAEBS_TurnType "" UBYTE AEBS_subsystem_integrated_CM_EnumAEBS_TurnType 0 0 1 4 ECU_ADDRESS 0xb00026f8 /* @ECU_Address@VeAEBS_TurnType@ */ /end MEASUREMENT
/begin MEASUREMENT VfARBT_steer_req_strwhl_angle "final steer angle req (as deg) after arbitration and saturation" FLOAT32_IEEE ARBT_subsystem_integrated_CM_single_deg 0 0 -3.4E+38 3.4E+38 ECU_ADDRESS 0xb0002df0 /* @ECU_Address@VfARBT_steer_req_strwhl_angle@ */ /end MEASUREMENT
/begin MEASUREMENT VfARBT_steer_req_strwhl_angle_raw "raw steer angle request after arbitration before saturation" FLOAT32_IEEE ARBT_subsystem_integrated_CM_single_deg 0 0 -3.4E+38 3.4E+38 ECU_ADDRESS 0xb0002dec /* @ECU_Address@VfARBT_steer_req_strwhl_angle_raw@ */ /end MEASUREMENT
/begin MEASUREMENT VfARBT_steer_req_strwhl_torque "" FLOAT32_IEEE ARBT_subsystem_integrated_CM_single_Nm 0 0 -3.4E+38 3.4E+38 ECU_ADDRESS 0xb0002de8 /* @ECU_Address@VfARBT_steer_req_strwhl_torque@ */ /end MEASUREMENT
/begin MEASUREMENT VfARBT_power_req_lon_a_raw "raw power request after arbitration before saturation" FLOAT32_IEEE ARBT_subsystem_integrated_CM_single_m_s2 0 0 -3.4E+38 3.4E+38 ECU_ADDRESS 0xb0002de4 /* @ECU_Address@VfARBT_power_req_lon_a_raw@ */ /end MEASUREMENT
/begin MEASUREMENT VfARBT_power_req_lon_a "final power req (as m/s2) after arbitration and saturation" FLOAT32_IEEE ARBT_subsystem_integrated_CM_single_m_s2 0 0 -3.4E+38 3.4E+38 ECU_ADDRESS 0xb0002de0 /* @ECU_Address@VfARBT_power_req_lon_a@ */ /end MEASUREMENT
/begin MEASUREMENT VfARBT_power_req_torque "" FLOAT32_IEEE ARBT_subsystem_integrated_CM_single 0 0 -3.4E+38 3.4E+38 ECU_ADDRESS 0xb0002ddc /* @ECU_Address@VfARBT_power_req_torque@ */ /end MEASUREMENT
/begin MEASUREMENT VfARBT_brake_req_lon_a_raw "raw brake request after arbitration before saturation" FLOAT32_IEEE ARBT_subsystem_integrated_CM_single_m_s2 0 0 -3.4E+38 3.4E+38 ECU_ADDRESS 0xb0002dd8 /* @ECU_Address@VfARBT_brake_req_lon_a_raw@ */ /end MEASUREMENT
/begin MEASUREMENT VfARBT_brake_req_lon_a "final brake req (as m/s2) after arbitration and saturation" FLOAT32_IEEE ARBT_subsystem_integrated_CM_single_m_s2 0 0 -3.4E+38 3.4E+38 ECU_ADDRESS 0xb0002dd4 /* @ECU_Address@VfARBT_brake_req_lon_a@ */ /end MEASUREMENT
/begin MEASUREMENT VfARBT_steer_req_mode "0 = acceleration mode
      1 = torque mode" UBYTE ARBT_subsystem_integrated_CM_uint8 0 0 0 255 ECU_ADDRESS 0xb0002dd3 /* @ECU_Address@VfARBT_steer_req_mode@ */ /end MEASUREMENT
/begin MEASUREMENT VfARBT_power_req_mode "0 = steering wheel angle
      1 = steering wheel torque" UBYTE ARBT_subsystem_integrated_CM_uint8 0 0 0 255 ECU_ADDRESS 0xb0002dd2 /* @ECU_Address@VfARBT_power_req_mode@ */ /end MEASUREMENT
/begin MEASUREMENT VfARBT_gear_pos_req "Gear Pos Definition
      0->N
      1->D
      13->R
      14->P
      15->Invalid" UBYTE ARBT_subsystem_integrated_CM_uint8 0 0 0 255 ECU_ADDRESS 0xb0002dd1 /* @ECU_Address@VfARBT_gear_pos_req@ */ /end MEASUREMENT
/begin MEASUREMENT VfARBT_gear_ctrl_state "" UBYTE ARBT_subsystem_integrated_CM_uint8 0 0 0 255 ECU_ADDRESS 0xb0002dd0 /* @ECU_Address@VfARBT_gear_ctrl_state@ */ /end MEASUREMENT
/begin MEASUREMENT VbARBT_EPB_ctrl_mode "" UBYTE ARBT_subsystem_integrated_CM_uint8 0 0 0 255 ECU_ADDRESS 0xb0002dcf /* @ECU_Address@VbARBT_EPB_ctrl_mode@ */ /end MEASUREMENT
/begin MEASUREMENT VbARBT_FCW_level_one "" UBYTE ARBT_subsystem_integrated_CM_boolean 0 0 0 1 ECU_ADDRESS 0xb0002dce /* @ECU_Address@VbARBT_FCW_level_one@ */ /end MEASUREMENT
/begin MEASUREMENT VbARBT_FCW_level_two "" UBYTE ARBT_subsystem_integrated_CM_boolean 0 0 0 1 ECU_ADDRESS 0xb0002dcd /* @ECU_Address@VbARBT_FCW_level_two@ */ /end MEASUREMENT
/begin MEASUREMENT VbARBT_LDW_left "" UBYTE ARBT_subsystem_integrated_CM_boolean 0 0 0 1 ECU_ADDRESS 0xb0002dcc /* @ECU_Address@VbARBT_LDW_left@ */ /end MEASUREMENT
/begin MEASUREMENT VbARBT_LDW_right "" UBYTE ARBT_subsystem_integrated_CM_boolean 0 0 0 1 ECU_ADDRESS 0xb0002dcb /* @ECU_Address@VbARBT_LDW_right@ */ /end MEASUREMENT
/begin MEASUREMENT VbARBT_LCW_left_level_one "" UBYTE ARBT_subsystem_integrated_CM_boolean 0 0 0 1 ECU_ADDRESS 0xb0002dca /* @ECU_Address@VbARBT_LCW_left_level_one@ */ /end MEASUREMENT
/begin MEASUREMENT VbARBT_LCW_left_level_two "" UBYTE ARBT_subsystem_integrated_CM_boolean 0 0 0 1 ECU_ADDRESS 0xb0002dc9 /* @ECU_Address@VbARBT_LCW_left_level_two@ */ /end MEASUREMENT
/begin MEASUREMENT VbARBT_LCW_right_level_one "" UBYTE ARBT_subsystem_integrated_CM_boolean 0 0 0 1 ECU_ADDRESS 0xb0002dc8 /* @ECU_Address@VbARBT_LCW_right_level_one@ */ /end MEASUREMENT
/begin MEASUREMENT VbARBT_LCW_right_level_two "" UBYTE ARBT_subsystem_integrated_CM_boolean 0 0 0 1 ECU_ADDRESS 0xb0002dc7 /* @ECU_Address@VbARBT_LCW_right_level_two@ */ /end MEASUREMENT
/begin MEASUREMENT VbARBT_steer_ctrl_enbl_to_comm "" UBYTE ARBT_subsystem_integrated_CM_boolean 0 0 0 1 ECU_ADDRESS 0xb0002dc6 /* @ECU_Address@VbARBT_steer_ctrl_enbl_to_comm@ */ /end MEASUREMENT
/begin MEASUREMENT VbARBT_aeb_triggered_flag "Flag of whether AEB is triggered" UBYTE ARBT_subsystem_integrated_CM_boolean 0 0 0 1 ECU_ADDRESS 0xb0002dc5 /* @ECU_Address@VbARBT_aeb_triggered_flag@ */ /end MEASUREMENT
/begin MEASUREMENT VbARBT_missed_aeb_flag "Flag of whether a missed aeb event is detected" UBYTE ARBT_subsystem_integrated_CM_boolean 0 0 0 1 ECU_ADDRESS 0xb0002dc4 /* @ECU_Address@VbARBT_missed_aeb_flag@ */ /end MEASUREMENT
/begin MEASUREMENT VbARBT_false_aeb_flag "Flag of whether a false AEB event is detected
      " UBYTE ARBT_subsystem_integrated_CM_boolean 0 0 0 1 ECU_ADDRESS 0xb0002dc3 /* @ECU_Address@VbARBT_false_aeb_flag@ */ /end MEASUREMENT
/begin MEASUREMENT VbARBT_driver_hard_brake_flag "Flag of whether driver is taking a hard brake" UBYTE ARBT_subsystem_integrated_CM_boolean 0 0 0 1 ECU_ADDRESS 0xb0002dc2 /* @ECU_Address@VbARBT_driver_hard_brake_flag@ */ /end MEASUREMENT
/begin MEASUREMENT VbARBT_power_ctrl_enbl_to_comm "" UBYTE ARBT_subsystem_integrated_CM_boolean 0 0 0 1 ECU_ADDRESS 0xb0002dc1 /* @ECU_Address@VbARBT_power_ctrl_enbl_to_comm@ */ /end MEASUREMENT
/begin MEASUREMENT VbARBT_brake_ctrl_enbl_to_comm "" UBYTE ARBT_subsystem_integrated_CM_boolean 0 0 0 1 ECU_ADDRESS 0xb0002dc0 /* @ECU_Address@VbARBT_brake_ctrl_enbl_to_comm@ */ /end MEASUREMENT
/begin MEASUREMENT VbARBT_EPB_ctrl_enbl_to_comm "" UBYTE ARBT_subsystem_integrated_CM_boolean 0 0 0 1 ECU_ADDRESS 0xb0002dbf /* @ECU_Address@VbARBT_EPB_ctrl_enbl_to_comm@ */ /end MEASUREMENT
/begin MEASUREMENT VbARBT_vehicle_standstill "" UBYTE ARBT_subsystem_integrated_CM_boolean 0 0 0 1 ECU_ADDRESS 0xb0002dbe /* @ECU_Address@VbARBT_vehicle_standstill@ */ /end MEASUREMENT
/begin MEASUREMENT VbARBT_EPB_switch_request "1 = clamping request
      0 = release request" UBYTE ARBT_subsystem_integrated_CM_boolean 0 0 0 1 ECU_ADDRESS 0xb0002dbd /* @ECU_Address@VbARBT_EPB_switch_request@ */ /end MEASUREMENT
/begin MEASUREMENT VbARBT_gear_ctrl_enbl_to_comm "" UBYTE ARBT_subsystem_integrated_CM_boolean 0 0 0 1 ECU_ADDRESS 0xb0002dbc /* @ECU_Address@VbARBT_gear_ctrl_enbl_to_comm@ */ /end MEASUREMENT
/begin MEASUREMENT VbARBT_auto_hold_req "" UBYTE ARBT_subsystem_integrated_CM_boolean 0 0 0 1 ECU_ADDRESS 0xb0002dbb /* @ECU_Address@VbARBT_auto_hold_req@ */ /end MEASUREMENT
/begin MEASUREMENT VeARBT_steer_arbt_winner "" UBYTE ARBT_subsystem_integrated_CM_EnumARBT_arbitration_winner 0 0 0 6 ECU_ADDRESS 0xb0002dba /* @ECU_Address@VeARBT_steer_arbt_winner@ */ /end MEASUREMENT
/begin MEASUREMENT VeARBT_power_arbt_winner "" UBYTE ARBT_subsystem_integrated_CM_EnumARBT_arbitration_winner 0 0 0 6 ECU_ADDRESS 0xb0002db9 /* @ECU_Address@VeARBT_power_arbt_winner@ */ /end MEASUREMENT
/begin MEASUREMENT VeARBT_brake_arbt_winner "" UBYTE ARBT_subsystem_integrated_CM_EnumARBT_arbitration_winner 0 0 0 6 ECU_ADDRESS 0xb0002db8 /* @ECU_Address@VeARBT_brake_arbt_winner@ */ /end MEASUREMENT
/begin MEASUREMENT VbHWIO_DriverModeComd "" UBYTE COMM_subsystem_integrated_CM_boolean 0 0 0 1 ECU_ADDRESS 0xb0003886 /* @ECU_Address@VbHWIO_DriverModeComd@ */ /end MEASUREMENT
/begin MEASUREMENT VbHWIO_LeftTurningLightState "" UBYTE COMM_subsystem_integrated_CM_boolean 0 0 0 1 ECU_ADDRESS 0xb0003885 /* @ECU_Address@VbHWIO_LeftTurningLightState@ */ /end MEASUREMENT
/begin MEASUREMENT VbHWIO_RightTurningLightState "" UBYTE COMM_subsystem_integrated_CM_boolean 0 0 0 1 ECU_ADDRESS 0xb0003884 /* @ECU_Address@VbHWIO_RightTurningLightState@ */ /end MEASUREMENT
/begin MEASUREMENT VfCOMM_Decs_Breake_Value "" FLOAT32_IEEE COMM_subsystem_integrated_CM_single 0 0 -3.4E+38 3.4E+38 ECU_ADDRESS 0xb00035c4 /* @ECU_Address@VfCOMM_Decs_Breake_Value@ */ /end MEASUREMENT
/begin MEASUREMENT VfCOMM_Decs_Acc_Value "" FLOAT32_IEEE COMM_subsystem_integrated_CM_single 0 0 -3.4E+38 3.4E+38 ECU_ADDRESS 0xb00035c0 /* @ECU_Address@VfCOMM_Decs_Acc_Value@ */ /end MEASUREMENT
/begin MEASUREMENT VfCOMM_Decs_SteeringAngle "" FLOAT32_IEEE COMM_subsystem_integrated_CM_single 0 0 -3.4E+38 3.4E+38 ECU_ADDRESS 0xb00035bc /* @ECU_Address@VfCOMM_Decs_SteeringAngle@ */ /end MEASUREMENT
/begin MEASUREMENT VcCOMM_EPB_control_enable "EPB control enable flag." FLOAT32_IEEE COMM_subsystem_integrated_CM_single 0 0 -3.4E+38 3.4E+38 ECU_ADDRESS 0xb00035b8 /* @ECU_Address@VcCOMM_EPB_control_enable@ */ /end MEASUREMENT
/begin MEASUREMENT VcCOMM_EPB_switch_request "EPB Switch request. 0 = Release, 1 = Clamp." FLOAT32_IEEE COMM_subsystem_integrated_CM_single 0 0 -3.4E+38 3.4E+38 ECU_ADDRESS 0xb00035b4 /* @ECU_Address@VcCOMM_EPB_switch_request@ */ /end MEASUREMENT
/begin MEASUREMENT VfCOMM_req_pct_torque_raw "Power requested torque in percentage." FLOAT32_IEEE COMM_subsystem_integrated_CM_single 0 0 -3.4E+38 3.4E+38 ECU_ADDRESS 0xb00035b0 /* @ECU_Address@VfCOMM_req_pct_torque_raw@ */ /end MEASUREMENT
/begin MEASUREMENT VcCOMM_max_gas_pedal_EPB "" FLOAT32_IEEE COMM_subsystem_integrated_CM_single 0 0 -3.4E+38 3.4E+38 ECU_ADDRESS 0xb00035ac /* @ECU_Address@VcCOMM_max_gas_pedal_EPB@ */ /end MEASUREMENT
/begin MEASUREMENT VfCOMM_EPS_SteeringTorqueAct "" FLOAT32_IEEE COMM_subsystem_integrated_CM_single 0 0 -3.4E+38 3.4E+38 ECU_ADDRESS 0xb00035a8 /* @ECU_Address@VfCOMM_EPS_SteeringTorqueAct@ */ /end MEASUREMENT
/begin MEASUREMENT VfCOMM_VCU_LongitudinalAcc "" FLOAT32_IEEE COMM_subsystem_integrated_CM_single 0 0 -3.4E+38 3.4E+38 ECU_ADDRESS 0xb00035a4 /* @ECU_Address@VfCOMM_VCU_LongitudinalAcc@ */ /end MEASUREMENT
/begin MEASUREMENT VfCOMM_VCU_BrkPedPos "Brake pedal position." FLOAT32_IEEE COMM_subsystem_integrated_CM_single 0 0 -3.4E+38 3.4E+38 ECU_ADDRESS 0xb00035a0 /* @ECU_Address@VfCOMM_VCU_BrkPedPos@ */ /end MEASUREMENT
/begin MEASUREMENT VfCOMM_VCU_YawRate "Yaw Rate." FLOAT32_IEEE COMM_subsystem_integrated_CM_single 0 0 -3.4E+38 3.4E+38 ECU_ADDRESS 0xb000359c /* @ECU_Address@VfCOMM_VCU_YawRate@ */ /end MEASUREMENT
/begin MEASUREMENT VfCOMM_VCU_LateralAcc "Lateral acceleration (m/s~2)." FLOAT32_IEEE COMM_subsystem_integrated_CM_single 0 0 -3.4E+38 3.4E+38 ECU_ADDRESS 0xb0003598 /* @ECU_Address@VfCOMM_VCU_LateralAcc@ */ /end MEASUREMENT
/begin MEASUREMENT VfCOMM_VCU_ESCWhlRRSpd "Rear right wheel speed (kph)." FLOAT32_IEEE COMM_subsystem_integrated_CM_single 0 0 -3.4E+38 3.4E+38 ECU_ADDRESS 0xb0003594 /* @ECU_Address@VfCOMM_VCU_ESCWhlRRSpd@ */ /end MEASUREMENT
/begin MEASUREMENT VfCOMM_VCU_ESCWhlRLSpd "Rear left wheel speed (kph)." FLOAT32_IEEE COMM_subsystem_integrated_CM_single 0 0 -3.4E+38 3.4E+38 ECU_ADDRESS 0xb0003590 /* @ECU_Address@VfCOMM_VCU_ESCWhlRLSpd@ */ /end MEASUREMENT
/begin MEASUREMENT VfCOMM_VCU_ESCWhlFRSpd "Front right wheel speed (kph)." FLOAT32_IEEE COMM_subsystem_integrated_CM_single 0 0 -3.4E+38 3.4E+38 ECU_ADDRESS 0xb000358c /* @ECU_Address@VfCOMM_VCU_ESCWhlFRSpd@ */ /end MEASUREMENT
/begin MEASUREMENT VfCOMM_VCU_ESCWhlFLSpd "Front left wheel speed (kph)." FLOAT32_IEEE COMM_subsystem_integrated_CM_single 0 0 -3.4E+38 3.4E+38 ECU_ADDRESS 0xb0003588 /* @ECU_Address@VfCOMM_VCU_ESCWhlFLSpd@ */ /end MEASUREMENT
/begin MEASUREMENT VfCOMM_Actual_Gear_Ratio "" FLOAT32_IEEE COMM_subsystem_integrated_CM_single 0 0 -3.4E+38 3.4E+38 ECU_ADDRESS 0xb0003584 /* @ECU_Address@VfCOMM_Actual_Gear_Ratio@ */ /end MEASUREMENT
/begin MEASUREMENT VfCOMM_Decs_FedBck_StrAngle "" FLOAT32_IEEE COMM_subsystem_integrated_CM_single 0 0 -3.4E+38 3.4E+38 ECU_ADDRESS 0xb0003580 /* @ECU_Address@VfCOMM_Decs_FedBck_StrAngle@ */ /end MEASUREMENT
/begin MEASUREMENT VfCOMM_Decs_FedBck_VehSpd "" FLOAT32_IEEE COMM_subsystem_integrated_CM_single 0 0 -3.4E+38 3.4E+38 ECU_ADDRESS 0xb000357c /* @ECU_Address@VfCOMM_Decs_FedBck_VehSpd@ */ /end MEASUREMENT
/begin MEASUREMENT VfCOMM_AccPedl "" FLOAT32_IEEE COMM_subsystem_integrated_CM_single 0 0 -3.4E+38 3.4E+38 ECU_ADDRESS 0xb0003578 /* @ECU_Address@VfCOMM_AccPedl@ */ /end MEASUREMENT
/begin MEASUREMENT VfCOMM_req_pct_torque_final "" SWORD COMM_subsystem_integrated_CM_int16 0 0 -32768 32767 ECU_ADDRESS 0xb0003576 /* @ECU_Address@VfCOMM_req_pct_torque_final@ */ /end MEASUREMENT
/begin MEASUREMENT VcCOMM_Auto_To_Manual_Tips "" UWORD COMM_subsystem_integrated_CM_uint16 0 0 0 65535 ECU_ADDRESS 0xb0003574 /* @ECU_Address@VcCOMM_Auto_To_Manual_Tips@ */ /end MEASUREMENT
/begin MEASUREMENT VcCOMM_Decs_Control_mod "" UBYTE COMM_subsystem_integrated_CM_uint8 0 0 0 255 ECU_ADDRESS 0xb0003572 /* @ECU_Address@VcCOMM_Decs_Control_mod@ */ /end MEASUREMENT
/begin MEASUREMENT VcCOMM_Decs_Gear_Value "" UBYTE COMM_subsystem_integrated_CM_uint8 0 0 0 255 ECU_ADDRESS 0xb0003571 /* @ECU_Address@VcCOMM_Decs_Gear_Value@ */ /end MEASUREMENT
/begin MEASUREMENT VcCOMM_Decs_Gear_Req "" UBYTE COMM_subsystem_integrated_CM_uint8 0 0 0 255 ECU_ADDRESS 0xb0003570 /* @ECU_Address@VcCOMM_Decs_Gear_Req@ */ /end MEASUREMENT
/begin MEASUREMENT VcCOMM_Decs_Breake_Req "" UBYTE COMM_subsystem_integrated_CM_uint8 0 0 0 255 ECU_ADDRESS 0xb000356f /* @ECU_Address@VcCOMM_Decs_Breake_Req@ */ /end MEASUREMENT
/begin MEASUREMENT VcCOMM_Decs_Acc_Req "" UBYTE COMM_subsystem_integrated_CM_uint8 0 0 0 255 ECU_ADDRESS 0xb000356e /* @ECU_Address@VcCOMM_Decs_Acc_Req@ */ /end MEASUREMENT
/begin MEASUREMENT VcCOMM_Decs_Steering_Req "" UBYTE COMM_subsystem_integrated_CM_uint8 0 0 0 255 ECU_ADDRESS 0xb000356d /* @ECU_Address@VcCOMM_Decs_Steering_Req@ */ /end MEASUREMENT
/begin MEASUREMENT VcCOMM_Decs_FedBck_EPBstate "" UBYTE COMM_subsystem_integrated_CM_uint8 0 0 0 255 ECU_ADDRESS 0xb000356c /* @ECU_Address@VcCOMM_Decs_FedBck_EPBstate@ */ /end MEASUREMENT
/begin MEASUREMENT VcCOMM_DriverModeComd "" UBYTE COMM_subsystem_integrated_CM_uint8 0 0 0 255 ECU_ADDRESS 0xb000356b /* @ECU_Address@VcCOMM_DriverModeComd@ */ /end MEASUREMENT
/begin MEASUREMENT VcCOMM_Decs_FedBck_KeyState "Ignition Key State." UBYTE COMM_subsystem_integrated_CM_uint8 0 0 0 255 ECU_ADDRESS 0xb000356a /* @ECU_Address@VcCOMM_Decs_FedBck_KeyState@ */ /end MEASUREMENT
/begin MEASUREMENT VcCOMM_VCU_DirIndicationLH "Left turning lamp status." UBYTE COMM_subsystem_integrated_CM_uint8 0 0 0 255 ECU_ADDRESS 0xb0003569 /* @ECU_Address@VcCOMM_VCU_DirIndicationLH@ */ /end MEASUREMENT
/begin MEASUREMENT VcCOMM_VCU_DirIndicationRH "Right turning lamp status." UBYTE COMM_subsystem_integrated_CM_uint8 0 0 0 255 ECU_ADDRESS 0xb0003568 /* @ECU_Address@VcCOMM_VCU_DirIndicationRH@ */ /end MEASUREMENT
/begin MEASUREMENT VcCOMM_Decs_FedBck_BrkPedSts "" UBYTE COMM_subsystem_integrated_CM_uint8 0 0 0 255 ECU_ADDRESS 0xb0003567 /* @ECU_Address@VcCOMM_Decs_FedBck_BrkPedSts@ */ /end MEASUREMENT
/begin MEASUREMENT VcCOMM_VCU_HeadLampLowBeam "" UBYTE COMM_subsystem_integrated_CM_uint8 0 0 0 255 ECU_ADDRESS 0xb0003566 /* @ECU_Address@VcCOMM_VCU_HeadLampLowBeam@ */ /end MEASUREMENT
/begin MEASUREMENT VcCOMM_VCU_HeadLampHighBeam "" UBYTE COMM_subsystem_integrated_CM_uint8 0 0 0 255 ECU_ADDRESS 0xb0003565 /* @ECU_Address@VcCOMM_VCU_HeadLampHighBeam@ */ /end MEASUREMENT
/begin MEASUREMENT VcCOMM_Decs_FedBck_EPSmod "" UBYTE COMM_subsystem_integrated_CM_uint8 0 0 0 255 ECU_ADDRESS 0xb0003564 /* @ECU_Address@VcCOMM_Decs_FedBck_EPSmod@ */ /end MEASUREMENT
/begin MEASUREMENT VcCOMM_Decs_FedBck_ESCmod "" UBYTE COMM_subsystem_integrated_CM_uint8 0 0 0 255 ECU_ADDRESS 0xb0003563 /* @ECU_Address@VcCOMM_Decs_FedBck_ESCmod@ */ /end MEASUREMENT
/begin MEASUREMENT VcCOMM_Decs_FedBck_Drivemod "" UBYTE COMM_subsystem_integrated_CM_uint8 0 0 0 255 ECU_ADDRESS 0xb0003562 /* @ECU_Address@VcCOMM_Decs_FedBck_Drivemod@ */ /end MEASUREMENT
/begin MEASUREMENT VcCOMM_Decs_FedBck_GearValue "" UBYTE COMM_subsystem_integrated_CM_uint8 0 0 0 255 ECU_ADDRESS 0xb0003561 /* @ECU_Address@VcCOMM_Decs_FedBck_GearValue@ */ /end MEASUREMENT
/begin MEASUREMENT VbCOMM_Decs_WarnLight_Req "" UBYTE COMM_subsystem_integrated_CM_boolean 0 0 0 1 ECU_ADDRESS 0xb0003560 /* @ECU_Address@VbCOMM_Decs_WarnLight_Req@ */ /end MEASUREMENT
/begin MEASUREMENT VbCOMM_Decs_RihtLmp_Req "" UBYTE COMM_subsystem_integrated_CM_boolean 0 0 0 1 ECU_ADDRESS 0xb000355f /* @ECU_Address@VbCOMM_Decs_RihtLmp_Req@ */ /end MEASUREMENT
/begin MEASUREMENT VbCOMM_Decs_Light_Req "" UBYTE COMM_subsystem_integrated_CM_boolean 0 0 0 1 ECU_ADDRESS 0xb000355e /* @ECU_Address@VbCOMM_Decs_Light_Req@ */ /end MEASUREMENT
/begin MEASUREMENT VbCOMM_Decs_LftLmp_Req "" UBYTE COMM_subsystem_integrated_CM_boolean 0 0 0 1 ECU_ADDRESS 0xb000355d /* @ECU_Address@VbCOMM_Decs_LftLmp_Req@ */ /end MEASUREMENT
/begin MEASUREMENT VbCOMM_Decs_Horn_Req "" UBYTE COMM_subsystem_integrated_CM_boolean 0 0 0 1 ECU_ADDRESS 0xb000355c /* @ECU_Address@VbCOMM_Decs_Horn_Req@ */ /end MEASUREMENT
/begin MEASUREMENT VbCOMM_Decs_HighBeam_Req "" UBYTE COMM_subsystem_integrated_CM_boolean 0 0 0 1 ECU_ADDRESS 0xb000355b /* @ECU_Address@VbCOMM_Decs_HighBeam_Req@ */ /end MEASUREMENT
/begin MEASUREMENT VbCOMM_Decs_FrontFogLamp_Req "" UBYTE COMM_subsystem_integrated_CM_boolean 0 0 0 1 ECU_ADDRESS 0xb000355a /* @ECU_Address@VbCOMM_Decs_FrontFogLamp_Req@ */ /end MEASUREMENT
/begin MEASUREMENT VbCOMM_Decs_DippedBeam_Req "" UBYTE COMM_subsystem_integrated_CM_boolean 0 0 0 1 ECU_ADDRESS 0xb0003559 /* @ECU_Address@VbCOMM_Decs_DippedBeam_Req@ */ /end MEASUREMENT
/begin MEASUREMENT VbCOMM_Decs_BrkLight_Req "" UBYTE COMM_subsystem_integrated_CM_boolean 0 0 0 1 ECU_ADDRESS 0xb0003558 /* @ECU_Address@VbCOMM_Decs_BrkLight_Req@ */ /end MEASUREMENT
/begin MEASUREMENT VbCOMM_Decs_BckfogLmp_Req "" UBYTE COMM_subsystem_integrated_CM_boolean 0 0 0 1 ECU_ADDRESS 0xb0003557 /* @ECU_Address@VbCOMM_Decs_BckfogLmp_Req@ */ /end MEASUREMENT
/begin MEASUREMENT VbCOMM_Decs_iBCM_Req "" UBYTE COMM_subsystem_integrated_CM_boolean 0 0 0 1 ECU_ADDRESS 0xb0003556 /* @ECU_Address@VbCOMM_Decs_iBCM_Req@ */ /end MEASUREMENT
/begin MEASUREMENT VbCOMM_HandsOffWheelDetected "" UBYTE COMM_subsystem_integrated_CM_boolean 0 0 0 1 ECU_ADDRESS 0xb0003555 /* @ECU_Address@VbCOMM_HandsOffWheelDetected@ */ /end MEASUREMENT
/begin MEASUREMENT VbCOMM_HandsOnWheelDetected "" UBYTE COMM_subsystem_integrated_CM_boolean 0 0 0 1 ECU_ADDRESS 0xb0003554 /* @ECU_Address@VbCOMM_HandsOnWheelDetected@ */ /end MEASUREMENT
/begin MEASUREMENT VeDCSN_usr_cmd_autodrive_activate "usr activate cmd
      0 = deactivate
      1 = activate
      2 = hold" UBYTE DCSN_subsystem_integrated_CM_uint8 0 0 0 255 ECU_ADDRESS 0x7000417e /* @ECU_Address@VeDCSN_usr_cmd_autodrive_activate@ */ /end MEASUREMENT
/begin MEASUREMENT VbDCSN_ACC_ready_to_engage "ACCS subsystem ready" UBYTE DCSN_subsystem_integrated_CM_boolean 0 0 0 1 ECU_ADDRESS 0x70004152 /* @ECU_Address@VbDCSN_ACC_ready_to_engage@ */ /end MEASUREMENT
/begin MEASUREMENT VbDCSN_accs_resume "0 = no accs resume request
      1 = accs resume request" UBYTE DCSN_subsystem_integrated_CM_boolean 0 0 0 1 ECU_ADDRESS 0x70004150 /* @ECU_Address@VbDCSN_accs_resume@ */ /end MEASUREMENT
/begin MEASUREMENT VbDCSN_adm_steering_override "0 = not override
      1 = override" UBYTE DCSN_subsystem_integrated_CM_boolean 0 0 0 1 ECU_ADDRESS 0x7000414f /* @ECU_Address@VbDCSN_adm_steering_override@ */ /end MEASUREMENT
/begin MEASUREMENT VbDCSN_adm_steering_resume "0 = not resume
      1 = resume" UBYTE DCSN_subsystem_integrated_CM_boolean 0 0 0 1 ECU_ADDRESS 0x7000414e /* @ECU_Address@VbDCSN_adm_steering_resume@ */ /end MEASUREMENT
/begin MEASUREMENT VeDCSN_adm_main_mode "0 = ADM_OFF
      1 = ADM_STANDBY
      2 = ADM_READY
      3 = ADM_ACTIVE
      4 = ADM_STEER_OVRD
      5 = ADM_TAKEOVER_WARNING
      6 = ADM_FAULT_WARNING
      7 = ADM_FAULT_REACTION
      8 = ADM_FAULT_DETECTED" UBYTE DCSN_subsystem_integrated_CM_EnumDCSN_adm_main_mode 0 0 0 8 ECU_ADDRESS 0x7000414a /* @ECU_Address@VeDCSN_adm_main_mode@ */ /end MEASUREMENT
/begin MEASUREMENT VeDCSN_hmi_msg_display "0 = NO_MSG
      1 = ACTIVE
      2 = OVRD
      3 = TAKOVER_REQ
      4 = FAULT" UBYTE DCSN_subsystem_integrated_CM_EnumDCSN_adm_hmi_msg_display 0 0 0 4 ECU_ADDRESS 0x70004149 /* @ECU_Address@VeDCSN_hmi_msg_display@ */ /end MEASUREMENT
/begin MEASUREMENT VeDCSN_hmi_icon_display "0 = NO_ICON
      1 = GREY_SOLID
      2 = GREEN_SOLID
      3 = BLUE_SOLID
      4 = RED_FLASH_SLOW
      5 = RED_FLASH_FAST
      6 = RED_SOLID" UBYTE DCSN_subsystem_integrated_CM_EnumDCSN_adm_hmi_icon_display 0 0 0 6 ECU_ADDRESS 0x70004148 /* @ECU_Address@VeDCSN_hmi_icon_display@ */ /end MEASUREMENT
/begin COMPU_METHOD AEBS_subsystem_integrated_CM_single "Q = V" RAT_FUNC "%8.6" "" COEFFS 0 1 0 0 0 1 /end COMPU_METHOD
/begin COMPU_METHOD AEBS_subsystem_integrated_CM_int32 "Q = V" RAT_FUNC "%10.0" "" COEFFS 0 1 0 0 0 1 /end COMPU_METHOD
/begin COMPU_METHOD AEBS_subsystem_integrated_CM_int8 "Q = V" RAT_FUNC "%3.0" "" COEFFS 0 1 0 0 0 1 /end COMPU_METHOD
/begin COMPU_METHOD AEBS_subsystem_integrated_CM_uint8 "Q = V" RAT_FUNC "%3.0" "" COEFFS 0 1 0 0 0 1 /end COMPU_METHOD
/begin COMPU_METHOD AEBS_subsystem_integrated_CM_boolean "Q = V" RAT_FUNC "%1.0" "" COEFFS 0 1 0 0 0 1 /end COMPU_METHOD
/begin COMPU_METHOD AEBS_subsystem_integrated_CM_EnumAEBS_FCWState "Enumerated data type: EnumAEBS_FCWState" TAB_VERB "%0.6" "" COMPU_TAB_REF VTAB_FOR_AEBS_subsystem_integrated_CM_EnumAEBS_FCWState /end COMPU_METHOD
/begin COMPU_METHOD AEBS_subsystem_integrated_CM_EnumAEBS_TurnType "Enumerated data type: EnumAEBS_TurnType" TAB_VERB "%0.6" "" COMPU_TAB_REF VTAB_FOR_AEBS_subsystem_integrated_CM_EnumAEBS_TurnType /end COMPU_METHOD
/begin COMPU_METHOD ARBT_subsystem_integrated_CM_single_s "Q = V" RAT_FUNC "%8.6" "s" COEFFS 0 1 0 0 0 1 /end COMPU_METHOD
/begin COMPU_METHOD ARBT_subsystem_integrated_CM_single_m_s2 "Q = V" RAT_FUNC "%8.6" "m/s2" COEFFS 0 1 0 0 0 1 /end COMPU_METHOD
/begin COMPU_METHOD ARBT_subsystem_integrated_CM_single__ "Q = V" RAT_FUNC "%8.6" "%" COEFFS 0 1 0 0 0 1 /end COMPU_METHOD
/begin COMPU_METHOD ARBT_subsystem_integrated_CM_single_deg "Q = V" RAT_FUNC "%8.6" "deg" COEFFS 0 1 0 0 0 1 /end COMPU_METHOD
/begin COMPU_METHOD ARBT_subsystem_integrated_CM_single_ms "Q = V" RAT_FUNC "%8.6" "ms" COEFFS 0 1 0 0 0 1 /end COMPU_METHOD
/begin COMPU_METHOD ARBT_subsystem_integrated_CM_single_sec "Q = V" RAT_FUNC "%8.6" "sec" COEFFS 0 1 0 0 0 1 /end COMPU_METHOD
/begin COMPU_METHOD ARBT_subsystem_integrated_CM_single "Q = V" RAT_FUNC "%8.6" "" COEFFS 0 1 0 0 0 1 /end COMPU_METHOD
/begin COMPU_METHOD ARBT_subsystem_integrated_CM_single_m_s "Q = V" RAT_FUNC "%8.6" "m/s" COEFFS 0 1 0 0 0 1 /end COMPU_METHOD
/begin COMPU_METHOD ARBT_subsystem_integrated_CM_uint8 "Q = V" RAT_FUNC "%3.0" "" COEFFS 0 1 0 0 0 1 /end COMPU_METHOD
/begin COMPU_METHOD ARBT_subsystem_integrated_CM_boolean "Q = V" RAT_FUNC "%1.0" "" COEFFS 0 1 0 0 0 1 /end COMPU_METHOD
/begin COMPU_METHOD ARBT_subsystem_integrated_CM_single_Nm "Q = V" RAT_FUNC "%8.6" "Nm" COEFFS 0 1 0 0 0 1 /end COMPU_METHOD
/begin COMPU_METHOD ARBT_subsystem_integrated_CM_EnumARBT_arbitration_winner "Enumerated data type: EnumARBT_arbitration_winner" TAB_VERB "%0.6" "" COMPU_TAB_REF VTAB_FOR_ARBT_subsystem_integrated_CM_EnumARBT_arbitration_winner /end COMPU_METHOD
/begin COMPU_METHOD COMM_subsystem_integrated_CM_single "Q = V" RAT_FUNC "%8.6" "" COEFFS 0 1 0 0 0 1 /end COMPU_METHOD
/begin COMPU_METHOD COMM_subsystem_integrated_CM_single_mm "Q = V" RAT_FUNC "%8.6" "mm" COEFFS 0 1 0 0 0 1 /end COMPU_METHOD
/begin COMPU_METHOD COMM_subsystem_integrated_CM_single_rad "Q = V" RAT_FUNC "%8.6" "rad" COEFFS 0 1 0 0 0 1 /end COMPU_METHOD
/begin COMPU_METHOD COMM_subsystem_integrated_CM_single_kg "Q = V" RAT_FUNC "%8.6" "kg" COEFFS 0 1 0 0 0 1 /end COMPU_METHOD
/begin COMPU_METHOD COMM_subsystem_integrated_CM_single_N_deg "Q = V" RAT_FUNC "%8.6" "N/deg" COEFFS 0 1 0 0 0 1 /end COMPU_METHOD
/begin COMPU_METHOD COMM_subsystem_integrated_CM_single_kg_m2 "Q = V" RAT_FUNC "%8.6" "kg*m2" COEFFS 0 1 0 0 0 1 /end COMPU_METHOD
/begin COMPU_METHOD COMM_subsystem_integrated_CM_single_m "Q = V" RAT_FUNC "%8.6" "m" COEFFS 0 1 0 0 0 1 /end COMPU_METHOD
/begin COMPU_METHOD COMM_subsystem_integrated_CM_uint8 "Q = V" RAT_FUNC "%3.0" "" COEFFS 0 1 0 0 0 1 /end COMPU_METHOD
/begin COMPU_METHOD COMM_subsystem_integrated_CM_boolean "Q = V" RAT_FUNC "%1.0" "" COEFFS 0 1 0 0 0 1 /end COMPU_METHOD
/begin COMPU_METHOD COMM_subsystem_integrated_CM_int16 "Q = V" RAT_FUNC "%5.0" "" COEFFS 0 1 0 0 0 1 /end COMPU_METHOD
/begin COMPU_METHOD COMM_subsystem_integrated_CM_uint16 "Q = V" RAT_FUNC "%5.0" "" COEFFS 0 1 0 0 0 1 /end COMPU_METHOD
/begin COMPU_METHOD DCSN_subsystem_integrated_CM_single_s "Q = V" RAT_FUNC "%8.6" "s" COEFFS 0 1 0 0 0 1 /end COMPU_METHOD
/begin COMPU_METHOD DCSN_subsystem_integrated_CM_single_m_s "Q = V" RAT_FUNC "%8.6" "m/s" COEFFS 0 1 0 0 0 1 /end COMPU_METHOD
/begin COMPU_METHOD DCSN_subsystem_integrated_CM_uint8 "Q = V" RAT_FUNC "%3.0" "" COEFFS 0 1 0 0 0 1 /end COMPU_METHOD
/begin COMPU_METHOD DCSN_subsystem_integrated_CM_boolean "Q = V" RAT_FUNC "%1.0" "" COEFFS 0 1 0 0 0 1 /end COMPU_METHOD
/begin COMPU_METHOD DCSN_subsystem_integrated_CM_EnumDCSN_adm_main_mode "Enumerated data type: EnumDCSN_adm_main_mode" TAB_VERB "%0.6" "" COMPU_TAB_REF VTAB_FOR_DCSN_subsystem_integrated_CM_EnumDCSN_adm_main_mode /end COMPU_METHOD
/begin COMPU_METHOD DCSN_subsystem_integrated_CM_EnumDCSN_adm_hmi_msg_display "Enumerated data type: EnumDCSN_adm_hmi_msg_display" TAB_VERB "%0.6" "" COMPU_TAB_REF VTAB_FOR_DCSN_subsystem_integrated_CM_EnumDCSN_adm_hmi_msg_display /end COMPU_METHOD
/begin COMPU_METHOD DCSN_subsystem_integrated_CM_EnumDCSN_adm_hmi_icon_display "Enumerated data type: EnumDCSN_adm_hmi_icon_display" TAB_VERB "%0.6" "" COMPU_TAB_REF VTAB_FOR_DCSN_subsystem_integrated_CM_EnumDCSN_adm_hmi_icon_display /end COMPU_METHOD
/begin COMPU_VTAB VTAB_FOR_AEBS_subsystem_integrated_CM_EnumAEBS_FCWState "Enumerated data type: EnumAEBS_FCWState" TAB_VERB 6 0 "AEBS_FCWState_StandBy" 1 "AEBS_FCWState_Level1Actived" 2 "AEBS_FCWState_Level2Actived" 3 "AEBS_FCWState_Level3Actived" 4 "AEBS_FCWState_Level4Actived" 5 "AEBS_FCWState_Level5Actived" /end COMPU_VTAB
/begin COMPU_VTAB VTAB_FOR_AEBS_subsystem_integrated_CM_EnumAEBS_TurnType "Enumerated data type: EnumAEBS_TurnType" TAB_VERB 4 1 "AEBS_Straight" 2 "AEBS_LeftTurn" 3 "AEBS_RightTurn" 4 "AEBS_TurnInvalid" /end COMPU_VTAB
/begin COMPU_VTAB VTAB_FOR_ARBT_subsystem_integrated_CM_EnumARBT_arbitration_winner "Enumerated data type: EnumARBT_arbitration_winner" TAB_VERB 7 0 "ARBT_NO_REQ" 1 "AEB" 2 "ACC" 3 "LCC" 4 "LKA" 5 "BRAKE_OVRD" 6 "RSVD2" /end COMPU_VTAB
/begin COMPU_VTAB VTAB_FOR_DCSN_subsystem_integrated_CM_EnumDCSN_adm_main_mode "Enumerated data type: EnumDCSN_adm_main_mode" TAB_VERB 9 0 "ADM_OFF" 1 "ADM_STANDBY" 2 "ADM_READY" 3 "ADM_ACTIVE" 4 "ADM_STEER_OVRD" 5 "ADM_TAKEOVER_WARNING" 6 "ADM_FAULT_WARNING" 7 "ADM_FAULT_REACTION" 8 "ADM_FAULT_DETECTED" /end COMPU_VTAB
/begin COMPU_VTAB VTAB_FOR_DCSN_subsystem_integrated_CM_EnumDCSN_adm_hmi_msg_display "Enumerated data type: EnumDCSN_adm_hmi_msg_display" TAB_VERB 5 0 "NO_MSG" 1 "ACTIVE" 2 "OVRD" 3 "TAKEOVER_REQ" 4 "FAULT" /end COMPU_VTAB
/begin COMPU_VTAB VTAB_FOR_DCSN_subsystem_integrated_CM_EnumDCSN_adm_hmi_icon_display "Enumerated data type: EnumDCSN_adm_hmi_icon_display" TAB_VERB 7 0 "NO_ICON" 1 "GREY_SOLID" 2 "GREEN_SOLID" 3 "BLUE_SOLID" 4 "RED_FLASH_SLOW" 5 "RED_FLASH_FAST" 6 "RED_SOLID" /end COMPU_VTAB
/begin GROUP S3_AEB_FCWVIPTargetSelection "AEBS_subsystem_integrated/AEBS/AEBS_Enabled/AEB_FCWVIPTargetSelection"
 /begin SUB_GROUP S9_Calc_obs_lateral_long_buffer S9_RedifineVIPObsType S9_SubsystemMonitor S9_TestMode S9_TurnState /end SUB_GROUP
 /begin REF_CHARACTERISTIC KbAEBS_Enable_DoRbIW KbAEBS_Enable_DoRbIW_LeftTurn KbAEBS_FilterVehicleinSide KbAEBS_Test_Mode KbAEBS_Use_OBFU_Acceleration KbAEBS_Use_OBFU_Type KfAEBS_Cur_LeftTurnThrshHi KfAEBS_Cur_LeftTurnThrshLo KfAEBS_Cur_RightTurnThrshHi KfAEBS_Cur_RightTurnThrshLo KfAEBS_GainTHW KfAEBS_GainTTC KfAEBS_Pedstr_length_Thrsh KfAEBS_Pedstr_width_Thrsh KfAEBS_Veh_DisEnd2OC KfAEBS_Veh_DisHead2OC KfAEBS_Veh_DisRear2COM KfAEBS_Veh_DisRear2OC KfAEBS_Veh_Length KfAEBS_Veh_Width KfAEBS_Veh_WidthBuffer KfAEBS_Zone_DoRbIW_x_front KfAEBS_Zone_DoRbIW_x_rear KfAEBS_d_Dis2HeadIgnoreSide KfAEBS_d_Dis_BufferTTSP KfAEBS_d_Dis_BufferTTSP_length KfAEBS_d_Dis_LateralIgnore KfAEBS_d_min_dis_swap KfAEBS_t_timeGap_ignore_turn KfAEBS_v_Speed_DeltaWExit KfAEBS_v_Speed_ObjStillThrsh KfAEBS_v_Speed_ObjStillThrshLateral KtAEBS_veh_widthGain /end REF_CHARACTERISTIC
 /begin REF_MEASUREMENT VfAEBS_obs_delta_dis VfAEBS_obs_delta_speed VfAEBS_obs_dis2adc_lateral VfAEBS_obs_dis2adc_long VfAEBS_obs_filtered_type VfAEBS_obs_position_state VfAEBS_obs_ttc VfAEBS_obs_v_lateral VfAEBS_obs_v_long VfAEBS_speed_x_used VfAEBS_speed_y_used VfAEBS_veh_acc_used VfAEBS_veh_cur_used VfAEBS_veh_speed_used /end REF_MEASUREMENT
/end GROUP
/begin GROUP S3_FCW_Determination "AEBS_subsystem_integrated/AEBS/AEBS_Enabled/FCW_Determination" /begin SUB_GROUP S10_DetermineFCWStatus S10_ThreatEvaluation /end SUB_GROUP /end GROUP
/begin GROUP S6_Error_Detection "AEBS_subsystem_integrated/AEBS/AEBS_Enabled/AEBS_Input/Error Detection" /begin REF_CHARACTERISTIC KfAEBS_t_Time_OBFUNReceivedThrsh /end REF_CHARACTERISTIC /end GROUP
/begin GROUP S6_adc_path_prediction "AEBS_subsystem_integrated/AEBS/AEBS_Enabled/AEBS_Input/adc_path_prediction"
 /begin REF_CHARACTERISTIC KfAEBS_CoeffStrwhl2Radius KfAEBS_Veh_Strwhl2FrtwhlRatio KfAEBS_Veh_WheelBase /end REF_CHARACTERISTIC
/end GROUP
/begin GROUP S6_veh_FedBck_update "AEBS_subsystem_integrated/AEBS/AEBS_Enabled/AEBS_Input/veh_FedBck_update"
 /begin REF_MEASUREMENT VfAEBS_FedBck_AccLateral VfAEBS_FedBck_AccLong VfAEBS_FedBck_AccPedPos VfAEBS_FedBck_BrkLightState VfAEBS_FedBck_BrkPedPos VfAEBS_FedBck_BrkPedStatus VfAEBS_FedBck_Drivemode VfAEBS_FedBck_EPBstate VfAEBS_FedBck_GearValue VfAEBS_FedBck_LeftLampState VfAEBS_FedBck_RightLampState VfAEBS_FedBck_SmallLampState VfAEBS_FedBck_StrAngle VfAEBS_FedBck_Vehspd VfAEBS_FedBck_yawRate /end REF_MEASUREMENT
/end GROUP
/begin GROUP S7_updataFcwWarning "AEBS_subsystem_integrated/AEBS/AEBS_Enabled/AEBS_Output/updataFcwWarning" /begin REF_MEASUREMENT VfAEBS_FCW_active_state VfAEBS_FCW_warn_level /end REF_MEASUREMENT /end GROUP
/begin GROUP S7_updateobsID "AEBS_subsystem_integrated/AEBS/AEBS_Enabled/AEBS_Output/updateobsID" /begin REF_MEASUREMENT VfAEBS_AEBS_obs_id /end REF_MEASUREMENT /end GROUP
/begin GROUP S8_DetermineAEBStatus "AEBS_subsystem_integrated/AEBS/AEBS_Enabled/AEB_Determination/DetermineAEBStatus" /begin SUB_GROUP S39_CalcAEBSAcceleration S39_CheckAEBS_SystemOverride /end SUB_GROUP /begin REF_CHARACTERISTIC KbAEBS_Enable_OutputAEB /end REF_CHARACTERISTIC /begin REF_MEASUREMENT VfAEBS_AEB_request_beforeSend /end REF_MEASUREMENT /end GROUP
/begin GROUP S8_DtrmnThreatEvaluation "AEBS_subsystem_integrated/AEBS/AEBS_Enabled/AEB_Determination/DtrmnThreatEvaluation"
 /begin SUB_GROUP S40_CalcObsAreq S40_Deactive S40_Dtrn_VUR_and_VRU_Protection S40_Dtrn_vehicleStandStill S40_Enable_Evaluation S40_FullBrakeThreat S40_PartialBrakeThreat S40_Prebrake_Threat S40_inhibit /end SUB_GROUP
/end GROUP
/begin GROUP S8_QueueOverride "AEBS_subsystem_integrated/AEBS/AEBS_Enabled/AEB_Determination/QueueOverride" /begin SUB_GROUP S41_ConfirmBrakePedlPsd /end SUB_GROUP
 /begin REF_CHARACTERISTIC KbAEBS_AllowOverride KfAEBS_AccPedelThrshOvrrd KfAEBS_v_SpeedLLThrshOvrrd KfAEBS_v_SpeedRelLThrshOvrrd /end REF_CHARACTERISTIC
/end GROUP
/begin GROUP S9_Calc_obs_lateral_long_buffer "AEBS_subsystem_integrated/AEBS/AEBS_Enabled/AEB_FCWVIPTargetSelection/Calc_obs_lateral_long_buffer" /begin SUB_GROUP S134_Calc_Lateral_long_buffer /end SUB_GROUP /end GROUP
/begin GROUP S9_RedifineVIPObsType "AEBS_subsystem_integrated/AEBS/AEBS_Enabled/AEB_FCWVIPTargetSelection/RedifineVIPObsType" /begin REF_CHARACTERISTIC KbAEBS_RedifineVIPObsType KfAEBS_VIPObsType /end REF_CHARACTERISTIC /end GROUP
/begin GROUP S9_SubsystemMonitor "AEBS_subsystem_integrated/AEBS/AEBS_Enabled/AEB_FCWVIPTargetSelection/SubsystemMonitor"
 /begin REF_MEASUREMENT VbAEBS_has_obs_vip VfAEBS_obs_acc_lateral_vip VfAEBS_obs_acc_long_vip VfAEBS_obs_center_x_vip VfAEBS_obs_center_y_vip VfAEBS_obs_delta_dis_vip VfAEBS_obs_delta_speed_vip VfAEBS_obs_dis_lateral_VIP VfAEBS_obs_dis_long_VIP VfAEBS_obs_heading_VIP VfAEBS_obs_id_vip VfAEBS_obs_index_vip VfAEBS_obs_length_VIP VfAEBS_obs_position_state_vip VfAEBS_obs_rp_vip VfAEBS_obs_ttc_vip VfAEBS_obs_type_vip VfAEBS_obs_v_lateral_vip VfAEBS_obs_v_long_vip VfAEBS_obs_width_VIP /end REF_MEASUREMENT
/end GROUP
/begin GROUP S9_TestMode "AEBS_subsystem_integrated/AEBS/AEBS_Enabled/AEB_FCWVIPTargetSelection/TestMode"
 /begin REF_CHARACTERISTIC KbAEBS_Test_HasObsVIP KfAEBS_Test_CeterXVIP KfAEBS_Test_CeterYVIP KfAEBS_Test_DeltaDisVIP KfAEBS_Test_DeltaSpeedVIP KfAEBS_Test_IDVIP KfAEBS_Test_TTCVIP /end REF_CHARACTERISTIC
/end GROUP
/begin GROUP S9_TurnState "AEBS_subsystem_integrated/AEBS/AEBS_Enabled/AEB_FCWVIPTargetSelection/TurnState"
 /begin REF_CHARACTERISTIC KbAEBS_Active_LeftTurn KbAEBS_Active_RightTurn KbAEBS_Active_Straight /end REF_CHARACTERISTIC
 /begin REF_MEASUREMENT VeAEBS_TurnType /end REF_MEASUREMENT
/end GROUP
/begin GROUP S10_DetermineFCWStatus "AEBS_subsystem_integrated/AEBS/AEBS_Enabled/FCW_Determination/DetermineFCWStatus" /begin SUB_GROUP S165_CheckAEBS_SystemOverride /end SUB_GROUP /end GROUP
/begin GROUP S10_ThreatEvaluation "AEBS_subsystem_integrated/AEBS/AEBS_Enabled/FCW_Determination/ThreatEvaluation"
 /begin SUB_GROUP S167_Deactive S167_Dtrn_vehicleStandStill S167_Enable_Evaluation S167_FCW_level1_Threat S167_FCW_level2_Threat S167_FCW_level3_Threat S167_inhibit /end SUB_GROUP
/end GROUP
/begin GROUP S39_CalcAEBSAcceleration "AEBS_subsystem_integrated/AEBS/AEBS_Enabled/AEB_Determination/DetermineAEBStatus/CalcAEBSAcceleration"
 /begin SUB_GROUP S42_AccelReqFilter S42_AccelerationLimit S42_ClacCurrTime S42_First_Order_Low_Pass_Filter /end SUB_GROUP
 /begin REF_CHARACTERISTIC KfAEBS_a_BrakeInit KfAEBS_a_BrakeMax KfAEBS_a_FullBrakeHi KfAEBS_a_FullBrakeLo KfAEBS_a_PartialBrakeHi KfAEBS_a_PartialBrakeLo KfAEBS_t_Time_BrakeInit KfAEBS_t_Time_BrakeRamp /end REF_CHARACTERISTIC
/end GROUP
/begin GROUP S39_CheckAEBS_SystemOverride "AEBS_subsystem_integrated/AEBS/AEBS_Enabled/AEB_Determination/DetermineAEBStatus/CheckAEBS_SystemOverride"
 /begin REF_CHARACTERISTIC KfAEBS_LoPosValInCllsnRednByBrkg KfAEBS_SpdMinOvrdAccrResetInCllsnRednByBrkg /end REF_CHARACTERISTIC
/end GROUP
/begin GROUP S40_CalcObsAreq "AEBS_subsystem_integrated/AEBS/AEBS_Enabled/AEB_Determination/DtrmnThreatEvaluation/CalcObsAreq" /begin SUB_GROUP S68_Subsystem2 /end SUB_GROUP
 /begin REF_CHARACTERISTIC KfAEBS_a_FullBrakeHi KfAEBS_a_ObjUrgentBrake_Thrsh KfAEBS_t_Time_BrakeDelay KfAEBS_t_Time_ObjUrgentBrk KfAEBS_v_ObjUrgentBrk_speed_Thrsh /end REF_CHARACTERISTIC
 /begin REF_MEASUREMENT VfAEBS_a_obj_absolute_acc VfAEBS_areq VfAEBS_areq_withoutDelay VfAEBS_areq_withoutDelay_UrgentBrk VfAEBS_dis_delay VfAEBS_v_obj_absolute_speed /end REF_MEASUREMENT
/end GROUP
/begin GROUP S40_Deactive "AEBS_subsystem_integrated/AEBS/AEBS_Enabled/AEB_Determination/DtrmnThreatEvaluation/Deactive"
 /begin SUB_GROUP S69_ObjDataChangeDetection S69_RaisingEdgeDelay1 S69_RaisingEdgeDelay2 S69_SpeedReductionMonitoring /end SUB_GROUP
 /begin REF_CHARACTERISTIC KfAEBS_a_Areq_ObjChangThrsd KfAEBS_t_TTC_DeactiveThrsh KfAEBS_t_Time_HasNoVIPDelay KfAEBS_t_Time_TTCHLInhibitAEB /end REF_CHARACTERISTIC
 /begin REF_MEASUREMENT VbAEBS_Deactive_R_NoVIP VbAEBS_Deactive_R_VIPChanged /end REF_MEASUREMENT
/end GROUP
/begin GROUP S40_Dtrn_VUR_and_VRU_Protection "AEBS_subsystem_integrated/AEBS/AEBS_Enabled/AEB_Determination/DtrmnThreatEvaluation/Dtrn_VUR_and_VRU_Protection" /begin SUB_GROUP S70_Dtrn_VRU_obstacle S70_Dtrn_VehicleSpeedState /end SUB_GROUP /begin REF_CHARACTERISTIC KbAEBS_Enable_VRU_Protection /end REF_CHARACTERISTIC /begin REF_MEASUREMENT VfAEBS_use_VRU_TTC_threshold /end REF_MEASUREMENT /end GROUP
/begin GROUP S40_Dtrn_vehicleStandStill "AEBS_subsystem_integrated/AEBS/AEBS_Enabled/AEB_Determination/DtrmnThreatEvaluation/Dtrn_vehicleStandStill"
 /begin REF_CHARACTERISTIC KfAEBS_t_Speed_DebounceTime KfAEBS_v_Speed_DeltaStStThrsh KfAEBS_v_Speed_StandStillThrsh /end REF_CHARACTERISTIC
 /begin REF_MEASUREMENT VfAEBS_veh_standstill /end REF_MEASUREMENT
/end GROUP
/begin GROUP S40_Enable_Evaluation "AEBS_subsystem_integrated/AEBS/AEBS_Enabled/AEB_Determination/DtrmnThreatEvaluation/Enable Evaluation" /begin REF_MEASUREMENT VfAEBS_AEB_disabled VfAEBS_AEB_enabled /end REF_MEASUREMENT /end GROUP
/begin GROUP S40_FullBrakeThreat "AEBS_subsystem_integrated/AEBS/AEBS_Enabled/AEB_Determination/DtrmnThreatEvaluation/FullBrakeThreat" /begin SUB_GROUP S73_Subsystem /end SUB_GROUP
 /begin REF_CHARACTERISTIC KfAEBS_a_Areq_FullBrkActThrsd KfAEBS_a_Areq_FullBrkDeactThrsd KfAEBS_t_fb_active_delay_turn /end REF_CHARACTERISTIC
 /begin REF_MEASUREMENT VfAEBS_fullBrk_active VfAEBS_fullBrk_dactive /end REF_MEASUREMENT
/end GROUP
/begin GROUP S40_PartialBrakeThreat "AEBS_subsystem_integrated/AEBS/AEBS_Enabled/AEB_Determination/DtrmnThreatEvaluation/PartialBrakeThreat" /begin SUB_GROUP S74_Dtrn_TTC_Threshold S74_Subsystem /end SUB_GROUP
 /begin REF_CHARACTERISTIC KfAEBS_a_Areq_PartialBrkActThrsd KfAEBS_a_Areq_PartialBrkDeactThrsd KfAEBS_t_TTC_PartialBrkDeactiveThrsd KfAEBS_t_pb_active_delay_turn /end REF_CHARACTERISTIC
 /begin REF_MEASUREMENT VfAEBS_partialBrk_active VfAEBS_partialBrk_dactive /end REF_MEASUREMENT
/end GROUP
/begin GROUP S40_Prebrake_Threat "AEBS_subsystem_integrated/AEBS/AEBS_Enabled/AEB_Determination/DtrmnThreatEvaluation/Prebrake Threat" /begin SUB_GROUP S75_Dtrn_TTC_Threshold /end SUB_GROUP /begin REF_CHARACTERISTIC KfAEBS_t_TTC_PreBrkDeactThrsd /end REF_CHARACTERISTIC /begin REF_MEASUREMENT VfAEBS_preBrake_active VfAEBS_preBrake_dactive /end REF_MEASUREMENT /end GROUP
/begin GROUP S40_inhibit "AEBS_subsystem_integrated/AEBS/AEBS_Enabled/AEB_Determination/DtrmnThreatEvaluation/inhibit" /begin SUB_GROUP S76_Deactive_time S76_speed_inhibit /end SUB_GROUP /begin REF_CHARACTERISTIC KfAEBS_Gear_Value_R KfAEBS_t_Time_TwiceAEBActive /end REF_CHARACTERISTIC /begin REF_MEASUREMENT VfAEBS_AEB_inhibit VfAEBS_Gear_InhibitAEB /end REF_MEASUREMENT /end GROUP
/begin GROUP S134_Calc_Lateral_long_buffer "AEBS_subsystem_integrated/AEBS/AEBS_Enabled/AEB_FCWVIPTargetSelection/Calc_obs_lateral_long_buffer/Calc_Lateral_long_buffer"
 /begin SUB_GROUP S139_Calc_lateral_buffer S139_Calc_long_buffer S139_ObsIgnore /end SUB_GROUP
/end GROUP
/begin GROUP S165_CheckAEBS_SystemOverride "AEBS_subsystem_integrated/AEBS/AEBS_Enabled/FCW_Determination/DetermineFCWStatus/CheckAEBS_SystemOverride"
 /begin REF_CHARACTERISTIC KfAEBS_LoPosValInCllsnRednByBrkg KfAEBS_SpdMinOvrdAccrResetInCllsnRednByBrkg /end REF_CHARACTERISTIC
/end GROUP
/begin GROUP S167_Deactive "AEBS_subsystem_integrated/AEBS/AEBS_Enabled/FCW_Determination/ThreatEvaluation/Deactive" /begin SUB_GROUP S176_ObjDataChangeDetection S176_RaisingEdgeDelay1 /end SUB_GROUP
 /begin REF_CHARACTERISTIC KfAEBS_t_TTC_DeactiveThrsh KfAEBS_t_TTC_ObjChangThrsd KfAEBS_t_Time_HasNoVIPDelay KfAEBS_t_Time_TTCHLInhibitAEB /end REF_CHARACTERISTIC
/end GROUP
/begin GROUP S167_Dtrn_vehicleStandStill "AEBS_subsystem_integrated/AEBS/AEBS_Enabled/FCW_Determination/ThreatEvaluation/Dtrn_vehicleStandStill"
 /begin REF_CHARACTERISTIC KfAEBS_t_Speed_DebounceTime KfAEBS_v_Speed_DeltaStStThrsh KfAEBS_v_Speed_StandStillThrsh /end REF_CHARACTERISTIC
/end GROUP
/begin GROUP S167_Enable_Evaluation "AEBS_subsystem_integrated/AEBS/AEBS_Enabled/FCW_Determination/ThreatEvaluation/Enable Evaluation" /begin REF_MEASUREMENT VfAEBS_FCW_disabled VfAEBS_FCW_enabled /end REF_MEASUREMENT /end GROUP
/begin GROUP S167_FCW_level1_Threat "AEBS_subsystem_integrated/AEBS/AEBS_Enabled/FCW_Determination/ThreatEvaluation/FCW_level1 Threat"
 /begin REF_CHARACTERISTIC KfAEBS_t_TTC_FCWLevel1DeactThrsd KtAEBS_FCWL1ActiveTTCThrshld /end REF_CHARACTERISTIC
 /begin REF_MEASUREMENT VfAEBS_FCWLev1_active VfAEBS_FCWLev1_dactive /end REF_MEASUREMENT
/end GROUP
/begin GROUP S167_FCW_level2_Threat "AEBS_subsystem_integrated/AEBS/AEBS_Enabled/FCW_Determination/ThreatEvaluation/FCW_level2 Threat"
 /begin REF_CHARACTERISTIC KfAEBS_t_TTC_FCWLevel2DeactThrsd KtAEBS_FCWL2ActiveTTCThrshld /end REF_CHARACTERISTIC
 /begin REF_MEASUREMENT VfAEBS_FCWLev2_active VfAEBS_FCWLev2_dactive /end REF_MEASUREMENT
/end GROUP
/begin GROUP S167_FCW_level3_Threat "AEBS_subsystem_integrated/AEBS/AEBS_Enabled/FCW_Determination/ThreatEvaluation/FCW_level3 Threat"
 /begin REF_CHARACTERISTIC KfAEBS_t_TTC_FCWLevel3DeactThrsd KtAEBS_FCWL3ActiveTTCThrshld /end REF_CHARACTERISTIC
 /begin REF_MEASUREMENT VfAEBS_FCWLev3_active VfAEBS_FCWLev3_dactive /end REF_MEASUREMENT
/end GROUP
/begin GROUP S167_inhibit "AEBS_subsystem_integrated/AEBS/AEBS_Enabled/FCW_Determination/ThreatEvaluation/inhibit" /begin REF_CHARACTERISTIC KfAEBS_Gear_Value_R /end REF_CHARACTERISTIC /end GROUP
/begin GROUP S42_AccelReqFilter "AEBS_subsystem_integrated/AEBS/AEBS_Enabled/AEB_Determination/DetermineAEBStatus/CalcAEBSAcceleration/AccelReqFilter" /begin REF_CHARACTERISTIC KfAEBS_a_AreqRampRate /end REF_CHARACTERISTIC /end GROUP
/begin GROUP S42_AccelerationLimit "AEBS_subsystem_integrated/AEBS/AEBS_Enabled/AEB_Determination/DetermineAEBStatus/CalcAEBSAcceleration/AccelerationLimit" /begin REF_CHARACTERISTIC KtAEBS_a_BrakeValueLimit /end REF_CHARACTERISTIC /begin REF_MEASUREMENT VfAEBS_AEB_accReq_beforeSend /end REF_MEASUREMENT /end GROUP
/begin GROUP S42_First_Order_Low_Pass_Filter "AEBS_subsystem_integrated/AEBS/AEBS_Enabled/AEB_Determination/DetermineAEBStatus/CalcAEBSAcceleration/First Order Low Pass Filter" /begin REF_MEASUREMENT VfAEBS_AEB_acceleration_af_filter /end REF_MEASUREMENT /end GROUP
/begin GROUP S68_Subsystem2 "AEBS_subsystem_integrated/AEBS/AEBS_Enabled/AEB_Determination/DtrmnThreatEvaluation/CalcObsAreq/Subsystem2" /begin SUB_GROUP S78_Subsystem S78_Subsystem1 /end SUB_GROUP /begin REF_CHARACTERISTIC KfAEBS_a_FullBrakeHi KfAEBS_d_Dis_Safe /end REF_CHARACTERISTIC /end GROUP
/begin GROUP S69_ObjDataChangeDetection "AEBS_subsystem_integrated/AEBS/AEBS_Enabled/AEB_Determination/DtrmnThreatEvaluation/Deactive/ObjDataChangeDetection" /begin REF_CHARACTERISTIC KfAEBS_Change_LateralPosThrsh KfAEBS_Change_LonglPosThrsh /end REF_CHARACTERISTIC /end GROUP
/begin GROUP S69_RaisingEdgeDelay1 "AEBS_subsystem_integrated/AEBS/AEBS_Enabled/AEB_Determination/DtrmnThreatEvaluation/Deactive/RaisingEdgeDelay1" /begin REF_MEASUREMENT VfAEBS_AEB_deactive /end REF_MEASUREMENT /end GROUP
/begin GROUP S69_RaisingEdgeDelay2 "AEBS_subsystem_integrated/AEBS/AEBS_Enabled/AEB_Determination/DtrmnThreatEvaluation/Deactive/RaisingEdgeDelay2" /begin REF_MEASUREMENT VbAEBS_Deactive_R_HighTTC /end REF_MEASUREMENT /end GROUP
/begin GROUP S69_SpeedReductionMonitoring "AEBS_subsystem_integrated/AEBS/AEBS_Enabled/AEB_Determination/DtrmnThreatEvaluation/Deactive/SpeedReductionMonitoring" /begin SUB_GROUP S86_SpeedReductionASILACheck /end SUB_GROUP /begin REF_CHARACTERISTIC KfAEBS_VeloRectThrsdByBrkg KfAEBS_t_TimeBrakeThrsd /end REF_CHARACTERISTIC /begin REF_MEASUREMENT VfAEBS_DeniedDueToSpdRed VfAEBS_DeniedDueToTimeBrake /end REF_MEASUREMENT /end GROUP
/begin GROUP S70_Dtrn_VRU_obstacle "AEBS_subsystem_integrated/AEBS/AEBS_Enabled/AEB_Determination/DtrmnThreatEvaluation/Dtrn_VUR_and_VRU_Protection/Dtrn_VRU_obstacle" /begin REF_MEASUREMENT VfAEBS_Obj_IsVRU /end REF_MEASUREMENT /end GROUP
/begin GROUP S70_Dtrn_VehicleSpeedState "AEBS_subsystem_integrated/AEBS/AEBS_Enabled/AEB_Determination/DtrmnThreatEvaluation/Dtrn_VUR_and_VRU_Protection/Dtrn_VehicleSpeedState"
 /begin REF_CHARACTERISTIC KfAEBS_v_isInHighSpeed_HighThrshd KfAEBS_v_isInHighSpeed_LowThrshd /end REF_CHARACTERISTIC
 /begin REF_MEASUREMENT VfAEBS_Vehicle_isInHighSpeed /end REF_MEASUREMENT
/end GROUP
/begin GROUP S73_Subsystem "AEBS_subsystem_integrated/AEBS/AEBS_Enabled/AEB_Determination/DtrmnThreatEvaluation/FullBrakeThreat/Subsystem"
 /begin REF_CHARACTERISTIC KbAEBS_use_steerAngle KfAEBS_SteerRate_Limit_hi KfAEBS_SteerRate_Limit_lo KfAEBS_YawRate_Limit_hi KfAEBS_YawRate_Limit_lo /end REF_CHARACTERISTIC
/end GROUP
/begin GROUP S74_Dtrn_TTC_Threshold "AEBS_subsystem_integrated/AEBS/AEBS_Enabled/AEB_Determination/DtrmnThreatEvaluation/PartialBrakeThreat/Dtrn_TTC_Threshold"
 /begin REF_CHARACTERISTIC KtAEBS_PrtlBrkActiveTTCThrshld KtAEBS_PrtlBrkActiveTTCThrshld_VRU /end REF_CHARACTERISTIC
 /begin REF_MEASUREMENT VfAEBS_Partial_BrakeActiveTTCThreshold /end REF_MEASUREMENT
/end GROUP
/begin GROUP S74_Subsystem "AEBS_subsystem_integrated/AEBS/AEBS_Enabled/AEB_Determination/DtrmnThreatEvaluation/PartialBrakeThreat/Subsystem"
 /begin REF_CHARACTERISTIC KbAEBS_use_steerAngle KfAEBS_SteerRate_Limit_hi KfAEBS_SteerRate_Limit_lo KfAEBS_YawRate_Limit_hi KfAEBS_YawRate_Limit_lo /end REF_CHARACTERISTIC
/end GROUP
/begin GROUP S75_Dtrn_TTC_Threshold "AEBS_subsystem_integrated/AEBS/AEBS_Enabled/AEB_Determination/DtrmnThreatEvaluation/Prebrake Threat/Dtrn_TTC_Threshold"
 /begin REF_CHARACTERISTIC KtAEBS_PreBrkActiveTTCThrshld KtAEBS_PreBrkActiveTTCThrshld_VRU /end REF_CHARACTERISTIC
 /begin REF_MEASUREMENT VfAEBS_Pre_BrakeActiveTTCThreshold /end REF_MEASUREMENT
/end GROUP
/begin GROUP S76_speed_inhibit "AEBS_subsystem_integrated/AEBS/AEBS_Enabled/AEB_Determination/DtrmnThreatEvaluation/inhibit/speed_inhibit"
 /begin REF_CHARACTERISTIC KfAEBS_t_Time_TTCHLInhibitAEB KfAEBS_v_Speed_High_InhibitAEB KfAEBS_v_Speed_MaxInhibitAEB KfAEBS_v_deltaSpeed_InhibitAEB /end REF_CHARACTERISTIC
 /begin REF_MEASUREMENT VfAEBS_HighSpeed_InhibitAEB VfAEBS_LowSpeed_InhibitAEB VfAEBS_Speed_InhibitAEB VfAEBS_VehDeltaSpeed_InhibitAEB /end REF_MEASUREMENT
/end GROUP
/begin GROUP S139_Calc_lateral_buffer "AEBS_subsystem_integrated/AEBS/AEBS_Enabled/AEB_FCWVIPTargetSelection/Calc_obs_lateral_long_buffer/Calc_Lateral_long_buffer/Calc_lateral_buffer"
 /begin SUB_GROUP S140_Bicycle S140_Motorcycle S140_Other S140_Pedestrain S140_VehicleBusTruck /end SUB_GROUP
/end GROUP
/begin GROUP S139_Calc_long_buffer "AEBS_subsystem_integrated/AEBS/AEBS_Enabled/AEB_FCWVIPTargetSelection/Calc_obs_lateral_long_buffer/Calc_Lateral_long_buffer/Calc_long_buffer"
 /begin SUB_GROUP S141_Bicycle S141_Motorcycle S141_Other S141_Pedestrain S141_VehicleBusTruck /end SUB_GROUP
/end GROUP
/begin GROUP S139_ObsIgnore "AEBS_subsystem_integrated/AEBS/AEBS_Enabled/AEB_FCWVIPTargetSelection/Calc_obs_lateral_long_buffer/Calc_Lateral_long_buffer/ObsIgnore" /begin REF_CHARACTERISTIC KfAEBS_Veh_DisHead2OC /end REF_CHARACTERISTIC /end GROUP
/begin GROUP S176_ObjDataChangeDetection "AEBS_subsystem_integrated/AEBS/AEBS_Enabled/FCW_Determination/ThreatEvaluation/Deactive/ObjDataChangeDetection" /begin REF_CHARACTERISTIC KfAEBS_Change_LateralPosThrsh KfAEBS_Change_LonglPosThrsh /end REF_CHARACTERISTIC /end GROUP
/begin GROUP S176_RaisingEdgeDelay1 "AEBS_subsystem_integrated/AEBS/AEBS_Enabled/FCW_Determination/ThreatEvaluation/Deactive/RaisingEdgeDelay1" /begin REF_MEASUREMENT VfAEBS_FCW_deacitve /end REF_MEASUREMENT /end GROUP
/begin GROUP S78_Subsystem "AEBS_subsystem_integrated/AEBS/AEBS_Enabled/AEB_Determination/DtrmnThreatEvaluation/CalcObsAreq/Subsystem2/Subsystem" /begin REF_CHARACTERISTIC KfAEBS_d_Dis_Safe /end REF_CHARACTERISTIC /end GROUP
/begin GROUP S78_Subsystem1 "AEBS_subsystem_integrated/AEBS/AEBS_Enabled/AEB_Determination/DtrmnThreatEvaluation/CalcObsAreq/Subsystem2/Subsystem1" /begin REF_CHARACTERISTIC KfAEBS_a_Buffer /end REF_CHARACTERISTIC /end GROUP
/begin GROUP S86_SpeedReductionASILACheck "AEBS_subsystem_integrated/AEBS/AEBS_Enabled/AEB_Determination/DtrmnThreatEvaluation/Deactive/SpeedReductionMonitoring/SpeedReductionASILACheck" /begin REF_CHARACTERISTIC KfAEBS_t_Time_ResetVeloRdctThrsd /end REF_CHARACTERISTIC /end GROUP
/begin GROUP S140_Bicycle "AEBS_subsystem_integrated/AEBS/AEBS_Enabled/AEB_FCWVIPTargetSelection/Calc_obs_lateral_long_buffer/Calc_Lateral_long_buffer/Calc_lateral_buffer/Bicycle" /begin REF_CHARACTERISTIC KtAEBS_LateralBuffer_Bicycle /end REF_CHARACTERISTIC /end GROUP
/begin GROUP S140_Motorcycle "AEBS_subsystem_integrated/AEBS/AEBS_Enabled/AEB_FCWVIPTargetSelection/Calc_obs_lateral_long_buffer/Calc_Lateral_long_buffer/Calc_lateral_buffer/Motorcycle" /begin REF_CHARACTERISTIC KtAEBS_LateralBuffer_Motor /end REF_CHARACTERISTIC /end GROUP
/begin GROUP S140_Other "AEBS_subsystem_integrated/AEBS/AEBS_Enabled/AEB_FCWVIPTargetSelection/Calc_obs_lateral_long_buffer/Calc_Lateral_long_buffer/Calc_lateral_buffer/Other" /begin REF_CHARACTERISTIC KtAEBS_LateralBuffer_Other /end REF_CHARACTERISTIC /end GROUP
/begin GROUP S140_Pedestrain "AEBS_subsystem_integrated/AEBS/AEBS_Enabled/AEB_FCWVIPTargetSelection/Calc_obs_lateral_long_buffer/Calc_Lateral_long_buffer/Calc_lateral_buffer/Pedestrain" /begin REF_CHARACTERISTIC KtAEBS_LateralBuffer_Pedstrn /end REF_CHARACTERISTIC /end GROUP
/begin GROUP S140_VehicleBusTruck "AEBS_subsystem_integrated/AEBS/AEBS_Enabled/AEB_FCWVIPTargetSelection/Calc_obs_lateral_long_buffer/Calc_Lateral_long_buffer/Calc_lateral_buffer/VehicleBusTruck" /begin REF_CHARACTERISTIC KtAEBS_LateralBuffer_Vehicle /end REF_CHARACTERISTIC /end GROUP
/begin GROUP S141_Bicycle "AEBS_subsystem_integrated/AEBS/AEBS_Enabled/AEB_FCWVIPTargetSelection/Calc_obs_lateral_long_buffer/Calc_Lateral_long_buffer/Calc_long_buffer/Bicycle" /begin REF_CHARACTERISTIC KtAEBS_LongBuffer_Bicycle /end REF_CHARACTERISTIC /end GROUP
/begin GROUP S141_Motorcycle "AEBS_subsystem_integrated/AEBS/AEBS_Enabled/AEB_FCWVIPTargetSelection/Calc_obs_lateral_long_buffer/Calc_Lateral_long_buffer/Calc_long_buffer/Motorcycle" /begin REF_CHARACTERISTIC KtAEBS_LongBuffer_Motor /end REF_CHARACTERISTIC /end GROUP
/begin GROUP S141_Other "AEBS_subsystem_integrated/AEBS/AEBS_Enabled/AEB_FCWVIPTargetSelection/Calc_obs_lateral_long_buffer/Calc_Lateral_long_buffer/Calc_long_buffer/Other" /begin REF_CHARACTERISTIC KtAEBS_LongBuffer_Other /end REF_CHARACTERISTIC /end GROUP
/begin GROUP S141_Pedestrain "AEBS_subsystem_integrated/AEBS/AEBS_Enabled/AEB_FCWVIPTargetSelection/Calc_obs_lateral_long_buffer/Calc_Lateral_long_buffer/Calc_long_buffer/Pedestrain" /begin REF_CHARACTERISTIC KtAEBS_LongBuffer_Pedstrn /end REF_CHARACTERISTIC /end GROUP
/begin GROUP S141_VehicleBusTruck "AEBS_subsystem_integrated/AEBS/AEBS_Enabled/AEB_FCWVIPTargetSelection/Calc_obs_lateral_long_buffer/Calc_Lateral_long_buffer/Calc_long_buffer/VehicleBusTruck" /begin REF_CHARACTERISTIC KtAEBS_LongBuffer_Vehicle /end REF_CHARACTERISTIC /end GROUP
/begin GROUP ARBT_subsystem_integrated "ARBT_subsystem_integrated" ROOT /begin SUB_GROUP Root_ARBTIntegrated /end SUB_GROUP /begin REF_MEASUREMENT VbHWIO_DriverModeComd /end REF_MEASUREMENT /end GROUP
/begin GROUP Root_ARBTIntegrated "ARBT_subsystem_integrated/ARBTIntegrated"
 /begin SUB_GROUP S1_AccessoryArbitration S1_BrakeArbitration S1_PowerArbitration S1_RecordTriggerArbitration S1_SteerArbitration S1_WarningArbitration /end SUB_GROUP
/end GROUP
/begin GROUP S1_AccessoryArbitration "ARBT_subsystem_integrated/ARBTIntegrated/AccessoryArbitration"
 /begin SUB_GROUP S3_DtrmnVehStandStill S3_ElectricParkingBrakeControl S3_GearPosControl /end SUB_GROUP
 /begin REF_CHARACTERISTIC KbARBT_SLEW_autohold_active KbARBT_SLEW_gear_ctrl_accel_req KfARBT_autohold_timeout /end REF_CHARACTERISTIC
/end GROUP
/begin GROUP S1_BrakeArbitration "ARBT_subsystem_integrated/ARBTIntegrated/BrakeArbitration"
 /begin REF_CHARACTERISTIC KfARBT_brake_req_lon_a_lowerlimit KfARBT_brake_req_lon_a_upperlimit /end REF_CHARACTERISTIC
 /begin REF_MEASUREMENT VbARBT_brake_ctrl_enbl_to_comm VeARBT_brake_arbt_winner VfARBT_brake_req_lon_a VfARBT_brake_req_lon_a_raw /end REF_MEASUREMENT
/end GROUP
/begin GROUP S1_PowerArbitration "ARBT_subsystem_integrated/ARBTIntegrated/PowerArbitration"
 /begin REF_CHARACTERISTIC KbARBT_power_req_mode_man_ctrl_temp KfARBT_power_req_lon_a_lowerlimit KfARBT_power_req_lon_a_upperlimit /end REF_CHARACTERISTIC
 /begin REF_MEASUREMENT VbARBT_power_ctrl_enbl_to_comm VeARBT_power_arbt_winner VfARBT_power_req_lon_a VfARBT_power_req_lon_a_raw VfARBT_power_req_mode VfARBT_power_req_torque /end REF_MEASUREMENT
/end GROUP
/begin GROUP S1_RecordTriggerArbitration "ARBT_subsystem_integrated/ARBTIntegrated/RecordTriggerArbitration"
 /begin REF_CHARACTERISTIC KfARBT_brk_ped_pos_thrsh_rec_trig KfARBT_lon_a_thrsh_rec_trig KfARBT_t_false_aeb_time_gap_thrsh KfARBT_t_hard_brake_debounce_time KfARBT_t_hard_brake_time_out KfARBT_t_missed_aeb_time_gap_thrsh /end REF_CHARACTERISTIC
 /begin REF_MEASUREMENT VbARBT_aeb_triggered_flag VbARBT_driver_hard_brake_flag VbARBT_false_aeb_flag VbARBT_missed_aeb_flag /end REF_MEASUREMENT
/end GROUP
/begin GROUP S1_SteerArbitration "ARBT_subsystem_integrated/ARBTIntegrated/SteerArbitration"
 /begin REF_CHARACTERISTIC KfARBT_steer_req_strwhl_angle_lowerlimit KfARBT_steer_req_strwhl_angle_upperlimit /end REF_CHARACTERISTIC
 /begin REF_MEASUREMENT VbARBT_steer_ctrl_enbl_to_comm VeARBT_steer_arbt_winner VfARBT_steer_req_mode VfARBT_steer_req_strwhl_angle VfARBT_steer_req_strwhl_angle_raw VfARBT_steer_req_strwhl_torque /end REF_MEASUREMENT
/end GROUP
/begin GROUP S1_WarningArbitration "ARBT_subsystem_integrated/ARBTIntegrated/WarningArbitration"
 /begin REF_MEASUREMENT VbARBT_FCW_level_one VbARBT_FCW_level_two VbARBT_LCW_left_level_one VbARBT_LCW_left_level_two VbARBT_LCW_right_level_one VbARBT_LCW_right_level_two VbARBT_LDW_left VbARBT_LDW_right /end REF_MEASUREMENT
/end GROUP
/begin GROUP S3_DtrmnVehStandStill "ARBT_subsystem_integrated/ARBTIntegrated/AccessoryArbitration/DtrmnVehStandStill"
 /begin REF_CHARACTERISTIC KfARBT_t_speed_debounce_time KfARBT_v_moving_speed_thrsh KfARBT_v_standstill_speed_thrsh /end REF_CHARACTERISTIC
 /begin REF_MEASUREMENT VbARBT_vehicle_standstill /end REF_MEASUREMENT
/end GROUP
/begin GROUP S3_ElectricParkingBrakeControl "ARBT_subsystem_integrated/ARBTIntegrated/AccessoryArbitration/ElectricParkingBrakeControl" /begin REF_CHARACTERISTIC KbARBT_gear_pos_fedbck_valid /end REF_CHARACTERISTIC
 /begin REF_MEASUREMENT VbARBT_EPB_ctrl_enbl_to_comm VbARBT_EPB_ctrl_mode VbARBT_EPB_switch_request /end REF_MEASUREMENT
/end GROUP
/begin GROUP S3_GearPosControl "ARBT_subsystem_integrated/ARBTIntegrated/AccessoryArbitration/GearPosControl"
 /begin REF_MEASUREMENT VbARBT_auto_hold_req VbARBT_gear_ctrl_enbl_to_comm VfARBT_gear_ctrl_state VfARBT_gear_pos_req /end REF_MEASUREMENT
/end GROUP
/begin GROUP COMM_subsystem_integrated "COMM_subsystem_integrated" ROOT /begin SUB_GROUP Root_Receive Root_Transmit /end SUB_GROUP
 /begin REF_MEASUREMENT VbHWIO_DriverModeComd VbHWIO_LeftTurningLightState VbHWIO_RightTurningLightState /end REF_MEASUREMENT
/end GROUP
/begin GROUP Root_Receive "COMM_subsystem_integrated/Receive" /begin SUB_GROUP S1_Subsystem S1_iEV7S S1_iVISTA /end SUB_GROUP /begin REF_CHARACTERISTIC KbCOMM_VEH_UseNewConfig KcCOMM_VehicleCANbusConfig /end REF_CHARACTERISTIC
 /begin REF_MEASUREMENT VbCOMM_HandsOffWheelDetected VbCOMM_HandsOnWheelDetected VcCOMM_Auto_To_Manual_Tips VcCOMM_Decs_FedBck_BrkPedSts VcCOMM_Decs_FedBck_Drivemod VcCOMM_Decs_FedBck_EPBstate VcCOMM_Decs_FedBck_EPSmod VcCOMM_Decs_FedBck_ESCmod VcCOMM_Decs_FedBck_GearValue VcCOMM_Decs_FedBck_KeyState VcCOMM_DriverModeComd VcCOMM_VCU_DirIndicationLH VcCOMM_VCU_DirIndicationRH VcCOMM_VCU_HeadLampHighBeam VcCOMM_VCU_HeadLampLowBeam VfCOMM_AccPedl VfCOMM_Actual_Gear_Ratio VfCOMM_Decs_FedBck_StrAngle VfCOMM_Decs_FedBck_VehSpd VfCOMM_EPS_SteeringTorqueAct VfCOMM_VCU_BrkPedPos VfCOMM_VCU_ESCWhlFLSpd VfCOMM_VCU_ESCWhlFRSpd VfCOMM_VCU_ESCWhlRLSpd VfCOMM_VCU_ESCWhlRRSpd VfCOMM_VCU_LateralAcc VfCOMM_VCU_LongitudinalAcc VfCOMM_VCU_YawRate /end REF_MEASUREMENT
/end GROUP
/begin GROUP Root_Transmit "COMM_subsystem_integrated/Transmit" /begin SUB_GROUP S2_FAW S2_ICPV S2_Test_Mode /end SUB_GROUP
 /begin REF_CHARACTERISTIC KcCOMM_Test_Cmd_EPSXBW_En KcCOMM_Test_Cmd_EPSXBW_En_ovr KcCOMM_Test_Cmd_StrAngle KcCOMM_Test_Cmd_StrAngle_ovr KcCOMM_Test_Decs_Acc_Req KcCOMM_Test_Decs_Acc_Req_ovr KcCOMM_Test_Decs_Acc_Value KcCOMM_Test_Decs_Acc_Value_ovr KcCOMM_Test_Decs_Breake_Req KcCOMM_Test_Decs_Breake_Req_ovr KcCOMM_Test_Decs_Breake_Value KcCOMM_Test_Decs_Breake_Value_ovr KcCOMM_Test_mode KcCOMM_VehicleCANbusConfig /end REF_CHARACTERISTIC
 /begin REF_MEASUREMENT VbCOMM_Decs_BckfogLmp_Req VbCOMM_Decs_BrkLight_Req VbCOMM_Decs_DippedBeam_Req VbCOMM_Decs_FrontFogLamp_Req VbCOMM_Decs_HighBeam_Req VbCOMM_Decs_Horn_Req VbCOMM_Decs_LftLmp_Req VbCOMM_Decs_Light_Req VbCOMM_Decs_RihtLmp_Req VbCOMM_Decs_WarnLight_Req VbCOMM_Decs_iBCM_Req VcCOMM_Decs_Acc_Req VcCOMM_Decs_Breake_Req VcCOMM_Decs_Control_mod VcCOMM_Decs_Gear_Req VcCOMM_Decs_Gear_Value VcCOMM_Decs_Steering_Req VcCOMM_EPB_control_enable VcCOMM_EPB_switch_request VfCOMM_Decs_Acc_Value VfCOMM_Decs_Breake_Value VfCOMM_Decs_SteeringAngle VfCOMM_req_pct_torque_raw /end REF_MEASUREMENT
/end GROUP
/begin GROUP S1_Subsystem "COMM_subsystem_integrated/Receive/Subsystem"
 /begin REF_CHARACTERISTIC KfACCS_d_VEH_WheelDiameter KfCOMM_Ang_VEH_AngOrigin2FrontWheel KfCOMM_VEH_Mass KfCOMM_VEH_StiffnessFront KfCOMM_VEH_StiffnessRear KfCOMM_VEH_YawInertia_Z KfCOMM_d_VEH_DisCentorid2Front KfCOMM_d_VEH_DisFront2Rear KfCOMM_d_VEH_DisLeft2Right KfCOMM_d_VEH_DisOrigin2End KfCOMM_d_VEH_DisOrigin2FrontWheel KfCOMM_d_VEH_DisOrigin2Head KfCOMM_d_VEH_DisOrigin2RearAxle KfCOMM_d_VEH_Length KfCOMM_d_VEH_MinTurnRadius KfCOMM_d_VEH_Width /end REF_CHARACTERISTIC
/end GROUP
/begin GROUP S1_iEV7S "COMM_subsystem_integrated/Receive/iEV7S" /begin REF_CHARACTERISTIC KfCOMM_a_VCULongAccOffset KfCOMM_r_VCULongAccSlope /end REF_CHARACTERISTIC /end GROUP
/begin GROUP S1_iVISTA "COMM_subsystem_integrated/Receive/iVISTA" /begin REF_CHARACTERISTIC KfCOMM_a_VCULongAccOffset KfCOMM_r_VCULongAccSlope /end REF_CHARACTERISTIC /end GROUP
/begin GROUP S2_FAW "COMM_subsystem_integrated/Transmit/FAW" /begin SUB_GROUP S40_Command_Mapping /end SUB_GROUP /begin REF_CHARACTERISTIC KcCOMM_FirstGearRatio /end REF_CHARACTERISTIC /begin REF_MEASUREMENT VfCOMM_req_pct_torque_final /end REF_MEASUREMENT /end GROUP
/begin GROUP S2_ICPV "COMM_subsystem_integrated/Transmit/ICPV" /begin SUB_GROUP S41_EPB_clamped S41_EPB_released S41_EPB_releasing /end SUB_GROUP
 /begin REF_CHARACTERISTIC KcCOMM_BrakePedalMax KcCOMM_BrakePedalMin KcCOMM_GasPedalMax KcCOMM_GasPedalMin /end REF_CHARACTERISTIC
 /begin REF_MEASUREMENT VcCOMM_max_gas_pedal_EPB /end REF_MEASUREMENT
/end GROUP
/begin GROUP S2_Test_Mode "COMM_subsystem_integrated/Transmit/Test_Mode"
 /begin REF_CHARACTERISTIC KbCOMM_Test_BckFogLamp_Req KbCOMM_Test_BrakePrechargeRequest KbCOMM_Test_BrakePriorityMode KbCOMM_Test_Cmd_BrakeLightReq KbCOMM_Test_Cmd_EPSDir KbCOMM_Test_Decs_DippedBeam_Req KbCOMM_Test_Decs_HighBeam_Req KbCOMM_Test_Decs_LftLmp_Req KbCOMM_Test_Decs_Light_Req KbCOMM_Test_Decs_RihtLmp_Req KbCOMM_Test_Decs_iBCM_Req KbCOMM_Test_FrontFogLamp_Req KbCOMM_Test_Horn_Req KbCOMM_Test_HummerSts KbCOMM_Test_WarnLight_Req KcCOMM_Test_Checksum_0x150 KcCOMM_Test_Checksum_0x151 KcCOMM_Test_Cmd_ATOModEnable KcCOMM_Test_Cmd_AccPelEnable KcCOMM_Test_Cmd_AccPelPosAct KcCOMM_Test_Cmd_AccPelPosActInv KcCOMM_Test_Cmd_BrkPelEnable KcCOMM_Test_Cmd_BrkPelPosAct KcCOMM_Test_Cmd_BrkPelPosActInv KcCOMM_Test_Cmd_Checksum KcCOMM_Test_Cmd_EPSXBW_En KcCOMM_Test_Cmd_ICPDTC KcCOMM_Test_Cmd_RCnt KcCOMM_Test_Cmd_StrAngle KcCOMM_Test_Cmd_StrAngleLimit KcCOMM_Test_Cmd_StrAngleSpd KcCOMM_Test_Cmd_TgtSft KcCOMM_Test_Cmd_TgtSftEnable KcCOMM_Test_Cmd_VCUCnt KcCOMM_Test_Decs_Acc_Mod KcCOMM_Test_Decs_Acc_Req KcCOMM_Test_Decs_Acc_Value KcCOMM_Test_Decs_Breake_Req KcCOMM_Test_Decs_Breake_Value KcCOMM_Test_Over_Speed KcCOMM_Test_RCnt_0x150 KcCOMM_Test_RCnt_0x151 KcCOMM_Test_SlowDown_Indication KcCOMM_Test_SpeedUp_Indication KcCOMM_Test_Stop_Request KcCOMM_Test_Tar_Torq KcCOMM_Test_Tar_vehiclespd KcCOMM_Test_XBR_EBI_Mode KcCOMM_Test_XBR_Priority KcCOMM_Test_acceleration_fb KcCOMM_Test_cmd_VCUChecksum KcCOMM_Test_driveoff_Req KcCOMM_Test_yaw_rate_fb /end REF_CHARACTERISTIC
/end GROUP
/begin GROUP S40_Command_Mapping "COMM_subsystem_integrated/Transmit/FAW/Command_Mapping" /begin SUB_GROUP S46_T03 /end SUB_GROUP /begin REF_CHARACTERISTIC KbCOMM_Test_Decs_iBCM_Req /end REF_CHARACTERISTIC /end GROUP
/begin GROUP S41_EPB_clamped "COMM_subsystem_integrated/Transmit/ICPV/EPB_clamped" /begin REF_CHARACTERISTIC KcCOMM_GasPedalMinEPB /end REF_CHARACTERISTIC /end GROUP
/begin GROUP S41_EPB_released "COMM_subsystem_integrated/Transmit/ICPV/EPB_released" /begin REF_CHARACTERISTIC KcCOMM_GasPedalMax KcCOMM_GasPedalRampEPB /end REF_CHARACTERISTIC /end GROUP
/begin GROUP S41_EPB_releasing "COMM_subsystem_integrated/Transmit/ICPV/EPB_releasing" /begin REF_CHARACTERISTIC KcCOMM_GasPedalMaxEPB KcCOMM_GasPedalRampEPB /end REF_CHARACTERISTIC /end GROUP
/begin GROUP S46_T03 "COMM_subsystem_integrated/Transmit/FAW/Command_Mapping/T03"
 /begin REF_CHARACTERISTIC KcCOMM_TorqCtrlPriority_Active KcCOMM_TorqCtrlPriority_Default /end REF_CHARACTERISTIC
/end GROUP
/begin GROUP DCSN_subsystem_integrated "DCSN_subsystem_integrated" ROOT /begin SUB_GROUP Root_DtrmnDCSN_Integrated /end SUB_GROUP /end GROUP
/begin GROUP Root_DtrmnDCSN_Integrated "DCSN_subsystem_integrated/DtrmnDCSN_Integrated"
 /begin SUB_GROUP S1_DtrmnDCSN_ADM S1_DtrmnDCSN_EnablingManager S1_DtrmnDCSN_TrafficDecider /end SUB_GROUP
/end GROUP
/begin GROUP S1_DtrmnDCSN_ADM "DCSN_subsystem_integrated/DtrmnDCSN_Integrated/DtrmnDCSN_ADM"
 /begin SUB_GROUP S3_CheckDCSN_ACCS_mode S3_CheckDCSN_UsrSwitchStatus S3_DtrmnDCSN_ADMMainManager S3_DtrmnDCSN_DRIVIintentionSimu S3_DtrmnDCSN_InitializationManager /end SUB_GROUP
 /begin REF_CHARACTERISTIC KbDCSN_accs_resume_man_enbl KbDCSN_accs_resume_man_value KbDCSN_use_EgmoLinearSpeed KbDCSN_use_EgmoReadyFlag /end REF_CHARACTERISTIC
 /begin REF_MEASUREMENT VbDCSN_accs_resume /end REF_MEASUREMENT
/end GROUP
/begin GROUP S1_DtrmnDCSN_EnablingManager "DCSN_subsystem_integrated/DtrmnDCSN_Integrated/DtrmnDCSN_EnablingManager"
 /begin SUB_GROUP S4_DtrmnDCSN_ActiveFeatureSwitch S4_DtrmnDCSN_AutoDriveModeManager S4_DtrmnDCSN_EpbCtrlSwitch S4_DtrmnDCSN_GearCtrlSwitch S4_DtrmnDCSN_PowerControlInhibit S4_DtrmnDCSN_SteerCtrlSwitch S4_Dtrmn_EnablingFlagsOSP /end SUB_GROUP
 /begin REF_CHARACTERISTIC KbDCSN_aeb_usr_switch KbDCSN_fcw_usr_switch KbDCSN_lcw_usr_switch KbDCSN_ldw_usr_switch KbDCSN_lka_usr_switch KbDCSN_use_EgmoReadyFlag /end REF_CHARACTERISTIC
/end GROUP
/begin GROUP S1_DtrmnDCSN_TrafficDecider "DCSN_subsystem_integrated/DtrmnDCSN_Integrated/DtrmnDCSN_TrafficDecider"
 /begin SUB_GROUP S5_CalcDCSN_OverSpeedWarning S5_CalcDCSN_SpeedLimit S5_CalcDCSN_StopRequest S5_CheckDCSN_InputDataValidity S5_CvrtDCSN_DataSelector S5_DtrmnDCSN_ChangeLaneReq S5_MngDCSN_TrafficDeciderManager S5_MngDCSN_TrafficDeciderOutputM /end SUB_GROUP
/end GROUP
/begin GROUP S3_CheckDCSN_ACCS_mode "DCSN_subsystem_integrated/DtrmnDCSN_Integrated/DtrmnDCSN_ADM/CheckDCSN_ACCS_mode" /begin REF_MEASUREMENT VbDCSN_ACC_ready_to_engage /end REF_MEASUREMENT /end GROUP
/begin GROUP S3_CheckDCSN_UsrSwitchStatus "DCSN_subsystem_integrated/DtrmnDCSN_Integrated/DtrmnDCSN_ADM/CheckDCSN_UsrSwitchStatus"
 /begin REF_CHARACTERISTIC KbDCSN_use_vehicle_activate_switch KcDCSN_t_usr_activate_cmd_send_count KeDCSN_usr_cmd_autodrive_activate_man /end REF_CHARACTERISTIC
 /begin REF_MEASUREMENT VeDCSN_usr_cmd_autodrive_activate /end REF_MEASUREMENT
/end GROUP
/begin GROUP S3_DtrmnDCSN_ADMMainManager "DCSN_subsystem_integrated/DtrmnDCSN_Integrated/DtrmnDCSN_ADM/DtrmnDCSN_ADMMainManager"
 /begin SUB_GROUP S8_CheckDCSN_SystemFaultCheck S8_CheckDCSN_VehicleStateCheck S8_DtrmnDCSN_CondActivation /end SUB_GROUP
 /begin REF_CHARACTERISTIC KbDCSN_adm_main_mode_man_ctrl KbDCSN_adm_temp_stop_finished KbDCSN_adm_temp_usr_cmd_autodrive_enabled KeDCSN_adm_main_mode_man_value KeDCSN_adm_temp_diag_system_fault KfDCSN_t_max_time_fault_warning KfDCSN_t_max_time_to_takeover KfDCSN_v_adm_temp_veh_setspeed KfDCSN_v_setspeed_thrsh_hi /end REF_CHARACTERISTIC
 /begin REF_MEASUREMENT VeDCSN_adm_main_mode VeDCSN_hmi_icon_display VeDCSN_hmi_msg_display /end REF_MEASUREMENT
/end GROUP
/begin GROUP S3_DtrmnDCSN_DRIVIintentionSimu "DCSN_subsystem_integrated/DtrmnDCSN_Integrated/DtrmnDCSN_ADM/DtrmnDCSN_DRIVIintentionSimu"
 /begin SUB_GROUP S9_DtrmnDCSN_FAWTorqueOverride S9_DtrmnDCSN_TakeOverLogicFAW S9_SteerOvrrideTorque S9_SteerResumeTorque /end SUB_GROUP
 /begin REF_CHARACTERISTIC KfDCSN_t_adm_temp_steering_ovrd_delay KfDCSN_t_adm_temp_steering_resume_delay /end REF_CHARACTERISTIC
 /begin REF_MEASUREMENT VbDCSN_adm_steering_override VbDCSN_adm_steering_resume /end REF_MEASUREMENT
/end GROUP
/begin GROUP S4_DtrmnDCSN_SteerCtrlSwitch "DCSN_subsystem_integrated/DtrmnDCSN_Integrated/DtrmnDCSN_EnablingManager/DtrmnDCSN_SteerCtrlSwitch" /begin REF_CHARACTERISTIC KbDCSN_adm_main_mode_man_ctrl /end REF_CHARACTERISTIC /end GROUP
/end MODULE
/end PROJECT
