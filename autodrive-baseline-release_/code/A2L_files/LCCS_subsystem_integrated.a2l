/******************************************************************************
* ASAP2 file: LCCS_subsystem_integrated.a2l
* Code generation for model "LCCS_subsystem_integrated".
* Model version : 1.2176
* Simulink Coder version : 8.13 (R2017b) 24-Jul-2017
* C source code generated on : Wed Jun 10 09:34:46 2020
* Target selection: ert.tlc
* Embedded hardware selection: Infineon->TriCore
* Code generation objectives:
* 1. MISRA C:2012 guidelines
* 2. Safety precaution
* 3. Execution efficiency
* 4. RAM efficiency
* 5. ROM efficiency
* Validation result: Not run
* (add additional file header information here)
******************************************************************************/ ASAP2_VERSION 1 31
/* Version 1.31 */
/begin PROJECT ProjectName "Project Comment Goes Here"
/begin HEADER "Header Comments go here" /end HEADER
/begin MODULE ModuleName "Module Comment Goes Here"
/begin MOD_PAR "MOD PAR Comment Goes Here" /end MOD_PAR
/begin MOD_COMMON "Mod Common Comment Here" BYTE_ORDER MSB_LAST /end MOD_COMMON
/begin RECORD_LAYOUT Scalar_BOOLEAN FNC_VALUES 1 UBYTE COLUMN_DIR DIRECT /end RECORD_LAYOUT
/begin RECORD_LAYOUT Scalar_UBYTE FNC_VALUES 1 UBYTE COLUMN_DIR DIRECT /end RECORD_LAYOUT
/begin RECORD_LAYOUT Scalar_BYTE FNC_VALUES 1 SBYTE COLUMN_DIR DIRECT /end RECORD_LAYOUT
/begin RECORD_LAYOUT Scalar_UWORD FNC_VALUES 1 UWORD COLUMN_DIR DIRECT /end RECORD_LAYOUT
/begin RECORD_LAYOUT Scalar_SWORD FNC_VALUES 1 SWORD COLUMN_DIR DIRECT /end RECORD_LAYOUT
/begin RECORD_LAYOUT Scalar_ULONG FNC_VALUES 1 ULONG COLUMN_DIR DIRECT /end RECORD_LAYOUT
/begin RECORD_LAYOUT Scalar_LONG FNC_VALUES 1 SLONG COLUMN_DIR DIRECT /end RECORD_LAYOUT
/begin RECORD_LAYOUT Scalar_FLOAT32_IEEE FNC_VALUES 1 FLOAT32_IEEE COLUMN_DIR DIRECT /end RECORD_LAYOUT
/begin RECORD_LAYOUT Scalar_FLOAT64_IEEE FNC_VALUES 1 FLOAT64_IEEE COLUMN_DIR DIRECT /end RECORD_LAYOUT
/begin RECORD_LAYOUT Lookup1D_BOOLEAN FNC_VALUES 1 UBYTE COLUMN_DIR DIRECT /end RECORD_LAYOUT
/begin RECORD_LAYOUT Lookup1D_X_BOOLEAN AXIS_PTS_X 1 UBYTE INDEX_INCR DIRECT /end RECORD_LAYOUT
/begin RECORD_LAYOUT Lookup1D_BYTE FNC_VALUES 1 SBYTE COLUMN_DIR DIRECT /end RECORD_LAYOUT
/begin RECORD_LAYOUT Lookup1D_X_BYTE AXIS_PTS_X 1 SBYTE INDEX_INCR DIRECT /end RECORD_LAYOUT
/begin RECORD_LAYOUT Lookup1D_UBYTE FNC_VALUES 1 UBYTE COLUMN_DIR DIRECT /end RECORD_LAYOUT
/begin RECORD_LAYOUT Lookup1D_X_UBYTE AXIS_PTS_X 1 UBYTE INDEX_INCR DIRECT /end RECORD_LAYOUT
/begin RECORD_LAYOUT Lookup1D_UWORD FNC_VALUES 1 UWORD COLUMN_DIR DIRECT /end RECORD_LAYOUT
/begin RECORD_LAYOUT Lookup1D_X_UWORD AXIS_PTS_X 1 UWORD INDEX_INCR DIRECT /end RECORD_LAYOUT
/begin RECORD_LAYOUT Lookup1D_WORD FNC_VALUES 1 SWORD COLUMN_DIR DIRECT /end RECORD_LAYOUT
/begin RECORD_LAYOUT Lookup1D_X_WORD AXIS_PTS_X 1 SWORD INDEX_INCR DIRECT /end RECORD_LAYOUT
/begin RECORD_LAYOUT Lookup1D_ULONG FNC_VALUES 1 ULONG COLUMN_DIR DIRECT /end RECORD_LAYOUT
/begin RECORD_LAYOUT Lookup1D_X_ULONG AXIS_PTS_X 1 ULONG INDEX_INCR DIRECT /end RECORD_LAYOUT
/begin RECORD_LAYOUT Lookup1D_SLONG FNC_VALUES 1 SLONG COLUMN_DIR DIRECT /end RECORD_LAYOUT
/begin RECORD_LAYOUT Lookup1D_X_LONG AXIS_PTS_X 1 SLONG INDEX_INCR DIRECT /end RECORD_LAYOUT
/begin RECORD_LAYOUT Lookup1D_FLOAT32_IEEE FNC_VALUES 1 FLOAT32_IEEE COLUMN_DIR DIRECT /end RECORD_LAYOUT
/begin RECORD_LAYOUT Lookup1D_X_FLOAT32_IEEE AXIS_PTS_X 1 FLOAT32_IEEE INDEX_INCR DIRECT /end RECORD_LAYOUT
/begin RECORD_LAYOUT Lookup1D_FLOAT64_IEEE FNC_VALUES 1 FLOAT64_IEEE COLUMN_DIR DIRECT /end RECORD_LAYOUT
/begin RECORD_LAYOUT Lookup1D_X_FLOAT64_IEEE AXIS_PTS_X 1 FLOAT64_IEEE INDEX_INCR DIRECT /end RECORD_LAYOUT
/begin RECORD_LAYOUT Lookup2D_BOOLEAN FNC_VALUES 1 UBYTE COLUMN_DIR DIRECT /end RECORD_LAYOUT
/begin RECORD_LAYOUT Lookup2D_X_BOOLEAN AXIS_PTS_X 1 UBYTE INDEX_INCR DIRECT /end RECORD_LAYOUT
/begin RECORD_LAYOUT Lookup2D_UBYTE FNC_VALUES 1 UBYTE COLUMN_DIR DIRECT /end RECORD_LAYOUT
/begin RECORD_LAYOUT Lookup2D_X_UBYTE AXIS_PTS_X 1 UBYTE INDEX_INCR DIRECT /end RECORD_LAYOUT
/begin RECORD_LAYOUT Lookup2D_BYTE FNC_VALUES 1 SBYTE COLUMN_DIR DIRECT /end RECORD_LAYOUT
/begin RECORD_LAYOUT Lookup2D_X_BYTE AXIS_PTS_X 1 SBYTE INDEX_INCR DIRECT /end RECORD_LAYOUT
/begin RECORD_LAYOUT Lookup2D_UWORD FNC_VALUES 1 UWORD COLUMN_DIR DIRECT /end RECORD_LAYOUT
/begin RECORD_LAYOUT Lookup2D_X_UWORD AXIS_PTS_X 1 UWORD INDEX_INCR DIRECT /end RECORD_LAYOUT
/begin RECORD_LAYOUT Lookup2D_WORD FNC_VALUES 1 SWORD COLUMN_DIR DIRECT /end RECORD_LAYOUT
/begin RECORD_LAYOUT Lookup2D_X_WORD AXIS_PTS_X 1 SWORD INDEX_INCR DIRECT /end RECORD_LAYOUT
/begin RECORD_LAYOUT Lookup2D_ULONG FNC_VALUES 1 ULONG COLUMN_DIR DIRECT /end RECORD_LAYOUT
/begin RECORD_LAYOUT Lookup2D_X_ULONG AXIS_PTS_X 1 ULONG INDEX_INCR DIRECT /end RECORD_LAYOUT
/begin RECORD_LAYOUT Lookup2D_LONG FNC_VALUES 1 SLONG COLUMN_DIR DIRECT /end RECORD_LAYOUT
/begin RECORD_LAYOUT Lookup2D_X_LONG AXIS_PTS_X 1 SLONG INDEX_INCR DIRECT /end RECORD_LAYOUT
/begin RECORD_LAYOUT Lookup2D_FLOAT32_IEEE FNC_VALUES 1 FLOAT32_IEEE COLUMN_DIR DIRECT /end RECORD_LAYOUT
/begin RECORD_LAYOUT Lookup2D_X_FLOAT32_IEEE AXIS_PTS_X 1 FLOAT32_IEEE INDEX_INCR DIRECT /end RECORD_LAYOUT
/begin RECORD_LAYOUT Lookup2D_FLOAT64_IEEE FNC_VALUES 1 FLOAT64_IEEE COLUMN_DIR DIRECT /end RECORD_LAYOUT
/begin RECORD_LAYOUT Lookup2D_X_FLOAT64_IEEE AXIS_PTS_X 1 FLOAT64_IEEE INDEX_INCR DIRECT /end RECORD_LAYOUT
/begin CHARACTERISTIC KtLCCS_k_LanemarkMergeCoef "Lane marker merging filter coef." CURVE 0x0000 /* @ECU_Address@KtLCCS_k_LanemarkMergeCoef@ */ Lookup1D_FLOAT32_IEEE 0 LCCS_subsystem_integrated_CM_single 0.001 1.0
 /begin AXIS_DESCR COM_AXIS VfLCCS_left_lanemark_switch_time LCCS_subsystem_integrated_CM_single_s 21 0.0 10.0 AXIS_PTS_REF KtLCCS_AXIS_lanemark_switch_time /end AXIS_DESCR
/end CHARACTERISTIC
/begin AXIS_PTS KtLCCS_AXIS_lanemark_switch_time "Lane marker switch time." 0x0000 /* @ECU_Address@KtLCCS_AXIS_lanemark_switch_time@ */ VfLCCS_left_lanemark_switch_time Lookup1D_X_FLOAT32_IEEE 0 LCCS_subsystem_integrated_CM_single_s 21 0.0 10.0 /end AXIS_PTS
/begin CHARACTERISTIC KtLCCS_d_lookahead_distance "Vehicle lookahead distance." MAP 0x0000 /* @ECU_Address@KtLCCS_d_lookahead_distance@ */ Lookup2D_FLOAT32_IEEE 0 LCCS_subsystem_integrated_CM_single_m -3.4E+38 3.4E+38
 /begin AXIS_DESCR /* Description of Y-Axis Points */ COM_AXIS VfLCCS_linear_velocity LCCS_subsystem_integrated_CM_single 21 -3.4E+38 3.4E+38 AXIS_PTS_REF KtLCCS_AXIS_vehicle_speed /end AXIS_DESCR
 /begin AXIS_DESCR COM_AXIS NO_INPUT_QUANTITY LCCS_subsystem_integrated_CM_single 5 -3.4E+38 3.4E+38 AXIS_PTS_REF KtLCCS_AXIS_route_curvature /end AXIS_DESCR
/end CHARACTERISTIC
/begin AXIS_PTS KtLCCS_AXIS_route_curvature "Curvature axis." 0x0000 /* @ECU_Address@KtLCCS_AXIS_route_curvature@ */ NO_INPUT_QUANTITY Lookup2D_X_FLOAT32_IEEE 0 LCCS_subsystem_integrated_CM_single 5 -3.4E+38 3.4E+38 /end AXIS_PTS
/begin AXIS_PTS KtLCCS_AXIS_vehicle_speed "Vehicle speed axis." 0x0000 /* @ECU_Address@KtLCCS_AXIS_vehicle_speed@ */ VfLCCS_linear_velocity Lookup2D_X_FLOAT32_IEEE 0 LCCS_subsystem_integrated_CM_single 21 -3.4E+38 3.4E+38 /end AXIS_PTS
/begin CHARACTERISTIC KtLCCS_Ang_steering_angle_reentry_zone "Steering angle delta limit for re-engage control. Unit: degree." CURVE 0x0000 /* @ECU_Address@KtLCCS_Ang_steering_angle_reentry_zone@ */ Lookup1D_FLOAT32_IEEE 0 LCCS_subsystem_integrated_CM_single -3.4E+38 3.4E+38
 /begin AXIS_DESCR COM_AXIS VfLCCS_linear_velocity LCCS_subsystem_integrated_CM_single 21 -3.4E+38 3.4E+38 AXIS_PTS_REF KtLCCS_AXIS_vehicle_speed /end AXIS_DESCR
/end CHARACTERISTIC
/begin CHARACTERISTIC KtLCCS_heading_err_correction "Correction for heading error." CURVE 0x0000 /* @ECU_Address@KtLCCS_heading_err_correction@ */ Lookup1D_FLOAT32_IEEE 0 LCCS_subsystem_integrated_CM_single -3.4E+38 3.4E+38
 /begin AXIS_DESCR COM_AXIS NO_INPUT_QUANTITY LCCS_subsystem_integrated_CM_single_rad 21 0.0 0.1 AXIS_PTS_REF KtLCCS_AXIS_heading_error /end AXIS_DESCR
/end CHARACTERISTIC
/begin AXIS_PTS KtLCCS_AXIS_heading_error "AXIS for heading error." 0x0000 /* @ECU_Address@KtLCCS_AXIS_heading_error@ */ NO_INPUT_QUANTITY Lookup1D_X_FLOAT32_IEEE 0 LCCS_subsystem_integrated_CM_single_rad 21 0.0 0.1 /end AXIS_PTS
/begin CHARACTERISTIC KtLCCS_heading_err_gain_scheduler "Gain for heading error scheduler." CURVE 0x0000 /* @ECU_Address@KtLCCS_heading_err_gain_scheduler@ */ Lookup1D_FLOAT32_IEEE 0 LCCS_subsystem_integrated_CM_single -3.4E+38 3.4E+38
 /begin AXIS_DESCR COM_AXIS NO_INPUT_QUANTITY LCCS_subsystem_integrated_CM_single 21 -3.4E+38 3.4E+38 AXIS_PTS_REF KtLCCS_AXIS_vehicle_speed /end AXIS_DESCR
/end CHARACTERISTIC
/begin CHARACTERISTIC KtLCCS_heading_err_rate_correction "Correction for heading error rate." CURVE 0x0000 /* @ECU_Address@KtLCCS_heading_err_rate_correction@ */ Lookup1D_FLOAT32_IEEE 0 LCCS_subsystem_integrated_CM_single -3.4E+38 3.4E+38
 /begin AXIS_DESCR COM_AXIS NO_INPUT_QUANTITY LCCS_subsystem_integrated_CM_single 21 -3.4E+38 3.4E+38 AXIS_PTS_REF KtLCCS_AXIS_vehicle_speed /end AXIS_DESCR
/end CHARACTERISTIC
/begin CHARACTERISTIC KtLCCS_heading_err_rate_gain_scheduler "Gain for heading error scheduler." CURVE 0x0000 /* @ECU_Address@KtLCCS_heading_err_rate_gain_scheduler@ */ Lookup1D_FLOAT32_IEEE 0 LCCS_subsystem_integrated_CM_single -3.4E+38 3.4E+38
 /begin AXIS_DESCR COM_AXIS NO_INPUT_QUANTITY LCCS_subsystem_integrated_CM_single 21 -3.4E+38 3.4E+38 AXIS_PTS_REF KtLCCS_AXIS_vehicle_speed /end AXIS_DESCR
/end CHARACTERISTIC
/begin CHARACTERISTIC KtLCCS_lateral_err_correction "Correction for lateral error." CURVE 0x0000 /* @ECU_Address@KtLCCS_lateral_err_correction@ */ Lookup1D_FLOAT32_IEEE 0 LCCS_subsystem_integrated_CM_single -1.0 1.0
 /begin AXIS_DESCR COM_AXIS NO_INPUT_QUANTITY LCCS_subsystem_integrated_CM_single 21 -3.4E+38 3.4E+38 AXIS_PTS_REF KtLCCS_AXIS_vehicle_speed /end AXIS_DESCR
/end CHARACTERISTIC
/begin CHARACTERISTIC KtLCCS_lateral_err_gain_scheduler "Gain for lateral error scheduler." CURVE 0x0000 /* @ECU_Address@KtLCCS_lateral_err_gain_scheduler@ */ Lookup1D_FLOAT32_IEEE 0 LCCS_subsystem_integrated_CM_single -3.4E+38 3.4E+38
 /begin AXIS_DESCR COM_AXIS NO_INPUT_QUANTITY LCCS_subsystem_integrated_CM_single 21 -3.4E+38 3.4E+38 AXIS_PTS_REF KtLCCS_AXIS_vehicle_speed /end AXIS_DESCR
/end CHARACTERISTIC
/begin CHARACTERISTIC KtLCCS_lateral_err_rate_correction "Correction for lateral error rate." CURVE 0x0000 /* @ECU_Address@KtLCCS_lateral_err_rate_correction@ */ Lookup1D_FLOAT32_IEEE 0 LCCS_subsystem_integrated_CM_single -1.0 1.0
 /begin AXIS_DESCR COM_AXIS NO_INPUT_QUANTITY LCCS_subsystem_integrated_CM_single 21 -3.4E+38 3.4E+38 AXIS_PTS_REF KtLCCS_AXIS_vehicle_speed /end AXIS_DESCR
/end CHARACTERISTIC
/begin CHARACTERISTIC KtLCCS_lateral_err_rate_gain_scheduler "Gain for lateral error rate scheduler." CURVE 0x0000 /* @ECU_Address@KtLCCS_lateral_err_rate_gain_scheduler@ */ Lookup1D_FLOAT32_IEEE 0 LCCS_subsystem_integrated_CM_single -3.4E+38 3.4E+38
 /begin AXIS_DESCR COM_AXIS NO_INPUT_QUANTITY LCCS_subsystem_integrated_CM_single 21 -3.4E+38 3.4E+38 AXIS_PTS_REF KtLCCS_AXIS_vehicle_speed /end AXIS_DESCR
/end CHARACTERISTIC
/begin CHARACTERISTIC KtLCCS_slowpath_steer_I_gain "Gain for slowpath steer I part." CURVE 0x0000 /* @ECU_Address@KtLCCS_slowpath_steer_I_gain@ */ Lookup1D_FLOAT32_IEEE 0 LCCS_subsystem_integrated_CM_single -3.4E+38 3.4E+38
 /begin AXIS_DESCR COM_AXIS NO_INPUT_QUANTITY LCCS_subsystem_integrated_CM_single 21 -3.4E+38 3.4E+38 AXIS_PTS_REF KtLCCS_AXIS_vehicle_speed /end AXIS_DESCR
/end CHARACTERISTIC
/begin CHARACTERISTIC KtLCCS_slowpath_steer_P_gain "Gain for slowpath steer P part." CURVE 0x0000 /* @ECU_Address@KtLCCS_slowpath_steer_P_gain@ */ Lookup1D_FLOAT32_IEEE 0 LCCS_subsystem_integrated_CM_single -3.4E+38 3.4E+38
 /begin AXIS_DESCR COM_AXIS NO_INPUT_QUANTITY LCCS_subsystem_integrated_CM_single 21 -3.4E+38 3.4E+38 AXIS_PTS_REF KtLCCS_AXIS_vehicle_speed /end AXIS_DESCR
/end CHARACTERISTIC
/begin CHARACTERISTIC KtLCCS_t_lateral_oscillation_period "THe control period of lateral oscillation." CURVE 0x0000 /* @ECU_Address@KtLCCS_t_lateral_oscillation_period@ */ Lookup1D_FLOAT32_IEEE 0 LCCS_subsystem_integrated_CM_single_s 0.0 10.0
 /begin AXIS_DESCR COM_AXIS NO_INPUT_QUANTITY LCCS_subsystem_integrated_CM_single 21 -3.4E+38 3.4E+38 AXIS_PTS_REF KtLCCS_AXIS_vehicle_speed /end AXIS_DESCR
/end CHARACTERISTIC
/begin CHARACTERISTIC KtLCCS_Ang_steering_angle_max "Absolute maximum steering wheel angle. Unit: degree." CURVE 0x0000 /* @ECU_Address@KtLCCS_Ang_steering_angle_max@ */ Lookup1D_FLOAT32_IEEE 0 LCCS_subsystem_integrated_CM_single -3.4E+38 3.4E+38
 /begin AXIS_DESCR COM_AXIS VfLCCS_linear_velocity LCCS_subsystem_integrated_CM_single 21 -3.4E+38 3.4E+38 AXIS_PTS_REF KtLCCS_AXIS_vehicle_speed /end AXIS_DESCR
/end CHARACTERISTIC
/begin CHARACTERISTIC KtLCCS_Ang_steering_angle_step "Desired steering wheel angle moving step per second. Unit: degree/s." CURVE 0x0000 /* @ECU_Address@KtLCCS_Ang_steering_angle_step@ */ Lookup1D_FLOAT32_IEEE 0 LCCS_subsystem_integrated_CM_single -3.4E+38 3.4E+38
 /begin AXIS_DESCR COM_AXIS VfLCCS_linear_velocity LCCS_subsystem_integrated_CM_single 21 -3.4E+38 3.4E+38 AXIS_PTS_REF KtLCCS_AXIS_vehicle_speed /end AXIS_DESCR
/end CHARACTERISTIC
/begin CHARACTERISTIC KtLCCS_Ang_steering_angle_step_engaging "Desired steering wheel angle moving step per second, when engaging steering control. Unit: degree/s." CURVE 0x0000 /* @ECU_Address@KtLCCS_Ang_steering_angle_step_engaging@ */ Lookup1D_FLOAT32_IEEE 0 LCCS_subsystem_integrated_CM_single -3.4E+38 3.4E+38
 /begin AXIS_DESCR COM_AXIS VfLCCS_linear_velocity LCCS_subsystem_integrated_CM_single 21 -3.4E+38 3.4E+38 AXIS_PTS_REF KtLCCS_AXIS_vehicle_speed /end AXIS_DESCR
/end CHARACTERISTIC
/begin CHARACTERISTIC KfLCCS_Ang_slowpath_steer_limit "Slowpath adjuct limit for front wheel angle. Unit: rad." VALUE 0x0000 /* @ECU_Address@KfLCCS_Ang_slowpath_steer_limit@ */ Scalar_FLOAT32_IEEE 0 LCCS_subsystem_integrated_CM_single -3.4E+38 3.4E+38 /end CHARACTERISTIC
/begin CHARACTERISTIC KfLCCS_Ang_steering_center_position "Steering wheel center position. Unit: degree." VALUE 0x0000 /* @ECU_Address@KfLCCS_Ang_steering_center_position@ */ Scalar_FLOAT32_IEEE 0 LCCS_subsystem_integrated_CM_single -3.4E+38 3.4E+38 /end CHARACTERISTIC
/begin CHARACTERISTIC KfLCCS_LanemarkerQualityThrsh "Lane marker quality thresh, below which that lane marker is not utilized.
      " VALUE 0x0000 /* @ECU_Address@KfLCCS_LanemarkerQualityThrsh@ */ Scalar_FLOAT32_IEEE 0 LCCS_subsystem_integrated_CM_single -3.4E+38 3.4E+38 /end CHARACTERISTIC
/begin CHARACTERISTIC KfLCCS_WeightMatrixStates_R "Regulator matrix for LQR solver.
      " VALUE 0x0000 /* @ECU_Address@KfLCCS_WeightMatrixStates_R@ */ Scalar_FLOAT32_IEEE 0 LCCS_subsystem_integrated_CM_single -3.4E+38 3.4E+38 /end CHARACTERISTIC
/begin CHARACTERISTIC KfLCCS_a_max_lat_acc "Max acceptable lateral acceleration. Unit: m/s^2." VALUE 0x0000 /* @ECU_Address@KfLCCS_a_max_lat_acc@ */ Scalar_FLOAT32_IEEE 0 LCCS_subsystem_integrated_CM_single -3.4E+38 3.4E+38 /end CHARACTERISTIC
/begin CHARACTERISTIC KfLCCS_cf "Corning stiffness for front wheel.
      " VALUE 0x0000 /* @ECU_Address@KfLCCS_cf@ */ Scalar_FLOAT32_IEEE 0 LCCS_subsystem_integrated_CM_single -3.4E+38 3.4E+38 /end CHARACTERISTIC
/begin CHARACTERISTIC KfLCCS_cr "Corning stiffness for rear wheel.
      " VALUE 0x0000 /* @ECU_Address@KfLCCS_cr@ */ Scalar_FLOAT32_IEEE 0 LCCS_subsystem_integrated_CM_single -3.4E+38 3.4E+38 /end CHARACTERISTIC
/begin CHARACTERISTIC KfLCCS_d_LateralErrorDeadBand "Lateral error deadband for slowpath I term." VALUE 0x0000 /* @ECU_Address@KfLCCS_d_LateralErrorDeadBand@ */ Scalar_FLOAT32_IEEE 0 LCCS_subsystem_integrated_CM_single_m 0.0 0.1 /end CHARACTERISTIC
/begin CHARACTERISTIC KfLCCS_d_NudgeSafetyZone "Inlane nudge safety margin between vehicle body and lane marker.
      " VALUE 0x0000 /* @ECU_Address@KfLCCS_d_NudgeSafetyZone@ */ Scalar_FLOAT32_IEEE 0 LCCS_subsystem_integrated_CM_single_m 0.1 1.0 /end CHARACTERISTIC
/begin CHARACTERISTIC KfLCCS_d_RearAxleToCameraOrigin "The distance between rear axle and camera coordinates origin." VALUE 0x0000 /* @ECU_Address@KfLCCS_d_RearAxleToCameraOrigin@ */ Scalar_FLOAT32_IEEE 0 LCCS_subsystem_integrated_CM_single_m 0.0 10.0 /end CHARACTERISTIC
/begin CHARACTERISTIC KfLCCS_d_ValidLaneWidthLimit "" VALUE 0x0000 /* @ECU_Address@KfLCCS_d_ValidLaneWidthLimit@ */ Scalar_FLOAT32_IEEE 0 LCCS_subsystem_integrated_CM_single_m -3.4E+38 3.4E+38 /end CHARACTERISTIC
/begin CHARACTERISTIC KfLCCS_d_VehicleWidth "Vehicle width." VALUE 0x0000 /* @ECU_Address@KfLCCS_d_VehicleWidth@ */ Scalar_FLOAT32_IEEE 0 LCCS_subsystem_integrated_CM_single_m 1.0 3.0 /end CHARACTERISTIC
/begin CHARACTERISTIC KfLCCS_d_lf "Distance between center of mass and front axle.
      " VALUE 0x0000 /* @ECU_Address@KfLCCS_d_lf@ */ Scalar_FLOAT32_IEEE 0 LCCS_subsystem_integrated_CM_single_m -3.4E+38 3.4E+38 /end CHARACTERISTIC
/begin CHARACTERISTIC KfLCCS_d_lr "Distance between center of mass and rear axle.
      " VALUE 0x0000 /* @ECU_Address@KfLCCS_d_lr@ */ Scalar_FLOAT32_IEEE 0 LCCS_subsystem_integrated_CM_single_m -3.4E+38 3.4E+38 /end CHARACTERISTIC
/begin CHARACTERISTIC KfLCCS_d_min_turn_radius "Minimum turn radius at lowest speed.
      " VALUE 0x0000 /* @ECU_Address@KfLCCS_d_min_turn_radius@ */ Scalar_FLOAT32_IEEE 0 LCCS_subsystem_integrated_CM_single_m -3.4E+38 3.4E+38 /end CHARACTERISTIC
/begin CHARACTERISTIC KfLCCS_d_wheel_base "Wheel base." VALUE 0x0000 /* @ECU_Address@KfLCCS_d_wheel_base@ */ Scalar_FLOAT32_IEEE 0 LCCS_subsystem_integrated_CM_single_m 1.0 10.0 /end CHARACTERISTIC
/begin CHARACTERISTIC KfLCCS_eps "Tolerance for LQR solver.
      " VALUE 0x0000 /* @ECU_Address@KfLCCS_eps@ */ Scalar_FLOAT32_IEEE 0 LCCS_subsystem_integrated_CM_single -3.4E+38 3.4E+38 /end CHARACTERISTIC
/begin CHARACTERISTIC KfLCCS_heading_error_rate_limit "High limit for calculated heading error rate.
      " VALUE 0x0000 /* @ECU_Address@KfLCCS_heading_error_rate_limit@ */ Scalar_FLOAT32_IEEE 0 LCCS_subsystem_integrated_CM_single -3.4E+38 3.4E+38 /end CHARACTERISTIC
/begin CHARACTERISTIC KfLCCS_iz "Vehicle yaw inertia around -Z- axis.
      " VALUE 0x0000 /* @ECU_Address@KfLCCS_iz@ */ Scalar_FLOAT32_IEEE 0 LCCS_subsystem_integrated_CM_single -3.4E+38 3.4E+38 /end CHARACTERISTIC
/begin CHARACTERISTIC KfLCCS_k_LaneWidthFilter "Filter to smooth lane width." VALUE 0x0000 /* @ECU_Address@KfLCCS_k_LaneWidthFilter@ */ Scalar_FLOAT32_IEEE 0 LCCS_subsystem_integrated_CM_single 0.0001 1.0 /end CHARACTERISTIC
/begin CHARACTERISTIC KfLCCS_mass "Vehicle mass.
      " VALUE 0x0000 /* @ECU_Address@KfLCCS_mass@ */ Scalar_FLOAT32_IEEE 0 LCCS_subsystem_integrated_CM_single_kg -3.4E+38 3.4E+38 /end CHARACTERISTIC
/begin CHARACTERISTIC KfLCCS_r_MaxLateralSpeedPortion "The maximum ratio of lateral speed over vehicle speed." VALUE 0x0000 /* @ECU_Address@KfLCCS_r_MaxLateralSpeedPortion@ */ Scalar_FLOAT32_IEEE 0 LCCS_subsystem_integrated_CM_single -3.4E+38 3.4E+38 /end CHARACTERISTIC
/begin CHARACTERISTIC KfLCCS_r_YawRateCorrection "Correction factor for Yaw Rate from CAN bus." VALUE 0x0000 /* @ECU_Address@KfLCCS_r_YawRateCorrection@ */ Scalar_FLOAT32_IEEE 0 LCCS_subsystem_integrated_CM_single -1.0 1.0 /end CHARACTERISTIC
/begin CHARACTERISTIC KfLCCS_r_shift_speed_gain "Lateral distance to go multiply by thisgain to calculate lateral shift speed." VALUE 0x0000 /* @ECU_Address@KfLCCS_r_shift_speed_gain@ */ Scalar_FLOAT32_IEEE 0 LCCS_subsystem_integrated_CM_single -3.4E+38 3.4E+38 /end CHARACTERISTIC
/begin CHARACTERISTIC KfLCCS_r_steering_rate_forward_gain "Steering wheel turning speed gain when moving to forward direction." VALUE 0x0000 /* @ECU_Address@KfLCCS_r_steering_rate_forward_gain@ */ Scalar_FLOAT32_IEEE 0 LCCS_subsystem_integrated_CM_single -3.4E+38 3.4E+38 /end CHARACTERISTIC
/begin CHARACTERISTIC KfLCCS_r_veh_strwhl_2_frtwhl_ratio "The gear ratio between steering wheel angle and front wheel angle." VALUE 0x0000 /* @ECU_Address@KfLCCS_r_veh_strwhl_2_frtwhl_ratio@ */ Scalar_FLOAT32_IEEE 0 LCCS_subsystem_integrated_CM_single -3.4E+38 3.4E+38 /end CHARACTERISTIC
/begin CHARACTERISTIC KfLCCS_t_SampleTime "Base control loop time.
      " VALUE 0x0000 /* @ECU_Address@KfLCCS_t_SampleTime@ */ Scalar_FLOAT32_IEEE 0 LCCS_subsystem_integrated_CM_single_s 0.01 0.1 /end CHARACTERISTIC
/begin CHARACTERISTIC KfLCCS_t_TimestampAliveThresh "Timestamp alive thresh to check the diff between EGMO and MPFU messages.." VALUE 0x0000 /* @ECU_Address@KfLCCS_t_TimestampAliveThresh@ */ Scalar_FLOAT32_IEEE 0 LCCS_subsystem_integrated_CM_single_s -3.4E+38 3.4E+38 /end CHARACTERISTIC
/begin CHARACTERISTIC KfLCCS_t_lateral_movement_delay "When vehicle is moving, and steering control is active, lateral movement will be enabled after this time delay." VALUE 0x0000 /* @ECU_Address@KfLCCS_t_lateral_movement_delay@ */ Scalar_FLOAT32_IEEE 0 LCCS_subsystem_integrated_CM_single_s -3.4E+38 3.4E+38 /end CHARACTERISTIC
/begin CHARACTERISTIC KfLCCS_v_shift_speed_high_limit "Lateral shift speed high limit." VALUE 0x0000 /* @ECU_Address@KfLCCS_v_shift_speed_high_limit@ */ Scalar_FLOAT32_IEEE 0 LCCS_subsystem_integrated_CM_single_m_s -3.4E+38 3.4E+38 /end CHARACTERISTIC
/begin CHARACTERISTIC KfLCCS_v_shift_speed_low_limit "Lateral shift speed low limit." VALUE 0x0000 /* @ECU_Address@KfLCCS_v_shift_speed_low_limit@ */ Scalar_FLOAT32_IEEE 0 LCCS_subsystem_integrated_CM_single_m_s -3.4E+38 3.4E+38 /end CHARACTERISTIC
/begin CHARACTERISTIC KcLCCS_HeadingErrorRateSmooth "This number of heading error samples are used to calculate heading error rate.
      " VALUE 0x0000 /* @ECU_Address@KcLCCS_HeadingErrorRateSmooth@ */ Scalar_LONG 0 LCCS_subsystem_integrated_CM_int32 1.0 50.0 /end CHARACTERISTIC
/begin CHARACTERISTIC KbLCCS_UsePurePursuit "True: Use lookahead point to calculate target driving direction." VALUE 0x0000 /* @ECU_Address@KbLCCS_UsePurePursuit@ */ Scalar_BOOLEAN 0 LCCS_subsystem_integrated_CM_boolean 0 1 /end CHARACTERISTIC
/begin CHARACTERISTIC KbLCCS_WheelEncoderReady "Indicator for wheel encoder system ready." VALUE 0x0000 /* @ECU_Address@KbLCCS_WheelEncoderReady@ */ Scalar_BOOLEAN 0 LCCS_subsystem_integrated_CM_boolean 0 1 /end CHARACTERISTIC
/begin CHARACTERISTIC KbLCCS_inlane_nudge_request_SLEW "Calibration switch to SLEW inlane nudge request." VALUE 0x0000 /* @ECU_Address@KbLCCS_inlane_nudge_request_SLEW@ */ Scalar_BOOLEAN 0 LCCS_subsystem_integrated_CM_boolean 0 1 /end CHARACTERISTIC
/begin CHARACTERISTIC KbLCCS_inlane_nudge_request_value "Inlane nudge request value in SLEW mode." VALUE 0x0000 /* @ECU_Address@KbLCCS_inlane_nudge_request_value@ */ Scalar_BOOLEAN 0 LCCS_subsystem_integrated_CM_boolean 0 1 /end CHARACTERISTIC
/begin CHARACTERISTIC KbLCCS_lane_change_request_SLEW "Calibration switch to SLEW lane change request." VALUE 0x0000 /* @ECU_Address@KbLCCS_lane_change_request_SLEW@ */ Scalar_BOOLEAN 0 LCCS_subsystem_integrated_CM_boolean 0 1 /end CHARACTERISTIC
/begin CHARACTERISTIC KbLCCS_lane_change_request_value "Lane change request value in SLEW mode." VALUE 0x0000 /* @ECU_Address@KbLCCS_lane_change_request_value@ */ Scalar_BOOLEAN 0 LCCS_subsystem_integrated_CM_boolean 0 1 /end CHARACTERISTIC
/begin CHARACTERISTIC KbLCCS_lane_change_source_ALCA "Lane change request source is ALCA." VALUE 0x0000 /* @ECU_Address@KbLCCS_lane_change_source_ALCA@ */ Scalar_BOOLEAN 0 LCCS_subsystem_integrated_CM_boolean 0 1 /end CHARACTERISTIC
/begin CHARACTERISTIC KeLCCS_shifting_direction_value "Shifting direction value in SLEW mode." VALUE 0x0000 /* @ECU_Address@KeLCCS_shifting_direction_value@ */ Scalar_UBYTE 0 LCCS_subsystem_integrated_CM_EnumDCSN_driving_direction 0 2 /end CHARACTERISTIC
/begin MEASUREMENT VfLCCS_timestamp_EGMO "Timestamp of EGMO interface." FLOAT64_IEEE LCCS_subsystem_integrated_CM_double_s 0 0 -1.7E+308 1.7E+308 ECU_ADDRESS 0x0000 /* @ECU_Address@VfLCCS_timestamp_EGMO@ */ /end MEASUREMENT
/begin MEASUREMENT VfLCCS_timestamp_MPFU "Timestamp of MPFU interface." FLOAT64_IEEE LCCS_subsystem_integrated_CM_double_s 0 0 -1.7E+308 1.7E+308 ECU_ADDRESS 0x0000 /* @ECU_Address@VfLCCS_timestamp_MPFU@ */ /end MEASUREMENT
/begin MEASUREMENT VfLCCS_steering_angle_diff_abs "Steering angle delta absolute value." FLOAT32_IEEE LCCS_subsystem_integrated_CM_single 0 0 -3.4E+38 3.4E+38 ECU_ADDRESS 0x0000 /* @ECU_Address@VfLCCS_steering_angle_diff_abs@ */ /end MEASUREMENT
/begin MEASUREMENT VfLCCS_lateral_v_from_ALCA "ALCA requested lateral speed to shift lane center." FLOAT32_IEEE LCCS_subsystem_integrated_CM_single_m_s 0 0 -3.4E+38 3.4E+38 ECU_ADDRESS 0x0000 /* @ECU_Address@VfLCCS_lateral_v_from_ALCA@ */ /end MEASUREMENT
/begin MEASUREMENT VfLCCS_linear_velocity "Linear velocity." FLOAT32_IEEE LCCS_subsystem_integrated_CM_single 0 0 -3.4E+38 3.4E+38 ECU_ADDRESS 0x0000 /* @ECU_Address@VfLCCS_linear_velocity@ */ /end MEASUREMENT
/begin MEASUREMENT VfLCCS_velocity_rel_y "Longitudinal speed Vy." FLOAT32_IEEE LCCS_subsystem_integrated_CM_single 0 0 -3.4E+38 3.4E+38 ECU_ADDRESS 0x0000 /* @ECU_Address@VfLCCS_velocity_rel_y@ */ /end MEASUREMENT
/begin MEASUREMENT VfLCCS_velocity_rel_x "Lateral speed Vx." FLOAT32_IEEE LCCS_subsystem_integrated_CM_single 0 0 -3.4E+38 3.4E+38 ECU_ADDRESS 0x0000 /* @ECU_Address@VfLCCS_velocity_rel_x@ */ /end MEASUREMENT
/begin MEASUREMENT VfLCCS_veh_heading_rel "Slip angle of center of mass." FLOAT32_IEEE LCCS_subsystem_integrated_CM_single 0 0 -3.4E+38 3.4E+38 ECU_ADDRESS 0x0000 /* @ECU_Address@VfLCCS_veh_heading_rel@ */ /end MEASUREMENT
/begin MEASUREMENT VfLCCS_EPS_ActualSteeringAngle "Steering wheel angle from CAN." FLOAT32_IEEE LCCS_subsystem_integrated_CM_single 0 0 -3.4E+38 3.4E+38 ECU_ADDRESS 0x0000 /* @ECU_Address@VfLCCS_EPS_ActualSteeringAngle@ */ /end MEASUREMENT
/begin MEASUREMENT VfLCCS_yaw_rate "Yaw rate from CAN." FLOAT32_IEEE LCCS_subsystem_integrated_CM_single_rad_s 0 0 -3.4E+38 3.4E+38 ECU_ADDRESS 0x0000 /* @ECU_Address@VfLCCS_yaw_rate@ */ /end MEASUREMENT
/begin MEASUREMENT VfLCCS_lookahead_distance "Lookahead distance." FLOAT32_IEEE LCCS_subsystem_integrated_CM_single 0 0 -3.4E+38 3.4E+38 ECU_ADDRESS 0x0000 /* @ECU_Address@VfLCCS_lookahead_distance@ */ /end MEASUREMENT
/begin MEASUREMENT VfLCCS_veh_frtwhl_angle_act "Vehicle front wheel angle actual value." FLOAT32_IEEE LCCS_subsystem_integrated_CM_single 0 0 -3.4E+38 3.4E+38 ECU_ADDRESS 0x0000 /* @ECU_Address@VfLCCS_veh_frtwhl_angle_act@ */ /end MEASUREMENT
/begin MEASUREMENT VaLCCS_raw_left_lanemark "Raw left lanemark." FLOAT32_IEEE LCCS_subsystem_integrated_CM_single 0 0 -3.4E+38 3.4E+38 ARRAY_SIZE 6 ECU_ADDRESS 0x0000 /* @ECU_Address@VaLCCS_raw_left_lanemark@ */ /end MEASUREMENT
/begin MEASUREMENT VaLCCS_raw_right_lanemark "Raw right lanemark." FLOAT32_IEEE LCCS_subsystem_integrated_CM_single 0 0 -3.4E+38 3.4E+38 ARRAY_SIZE 6 ECU_ADDRESS 0x0000 /* @ECU_Address@VaLCCS_raw_right_lanemark@ */ /end MEASUREMENT
/begin MEASUREMENT VfLCCS_smoothed_lane_width "Smoothed lane width." FLOAT32_IEEE LCCS_subsystem_integrated_CM_single 0 0 -3.4E+38 3.4E+38 ECU_ADDRESS 0x0000 /* @ECU_Address@VfLCCS_smoothed_lane_width@ */ /end MEASUREMENT
/begin MEASUREMENT VfLCCS_left_lanemark_confidence "" FLOAT32_IEEE LCCS_subsystem_integrated_CM_single 0 0 -3.4E+38 3.4E+38 ECU_ADDRESS 0x0000 /* @ECU_Address@VfLCCS_left_lanemark_confidence@ */ /end MEASUREMENT
/begin MEASUREMENT VfLCCS_right_lanemark_confidence "" FLOAT32_IEEE LCCS_subsystem_integrated_CM_single 0 0 -3.4E+38 3.4E+38 ECU_ADDRESS 0x0000 /* @ECU_Address@VfLCCS_right_lanemark_confidence@ */ /end MEASUREMENT
/begin MEASUREMENT VaLCCS_virtual_left_lanemark "Virtual left lanemark." FLOAT32_IEEE LCCS_subsystem_integrated_CM_single 0 0 -3.4E+38 3.4E+38 ARRAY_SIZE 4 ECU_ADDRESS 0x0000 /* @ECU_Address@VaLCCS_virtual_left_lanemark@ */ /end MEASUREMENT
/begin MEASUREMENT VaLCCS_virtual_right_lanemark "Virtual right lanemark." FLOAT32_IEEE LCCS_subsystem_integrated_CM_single 0 0 -3.4E+38 3.4E+38 ARRAY_SIZE 4 ECU_ADDRESS 0x0000 /* @ECU_Address@VaLCCS_virtual_right_lanemark@ */ /end MEASUREMENT
/begin MEASUREMENT VfLCCS_raw_lane_width "Raw lane width." FLOAT32_IEEE LCCS_subsystem_integrated_CM_single 0 0 -3.4E+38 3.4E+38 ECU_ADDRESS 0x0000 /* @ECU_Address@VfLCCS_raw_lane_width@ */ /end MEASUREMENT
/begin MEASUREMENT VfLCCS_c0_scaling "c0 scaling factor against lane width." FLOAT32_IEEE LCCS_subsystem_integrated_CM_single 0 0 -3.4E+38 3.4E+38 ECU_ADDRESS 0x0000 /* @ECU_Address@VfLCCS_c0_scaling@ */ /end MEASUREMENT
/begin MEASUREMENT VfLCCS_target_lateral_shift_width "Target shift width for lane change or inlane nudge." FLOAT32_IEEE LCCS_subsystem_integrated_CM_single 0 0 -3.4E+38 3.4E+38 ECU_ADDRESS 0x0000 /* @ECU_Address@VfLCCS_target_lateral_shift_width@ */ /end MEASUREMENT
/begin MEASUREMENT VfLCCS_lateral_shift_step "Lane change or nudge shift lateral distance step." FLOAT32_IEEE LCCS_subsystem_integrated_CM_single 0 0 -3.4E+38 3.4E+38 ECU_ADDRESS 0x0000 /* @ECU_Address@VfLCCS_lateral_shift_step@ */ /end MEASUREMENT
/begin MEASUREMENT VfLCCS_lateral_dist_to_go "Lateral distance from shifted lane center to target lane center." FLOAT32_IEEE LCCS_subsystem_integrated_CM_single_m 0 0 -3.4E+38 3.4E+38 ECU_ADDRESS 0x0000 /* @ECU_Address@VfLCCS_lateral_dist_to_go@ */ /end MEASUREMENT
/begin MEASUREMENT VfLCCS_lateral_shift_width "Lane change or inlane nudge lateral shift width, which is an offset to raw lane center." FLOAT32_IEEE LCCS_subsystem_integrated_CM_single 0 0 -3.4E+38 3.4E+38 ECU_ADDRESS 0x0000 /* @ECU_Address@VfLCCS_lateral_shift_width@ */ /end MEASUREMENT
/begin MEASUREMENT VaLCCS_shifted_lane_center_line "Shifted lane center line." FLOAT32_IEEE LCCS_subsystem_integrated_CM_single 0 0 -3.4E+38 3.4E+38 ARRAY_SIZE 4 ECU_ADDRESS 0x0000 /* @ECU_Address@VaLCCS_shifted_lane_center_line@ */ /end MEASUREMENT
/begin MEASUREMENT VfLCCS_frtwhl_angle_step_limit "Front wheel angle step limit." FLOAT32_IEEE LCCS_subsystem_integrated_CM_single 0 0 -3.4E+38 3.4E+38 ECU_ADDRESS 0x0000 /* @ECU_Address@VfLCCS_frtwhl_angle_step_limit@ */ /end MEASUREMENT
/begin MEASUREMENT VfLCCS_frtwhl_angle_limit_manual "Front wheel angle limit manual." FLOAT32_IEEE LCCS_subsystem_integrated_CM_single 0 0 -3.4E+38 3.4E+38 ECU_ADDRESS 0x0000 /* @ECU_Address@VfLCCS_frtwhl_angle_limit_manual@ */ /end MEASUREMENT
/begin MEASUREMENT VfLCCS_veh_frtwhl_angle_des_ramped "Vehicle front wheel angle desired value ramped." FLOAT32_IEEE LCCS_subsystem_integrated_CM_single 0 0 -3.4E+38 3.4E+38 ECU_ADDRESS 0x0000 /* @ECU_Address@VfLCCS_veh_frtwhl_angle_des_ramped@ */ /end MEASUREMENT
/begin MEASUREMENT VfLCCS_veh_strwhl_angle_des "Desired steering wheel angle." FLOAT32_IEEE LCCS_subsystem_integrated_CM_single 0 0 -3.4E+38 3.4E+38 ECU_ADDRESS 0x0000 /* @ECU_Address@VfLCCS_veh_strwhl_angle_des@ */ /end MEASUREMENT
/begin MEASUREMENT VfLCCS_steer_angle_feedback "Steer angle feedback." FLOAT32_IEEE LCCS_subsystem_integrated_CM_single 0 0 -3.4E+38 3.4E+38 ECU_ADDRESS 0x0000 /* @ECU_Address@VfLCCS_steer_angle_feedback@ */ /end MEASUREMENT
/begin MEASUREMENT VfLCCS_steer_angle_feedforward "Steer angle feedforward." FLOAT32_IEEE LCCS_subsystem_integrated_CM_single 0 0 -3.4E+38 3.4E+38 ECU_ADDRESS 0x0000 /* @ECU_Address@VfLCCS_steer_angle_feedforward@ */ /end MEASUREMENT
/begin MEASUREMENT VfLCCS_slowpath_steer_P "Slowpath steer P part." FLOAT32_IEEE LCCS_subsystem_integrated_CM_single 0 0 -3.4E+38 3.4E+38 ECU_ADDRESS 0x0000 /* @ECU_Address@VfLCCS_slowpath_steer_P@ */ /end MEASUREMENT
/begin MEASUREMENT VfLCCS_slowpath_steer_I "Slowpath steer I part." FLOAT32_IEEE LCCS_subsystem_integrated_CM_single 0 0 -3.4E+38 3.4E+38 ECU_ADDRESS 0x0000 /* @ECU_Address@VfLCCS_slowpath_steer_I@ */ /end MEASUREMENT
/begin MEASUREMENT VfLCCS_slowpath_steer_PI "Slowpath steer PI part." FLOAT32_IEEE LCCS_subsystem_integrated_CM_single 0 0 -3.4E+38 3.4E+38 ECU_ADDRESS 0x0000 /* @ECU_Address@VfLCCS_slowpath_steer_PI@ */ /end MEASUREMENT
/begin MEASUREMENT VfLCCS_frtwhl_angle_limit_lat_acc "Front wheel angle limit lat acc." FLOAT32_IEEE LCCS_subsystem_integrated_CM_single 0 0 -3.4E+38 3.4E+38 ECU_ADDRESS 0x0000 /* @ECU_Address@VfLCCS_frtwhl_angle_limit_lat_acc@ */ /end MEASUREMENT
/begin MEASUREMENT VfLCCS_veh_frtwhl_angle_des "Vehicle front wheel angle desired value raw." FLOAT32_IEEE LCCS_subsystem_integrated_CM_single 0 0 -3.4E+38 3.4E+38 ECU_ADDRESS 0x0000 /* @ECU_Address@VfLCCS_veh_frtwhl_angle_des@ */ /end MEASUREMENT
/begin MEASUREMENT VfLCCS_heading_error_contribution "Heading error contribution." FLOAT32_IEEE LCCS_subsystem_integrated_CM_single 0 0 -3.4E+38 3.4E+38 ECU_ADDRESS 0x0000 /* @ECU_Address@VfLCCS_heading_error_contribution@ */ /end MEASUREMENT
/begin MEASUREMENT VfLCCS_heading_error_rate_contribution "Heading error rate contribution." FLOAT32_IEEE LCCS_subsystem_integrated_CM_single 0 0 -3.4E+38 3.4E+38 ECU_ADDRESS 0x0000 /* @ECU_Address@VfLCCS_heading_error_rate_contribution@ */ /end MEASUREMENT
/begin MEASUREMENT VfLCCS_lateral_error_contribution "Lateral error contribution." FLOAT32_IEEE LCCS_subsystem_integrated_CM_single 0 0 -3.4E+38 3.4E+38 ECU_ADDRESS 0x0000 /* @ECU_Address@VfLCCS_lateral_error_contribution@ */ /end MEASUREMENT
/begin MEASUREMENT VfLCCS_lateral_error_rate_contribution "Lateral error rate contribution." FLOAT32_IEEE LCCS_subsystem_integrated_CM_single 0 0 -3.4E+38 3.4E+38 ECU_ADDRESS 0x0000 /* @ECU_Address@VfLCCS_lateral_error_rate_contribution@ */ /end MEASUREMENT
/begin MEASUREMENT VfLCCS_left_lanemark_switch_time "Left lanemark switch time." FLOAT32_IEEE LCCS_subsystem_integrated_CM_single 0 0 -3.4E+38 3.4E+38 ECU_ADDRESS 0x0000 /* @ECU_Address@VfLCCS_left_lanemark_switch_time@ */ /end MEASUREMENT
/begin MEASUREMENT VaLCCS_final_left_lanemark "Final left lanemarker." FLOAT32_IEEE LCCS_subsystem_integrated_CM_single 0 0 -3.4E+38 3.4E+38 ARRAY_SIZE 4 ECU_ADDRESS 0x0000 /* @ECU_Address@VaLCCS_final_left_lanemark@ */ /end MEASUREMENT
/begin MEASUREMENT VfLCCS_right_lanemark_switch_time "Right lanemark switch time." FLOAT32_IEEE LCCS_subsystem_integrated_CM_single 0 0 -3.4E+38 3.4E+38 ECU_ADDRESS 0x0000 /* @ECU_Address@VfLCCS_right_lanemark_switch_time@ */ /end MEASUREMENT
/begin MEASUREMENT VaLCCS_final_right_lanemark "Final right lanemarker." FLOAT32_IEEE LCCS_subsystem_integrated_CM_single 0 0 -3.4E+38 3.4E+38 ARRAY_SIZE 4 ECU_ADDRESS 0x0000 /* @ECU_Address@VaLCCS_final_right_lanemark@ */ /end MEASUREMENT
/begin MEASUREMENT VaLCCS_raw_lane_center_line "Raw lane center line." FLOAT32_IEEE LCCS_subsystem_integrated_CM_single 0 0 -3.4E+38 3.4E+38 ARRAY_SIZE 4 ECU_ADDRESS 0x0000 /* @ECU_Address@VaLCCS_raw_lane_center_line@ */ /end MEASUREMENT
/begin MEASUREMENT VaLCCS_com_point "Center of mass position." FLOAT32_IEEE LCCS_subsystem_integrated_CM_single 0 0 -3.4E+38 3.4E+38 ARRAY_SIZE 3 ECU_ADDRESS 0x0000 /* @ECU_Address@VaLCCS_com_point@ */ /end MEASUREMENT
/begin MEASUREMENT VaLCCS_preview_proj_point "Lookahead point projection position." FLOAT32_IEEE LCCS_subsystem_integrated_CM_single 0 0 -3.4E+38 3.4E+38 ARRAY_SIZE 3 ECU_ADDRESS 0x0000 /* @ECU_Address@VaLCCS_preview_proj_point@ */ /end MEASUREMENT
/begin MEASUREMENT VfLCCS_lookahead_angle "Lookahead angle." FLOAT32_IEEE LCCS_subsystem_integrated_CM_single 0 0 -3.4E+38 3.4E+38 ECU_ADDRESS 0x0000 /* @ECU_Address@VfLCCS_lookahead_angle@ */ /end MEASUREMENT
/begin MEASUREMENT VaLCCS_com_proj_point "Center of mass projection point position." FLOAT32_IEEE LCCS_subsystem_integrated_CM_single 0 0 -3.4E+38 3.4E+38 ARRAY_SIZE 3 ECU_ADDRESS 0x0000 /* @ECU_Address@VaLCCS_com_proj_point@ */ /end MEASUREMENT
/begin MEASUREMENT VfLCCS_lateral_error "Lateral error." FLOAT32_IEEE LCCS_subsystem_integrated_CM_single 0 0 -3.4E+38 3.4E+38 ECU_ADDRESS 0x0000 /* @ECU_Address@VfLCCS_lateral_error@ */ /end MEASUREMENT
/begin MEASUREMENT VfLCCS_heading_error_rate "Heading error rate." FLOAT32_IEEE LCCS_subsystem_integrated_CM_single 0 0 -3.4E+38 3.4E+38 ECU_ADDRESS 0x0000 /* @ECU_Address@VfLCCS_heading_error_rate@ */ /end MEASUREMENT
/begin MEASUREMENT VfLCCS_lateral_error_rate "Lateral error rate." FLOAT32_IEEE LCCS_subsystem_integrated_CM_single 0 0 -3.4E+38 3.4E+38 ECU_ADDRESS 0x0000 /* @ECU_Address@VfLCCS_lateral_error_rate@ */ /end MEASUREMENT
/begin MEASUREMENT VfLCCS_preview_curvature "The lane center curvature of preview projection point." FLOAT32_IEEE LCCS_subsystem_integrated_CM_single 0 0 -3.4E+38 3.4E+38 ECU_ADDRESS 0x0000 /* @ECU_Address@VfLCCS_preview_curvature@ */ /end MEASUREMENT
/begin MEASUREMENT VfLCCS_heading_error "Heading error." FLOAT32_IEEE LCCS_subsystem_integrated_CM_single 0 0 -3.4E+38 3.4E+38 ECU_ADDRESS 0x0000 /* @ECU_Address@VfLCCS_heading_error@ */ /end MEASUREMENT
/begin MEASUREMENT VcLCCS_EPS_SteeringControlResponse_LCC "EPS control mode feedback." UBYTE LCCS_subsystem_integrated_CM_uint8 0 0 0 255 ECU_ADDRESS 0x0000 /* @ECU_Address@VcLCCS_EPS_SteeringControlResponse_LCC@ */ /end MEASUREMENT
/begin MEASUREMENT VfLCCS_num_lane_markers "" UBYTE LCCS_subsystem_integrated_CM_uint8 0 0 0 255 ECU_ADDRESS 0x0000 /* @ECU_Address@VfLCCS_num_lane_markers@ */ /end MEASUREMENT
/begin MEASUREMENT VcLCCS_num_iteration "" UBYTE LCCS_subsystem_integrated_CM_uint8 0 0 0 255 ECU_ADDRESS 0x0000 /* @ECU_Address@VcLCCS_num_iteration@ */ /end MEASUREMENT
/begin MEASUREMENT VbLCCS_steering_control_active "Steering control active." UBYTE LCCS_subsystem_integrated_CM_boolean 0 0 0 1 ECU_ADDRESS 0x0000 /* @ECU_Address@VbLCCS_steering_control_active@ */ /end MEASUREMENT
/begin MEASUREMENT VbLCCS_LCC_ReadyToEngage "LCC ReadyToEngage." UBYTE LCCS_subsystem_integrated_CM_boolean 0 0 0 1 ECU_ADDRESS 0x0000 /* @ECU_Address@VbLCCS_LCC_ReadyToEngage@ */ /end MEASUREMENT
/begin MEASUREMENT VbLCCS_LCC_ForceToDisengage "Lane centering control is forced to disengage due to one of following reasons:
      1. EGMO and MPFU timestamp don't match.
      2. No valid lane marker." UBYTE LCCS_subsystem_integrated_CM_boolean 0 0 0 1 ECU_ADDRESS 0x0000 /* @ECU_Address@VbLCCS_LCC_ForceToDisengage@ */ /end MEASUREMENT
/begin MEASUREMENT VbLCCS_steering_control_stable "Steering control stable." UBYTE LCCS_subsystem_integrated_CM_boolean 0 0 0 1 ECU_ADDRESS 0x0000 /* @ECU_Address@VbLCCS_steering_control_stable@ */ /end MEASUREMENT
/begin MEASUREMENT VbLCCS_steering_control_engaged "Steering control engaged." UBYTE LCCS_subsystem_integrated_CM_boolean 0 0 0 1 ECU_ADDRESS 0x0000 /* @ECU_Address@VbLCCS_steering_control_engaged@ */ /end MEASUREMENT
/begin MEASUREMENT VbLCCS_lateral_movement_enabled "Flag to indicate lateral movement is allowed." UBYTE LCCS_subsystem_integrated_CM_boolean 0 0 0 1 ECU_ADDRESS 0x0000 /* @ECU_Address@VbLCCS_lateral_movement_enabled@ */ /end MEASUREMENT
/begin MEASUREMENT VbLCCS_lane_change_request "" UBYTE LCCS_subsystem_integrated_CM_boolean 0 0 0 1 ECU_ADDRESS 0x0000 /* @ECU_Address@VbLCCS_lane_change_request@ */ /end MEASUREMENT
/begin MEASUREMENT VbLCCS_inlane_nudge_request "Inlane nudge request." UBYTE LCCS_subsystem_integrated_CM_boolean 0 0 0 1 ECU_ADDRESS 0x0000 /* @ECU_Address@VbLCCS_inlane_nudge_request@ */ /end MEASUREMENT
/begin MEASUREMENT VbLCCS_input_isNaN_DCSN "" UBYTE LCCS_subsystem_integrated_CM_boolean 0 0 0 1 ECU_ADDRESS 0x0000 /* @ECU_Address@VbLCCS_input_isNaN_DCSN@ */ /end MEASUREMENT
/begin MEASUREMENT VbLCCS_lcc_feature_enable "" UBYTE LCCS_subsystem_integrated_CM_boolean 0 0 0 1 ECU_ADDRESS 0x0000 /* @ECU_Address@VbLCCS_lcc_feature_enable@ */ /end MEASUREMENT
/begin MEASUREMENT VbLCCS_steer_control_enable "LCC is allowed by decision module." UBYTE LCCS_subsystem_integrated_CM_boolean 0 0 0 1 ECU_ADDRESS 0x0000 /* @ECU_Address@VbLCCS_steer_control_enable@ */ /end MEASUREMENT
/begin MEASUREMENT VbLCCS_input_isNaN_ALCA "" UBYTE LCCS_subsystem_integrated_CM_boolean 0 0 0 1 ECU_ADDRESS 0x0000 /* @ECU_Address@VbLCCS_input_isNaN_ALCA@ */ /end MEASUREMENT
/begin MEASUREMENT VbLCCS_input_isNaN_COMM "" UBYTE LCCS_subsystem_integrated_CM_boolean 0 0 0 1 ECU_ADDRESS 0x0000 /* @ECU_Address@VbLCCS_input_isNaN_COMM@ */ /end MEASUREMENT
/begin MEASUREMENT VbLCCS_input_isNaN_EGMO "" UBYTE LCCS_subsystem_integrated_CM_boolean 0 0 0 1 ECU_ADDRESS 0x0000 /* @ECU_Address@VbLCCS_input_isNaN_EGMO@ */ /end MEASUREMENT
/begin MEASUREMENT VbLCCS_input_isNaN_MPFU "" UBYTE LCCS_subsystem_integrated_CM_boolean 0 0 0 1 ECU_ADDRESS 0x0000 /* @ECU_Address@VbLCCS_input_isNaN_MPFU@ */ /end MEASUREMENT
/begin MEASUREMENT VbLCCS_left_lanemark_valid "Left lanemark valid." UBYTE LCCS_subsystem_integrated_CM_boolean 0 0 0 1 ECU_ADDRESS 0x0000 /* @ECU_Address@VbLCCS_left_lanemark_valid@ */ /end MEASUREMENT
/begin MEASUREMENT VbLCCS_right_lanemark_valid "Right lanemark valid." UBYTE LCCS_subsystem_integrated_CM_boolean 0 0 0 1 ECU_ADDRESS 0x0000 /* @ECU_Address@VbLCCS_right_lanemark_valid@ */ /end MEASUREMENT
/begin MEASUREMENT VbLCCS_both_lanemark_available "" UBYTE LCCS_subsystem_integrated_CM_boolean 0 0 0 1 ECU_ADDRESS 0x0000 /* @ECU_Address@VbLCCS_both_lanemark_available@ */ /end MEASUREMENT
/begin MEASUREMENT VbLCCS_shifting_in_progress "Flag to indicate lateral shifting is in progress." UBYTE LCCS_subsystem_integrated_CM_boolean 0 0 0 1 ECU_ADDRESS 0x0000 /* @ECU_Address@VbLCCS_shifting_in_progress@ */ /end MEASUREMENT
/begin MEASUREMENT VbLCCS_touched_new_lane "Flag to to indicate that ego car has crossed lane marker." UBYTE LCCS_subsystem_integrated_CM_boolean 0 0 0 1 ECU_ADDRESS 0x0000 /* @ECU_Address@VbLCCS_touched_new_lane@ */ /end MEASUREMENT
/begin MEASUREMENT VeLCCS_shifting_direction_raw "Inlane nudge or lane change shifting_direction. 1 = left. 2 = right." UBYTE LCCS_subsystem_integrated_CM_EnumDCSN_driving_direction 0 0 0 2 ECU_ADDRESS 0x0000 /* @ECU_Address@VeLCCS_shifting_direction_raw@ */ /end MEASUREMENT
/begin MEASUREMENT VeLCCS_shifting_direction_final "Inlane nudge or lane change shifting_direction." UBYTE LCCS_subsystem_integrated_CM_EnumDCSN_driving_direction 0 0 0 2 ECU_ADDRESS 0x0000 /* @ECU_Address@VeLCCS_shifting_direction_final@ */ /end MEASUREMENT
/begin MEASUREMENT VeLCCS_valid_lane_marker "Valid lane marker. 0 = LCCS_NoLane; 1 = LCCS_LeftLane; 2 = LCCS_RightLane; 3 = BothLane." UBYTE LCCS_subsystem_integrated_CM_EnumLCCS_ValidLane 0 0 0 3 ECU_ADDRESS 0x0000 /* @ECU_Address@VeLCCS_valid_lane_marker@ */ /end MEASUREMENT
/begin COMPU_METHOD LCCS_subsystem_integrated_CM_single "Q = V" RAT_FUNC "%8.6" "" COEFFS 0 1 0 0 0 1 /end COMPU_METHOD
/begin COMPU_METHOD LCCS_subsystem_integrated_CM_single_s "Q = V" RAT_FUNC "%8.6" "s" COEFFS 0 1 0 0 0 1 /end COMPU_METHOD
/begin COMPU_METHOD LCCS_subsystem_integrated_CM_single_m "Q = V" RAT_FUNC "%8.6" "m" COEFFS 0 1 0 0 0 1 /end COMPU_METHOD
/begin COMPU_METHOD LCCS_subsystem_integrated_CM_single_rad "Q = V" RAT_FUNC "%8.6" "rad" COEFFS 0 1 0 0 0 1 /end COMPU_METHOD
/begin COMPU_METHOD LCCS_subsystem_integrated_CM_single_kg "Q = V" RAT_FUNC "%8.6" "kg" COEFFS 0 1 0 0 0 1 /end COMPU_METHOD
/begin COMPU_METHOD LCCS_subsystem_integrated_CM_single_m_s "Q = V" RAT_FUNC "%8.6" "m/s" COEFFS 0 1 0 0 0 1 /end COMPU_METHOD
/begin COMPU_METHOD LCCS_subsystem_integrated_CM_int32 "Q = V" RAT_FUNC "%10.0" "" COEFFS 0 1 0 0 0 1 /end COMPU_METHOD
/begin COMPU_METHOD LCCS_subsystem_integrated_CM_boolean "Q = V" RAT_FUNC "%1.0" "" COEFFS 0 1 0 0 0 1 /end COMPU_METHOD
/begin COMPU_METHOD LCCS_subsystem_integrated_CM_EnumDCSN_driving_direction "Enumerated data type: EnumDCSN_driving_direction" TAB_VERB "%0.6" "" /* Conversion Table */ COMPU_TAB_REF VTAB_FOR_LCCS_subsystem_integrated_CM_EnumDCSN_driving_direction /end COMPU_METHOD
/begin COMPU_VTAB /* Name of Table */ VTAB_FOR_LCCS_subsystem_integrated_CM_EnumDCSN_driving_direction "Enumerated data type: EnumDCSN_driving_direction" TAB_VERB /* Number of Elements */ 3 0 "FORWARD" 1 "LEFT" 2 "RIGHT" /end COMPU_VTAB
/begin COMPU_METHOD LCCS_subsystem_integrated_CM_double_s "Q = V" RAT_FUNC "%15.10" "s" COEFFS 0 1 0 0 0 1 /end COMPU_METHOD
/begin COMPU_METHOD LCCS_subsystem_integrated_CM_single_rad_s "Q = V" RAT_FUNC "%8.6" "rad/s" COEFFS 0 1 0 0 0 1 /end COMPU_METHOD
/begin COMPU_METHOD LCCS_subsystem_integrated_CM_uint8 "Q = V" RAT_FUNC "%3.0" "" COEFFS 0 1 0 0 0 1 /end COMPU_METHOD
/begin COMPU_METHOD LCCS_subsystem_integrated_CM_EnumLCCS_ValidLane "Enumerated data type: EnumLCCS_ValidLane" TAB_VERB "%0.6" "" /* Conversion Table */ COMPU_TAB_REF VTAB_FOR_LCCS_subsystem_integrated_CM_EnumLCCS_ValidLane /end COMPU_METHOD
/begin COMPU_VTAB /* Name of Table */ VTAB_FOR_LCCS_subsystem_integrated_CM_EnumLCCS_ValidLane "Enumerated data type: EnumLCCS_ValidLane" TAB_VERB /* Number of Elements */ 4 0 "LCCS_NoLane" 1 "LCCS_LeftLane" 2 "LCCS_RightLane" 3 "LCCS_BothLane" /end COMPU_VTAB
/begin GROUP LCCS_subsystem_integrated "LCCS_subsystem_integrated" /* Root */ ROOT /begin SUB_GROUP Root_LCCS /end SUB_GROUP /end GROUP
/begin GROUP Root_LCCS "LCCS_subsystem_integrated/LCCS" /begin SUB_GROUP S1_LCCS /end SUB_GROUP /end GROUP
/begin GROUP S1_LCCS "LCCS_subsystem_integrated/LCCS/LCCS"
 /begin SUB_GROUP S2_CalcLCCS_compute_lateral_errors S2_CalcLCCS_lane_center_discretize S2_CalcLCCS_lane_center_line S2_CalcLCCS_lateral_control_main S2_CalcLCCS_lateral_shift_width S2_CalcLCCS_virtual_lane_marker S2_DtrmnLCCS_sensor_signal_processing S2_DtrmnLCCS_sensor_signal_rationality S2_DtrmnLCCS_steering_control_output /end SUB_GROUP
/end GROUP
/begin GROUP S2_CalcLCCS_compute_lateral_errors "LCCS_subsystem_integrated/LCCS/LCCS/CalcLCCS_compute_lateral_errors"
 /begin SUB_GROUP S4_center_of_mass_projection S4_compute_lateral_errors S4_preview_point_projection /end SUB_GROUP
/end GROUP
/begin GROUP S2_CalcLCCS_lane_center_discretize "LCCS_subsystem_integrated/LCCS/LCCS/CalcLCCS_lane_center_discretize" /begin REF_CHARACTERISTIC KfLCCS_d_RearAxleToCameraOrigin /end REF_CHARACTERISTIC /end GROUP
/begin GROUP S2_CalcLCCS_lane_center_line "LCCS_subsystem_integrated/LCCS/LCCS/CalcLCCS_lane_center_line" /begin REF_CHARACTERISTIC KfLCCS_t_SampleTime KtLCCS_k_LanemarkMergeCoef /end REF_CHARACTERISTIC
 /begin REF_MEASUREMENT VaLCCS_final_left_lanemark VaLCCS_final_right_lanemark VaLCCS_raw_lane_center_line VbLCCS_touched_new_lane VfLCCS_left_lanemark_switch_time VfLCCS_right_lanemark_switch_time /end REF_MEASUREMENT
/end GROUP
/begin GROUP S2_CalcLCCS_lateral_control_main "LCCS_subsystem_integrated/LCCS/LCCS/CalcLCCS_lateral_control_main" /begin SUB_GROUP S7_lateral_control S7_steering_wheel_angle /end SUB_GROUP /end GROUP
/begin GROUP S2_CalcLCCS_lateral_shift_width "LCCS_subsystem_integrated/LCCS/LCCS/CalcLCCS_lateral_shift_width" /begin SUB_GROUP S8_CalcLCCS_target_shift_width /end SUB_GROUP
 /begin REF_CHARACTERISTIC KbLCCS_lane_change_source_ALCA KfLCCS_r_MaxLateralSpeedPortion KfLCCS_r_shift_speed_gain KfLCCS_t_SampleTime KfLCCS_v_shift_speed_high_limit KfLCCS_v_shift_speed_low_limit /end REF_CHARACTERISTIC
 /begin REF_MEASUREMENT VaLCCS_shifted_lane_center_line VbLCCS_shifting_in_progress VeLCCS_shifting_direction_final VfLCCS_lateral_dist_to_go VfLCCS_lateral_shift_step VfLCCS_lateral_shift_width /end REF_MEASUREMENT
/end GROUP
/begin GROUP S2_CalcLCCS_virtual_lane_marker "LCCS_subsystem_integrated/LCCS/LCCS/CalcLCCS_virtual_lane_marker" /begin SUB_GROUP S9_1st_order_filter /end SUB_GROUP
 /begin REF_CHARACTERISTIC KfLCCS_LanemarkerQualityThrsh KfLCCS_d_ValidLaneWidthLimit KfLCCS_k_LaneWidthFilter KfLCCS_t_SampleTime /end REF_CHARACTERISTIC
 /begin REF_MEASUREMENT VaLCCS_virtual_left_lanemark VaLCCS_virtual_right_lanemark VbLCCS_both_lanemark_available VbLCCS_left_lanemark_valid VbLCCS_right_lanemark_valid VeLCCS_valid_lane_marker VfLCCS_c0_scaling VfLCCS_left_lanemark_confidence VfLCCS_raw_lane_width VfLCCS_right_lanemark_confidence /end REF_MEASUREMENT
/end GROUP
/begin GROUP S2_DtrmnLCCS_sensor_signal_processing "LCCS_subsystem_integrated/LCCS/LCCS/DtrmnLCCS_sensor_signal_processing" /begin SUB_GROUP S10_check_signal_isNan10 /end SUB_GROUP
 /begin REF_CHARACTERISTIC KfLCCS_Ang_steering_center_position KfLCCS_d_wheel_base KfLCCS_r_veh_strwhl_2_frtwhl_ratio KtLCCS_d_lookahead_distance /end REF_CHARACTERISTIC
 /begin REF_MEASUREMENT VaLCCS_raw_left_lanemark VaLCCS_raw_right_lanemark VbLCCS_input_isNaN_MPFU VfLCCS_lookahead_distance VfLCCS_timestamp_MPFU VfLCCS_veh_frtwhl_angle_act /end REF_MEASUREMENT
/end GROUP
/begin GROUP S2_DtrmnLCCS_sensor_signal_rationality "LCCS_subsystem_integrated/LCCS/LCCS/DtrmnLCCS_sensor_signal_rationality"
 /begin SUB_GROUP S11_check_signal_isNan S11_check_signal_isNan12 S11_check_signal_isNan14 S11_check_signal_isNan2 S11_check_signal_isNan6 S11_check_signal_isNan8 S11_check_signal_isNan9 /end SUB_GROUP
 /begin REF_CHARACTERISTIC KbLCCS_WheelEncoderReady KbLCCS_inlane_nudge_request_SLEW KbLCCS_inlane_nudge_request_value KbLCCS_lane_change_request_SLEW KbLCCS_lane_change_request_value KbLCCS_lane_change_source_ALCA KeLCCS_shifting_direction_value KfLCCS_r_YawRateCorrection /end REF_CHARACTERISTIC
 /begin REF_MEASUREMENT VbLCCS_inlane_nudge_request VbLCCS_input_isNaN_ALCA VbLCCS_input_isNaN_COMM VbLCCS_input_isNaN_DCSN VbLCCS_input_isNaN_EGMO VbLCCS_lane_change_request VeLCCS_shifting_direction_raw VfLCCS_timestamp_EGMO VfLCCS_veh_heading_rel VfLCCS_velocity_rel_y VfLCCS_yaw_rate /end REF_MEASUREMENT
/end GROUP
/begin GROUP S2_DtrmnLCCS_steering_control_output "LCCS_subsystem_integrated/LCCS/LCCS/DtrmnLCCS_steering_control_output" /begin SUB_GROUP S12_steering_control_machine /end SUB_GROUP
 /begin REF_CHARACTERISTIC KfLCCS_t_TimestampAliveThresh KtLCCS_Ang_steering_angle_reentry_zone /end REF_CHARACTERISTIC
 /begin REF_MEASUREMENT VbLCCS_LCC_ForceToDisengage VbLCCS_LCC_ReadyToEngage VfLCCS_steering_angle_diff_abs /end REF_MEASUREMENT
/end GROUP
/begin GROUP S4_center_of_mass_projection "LCCS_subsystem_integrated/LCCS/LCCS/CalcLCCS_compute_lateral_errors/center_of_mass_projection" /begin REF_CHARACTERISTIC KfLCCS_d_lr /end REF_CHARACTERISTIC /begin REF_MEASUREMENT VaLCCS_com_point VaLCCS_com_proj_point /end REF_MEASUREMENT /end GROUP
/begin GROUP S4_compute_lateral_errors "LCCS_subsystem_integrated/LCCS/LCCS/CalcLCCS_compute_lateral_errors/compute_lateral_errors"
 /begin REF_CHARACTERISTIC KbLCCS_UsePurePursuit KcLCCS_HeadingErrorRateSmooth KfLCCS_heading_error_rate_limit KfLCCS_t_SampleTime /end REF_CHARACTERISTIC
 /begin REF_MEASUREMENT VfLCCS_heading_error VfLCCS_heading_error_rate VfLCCS_lateral_error VfLCCS_lateral_error_rate VfLCCS_lookahead_angle VfLCCS_preview_curvature /end REF_MEASUREMENT
/end GROUP
/begin GROUP S4_preview_point_projection "LCCS_subsystem_integrated/LCCS/LCCS/CalcLCCS_compute_lateral_errors/preview_point_projection" /begin REF_MEASUREMENT VaLCCS_preview_proj_point /end REF_MEASUREMENT /end GROUP
/begin GROUP S7_lateral_control "LCCS_subsystem_integrated/LCCS/LCCS/CalcLCCS_lateral_control_main/lateral_control" /begin SUB_GROUP S56_Compute_Feed_Forward S56_slowpath_steer_PI /end SUB_GROUP
 /begin REF_CHARACTERISTIC KbLCCS_UsePurePursuit KfLCCS_Ang_slowpath_steer_limit KfLCCS_WeightMatrixStates_R KfLCCS_a_max_lat_acc KfLCCS_cf KfLCCS_cr KfLCCS_d_lf KfLCCS_d_lr KfLCCS_d_min_turn_radius KfLCCS_eps KfLCCS_iz KfLCCS_mass KtLCCS_heading_err_correction KtLCCS_heading_err_gain_scheduler KtLCCS_heading_err_rate_correction KtLCCS_heading_err_rate_gain_scheduler KtLCCS_lateral_err_correction KtLCCS_lateral_err_gain_scheduler KtLCCS_lateral_err_rate_correction KtLCCS_lateral_err_rate_gain_scheduler KtLCCS_slowpath_steer_I_gain KtLCCS_slowpath_steer_P_gain KtLCCS_t_lateral_oscillation_period /end REF_CHARACTERISTIC
 /begin REF_MEASUREMENT VcLCCS_num_iteration VfLCCS_frtwhl_angle_limit_lat_acc VfLCCS_heading_error_contribution VfLCCS_heading_error_rate_contribution VfLCCS_lateral_error_contribution VfLCCS_lateral_error_rate_contribution VfLCCS_steer_angle_feedback VfLCCS_steer_angle_feedforward VfLCCS_veh_frtwhl_angle_des /end REF_MEASUREMENT
/end GROUP
/begin GROUP S7_steering_wheel_angle "LCCS_subsystem_integrated/LCCS/LCCS/CalcLCCS_lateral_control_main/steering_wheel_angle" /begin SUB_GROUP S57_angular_vel_limit /end SUB_GROUP /end GROUP
/begin GROUP S8_CalcLCCS_target_shift_width "LCCS_subsystem_integrated/LCCS/LCCS/CalcLCCS_lateral_shift_width/CalcLCCS_target_shift_width" /begin REF_CHARACTERISTIC KfLCCS_d_NudgeSafetyZone KfLCCS_d_VehicleWidth /end REF_CHARACTERISTIC /begin REF_MEASUREMENT VfLCCS_target_lateral_shift_width /end REF_MEASUREMENT /end GROUP
/begin GROUP S9_1st_order_filter "LCCS_subsystem_integrated/LCCS/LCCS/CalcLCCS_virtual_lane_marker/1st order filter" /begin REF_MEASUREMENT VfLCCS_smoothed_lane_width /end REF_MEASUREMENT /end GROUP
/begin GROUP S10_check_signal_isNan10 "LCCS_subsystem_integrated/LCCS/LCCS/DtrmnLCCS_sensor_signal_processing/check_signal_isNan10" /begin REF_MEASUREMENT VfLCCS_num_lane_markers /end REF_MEASUREMENT /end GROUP
/begin GROUP S11_check_signal_isNan "LCCS_subsystem_integrated/LCCS/LCCS/DtrmnLCCS_sensor_signal_rationality/check_signal_isNan" /begin REF_MEASUREMENT VfLCCS_linear_velocity /end REF_MEASUREMENT /end GROUP
/begin GROUP S11_check_signal_isNan12 "LCCS_subsystem_integrated/LCCS/LCCS/DtrmnLCCS_sensor_signal_rationality/check_signal_isNan12" /begin REF_MEASUREMENT VbLCCS_lcc_feature_enable /end REF_MEASUREMENT /end GROUP
/begin GROUP S11_check_signal_isNan14 "LCCS_subsystem_integrated/LCCS/LCCS/DtrmnLCCS_sensor_signal_rationality/check_signal_isNan14" /begin REF_MEASUREMENT VfLCCS_lateral_v_from_ALCA /end REF_MEASUREMENT /end GROUP
/begin GROUP S11_check_signal_isNan2 "LCCS_subsystem_integrated/LCCS/LCCS/DtrmnLCCS_sensor_signal_rationality/check_signal_isNan2" /begin REF_MEASUREMENT VfLCCS_velocity_rel_x /end REF_MEASUREMENT /end GROUP
/begin GROUP S11_check_signal_isNan6 "LCCS_subsystem_integrated/LCCS/LCCS/DtrmnLCCS_sensor_signal_rationality/check_signal_isNan6" /begin REF_MEASUREMENT VbLCCS_steer_control_enable /end REF_MEASUREMENT /end GROUP
/begin GROUP S11_check_signal_isNan8 "LCCS_subsystem_integrated/LCCS/LCCS/DtrmnLCCS_sensor_signal_rationality/check_signal_isNan8" /begin REF_MEASUREMENT VcLCCS_EPS_SteeringControlResponse_LCC /end REF_MEASUREMENT /end GROUP
/begin GROUP S11_check_signal_isNan9 "LCCS_subsystem_integrated/LCCS/LCCS/DtrmnLCCS_sensor_signal_rationality/check_signal_isNan9" /begin REF_MEASUREMENT VfLCCS_EPS_ActualSteeringAngle /end REF_MEASUREMENT /end GROUP
/begin GROUP S12_steering_control_machine "LCCS_subsystem_integrated/LCCS/LCCS/DtrmnLCCS_steering_control_output/steering_control_machine" /begin REF_CHARACTERISTIC KfLCCS_t_SampleTime KfLCCS_t_lateral_movement_delay /end REF_CHARACTERISTIC
 /begin REF_MEASUREMENT VbLCCS_lateral_movement_enabled VbLCCS_steering_control_active VbLCCS_steering_control_engaged VbLCCS_steering_control_stable /end REF_MEASUREMENT
/end GROUP
/begin GROUP S56_Compute_Feed_Forward "LCCS_subsystem_integrated/LCCS/LCCS/CalcLCCS_lateral_control_main/lateral_control/Compute_Feed_Forward"
 /begin REF_CHARACTERISTIC KfLCCS_cf KfLCCS_cr KfLCCS_d_lf KfLCCS_d_lr KfLCCS_d_wheel_base KfLCCS_mass /end REF_CHARACTERISTIC
/end GROUP
/begin GROUP S56_slowpath_steer_PI "LCCS_subsystem_integrated/LCCS/LCCS/CalcLCCS_lateral_control_main/lateral_control/slowpath_steer_PI" /begin REF_CHARACTERISTIC KfLCCS_d_LateralErrorDeadBand KfLCCS_t_SampleTime /end REF_CHARACTERISTIC
 /begin REF_MEASUREMENT VfLCCS_slowpath_steer_I VfLCCS_slowpath_steer_P VfLCCS_slowpath_steer_PI /end REF_MEASUREMENT
/end GROUP
/begin GROUP S57_angular_vel_limit "LCCS_subsystem_integrated/LCCS/LCCS/CalcLCCS_lateral_control_main/steering_wheel_angle/angular_vel_limit"
 /begin SUB_GROUP S79_frontwheel_2_steeringwheel S79_rate_limit S79_steering_angle_limit /end SUB_GROUP
/end GROUP
/begin GROUP S79_frontwheel_2_steeringwheel "LCCS_subsystem_integrated/LCCS/LCCS/CalcLCCS_lateral_control_main/steering_wheel_angle/angular_vel_limit/frontwheel_2_steeringwheel"
 /begin REF_CHARACTERISTIC KfLCCS_Ang_steering_center_position KfLCCS_r_veh_strwhl_2_frtwhl_ratio /end REF_CHARACTERISTIC
 /begin REF_MEASUREMENT VfLCCS_veh_strwhl_angle_des /end REF_MEASUREMENT
/end GROUP
/begin GROUP S79_rate_limit "LCCS_subsystem_integrated/LCCS/LCCS/CalcLCCS_lateral_control_main/steering_wheel_angle/angular_vel_limit/rate_limit" /begin REF_CHARACTERISTIC KfLCCS_r_steering_rate_forward_gain /end REF_CHARACTERISTIC
 /begin REF_MEASUREMENT VfLCCS_frtwhl_angle_step_limit VfLCCS_veh_frtwhl_angle_des_ramped /end REF_MEASUREMENT
/end GROUP
/begin GROUP S79_steering_angle_limit "LCCS_subsystem_integrated/LCCS/LCCS/CalcLCCS_lateral_control_main/steering_wheel_angle/angular_vel_limit/steering_angle_limit"
 /begin REF_CHARACTERISTIC KfLCCS_r_veh_strwhl_2_frtwhl_ratio KfLCCS_t_SampleTime KtLCCS_Ang_steering_angle_max KtLCCS_Ang_steering_angle_step KtLCCS_Ang_steering_angle_step_engaging /end REF_CHARACTERISTIC
 /begin REF_MEASUREMENT VfLCCS_frtwhl_angle_limit_manual /end REF_MEASUREMENT
/end GROUP
/end MODULE
/end PROJECT
/* (add any file trailer comments here) */
/* EOF LCCS_subsystem_integrated.a2l */
