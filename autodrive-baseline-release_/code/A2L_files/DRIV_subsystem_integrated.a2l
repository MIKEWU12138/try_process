/******************************************************************************
* ASAP2 file: DRIV_subsystem_integrated.a2l
* Code generation for model "DRIV_subsystem_integrated".
* Model version : 1.1200
* Simulink Coder version : 8.13 (R2017b) 24-Jul-2017
* C source code generated on : Wed Jun 10 08:46:08 2020
* Target selection: ert.tlc
* Embedded hardware selection: Infineon->TriCore
* Code generation objectives:
* 1. MISRA C:2012 guidelines
* 2. Safety precaution
* 3. Execution efficiency
* 4. RAM efficiency
* 5. ROM efficiency
* Validation result: Not run
* (add additional file header information here)
******************************************************************************/ ASAP2_VERSION 1 31
/* Version 1.31 */
/begin PROJECT ProjectName "Project Comment Goes Here"
/begin HEADER "Header Comments go here" /end HEADER
/begin MODULE ModuleName "Module Comment Goes Here"
/begin MOD_PAR "MOD PAR Comment Goes Here" /end MOD_PAR
/begin MOD_COMMON "Mod Common Comment Here" BYTE_ORDER MSB_LAST /end MOD_COMMON
/begin RECORD_LAYOUT Scalar_BOOLEAN FNC_VALUES 1 UBYTE COLUMN_DIR DIRECT /end RECORD_LAYOUT
/begin RECORD_LAYOUT Scalar_UBYTE FNC_VALUES 1 UBYTE COLUMN_DIR DIRECT /end RECORD_LAYOUT
/begin RECORD_LAYOUT Scalar_BYTE FNC_VALUES 1 SBYTE COLUMN_DIR DIRECT /end RECORD_LAYOUT
/begin RECORD_LAYOUT Scalar_UWORD FNC_VALUES 1 UWORD COLUMN_DIR DIRECT /end RECORD_LAYOUT
/begin RECORD_LAYOUT Scalar_SWORD FNC_VALUES 1 SWORD COLUMN_DIR DIRECT /end RECORD_LAYOUT
/begin RECORD_LAYOUT Scalar_ULONG FNC_VALUES 1 ULONG COLUMN_DIR DIRECT /end RECORD_LAYOUT
/begin RECORD_LAYOUT Scalar_LONG FNC_VALUES 1 SLONG COLUMN_DIR DIRECT /end RECORD_LAYOUT
/begin RECORD_LAYOUT Scalar_FLOAT32_IEEE FNC_VALUES 1 FLOAT32_IEEE COLUMN_DIR DIRECT /end RECORD_LAYOUT
/begin RECORD_LAYOUT Scalar_FLOAT64_IEEE FNC_VALUES 1 FLOAT64_IEEE COLUMN_DIR DIRECT /end RECORD_LAYOUT
/begin RECORD_LAYOUT Lookup1D_BOOLEAN FNC_VALUES 1 UBYTE COLUMN_DIR DIRECT /end RECORD_LAYOUT
/begin RECORD_LAYOUT Lookup1D_X_BOOLEAN AXIS_PTS_X 1 UBYTE INDEX_INCR DIRECT /end RECORD_LAYOUT
/begin RECORD_LAYOUT Lookup1D_BYTE FNC_VALUES 1 SBYTE COLUMN_DIR DIRECT /end RECORD_LAYOUT
/begin RECORD_LAYOUT Lookup1D_X_BYTE AXIS_PTS_X 1 SBYTE INDEX_INCR DIRECT /end RECORD_LAYOUT
/begin RECORD_LAYOUT Lookup1D_UBYTE FNC_VALUES 1 UBYTE COLUMN_DIR DIRECT /end RECORD_LAYOUT
/begin RECORD_LAYOUT Lookup1D_X_UBYTE AXIS_PTS_X 1 UBYTE INDEX_INCR DIRECT /end RECORD_LAYOUT
/begin RECORD_LAYOUT Lookup1D_UWORD FNC_VALUES 1 UWORD COLUMN_DIR DIRECT /end RECORD_LAYOUT
/begin RECORD_LAYOUT Lookup1D_X_UWORD AXIS_PTS_X 1 UWORD INDEX_INCR DIRECT /end RECORD_LAYOUT
/begin RECORD_LAYOUT Lookup1D_WORD FNC_VALUES 1 SWORD COLUMN_DIR DIRECT /end RECORD_LAYOUT
/begin RECORD_LAYOUT Lookup1D_X_WORD AXIS_PTS_X 1 SWORD INDEX_INCR DIRECT /end RECORD_LAYOUT
/begin RECORD_LAYOUT Lookup1D_ULONG FNC_VALUES 1 ULONG COLUMN_DIR DIRECT /end RECORD_LAYOUT
/begin RECORD_LAYOUT Lookup1D_X_ULONG AXIS_PTS_X 1 ULONG INDEX_INCR DIRECT /end RECORD_LAYOUT
/begin RECORD_LAYOUT Lookup1D_SLONG FNC_VALUES 1 SLONG COLUMN_DIR DIRECT /end RECORD_LAYOUT
/begin RECORD_LAYOUT Lookup1D_X_LONG AXIS_PTS_X 1 SLONG INDEX_INCR DIRECT /end RECORD_LAYOUT
/begin RECORD_LAYOUT Lookup1D_FLOAT32_IEEE FNC_VALUES 1 FLOAT32_IEEE COLUMN_DIR DIRECT /end RECORD_LAYOUT
/begin RECORD_LAYOUT Lookup1D_X_FLOAT32_IEEE AXIS_PTS_X 1 FLOAT32_IEEE INDEX_INCR DIRECT /end RECORD_LAYOUT
/begin RECORD_LAYOUT Lookup1D_FLOAT64_IEEE FNC_VALUES 1 FLOAT64_IEEE COLUMN_DIR DIRECT /end RECORD_LAYOUT
/begin RECORD_LAYOUT Lookup1D_X_FLOAT64_IEEE AXIS_PTS_X 1 FLOAT64_IEEE INDEX_INCR DIRECT /end RECORD_LAYOUT
/begin RECORD_LAYOUT Lookup2D_BOOLEAN FNC_VALUES 1 UBYTE COLUMN_DIR DIRECT /end RECORD_LAYOUT
/begin RECORD_LAYOUT Lookup2D_X_BOOLEAN AXIS_PTS_X 1 UBYTE INDEX_INCR DIRECT /end RECORD_LAYOUT
/begin RECORD_LAYOUT Lookup2D_UBYTE FNC_VALUES 1 UBYTE COLUMN_DIR DIRECT /end RECORD_LAYOUT
/begin RECORD_LAYOUT Lookup2D_X_UBYTE AXIS_PTS_X 1 UBYTE INDEX_INCR DIRECT /end RECORD_LAYOUT
/begin RECORD_LAYOUT Lookup2D_BYTE FNC_VALUES 1 SBYTE COLUMN_DIR DIRECT /end RECORD_LAYOUT
/begin RECORD_LAYOUT Lookup2D_X_BYTE AXIS_PTS_X 1 SBYTE INDEX_INCR DIRECT /end RECORD_LAYOUT
/begin RECORD_LAYOUT Lookup2D_UWORD FNC_VALUES 1 UWORD COLUMN_DIR DIRECT /end RECORD_LAYOUT
/begin RECORD_LAYOUT Lookup2D_X_UWORD AXIS_PTS_X 1 UWORD INDEX_INCR DIRECT /end RECORD_LAYOUT
/begin RECORD_LAYOUT Lookup2D_WORD FNC_VALUES 1 SWORD COLUMN_DIR DIRECT /end RECORD_LAYOUT
/begin RECORD_LAYOUT Lookup2D_X_WORD AXIS_PTS_X 1 SWORD INDEX_INCR DIRECT /end RECORD_LAYOUT
/begin RECORD_LAYOUT Lookup2D_ULONG FNC_VALUES 1 ULONG COLUMN_DIR DIRECT /end RECORD_LAYOUT
/begin RECORD_LAYOUT Lookup2D_X_ULONG AXIS_PTS_X 1 ULONG INDEX_INCR DIRECT /end RECORD_LAYOUT
/begin RECORD_LAYOUT Lookup2D_LONG FNC_VALUES 1 SLONG COLUMN_DIR DIRECT /end RECORD_LAYOUT
/begin RECORD_LAYOUT Lookup2D_X_LONG AXIS_PTS_X 1 SLONG INDEX_INCR DIRECT /end RECORD_LAYOUT
/begin RECORD_LAYOUT Lookup2D_FLOAT32_IEEE FNC_VALUES 1 FLOAT32_IEEE COLUMN_DIR DIRECT /end RECORD_LAYOUT
/begin RECORD_LAYOUT Lookup2D_X_FLOAT32_IEEE AXIS_PTS_X 1 FLOAT32_IEEE INDEX_INCR DIRECT /end RECORD_LAYOUT
/begin RECORD_LAYOUT Lookup2D_FLOAT64_IEEE FNC_VALUES 1 FLOAT64_IEEE COLUMN_DIR DIRECT /end RECORD_LAYOUT
/begin RECORD_LAYOUT Lookup2D_X_FLOAT64_IEEE AXIS_PTS_X 1 FLOAT64_IEEE INDEX_INCR DIRECT /end RECORD_LAYOUT
/begin CHARACTERISTIC KfACCS_t_SwitchLongPressThrsh "As press resume/set switch timer bigge than this calibration,tap up step will use KfACCS_v_TapUpDeltaLongPress" VALUE 0x0000 /* @ECU_Address@KfACCS_t_SwitchLongPressThrsh@ */ Scalar_FLOAT32_IEEE 0 DRIV_subsystem_integrated_CM_single_s 0.0 5.0 /end CHARACTERISTIC
/begin CHARACTERISTIC KfACCS_v_TapDownDelta "Tap down delta as press speed down switch" VALUE 0x0000 /* @ECU_Address@KfACCS_v_TapDownDelta@ */ Scalar_FLOAT32_IEEE 0 DRIV_subsystem_integrated_CM_single_m_s 0.0 5.0 /end CHARACTERISTIC
/begin CHARACTERISTIC KfACCS_v_TapDownDeltaLongPress "As press set switch timer bigge than KfACCS_t_SwitchLongPressThrsh,tap down step will use this calbiration" VALUE 0x0000 /* @ECU_Address@KfACCS_v_TapDownDeltaLongPress@ */ Scalar_FLOAT32_IEEE 0 DRIV_subsystem_integrated_CM_single_m_s 0.0 5.0 /end CHARACTERISTIC
/begin CHARACTERISTIC KfACCS_v_TapUpDelta "Tap up delta as press speed up switch" VALUE 0x0000 /* @ECU_Address@KfACCS_v_TapUpDelta@ */ Scalar_FLOAT32_IEEE 0 DRIV_subsystem_integrated_CM_single_m_s 0.0 5.0 /end CHARACTERISTIC
/begin CHARACTERISTIC KfACCS_v_TapUpDeltaLongPress "As press resume switch timer bigge than KfACCS_t_SwitchLongPressThrsh,tap up step will use this calibration" VALUE 0x0000 /* @ECU_Address@KfACCS_v_TapUpDeltaLongPress@ */ Scalar_FLOAT32_IEEE 0 DRIV_subsystem_integrated_CM_single_m_s 0.0 5.0 /end CHARACTERISTIC
/begin CHARACTERISTIC KfDRIV_CoeffStrwhl2Radius "When there's no EGMO, steer wheel angle is used to calculate Radius,
      Coefficent correction of radius." VALUE 0x0000 /* @ECU_Address@KfDRIV_CoeffStrwhl2Radius@ */ Scalar_FLOAT32_IEEE 0 DRIV_subsystem_integrated_CM_single 0.0 10.0 /end CHARACTERISTIC
/begin CHARACTERISTIC KfDRIV_Veh_Strwhl2FrtwhlRatio "steer ratio =17" VALUE 0x0000 /* @ECU_Address@KfDRIV_Veh_Strwhl2FrtwhlRatio@ */ Scalar_FLOAT32_IEEE 0 DRIV_subsystem_integrated_CM_single 17.0 20.0 /end CHARACTERISTIC
/begin CHARACTERISTIC KfDRIV_Veh_WheelBase "wheel base" VALUE 0x0000 /* @ECU_Address@KfDRIV_Veh_WheelBase@ */ Scalar_FLOAT32_IEEE 0 DRIV_subsystem_integrated_CM_single 3.0 3.5 /end CHARACTERISTIC
/begin CHARACTERISTIC KfDRIV_d_Dist2LaneChangeFinish "to lane_center distance < 0.4" VALUE 0x0000 /* @ECU_Address@KfDRIV_d_Dist2LaneChangeFinish@ */ Scalar_FLOAT32_IEEE 0 DRIV_subsystem_integrated_CM_single 0.0 1.0 /end CHARACTERISTIC
/begin CHARACTERISTIC KfDRIV_d_TouchedNewLaneDist "when vehicle touched new lane ,the distance to lane can increase in one sample time" VALUE 0x0000 /* @ECU_Address@KfDRIV_d_TouchedNewLaneDist@ */ Scalar_FLOAT32_IEEE 0 DRIV_subsystem_integrated_CM_single 2.0 5.0 /end CHARACTERISTIC
/begin CHARACTERISTIC KfDRIV_t_TimeEGMOReceivedThrsh "TimeEGMOReceivedThrsh" VALUE 0x0000 /* @ECU_Address@KfDRIV_t_TimeEGMOReceivedThrsh@ */ Scalar_FLOAT32_IEEE 0 DRIV_subsystem_integrated_CM_single 0.0 10.0 /end CHARACTERISTIC
/begin CHARACTERISTIC KfDRIV_t_TimeMPFUReceivedThrsh "TimeMPFUReceivedThrsh" VALUE 0x0000 /* @ECU_Address@KfDRIV_t_TimeMPFUReceivedThrsh@ */ Scalar_FLOAT32_IEEE 0 DRIV_subsystem_integrated_CM_single 0.0 10.0 /end CHARACTERISTIC
/begin CHARACTERISTIC KfDRIV_t_TimeOBFUNReceivedThrsh "TimeOBFUNReceivedThrsh" VALUE 0x0000 /* @ECU_Address@KfDRIV_t_TimeOBFUNReceivedThrsh@ */ Scalar_FLOAT32_IEEE 0 DRIV_subsystem_integrated_CM_single 0.0 10.0 /end CHARACTERISTIC
/begin CHARACTERISTIC KfDRIV_t_WaitTimeDriverDistracted "WaitTimeDriverDistracted" VALUE 0x0000 /* @ECU_Address@KfDRIV_t_WaitTimeDriverDistracted@ */ Scalar_FLOAT32_IEEE 0 DRIV_subsystem_integrated_CM_single 0.0 8.0 /end CHARACTERISTIC
/begin CHARACTERISTIC KfDRIV_t_WaitTimeLaneChangeFinish "WaitTimeLaneChangeFinish" VALUE 0x0000 /* @ECU_Address@KfDRIV_t_WaitTimeLaneChangeFinish@ */ Scalar_FLOAT32_IEEE 0 DRIV_subsystem_integrated_CM_single 0.0 4.0 /end CHARACTERISTIC
/begin CHARACTERISTIC KfDRIV_w_LaneWidthMax "LaneWidthMax" VALUE 0x0000 /* @ECU_Address@KfDRIV_w_LaneWidthMax@ */ Scalar_FLOAT32_IEEE 0 DRIV_subsystem_integrated_CM_single 3.0 4.0 /end CHARACTERISTIC
/begin CHARACTERISTIC kfDRIV_M_TorqueOverrideThreshold "steer torque threshold " VALUE 0x0000 /* @ECU_Address@kfDRIV_M_TorqueOverrideThreshold@ */ Scalar_FLOAT32_IEEE 0 DRIV_subsystem_integrated_CM_single -10.0 10.0 /end CHARACTERISTIC
/begin CHARACTERISTIC kfDRIV_M_TorqueOverrideThreshold_ACC "steer torque threshold ACC" VALUE 0x0000 /* @ECU_Address@kfDRIV_M_TorqueOverrideThreshold_ACC@ */ Scalar_FLOAT32_IEEE 0 DRIV_subsystem_integrated_CM_single -5.0 10.0 /end CHARACTERISTIC
/begin CHARACTERISTIC kfDRIV_M_TorqueOverrideThreshold_Auto "TorqueOverrideThreshold_Auto" VALUE 0x0000 /* @ECU_Address@kfDRIV_M_TorqueOverrideThreshold_Auto@ */ Scalar_FLOAT32_IEEE 0 DRIV_subsystem_integrated_CM_single -5.0 10.0 /end CHARACTERISTIC
/begin CHARACTERISTIC kfDRIV_M_TorqueOverrideThreshold_LCC "TorqueOverrideThreshold LCC driver  take over " VALUE 0x0000 /* @ECU_Address@kfDRIV_M_TorqueOverrideThreshold_LCC@ */ Scalar_FLOAT32_IEEE 0 DRIV_subsystem_integrated_CM_single -5.0 10.0 /end CHARACTERISTIC
/begin CHARACTERISTIC kfDRIV_M_TorqueThreshold_Distracted "" VALUE 0x0000 /* @ECU_Address@kfDRIV_M_TorqueThreshold_Distracted@ */ Scalar_FLOAT32_IEEE 0 DRIV_subsystem_integrated_CM_single -5.0 10.0 /end CHARACTERISTIC
/begin CHARACTERISTIC kfDRIV_SteerAngleRateThreshold "SteerAngleRateThreshold" VALUE 0x0000 /* @ECU_Address@kfDRIV_SteerAngleRateThreshold@ */ Scalar_FLOAT32_IEEE 0 DRIV_subsystem_integrated_CM_single 0.0 5.0 /end CHARACTERISTIC
/begin CHARACTERISTIC kfDRIV_SteerAngleThreshold "" VALUE 0x0000 /* @ECU_Address@kfDRIV_SteerAngleThreshold@ */ Scalar_FLOAT32_IEEE 0 DRIV_subsystem_integrated_CM_single 0.0 8.0 /end CHARACTERISTIC
/begin CHARACTERISTIC kfDRIV_TorqueRateThreshold "TorqueRateThreshold" VALUE 0x0000 /* @ECU_Address@kfDRIV_TorqueRateThreshold@ */ Scalar_FLOAT32_IEEE 0 DRIV_subsystem_integrated_CM_single 0.0 10.0 /end CHARACTERISTIC
/begin CHARACTERISTIC kfDRIV_TorqueRate_LC_Threshold "TorqueRate_LC_Threshold" VALUE 0x0000 /* @ECU_Address@kfDRIV_TorqueRate_LC_Threshold@ */ Scalar_FLOAT32_IEEE 0 DRIV_subsystem_integrated_CM_single 0.0 10.0 /end CHARACTERISTIC
/begin CHARACTERISTIC kfDRIV_YawRateThreshold "YawRateThreshold" VALUE 0x0000 /* @ECU_Address@kfDRIV_YawRateThreshold@ */ Scalar_FLOAT32_IEEE 0 DRIV_subsystem_integrated_CM_single 0.0 3.0 /end CHARACTERISTIC
/begin CHARACTERISTIC kfDRIV_YawRateThreshold2 "YawRateThreshold2" VALUE 0x0000 /* @ECU_Address@kfDRIV_YawRateThreshold2@ */ Scalar_FLOAT32_IEEE 0 DRIV_subsystem_integrated_CM_single 0.0 3.0 /end CHARACTERISTIC
/begin CHARACTERISTIC kfDRIV_c1_threshold "Lane Coefficient c1" VALUE 0x0000 /* @ECU_Address@kfDRIV_c1_threshold@ */ Scalar_FLOAT32_IEEE 0 DRIV_subsystem_integrated_CM_single -1.0 1.0 /end CHARACTERISTIC
/begin CHARACTERISTIC kfDRIV_k_FilterGain "steer torque  filter gain 0.9" VALUE 0x0000 /* @ECU_Address@kfDRIV_k_FilterGain@ */ Scalar_FLOAT32_IEEE 0 DRIV_subsystem_integrated_CM_single 0.0 1.0 /end CHARACTERISTIC
/begin CHARACTERISTIC kfDRIV_t_PeriodFunctionCall "model  sample time " VALUE 0x0000 /* @ECU_Address@kfDRIV_t_PeriodFunctionCall@ */ Scalar_FLOAT32_IEEE 0 DRIV_subsystem_integrated_CM_single 0.0 1.0 /end CHARACTERISTIC
/begin CHARACTERISTIC kfDRIV_t_TurnLightLeftOn_Time "TurnLightLeftOn_Time" VALUE 0x0000 /* @ECU_Address@kfDRIV_t_TurnLightLeftOn_Time@ */ Scalar_FLOAT32_IEEE 0 DRIV_subsystem_integrated_CM_single 0.0 8.0 /end CHARACTERISTIC
/begin CHARACTERISTIC kfDRIV_t_TurnLightOn_Time "TurnLightOn_Time" VALUE 0x0000 /* @ECU_Address@kfDRIV_t_TurnLightOn_Time@ */ Scalar_FLOAT32_IEEE 0 DRIV_subsystem_integrated_CM_single 0.0 8.0 /end CHARACTERISTIC
/begin CHARACTERISTIC kfDRIV_t_TurnLightRightOn_Time "TurnLightRightOn_Time" VALUE 0x0000 /* @ECU_Address@kfDRIV_t_TurnLightRightOn_Time@ */ Scalar_FLOAT32_IEEE 0 DRIV_subsystem_integrated_CM_single 0.0 8.0 /end CHARACTERISTIC
/begin CHARACTERISTIC KcDRIV_ACCSCancelSwitchDebounceThrsh "ACCS cancel switch debounce thresh." VALUE 0x0000 /* @ECU_Address@KcDRIV_ACCSCancelSwitchDebounceThrsh@ */ Scalar_UBYTE 0 DRIV_subsystem_integrated_CM_uint8 0.0 200.0 /end CHARACTERISTIC
/begin CHARACTERISTIC KcDRIV_ACCSMainSwitchDebounceThrsh "ACCS main switch debounce thresh." VALUE 0x0000 /* @ECU_Address@KcDRIV_ACCSMainSwitchDebounceThrsh@ */ Scalar_UBYTE 0 DRIV_subsystem_integrated_CM_uint8 0.0 200.0 /end CHARACTERISTIC
/begin CHARACTERISTIC KcDRIV_ACCSResumeSwitchDebounceThrsh "ACCS resume switch debounce thresh." VALUE 0x0000 /* @ECU_Address@KcDRIV_ACCSResumeSwitchDebounceThrsh@ */ Scalar_UBYTE 0 DRIV_subsystem_integrated_CM_uint8 0.0 200.0 /end CHARACTERISTIC
/begin CHARACTERISTIC KcDRIV_ACCSSetSwitchDebounceThrsh "ACCS set switch debounce thresh." VALUE 0x0000 /* @ECU_Address@KcDRIV_ACCSSetSwitchDebounceThrsh@ */ Scalar_UBYTE 0 DRIV_subsystem_integrated_CM_uint8 0.0 200.0 /end CHARACTERISTIC
/begin CHARACTERISTIC KcDRIV_ACCSTimeGapMinusDebounceThrsh "ACCS time gap minus switch debounce thresh." VALUE 0x0000 /* @ECU_Address@KcDRIV_ACCSTimeGapMinusDebounceThrsh@ */ Scalar_UBYTE 0 DRIV_subsystem_integrated_CM_uint8 0.0 200.0 /end CHARACTERISTIC
/begin CHARACTERISTIC KcDRIV_ACCSTimeGapPlusDebounceThrsh "ACCS time gap plus switch debounce thresh." VALUE 0x0000 /* @ECU_Address@KcDRIV_ACCSTimeGapPlusDebounceThrsh@ */ Scalar_UBYTE 0 DRIV_subsystem_integrated_CM_uint8 0.0 200.0 /end CHARACTERISTIC
/begin CHARACTERISTIC kfDRIV_DelayLoopGain "button delay loop gain " VALUE 0x0000 /* @ECU_Address@kfDRIV_DelayLoopGain@ */ Scalar_UBYTE 0 DRIV_subsystem_integrated_CM_uint8 0.0 10.0 /end CHARACTERISTIC
/begin CHARACTERISTIC KbDRIV_DRIVEnable "DRIV mode status is true" VALUE 0x0000 /* @ECU_Address@KbDRIV_DRIVEnable@ */ Scalar_BOOLEAN 0 DRIV_subsystem_integrated_CM_boolean 0.0 1.0 /end CHARACTERISTIC
/begin CHARACTERISTIC KbDRIV_Default_EnableAutoDrive "Default auto drive is false" VALUE 0x0000 /* @ECU_Address@KbDRIV_Default_EnableAutoDrive@ */ Scalar_BOOLEAN 0 DRIV_subsystem_integrated_CM_boolean 0.0 1.0 /end CHARACTERISTIC
/begin CHARACTERISTIC KbDRIV_Default_LaneKeepAssist "default vehicle is lanekeeping" VALUE 0x0000 /* @ECU_Address@KbDRIV_Default_LaneKeepAssist@ */ Scalar_BOOLEAN 0 DRIV_subsystem_integrated_CM_boolean 0.0 1.0 /end CHARACTERISTIC
/begin CHARACTERISTIC KbDRIV_Default_Override_Steering "default override steering  status is false" VALUE 0x0000 /* @ECU_Address@KbDRIV_Default_Override_Steering@ */ Scalar_BOOLEAN 0 DRIV_subsystem_integrated_CM_boolean 0.0 1.0 /end CHARACTERISTIC
/begin CHARACTERISTIC KbDRIV_Update_Override_Steering "update override steering status is true" VALUE 0x0000 /* @ECU_Address@KbDRIV_Update_Override_Steering@ */ Scalar_BOOLEAN 0 DRIV_subsystem_integrated_CM_boolean 0.0 1.0 /end CHARACTERISTIC
/begin MEASUREMENT VfDRIV_Steer_Torque_Rate "" FLOAT32_IEEE DRIV_subsystem_integrated_CM_single 0 0 -3.4E+38 3.4E+38 ECU_ADDRESS 0x0000 /* @ECU_Address@VfDRIV_Steer_Torque_Rate@ */ /end MEASUREMENT
/begin MEASUREMENT VfDRIV_yawrate "" FLOAT32_IEEE DRIV_subsystem_integrated_CM_single 0 0 -3.4E+38 3.4E+38 ECU_ADDRESS 0x0000 /* @ECU_Address@VfDRIV_yawrate@ */ /end MEASUREMENT
/begin MEASUREMENT VfDRIV_c1_heading "" FLOAT32_IEEE DRIV_subsystem_integrated_CM_single 0 0 -3.4E+38 3.4E+38 ECU_ADDRESS 0x0000 /* @ECU_Address@VfDRIV_c1_heading@ */ /end MEASUREMENT
/begin MEASUREMENT VfDRIV_ACCDriveSetSpeed "Driver set target speed(Consider with speed up/down switch)" FLOAT32_IEEE DRIV_subsystem_integrated_CM_single_m_s 0 0 0.0 50.0 ECU_ADDRESS 0x0000 /* @ECU_Address@VfDRIV_ACCDriveSetSpeed@ */ /end MEASUREMENT
/begin MEASUREMENT VfDRIV_steer_angle "" FLOAT32_IEEE DRIV_subsystem_integrated_CM_single 0 0 -3.4E+38 3.4E+38 ECU_ADDRESS 0x0000 /* @ECU_Address@VfDRIV_steer_angle@ */ /end MEASUREMENT
/begin MEASUREMENT VfDRIV_SteerAngleRate "" FLOAT32_IEEE DRIV_subsystem_integrated_CM_single 0 0 -3.4E+38 3.4E+38 ECU_ADDRESS 0x0000 /* @ECU_Address@VfDRIV_SteerAngleRate@ */ /end MEASUREMENT
/begin MEASUREMENT VfDRIV_Steer_Torque_Filter "" FLOAT32_IEEE DRIV_subsystem_integrated_CM_single 0 0 -3.4E+38 3.4E+38 ECU_ADDRESS 0x0000 /* @ECU_Address@VfDRIV_Steer_Torque_Filter@ */ /end MEASUREMENT
/begin MEASUREMENT VfDRIV_ACCTimeGap "Driver set time gap" UBYTE DRIV_subsystem_integrated_CM_uint8 0 0 0.0 8.0 ECU_ADDRESS 0x0000 /* @ECU_Address@VfDRIV_ACCTimeGap@ */ /end MEASUREMENT
/begin MEASUREMENT VbDRIV_Norm_driving "" UBYTE DRIV_subsystem_integrated_CM_boolean 0 0 0 1 ECU_ADDRESS 0x0000 /* @ECU_Address@VbDRIV_Norm_driving@ */ /end MEASUREMENT
/begin MEASUREMENT VbDRIV_Driver_Take_Over "" UBYTE DRIV_subsystem_integrated_CM_boolean 0 0 0 1 ECU_ADDRESS 0x0000 /* @ECU_Address@VbDRIV_Driver_Take_Over@ */ /end MEASUREMENT
/begin MEASUREMENT VbDRIV_Driver_Distracted "" UBYTE DRIV_subsystem_integrated_CM_boolean 0 0 0 1 ECU_ADDRESS 0x0000 /* @ECU_Address@VbDRIV_Driver_Distracted@ */ /end MEASUREMENT
/begin MEASUREMENT VbDIRV_Override_Steering "" UBYTE DRIV_subsystem_integrated_CM_boolean 0 0 0 1 ECU_ADDRESS 0x0000 /* @ECU_Address@VbDIRV_Override_Steering@ */ /end MEASUREMENT
/begin MEASUREMENT VbDRIV_LeftSide_LC_Req "" UBYTE DRIV_subsystem_integrated_CM_boolean 0 0 0 1 ECU_ADDRESS 0x0000 /* @ECU_Address@VbDRIV_LeftSide_LC_Req@ */ /end MEASUREMENT
/begin MEASUREMENT VbDRIV_RightSide_LC_Req "" UBYTE DRIV_subsystem_integrated_CM_boolean 0 0 0 1 ECU_ADDRESS 0x0000 /* @ECU_Address@VbDRIV_RightSide_LC_Req@ */ /end MEASUREMENT
/begin MEASUREMENT VbDRIV_LaneChangeReady_Req "" UBYTE DRIV_subsystem_integrated_CM_boolean 0 0 0 1 ECU_ADDRESS 0x0000 /* @ECU_Address@VbDRIV_LaneChangeReady_Req@ */ /end MEASUREMENT
/begin MEASUREMENT VbDRIV_LaneChanging_Req "" UBYTE DRIV_subsystem_integrated_CM_boolean 0 0 0 1 ECU_ADDRESS 0x0000 /* @ECU_Address@VbDRIV_LaneChanging_Req@ */ /end MEASUREMENT
/begin MEASUREMENT VbDRIV_LaneChangeFinish_Req "" UBYTE DRIV_subsystem_integrated_CM_boolean 0 0 0 1 ECU_ADDRESS 0x0000 /* @ECU_Address@VbDRIV_LaneChangeFinish_Req@ */ /end MEASUREMENT
/begin MEASUREMENT VbDRIV_LC_Enable "" UBYTE DRIV_subsystem_integrated_CM_boolean 0 0 0 1 ECU_ADDRESS 0x0000 /* @ECU_Address@VbDRIV_LC_Enable@ */ /end MEASUREMENT
/begin MEASUREMENT VbDRIV_TurnType "" UBYTE DRIV_subsystem_integrated_CM_boolean 0 0 0 1 ECU_ADDRESS 0x0000 /* @ECU_Address@VbDRIV_TurnType@ */ /end MEASUREMENT
/begin MEASUREMENT VbDRIV_Update_Override_Steering "" UBYTE DRIV_subsystem_integrated_CM_boolean 0 0 0 1 ECU_ADDRESS 0x0000 /* @ECU_Address@VbDRIV_Update_Override_Steering@ */ /end MEASUREMENT
/begin MEASUREMENT VbDRIV_LaneKeepAssist "" UBYTE DRIV_subsystem_integrated_CM_boolean 0 0 0 1 ECU_ADDRESS 0x0000 /* @ECU_Address@VbDRIV_LaneKeepAssist@ */ /end MEASUREMENT
/begin MEASUREMENT VbDRIV_Touched_new_lane "" UBYTE DRIV_subsystem_integrated_CM_boolean 0 0 0 1 ECU_ADDRESS 0x0000 /* @ECU_Address@VbDRIV_Touched_new_lane@ */ /end MEASUREMENT
/begin MEASUREMENT VbDRIV_ACCResumeSwitch "ACC resume switch status" UBYTE DRIV_subsystem_integrated_CM_boolean 0 0 0.0 1.0 ECU_ADDRESS 0x0000 /* @ECU_Address@VbDRIV_ACCResumeSwitch@ */ /end MEASUREMENT
/begin MEASUREMENT VbDRIV_ACCCancelSwitch "ACC cancel switch status" UBYTE DRIV_subsystem_integrated_CM_boolean 0 0 0.0 1.0 ECU_ADDRESS 0x0000 /* @ECU_Address@VbDRIV_ACCCancelSwitch@ */ /end MEASUREMENT
/begin MEASUREMENT VbDRIV_ACCMainSwitch "ACC main switch status" UBYTE DRIV_subsystem_integrated_CM_boolean 0 0 0.0 0.0 ECU_ADDRESS 0x0000 /* @ECU_Address@VbDRIV_ACCMainSwitch@ */ /end MEASUREMENT
/begin MEASUREMENT VeDRIV_LeftChangeLane "" UBYTE DRIV_subsystem_integrated_CM_EnumDRIV_LeftChangeLane 0 0 0 3 ECU_ADDRESS 0x0000 /* @ECU_Address@VeDRIV_LeftChangeLane@ */ /end MEASUREMENT
/begin MEASUREMENT VeDRIV_RightChangeLane "" UBYTE DRIV_subsystem_integrated_CM_EnumDRIV_RightChangeLane 0 0 0 3 ECU_ADDRESS 0x0000 /* @ECU_Address@VeDRIV_RightChangeLane@ */ /end MEASUREMENT
/begin COMPU_METHOD DRIV_subsystem_integrated_CM_single_s "Q = V" RAT_FUNC "%8.6" "s" COEFFS 0 1 0 0 0 1 /end COMPU_METHOD
/begin COMPU_METHOD DRIV_subsystem_integrated_CM_single_m_s "Q = V" RAT_FUNC "%8.6" "m/s" COEFFS 0 1 0 0 0 1 /end COMPU_METHOD
/begin COMPU_METHOD DRIV_subsystem_integrated_CM_single "Q = V" RAT_FUNC "%8.6" "" COEFFS 0 1 0 0 0 1 /end COMPU_METHOD
/begin COMPU_METHOD DRIV_subsystem_integrated_CM_uint8 "Q = V" RAT_FUNC "%3.0" "" COEFFS 0 1 0 0 0 1 /end COMPU_METHOD
/begin COMPU_METHOD DRIV_subsystem_integrated_CM_boolean "Q = V" RAT_FUNC "%1.0" "" COEFFS 0 1 0 0 0 1 /end COMPU_METHOD
/begin COMPU_METHOD DRIV_subsystem_integrated_CM_EnumDRIV_LeftChangeLane "Enumerated data type: EnumDRIV_LeftChangeLane" TAB_VERB "%0.6" "" /* Conversion Table */ COMPU_TAB_REF VTAB_FOR_DRIV_subsystem_integrated_CM_EnumDRIV_LeftChangeLane /end COMPU_METHOD
/begin COMPU_VTAB /* Name of Table */ VTAB_FOR_DRIV_subsystem_integrated_CM_EnumDRIV_LeftChangeLane "Enumerated data type: EnumDRIV_LeftChangeLane" TAB_VERB /* Number of Elements */ 4 0 "LeftLC_NOT" 1 "LeftLC_Ready" 2 "LeftLC_Ing" 3 "LeftLC_Finish" /end COMPU_VTAB
/begin COMPU_METHOD DRIV_subsystem_integrated_CM_EnumDRIV_RightChangeLane "Enumerated data type: EnumDRIV_RightChangeLane" TAB_VERB "%0.6" "" /* Conversion Table */ COMPU_TAB_REF VTAB_FOR_DRIV_subsystem_integrated_CM_EnumDRIV_RightChangeLane /end COMPU_METHOD
/begin COMPU_VTAB /* Name of Table */ VTAB_FOR_DRIV_subsystem_integrated_CM_EnumDRIV_RightChangeLane "Enumerated data type: EnumDRIV_RightChangeLane" TAB_VERB /* Number of Elements */ 4 0 "RightLC_NOT" 1 "RightLC_Ready" 2 "RightLC_Ing" 3 "RightLC_Finish" /end COMPU_VTAB
/begin GROUP DRIV_subsystem_integrated "DRIV_subsystem_integrated" /* Root */ ROOT /begin SUB_GROUP Root_DRIV_ /end SUB_GROUP /end GROUP
/begin GROUP Root_DRIV_ "DRIV_subsystem_integrated/DRIV "
 /begin SUB_GROUP S1_CheckDRIV_SignalInput S1_CheckDRIV_SignalOutput S1_DtrmnDRIV_RunStatus /end SUB_GROUP
/end GROUP
/begin GROUP S1_CheckDRIV_SignalInput "DRIV_subsystem_integrated/DRIV /CheckDRIV_SignalInput"
 /begin SUB_GROUP S3_Fault_Detection S3_Subsystem S3_Subsystem1 S3_adc_path_prediction /end SUB_GROUP
 /begin REF_MEASUREMENT VfDRIV_steer_angle /end REF_MEASUREMENT
/end GROUP
/begin GROUP S1_CheckDRIV_SignalOutput "DRIV_subsystem_integrated/DRIV /CheckDRIV_SignalOutput" /begin REF_CHARACTERISTIC KbDRIV_DRIVEnable /end REF_CHARACTERISTIC /end GROUP
/begin GROUP S1_DtrmnDRIV_RunStatus "DRIV_subsystem_integrated/DRIV /DtrmnDRIV_RunStatus" /begin SUB_GROUP S5_DtrmnDRIV_OvrdButtonStatus S5_DtrmnDRIV_OvrdSteerStatus /end SUB_GROUP /begin REF_CHARACTERISTIC KbDRIV_Default_EnableAutoDrive /end REF_CHARACTERISTIC /end GROUP
/begin GROUP S3_Fault_Detection "DRIV_subsystem_integrated/DRIV /CheckDRIV_SignalInput/Fault Detection"
 /begin REF_CHARACTERISTIC KfDRIV_t_TimeEGMOReceivedThrsh KfDRIV_t_TimeMPFUReceivedThrsh KfDRIV_t_TimeOBFUNReceivedThrsh /end REF_CHARACTERISTIC
/end GROUP
/begin GROUP S3_Subsystem "DRIV_subsystem_integrated/DRIV /CheckDRIV_SignalInput/Subsystem" /begin REF_CHARACTERISTIC kfDRIV_k_FilterGain /end REF_CHARACTERISTIC /begin REF_MEASUREMENT VfDRIV_Steer_Torque_Filter /end REF_MEASUREMENT /end GROUP
/begin GROUP S3_Subsystem1 "DRIV_subsystem_integrated/DRIV /CheckDRIV_SignalInput/Subsystem1" /begin REF_CHARACTERISTIC kfDRIV_t_PeriodFunctionCall /end REF_CHARACTERISTIC /begin REF_MEASUREMENT VfDRIV_SteerAngleRate /end REF_MEASUREMENT /end GROUP
/begin GROUP S3_adc_path_prediction "DRIV_subsystem_integrated/DRIV /CheckDRIV_SignalInput/adc_path_prediction"
 /begin REF_CHARACTERISTIC KfDRIV_CoeffStrwhl2Radius KfDRIV_Veh_Strwhl2FrtwhlRatio KfDRIV_Veh_WheelBase /end REF_CHARACTERISTIC
/end GROUP
/begin GROUP S5_DtrmnDRIV_OvrdButtonStatus "DRIV_subsystem_integrated/DRIV /DtrmnDRIV_RunStatus/DtrmnDRIV_OvrdButtonStatus" /begin SUB_GROUP S28_DtrmnDRIV_ACC_Switch /end SUB_GROUP /begin REF_CHARACTERISTIC kfDRIV_DelayLoopGain kfDRIV_t_PeriodFunctionCall /end REF_CHARACTERISTIC /end GROUP
/begin GROUP S5_DtrmnDRIV_OvrdSteerStatus "DRIV_subsystem_integrated/DRIV /DtrmnDRIV_RunStatus/DtrmnDRIV_OvrdSteerStatus"
 /begin SUB_GROUP S29_DtrmnDRIV_LaneChange_Judge S29_DtrmnDRIV_OverrideSteering /end SUB_GROUP
/end GROUP
/begin GROUP S28_DtrmnDRIV_ACC_Switch "DRIV_subsystem_integrated/DRIV /DtrmnDRIV_RunStatus/DtrmnDRIV_OvrdButtonStatus/DtrmnDRIV_ACC_Switch" /begin SUB_GROUP S30_DtrmnDRIV_TargetTimeGap /end SUB_GROUP
 /begin REF_CHARACTERISTIC KcDRIV_ACCSCancelSwitchDebounceThrsh KcDRIV_ACCSMainSwitchDebounceThrsh KcDRIV_ACCSResumeSwitchDebounceThrsh KcDRIV_ACCSSetSwitchDebounceThrsh KcDRIV_ACCSTimeGapMinusDebounceThrsh KcDRIV_ACCSTimeGapPlusDebounceThrsh KfACCS_t_SwitchLongPressThrsh KfACCS_v_TapDownDelta KfACCS_v_TapDownDeltaLongPress KfACCS_v_TapUpDelta KfACCS_v_TapUpDeltaLongPress /end REF_CHARACTERISTIC
 /begin REF_MEASUREMENT VbDRIV_ACCCancelSwitch VbDRIV_ACCMainSwitch VbDRIV_ACCResumeSwitch VfDRIV_ACCDriveSetSpeed /end REF_MEASUREMENT
/end GROUP
/begin GROUP S29_DtrmnDRIV_LaneChange_Judge "DRIV_subsystem_integrated/DRIV /DtrmnDRIV_RunStatus/DtrmnDRIV_OvrdSteerStatus/DtrmnDRIV_LaneChange_Judge"
 /begin SUB_GROUP S48_DRIV_LC_Intention_Judge S48_DRIV_OverrideSteer_DefaultData /end SUB_GROUP
 /begin REF_CHARACTERISTIC KfDRIV_d_TouchedNewLaneDist KfDRIV_w_LaneWidthMax /end REF_CHARACTERISTIC
/end GROUP
/begin GROUP S29_DtrmnDRIV_OverrideSteering "DRIV_subsystem_integrated/DRIV /DtrmnDRIV_RunStatus/DtrmnDRIV_OvrdSteerStatus/DtrmnDRIV_OverrideSteering"
 /begin SUB_GROUP S49_driver_Normal_driving S49_driver_distracted S49_driver_take_over /end SUB_GROUP
 /begin REF_MEASUREMENT VbDIRV_Override_Steering /end REF_MEASUREMENT
/end GROUP
/begin GROUP S30_DtrmnDRIV_TargetTimeGap "DRIV_subsystem_integrated/DRIV /DtrmnDRIV_RunStatus/DtrmnDRIV_OvrdButtonStatus/DtrmnDRIV_ACC_Switch/DtrmnDRIV_TargetTimeGap" /begin REF_MEASUREMENT VfDRIV_ACCTimeGap /end REF_MEASUREMENT /end GROUP
/begin GROUP S48_DRIV_LC_Intention_Judge "DRIV_subsystem_integrated/DRIV /DtrmnDRIV_RunStatus/DtrmnDRIV_OvrdSteerStatus/DtrmnDRIV_LaneChange_Judge/DRIV_LC_Intention_Judge"
 /begin SUB_GROUP S50_CheckLCLogiCondition S50_CheckLCProcess S50_DtrmnDRIV_OverrideSteerStatus /end SUB_GROUP
/end GROUP
/begin GROUP S48_DRIV_OverrideSteer_DefaultData "DRIV_subsystem_integrated/DRIV /DtrmnDRIV_RunStatus/DtrmnDRIV_OvrdSteerStatus/DtrmnDRIV_LaneChange_Judge/DRIV_OverrideSteer_DefaultData"
 /begin REF_CHARACTERISTIC KbDRIV_Default_LaneKeepAssist KbDRIV_Default_Override_Steering /end REF_CHARACTERISTIC
/end GROUP
/begin GROUP S49_driver_Normal_driving "DRIV_subsystem_integrated/DRIV /DtrmnDRIV_RunStatus/DtrmnDRIV_OvrdSteerStatus/DtrmnDRIV_OverrideSteering/driver_Normal_driving"
 /begin REF_CHARACTERISTIC kfDRIV_M_TorqueOverrideThreshold kfDRIV_TorqueRateThreshold kfDRIV_t_PeriodFunctionCall /end REF_CHARACTERISTIC
 /begin REF_MEASUREMENT VbDRIV_Norm_driving VfDRIV_Steer_Torque_Rate /end REF_MEASUREMENT
/end GROUP
/begin GROUP S49_driver_distracted "DRIV_subsystem_integrated/DRIV /DtrmnDRIV_RunStatus/DtrmnDRIV_OvrdSteerStatus/DtrmnDRIV_OverrideSteering/driver_distracted"
 /begin REF_CHARACTERISTIC KfDRIV_t_WaitTimeDriverDistracted kfDRIV_M_TorqueOverrideThreshold_Auto kfDRIV_M_TorqueThreshold_Distracted /end REF_CHARACTERISTIC
 /begin REF_MEASUREMENT VbDRIV_Driver_Distracted /end REF_MEASUREMENT
/end GROUP
/begin GROUP S49_driver_take_over "DRIV_subsystem_integrated/DRIV /DtrmnDRIV_RunStatus/DtrmnDRIV_OvrdSteerStatus/DtrmnDRIV_OverrideSteering/driver_take_over"
 /begin REF_CHARACTERISTIC kfDRIV_M_TorqueOverrideThreshold_ACC kfDRIV_M_TorqueOverrideThreshold_LCC /end REF_CHARACTERISTIC
 /begin REF_MEASUREMENT VbDRIV_Driver_Take_Over /end REF_MEASUREMENT
/end GROUP
/begin GROUP S50_CheckLCLogiCondition "DRIV_subsystem_integrated/DRIV /DtrmnDRIV_RunStatus/DtrmnDRIV_OvrdSteerStatus/DtrmnDRIV_LaneChange_Judge/DRIV_LC_Intention_Judge/CheckLCLogiCondition" /begin SUB_GROUP S52_CheckTurntype S52_lc_side_estimate /end SUB_GROUP /begin REF_MEASUREMENT VbDRIV_LC_Enable VfDRIV_yawrate /end REF_MEASUREMENT /end GROUP
/begin GROUP S50_CheckLCProcess "DRIV_subsystem_integrated/DRIV /DtrmnDRIV_RunStatus/DtrmnDRIV_OvrdSteerStatus/DtrmnDRIV_LaneChange_Judge/DRIV_LC_Intention_Judge/CheckLCProcess"
 /begin SUB_GROUP S53_CheckLCFinish S53_CheckLCIng S53_CheckLCReady S53_Subsystem /end SUB_GROUP
 /begin REF_MEASUREMENT VbDRIV_Touched_new_lane VfDRIV_c1_heading /end REF_MEASUREMENT
/end GROUP
/begin GROUP S50_DtrmnDRIV_OverrideSteerStatus "DRIV_subsystem_integrated/DRIV /DtrmnDRIV_RunStatus/DtrmnDRIV_OvrdSteerStatus/DtrmnDRIV_LaneChange_Judge/DRIV_LC_Intention_Judge/DtrmnDRIV_OverrideSteerStatus" /begin SUB_GROUP S54_DRIV_Out /end SUB_GROUP
 /begin REF_MEASUREMENT VbDRIV_LaneKeepAssist VeDRIV_LeftChangeLane VeDRIV_RightChangeLane /end REF_MEASUREMENT
/end GROUP
/begin GROUP S52_CheckTurntype "DRIV_subsystem_integrated/DRIV /DtrmnDRIV_RunStatus/DtrmnDRIV_OvrdSteerStatus/DtrmnDRIV_LaneChange_Judge/DRIV_LC_Intention_Judge/CheckLCLogiCondition/CheckTurntype" /begin REF_MEASUREMENT VbDRIV_TurnType /end REF_MEASUREMENT /end GROUP
/begin GROUP S52_lc_side_estimate "DRIV_subsystem_integrated/DRIV /DtrmnDRIV_RunStatus/DtrmnDRIV_OvrdSteerStatus/DtrmnDRIV_LaneChange_Judge/DRIV_LC_Intention_Judge/CheckLCLogiCondition/lc_side_estimate"
 /begin REF_CHARACTERISTIC kfDRIV_SteerAngleThreshold kfDRIV_t_TurnLightLeftOn_Time kfDRIV_t_TurnLightRightOn_Time /end REF_CHARACTERISTIC
 /begin REF_MEASUREMENT VbDRIV_LeftSide_LC_Req VbDRIV_RightSide_LC_Req /end REF_MEASUREMENT
/end GROUP
/begin GROUP S53_CheckLCFinish "DRIV_subsystem_integrated/DRIV /DtrmnDRIV_RunStatus/DtrmnDRIV_OvrdSteerStatus/DtrmnDRIV_LaneChange_Judge/DRIV_LC_Intention_Judge/CheckLCProcess/CheckLCFinish"
 /begin REF_CHARACTERISTIC KfDRIV_d_Dist2LaneChangeFinish KfDRIV_t_WaitTimeLaneChangeFinish /end REF_CHARACTERISTIC
/end GROUP
/begin GROUP S53_CheckLCIng "DRIV_subsystem_integrated/DRIV /DtrmnDRIV_RunStatus/DtrmnDRIV_OvrdSteerStatus/DtrmnDRIV_LaneChange_Judge/DRIV_LC_Intention_Judge/CheckLCProcess/CheckLCIng" /begin REF_CHARACTERISTIC kfDRIV_YawRateThreshold2 kfDRIV_c1_threshold /end REF_CHARACTERISTIC /end GROUP
/begin GROUP S53_CheckLCReady "DRIV_subsystem_integrated/DRIV /DtrmnDRIV_RunStatus/DtrmnDRIV_OvrdSteerStatus/DtrmnDRIV_LaneChange_Judge/DRIV_LC_Intention_Judge/CheckLCProcess/CheckLCReady"
 /begin REF_CHARACTERISTIC kfDRIV_SteerAngleRateThreshold kfDRIV_TorqueRate_LC_Threshold kfDRIV_YawRateThreshold kfDRIV_t_PeriodFunctionCall kfDRIV_t_TurnLightOn_Time /end REF_CHARACTERISTIC
/end GROUP
/begin GROUP S53_Subsystem "DRIV_subsystem_integrated/DRIV /DtrmnDRIV_RunStatus/DtrmnDRIV_OvrdSteerStatus/DtrmnDRIV_LaneChange_Judge/DRIV_LC_Intention_Judge/CheckLCProcess/Subsystem"
 /begin REF_MEASUREMENT VbDRIV_LaneChangeFinish_Req VbDRIV_LaneChangeReady_Req VbDRIV_LaneChanging_Req /end REF_MEASUREMENT
/end GROUP
/begin GROUP S54_DRIV_Out "DRIV_subsystem_integrated/DRIV /DtrmnDRIV_RunStatus/DtrmnDRIV_OvrdSteerStatus/DtrmnDRIV_LaneChange_Judge/DRIV_LC_Intention_Judge/DtrmnDRIV_OverrideSteerStatus/DRIV_Out" /begin REF_CHARACTERISTIC KbDRIV_Update_Override_Steering /end REF_CHARACTERISTIC /begin REF_MEASUREMENT VbDRIV_Update_Override_Steering /end REF_MEASUREMENT /end GROUP
/end MODULE
/end PROJECT
/* (add any file trailer comments here) */
/* EOF DRIV_subsystem_integrated.a2l */
