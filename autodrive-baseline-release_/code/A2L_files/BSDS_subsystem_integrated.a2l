/******************************************************************************
* ASAP2 file: BSDS_subsystem_integrated.a2l
* Code generation for model "BSDS_subsystem_integrated".
* Model version : 1.461
* Simulink Coder version : 8.13 (R2017b) 24-Jul-2017
* C source code generated on : Mon Jun 8 17:08:55 2020
* Target selection: ert.tlc
* Embedded hardware selection: Infineon->TriCore
* Code generation objectives:
* 1. MISRA C:2012 guidelines
* 2. Safety precaution
* 3. Execution efficiency
* 4. RAM efficiency
* 5. ROM efficiency
* Validation result: Not run
* (add additional file header information here)
******************************************************************************/ ASAP2_VERSION 1 31
/* Version 1.31 */
/begin PROJECT ProjectName "Project Comment Goes Here"
/begin HEADER "Header Comments go here" /end HEADER
/begin MODULE ModuleName "Module Comment Goes Here"
/begin MOD_PAR "MOD PAR Comment Goes Here" /end MOD_PAR
/begin MOD_COMMON "Mod Common Comment Here" BYTE_ORDER MSB_LAST /end MOD_COMMON
/begin RECORD_LAYOUT Scalar_BOOLEAN FNC_VALUES 1 UBYTE COLUMN_DIR DIRECT /end RECORD_LAYOUT
/begin RECORD_LAYOUT Scalar_UBYTE FNC_VALUES 1 UBYTE COLUMN_DIR DIRECT /end RECORD_LAYOUT
/begin RECORD_LAYOUT Scalar_BYTE FNC_VALUES 1 SBYTE COLUMN_DIR DIRECT /end RECORD_LAYOUT
/begin RECORD_LAYOUT Scalar_UWORD FNC_VALUES 1 UWORD COLUMN_DIR DIRECT /end RECORD_LAYOUT
/begin RECORD_LAYOUT Scalar_SWORD FNC_VALUES 1 SWORD COLUMN_DIR DIRECT /end RECORD_LAYOUT
/begin RECORD_LAYOUT Scalar_ULONG FNC_VALUES 1 ULONG COLUMN_DIR DIRECT /end RECORD_LAYOUT
/begin RECORD_LAYOUT Scalar_LONG FNC_VALUES 1 SLONG COLUMN_DIR DIRECT /end RECORD_LAYOUT
/begin RECORD_LAYOUT Scalar_FLOAT32_IEEE FNC_VALUES 1 FLOAT32_IEEE COLUMN_DIR DIRECT /end RECORD_LAYOUT
/begin RECORD_LAYOUT Scalar_FLOAT64_IEEE FNC_VALUES 1 FLOAT64_IEEE COLUMN_DIR DIRECT /end RECORD_LAYOUT
/begin RECORD_LAYOUT Lookup1D_BOOLEAN FNC_VALUES 1 UBYTE COLUMN_DIR DIRECT /end RECORD_LAYOUT
/begin RECORD_LAYOUT Lookup1D_X_BOOLEAN AXIS_PTS_X 1 UBYTE INDEX_INCR DIRECT /end RECORD_LAYOUT
/begin RECORD_LAYOUT Lookup1D_BYTE FNC_VALUES 1 SBYTE COLUMN_DIR DIRECT /end RECORD_LAYOUT
/begin RECORD_LAYOUT Lookup1D_X_BYTE AXIS_PTS_X 1 SBYTE INDEX_INCR DIRECT /end RECORD_LAYOUT
/begin RECORD_LAYOUT Lookup1D_UBYTE FNC_VALUES 1 UBYTE COLUMN_DIR DIRECT /end RECORD_LAYOUT
/begin RECORD_LAYOUT Lookup1D_X_UBYTE AXIS_PTS_X 1 UBYTE INDEX_INCR DIRECT /end RECORD_LAYOUT
/begin RECORD_LAYOUT Lookup1D_UWORD FNC_VALUES 1 UWORD COLUMN_DIR DIRECT /end RECORD_LAYOUT
/begin RECORD_LAYOUT Lookup1D_X_UWORD AXIS_PTS_X 1 UWORD INDEX_INCR DIRECT /end RECORD_LAYOUT
/begin RECORD_LAYOUT Lookup1D_WORD FNC_VALUES 1 SWORD COLUMN_DIR DIRECT /end RECORD_LAYOUT
/begin RECORD_LAYOUT Lookup1D_X_WORD AXIS_PTS_X 1 SWORD INDEX_INCR DIRECT /end RECORD_LAYOUT
/begin RECORD_LAYOUT Lookup1D_ULONG FNC_VALUES 1 ULONG COLUMN_DIR DIRECT /end RECORD_LAYOUT
/begin RECORD_LAYOUT Lookup1D_X_ULONG AXIS_PTS_X 1 ULONG INDEX_INCR DIRECT /end RECORD_LAYOUT
/begin RECORD_LAYOUT Lookup1D_SLONG FNC_VALUES 1 SLONG COLUMN_DIR DIRECT /end RECORD_LAYOUT
/begin RECORD_LAYOUT Lookup1D_X_LONG AXIS_PTS_X 1 SLONG INDEX_INCR DIRECT /end RECORD_LAYOUT
/begin RECORD_LAYOUT Lookup1D_FLOAT32_IEEE FNC_VALUES 1 FLOAT32_IEEE COLUMN_DIR DIRECT /end RECORD_LAYOUT
/begin RECORD_LAYOUT Lookup1D_X_FLOAT32_IEEE AXIS_PTS_X 1 FLOAT32_IEEE INDEX_INCR DIRECT /end RECORD_LAYOUT
/begin RECORD_LAYOUT Lookup1D_FLOAT64_IEEE FNC_VALUES 1 FLOAT64_IEEE COLUMN_DIR DIRECT /end RECORD_LAYOUT
/begin RECORD_LAYOUT Lookup1D_X_FLOAT64_IEEE AXIS_PTS_X 1 FLOAT64_IEEE INDEX_INCR DIRECT /end RECORD_LAYOUT
/begin RECORD_LAYOUT Lookup2D_BOOLEAN FNC_VALUES 1 UBYTE COLUMN_DIR DIRECT /end RECORD_LAYOUT
/begin RECORD_LAYOUT Lookup2D_X_BOOLEAN AXIS_PTS_X 1 UBYTE INDEX_INCR DIRECT /end RECORD_LAYOUT
/begin RECORD_LAYOUT Lookup2D_UBYTE FNC_VALUES 1 UBYTE COLUMN_DIR DIRECT /end RECORD_LAYOUT
/begin RECORD_LAYOUT Lookup2D_X_UBYTE AXIS_PTS_X 1 UBYTE INDEX_INCR DIRECT /end RECORD_LAYOUT
/begin RECORD_LAYOUT Lookup2D_BYTE FNC_VALUES 1 SBYTE COLUMN_DIR DIRECT /end RECORD_LAYOUT
/begin RECORD_LAYOUT Lookup2D_X_BYTE AXIS_PTS_X 1 SBYTE INDEX_INCR DIRECT /end RECORD_LAYOUT
/begin RECORD_LAYOUT Lookup2D_UWORD FNC_VALUES 1 UWORD COLUMN_DIR DIRECT /end RECORD_LAYOUT
/begin RECORD_LAYOUT Lookup2D_X_UWORD AXIS_PTS_X 1 UWORD INDEX_INCR DIRECT /end RECORD_LAYOUT
/begin RECORD_LAYOUT Lookup2D_WORD FNC_VALUES 1 SWORD COLUMN_DIR DIRECT /end RECORD_LAYOUT
/begin RECORD_LAYOUT Lookup2D_X_WORD AXIS_PTS_X 1 SWORD INDEX_INCR DIRECT /end RECORD_LAYOUT
/begin RECORD_LAYOUT Lookup2D_ULONG FNC_VALUES 1 ULONG COLUMN_DIR DIRECT /end RECORD_LAYOUT
/begin RECORD_LAYOUT Lookup2D_X_ULONG AXIS_PTS_X 1 ULONG INDEX_INCR DIRECT /end RECORD_LAYOUT
/begin RECORD_LAYOUT Lookup2D_LONG FNC_VALUES 1 SLONG COLUMN_DIR DIRECT /end RECORD_LAYOUT
/begin RECORD_LAYOUT Lookup2D_X_LONG AXIS_PTS_X 1 SLONG INDEX_INCR DIRECT /end RECORD_LAYOUT
/begin RECORD_LAYOUT Lookup2D_FLOAT32_IEEE FNC_VALUES 1 FLOAT32_IEEE COLUMN_DIR DIRECT /end RECORD_LAYOUT
/begin RECORD_LAYOUT Lookup2D_X_FLOAT32_IEEE AXIS_PTS_X 1 FLOAT32_IEEE INDEX_INCR DIRECT /end RECORD_LAYOUT
/begin RECORD_LAYOUT Lookup2D_FLOAT64_IEEE FNC_VALUES 1 FLOAT64_IEEE COLUMN_DIR DIRECT /end RECORD_LAYOUT
/begin RECORD_LAYOUT Lookup2D_X_FLOAT64_IEEE AXIS_PTS_X 1 FLOAT64_IEEE INDEX_INCR DIRECT /end RECORD_LAYOUT
/begin CHARACTERISTIC KfBSDS_Ang_DisbleStrAngleThrshMax "" VALUE 0x0000 /* @ECU_Address@KfBSDS_Ang_DisbleStrAngleThrshMax@ */ Scalar_FLOAT32_IEEE 0 BSDS_subsystem_integrated_CM_single 0.0 12.0 /end CHARACTERISTIC
/begin CHARACTERISTIC KfBSDS_Ang_EnbleStrAngleThrshMax "" VALUE 0x0000 /* @ECU_Address@KfBSDS_Ang_EnbleStrAngleThrshMax@ */ Scalar_FLOAT32_IEEE 0 BSDS_subsystem_integrated_CM_single 0.0 12.0 /end CHARACTERISTIC
/begin CHARACTERISTIC KfBSDS_c_DisbleCurveThrshMax "" VALUE 0x0000 /* @ECU_Address@KfBSDS_c_DisbleCurveThrshMax@ */ Scalar_FLOAT32_IEEE 0 BSDS_subsystem_integrated_CM_single 0.001 0.1 /end CHARACTERISTIC
/begin CHARACTERISTIC KfBSDS_c_EnbleCurveThrshMax "" VALUE 0x0000 /* @ECU_Address@KfBSDS_c_EnbleCurveThrshMax@ */ Scalar_FLOAT32_IEEE 0 BSDS_subsystem_integrated_CM_single 0.001 0.1 /end CHARACTERISTIC
/begin CHARACTERISTIC KfBSDS_d_BSDLargerZone_BackDis "" VALUE 0x0000 /* @ECU_Address@KfBSDS_d_BSDLargerZone_BackDis@ */ Scalar_FLOAT32_IEEE 0 BSDS_subsystem_integrated_CM_single 3.0 30.0 /end CHARACTERISTIC
/begin CHARACTERISTIC KfBSDS_d_BSDLargerZone_FarDis "" VALUE 0x0000 /* @ECU_Address@KfBSDS_d_BSDLargerZone_FarDis@ */ Scalar_FLOAT32_IEEE 0 BSDS_subsystem_integrated_CM_single 3.0 6.0 /end CHARACTERISTIC
/begin CHARACTERISTIC KfBSDS_d_BSDLargerZone_FrontDis "" VALUE 0x0000 /* @ECU_Address@KfBSDS_d_BSDLargerZone_FrontDis@ */ Scalar_FLOAT32_IEEE 0 BSDS_subsystem_integrated_CM_single -1.0 2.0 /end CHARACTERISTIC
/begin CHARACTERISTIC KfBSDS_d_BSDLargerZone_NearDis "" VALUE 0x0000 /* @ECU_Address@KfBSDS_d_BSDLargerZone_NearDis@ */ Scalar_FLOAT32_IEEE 0 BSDS_subsystem_integrated_CM_single -0.5 0.5 /end CHARACTERISTIC
/begin CHARACTERISTIC KfBSDS_d_BSDZone_BackDis "" VALUE 0x0000 /* @ECU_Address@KfBSDS_d_BSDZone_BackDis@ */ Scalar_FLOAT32_IEEE 0 BSDS_subsystem_integrated_CM_single 3.0 30.0 /end CHARACTERISTIC
/begin CHARACTERISTIC KfBSDS_d_BSDZone_Eye95Dis "" VALUE 0x0000 /* @ECU_Address@KfBSDS_d_BSDZone_Eye95Dis@ */ Scalar_FLOAT32_IEEE 0 BSDS_subsystem_integrated_CM_single 0.0 5.0 /end CHARACTERISTIC
/begin CHARACTERISTIC KfBSDS_d_BSDZone_FarDis "" VALUE 0x0000 /* @ECU_Address@KfBSDS_d_BSDZone_FarDis@ */ Scalar_FLOAT32_IEEE 0 BSDS_subsystem_integrated_CM_single 3.0 6.0 /end CHARACTERISTIC
/begin CHARACTERISTIC KfBSDS_d_BSDZone_FrontDis "" VALUE 0x0000 /* @ECU_Address@KfBSDS_d_BSDZone_FrontDis@ */ Scalar_FLOAT32_IEEE 0 BSDS_subsystem_integrated_CM_single -1.0 2.0 /end CHARACTERISTIC
/begin CHARACTERISTIC KfBSDS_d_BSDZone_NearDis "" VALUE 0x0000 /* @ECU_Address@KfBSDS_d_BSDZone_NearDis@ */ Scalar_FLOAT32_IEEE 0 BSDS_subsystem_integrated_CM_single -0.5 0.5 /end CHARACTERISTIC
/begin CHARACTERISTIC KfBSDS_d_VehCenterFront "" VALUE 0x0000 /* @ECU_Address@KfBSDS_d_VehCenterFront@ */ Scalar_FLOAT32_IEEE 0 BSDS_subsystem_integrated_CM_single 0.0 4.0 /end CHARACTERISTIC
/begin CHARACTERISTIC KfBSDS_d_VehCenterRear "" VALUE 0x0000 /* @ECU_Address@KfBSDS_d_VehCenterRear@ */ Scalar_FLOAT32_IEEE 0 BSDS_subsystem_integrated_CM_single 0.0 4.0 /end CHARACTERISTIC
/begin CHARACTERISTIC KfBSDS_d_VehLenth "" VALUE 0x0000 /* @ECU_Address@KfBSDS_d_VehLenth@ */ Scalar_FLOAT32_IEEE 0 BSDS_subsystem_integrated_CM_single 0.0 20.0 /end CHARACTERISTIC
/begin CHARACTERISTIC KfBSDS_d_VehWidth "" VALUE 0x0000 /* @ECU_Address@KfBSDS_d_VehWidth@ */ Scalar_FLOAT32_IEEE 0 BSDS_subsystem_integrated_CM_single 0.0 10.0 /end CHARACTERISTIC
/begin CHARACTERISTIC KfBSDS_r_ObtWidthProportion "" VALUE 0x0000 /* @ECU_Address@KfBSDS_r_ObtWidthProportion@ */ Scalar_FLOAT32_IEEE 0 BSDS_subsystem_integrated_CM_single 0.0 1.0 /end CHARACTERISTIC
/begin CHARACTERISTIC KfBSDS_t_WarnSustainedTime "" VALUE 0x0000 /* @ECU_Address@KfBSDS_t_WarnSustainedTime@ */ Scalar_FLOAT32_IEEE 0 BSDS_subsystem_integrated_CM_single 0.0 10.0 /end CHARACTERISTIC
/begin CHARACTERISTIC KfBSDS_v_DisbleVehSpdThrshHi "" VALUE 0x0000 /* @ECU_Address@KfBSDS_v_DisbleVehSpdThrshHi@ */ Scalar_FLOAT32_IEEE 0 BSDS_subsystem_integrated_CM_single 0.0 100.0 /end CHARACTERISTIC
/begin CHARACTERISTIC KfBSDS_v_DisbleVehSpdThrshLo "" VALUE 0x0000 /* @ECU_Address@KfBSDS_v_DisbleVehSpdThrshLo@ */ Scalar_FLOAT32_IEEE 0 BSDS_subsystem_integrated_CM_single -5.0 20.0 /end CHARACTERISTIC
/begin CHARACTERISTIC KfBSDS_v_EnbleVehSpdThrshHi "" VALUE 0x0000 /* @ECU_Address@KfBSDS_v_EnbleVehSpdThrshHi@ */ Scalar_FLOAT32_IEEE 0 BSDS_subsystem_integrated_CM_single 0.0 100.0 /end CHARACTERISTIC
/begin CHARACTERISTIC KfBSDS_v_EnbleVehSpdThrshLo "" VALUE 0x0000 /* @ECU_Address@KfBSDS_v_EnbleVehSpdThrshLo@ */ Scalar_FLOAT32_IEEE 0 BSDS_subsystem_integrated_CM_single -5.0 20.0 /end CHARACTERISTIC
/begin CHARACTERISTIC KfBSDS_v_LatSpdThr "" VALUE 0x0000 /* @ECU_Address@KfBSDS_v_LatSpdThr@ */ Scalar_FLOAT32_IEEE 0 BSDS_subsystem_integrated_CM_single_m_s 0.0 20.0 /end CHARACTERISTIC
/begin CHARACTERISTIC KfBSDS_v_OncomRelSpdThrshHi_in "" VALUE 0x0000 /* @ECU_Address@KfBSDS_v_OncomRelSpdThrshHi_in@ */ Scalar_FLOAT32_IEEE 0 BSDS_subsystem_integrated_CM_single 0.0 30.0 /end CHARACTERISTIC
/begin CHARACTERISTIC KfBSDS_v_OncomRelSpdThrshHi_out "" VALUE 0x0000 /* @ECU_Address@KfBSDS_v_OncomRelSpdThrshHi_out@ */ Scalar_FLOAT32_IEEE 0 BSDS_subsystem_integrated_CM_single 0.0 30.0 /end CHARACTERISTIC
/begin CHARACTERISTIC KfBSDS_v_staticSpdThr "" VALUE 0x0000 /* @ECU_Address@KfBSDS_v_staticSpdThr@ */ Scalar_FLOAT32_IEEE 0 BSDS_subsystem_integrated_CM_single 0.0 10.0 /end CHARACTERISTIC
/begin CHARACTERISTIC KbBSDS_Sensor_Error "" VALUE 0x0000 /* @ECU_Address@KbBSDS_Sensor_Error@ */ Scalar_BOOLEAN 0 BSDS_subsystem_integrated_CM_boolean 0.0 1.0 /end CHARACTERISTIC
/begin CHARACTERISTIC KbBSDS_Sensor_Work "" VALUE 0x0000 /* @ECU_Address@KbBSDS_Sensor_Work@ */ Scalar_BOOLEAN 0 BSDS_subsystem_integrated_CM_boolean 0.0 1.0 /end CHARACTERISTIC
/begin CHARACTERISTIC KbBSDS_Switch "" VALUE 0x0000 /* @ECU_Address@KbBSDS_Switch@ */ Scalar_BOOLEAN 0 BSDS_subsystem_integrated_CM_boolean 0.0 1.0 /end CHARACTERISTIC
/begin CHARACTERISTIC KbBSDS_configBSD "" VALUE 0x0000 /* @ECU_Address@KbBSDS_configBSD@ */ Scalar_BOOLEAN 0 BSDS_subsystem_integrated_CM_boolean 0.0 1.0 /end CHARACTERISTIC
/begin CHARACTERISTIC KbBSDS_curve "" VALUE 0x0000 /* @ECU_Address@KbBSDS_curve@ */ Scalar_BOOLEAN 0 BSDS_subsystem_integrated_CM_boolean 0.0 1.0 /end CHARACTERISTIC
/begin MEASUREMENT VfBSDS_curvature "" FLOAT32_IEEE BSDS_subsystem_integrated_CM_single 0 0 -3.4E+38 3.4E+38 ECU_ADDRESS 0x0000 /* @ECU_Address@VfBSDS_curvature@ */ /end MEASUREMENT
/begin MEASUREMENT VfBSDS_speed_in "" FLOAT32_IEEE BSDS_subsystem_integrated_CM_single 0 0 -3.4E+38 3.4E+38 ECU_ADDRESS 0x0000 /* @ECU_Address@VfBSDS_speed_in@ */ /end MEASUREMENT
/begin MEASUREMENT VfBSDS_veh_vx "" FLOAT32_IEEE BSDS_subsystem_integrated_CM_single 0 0 -3.4E+38 3.4E+38 ECU_ADDRESS 0x0000 /* @ECU_Address@VfBSDS_veh_vx@ */ /end MEASUREMENT
/begin MEASUREMENT VaLCWS_Obt "" FLOAT32_IEEE BSDS_subsystem_integrated_CM_single 0 0 -3.4E+38 3.4E+38 ARRAY_SIZE 33 ECU_ADDRESS 0x0000 /* @ECU_Address@VaLCWS_Obt@ */ /end MEASUREMENT
/begin MEASUREMENT VaLCWS_x_in "" FLOAT32_IEEE BSDS_subsystem_integrated_CM_single 0 0 -3.4E+38 3.4E+38 ARRAY_SIZE 10 ECU_ADDRESS 0x0000 /* @ECU_Address@VaLCWS_x_in@ */ /end MEASUREMENT
/begin MEASUREMENT VaLCWS_y_in "" FLOAT32_IEEE BSDS_subsystem_integrated_CM_single 0 0 -3.4E+38 3.4E+38 ARRAY_SIZE 10 ECU_ADDRESS 0x0000 /* @ECU_Address@VaLCWS_y_in@ */ /end MEASUREMENT
/begin MEASUREMENT VaLCWS_heading_in "" FLOAT32_IEEE BSDS_subsystem_integrated_CM_single 0 0 -3.4E+38 3.4E+38 ARRAY_SIZE 10 ECU_ADDRESS 0x0000 /* @ECU_Address@VaLCWS_heading_in@ */ /end MEASUREMENT
/begin MEASUREMENT VaLCWS_Vx_in "" FLOAT32_IEEE BSDS_subsystem_integrated_CM_single 0 0 -3.4E+38 3.4E+38 ARRAY_SIZE 10 ECU_ADDRESS 0x0000 /* @ECU_Address@VaLCWS_Vx_in@ */ /end MEASUREMENT
/begin MEASUREMENT VaLCWS_Vy_in "" FLOAT32_IEEE BSDS_subsystem_integrated_CM_single 0 0 -3.4E+38 3.4E+38 ARRAY_SIZE 10 ECU_ADDRESS 0x0000 /* @ECU_Address@VaLCWS_Vy_in@ */ /end MEASUREMENT
/begin MEASUREMENT VaLCWS_obt_lenth_in "" FLOAT32_IEEE BSDS_subsystem_integrated_CM_single 0 0 -3.4E+38 3.4E+38 ARRAY_SIZE 10 ECU_ADDRESS 0x0000 /* @ECU_Address@VaLCWS_obt_lenth_in@ */ /end MEASUREMENT
/begin MEASUREMENT VaLCWS_obt_width_in "" FLOAT32_IEEE BSDS_subsystem_integrated_CM_single 0 0 -3.4E+38 3.4E+38 ARRAY_SIZE 10 ECU_ADDRESS 0x0000 /* @ECU_Address@VaLCWS_obt_width_in@ */ /end MEASUREMENT
/begin MEASUREMENT VaLCWS_nearest_point_rel_x_in "" FLOAT32_IEEE BSDS_subsystem_integrated_CM_single 0 0 -3.4E+38 3.4E+38 ARRAY_SIZE 10 ECU_ADDRESS 0x0000 /* @ECU_Address@VaLCWS_nearest_point_rel_x_in@ */ /end MEASUREMENT
/begin MEASUREMENT VaLCWS_nearest_point_rel_y_in "" FLOAT32_IEEE BSDS_subsystem_integrated_CM_single 0 0 -3.4E+38 3.4E+38 ARRAY_SIZE 10 ECU_ADDRESS 0x0000 /* @ECU_Address@VaLCWS_nearest_point_rel_y_in@ */ /end MEASUREMENT
/begin MEASUREMENT VaLCWS_id_in "" SLONG BSDS_subsystem_integrated_CM_int32 0 0 -2147483648 2147483647 ARRAY_SIZE 10 ECU_ADDRESS 0x0000 /* @ECU_Address@VaLCWS_id_in@ */ /end MEASUREMENT
/begin MEASUREMENT ViBSDS_bswR_ID "" SLONG BSDS_subsystem_integrated_CM_int32 0 0 -2147483648 2147483647 ECU_ADDRESS 0x0000 /* @ECU_Address@ViBSDS_bswR_ID@ */ /end MEASUREMENT
/begin MEASUREMENT ViBSDS_bswL_ID "" SLONG BSDS_subsystem_integrated_CM_int32 0 0 -2147483648 2147483647 ECU_ADDRESS 0x0000 /* @ECU_Address@ViBSDS_bswL_ID@ */ /end MEASUREMENT
/begin MEASUREMENT VnLCWS_num_R "" UWORD BSDS_subsystem_integrated_CM_uint16 0 0 0 65535 ECU_ADDRESS 0x0000 /* @ECU_Address@VnLCWS_num_R@ */ /end MEASUREMENT
/begin MEASUREMENT VnLCWS_num_L "" UWORD BSDS_subsystem_integrated_CM_uint16 0 0 0 65535 ECU_ADDRESS 0x0000 /* @ECU_Address@VnLCWS_num_L@ */ /end MEASUREMENT
/begin MEASUREMENT VnLCWS_num_in "" UWORD BSDS_subsystem_integrated_CM_uint16 0 0 0 65535 ECU_ADDRESS 0x0000 /* @ECU_Address@VnLCWS_num_in@ */ /end MEASUREMENT
/begin MEASUREMENT VaLCWS_position_zone_in "" SBYTE BSDS_subsystem_integrated_CM_int8 0 0 -128 127 ARRAY_SIZE 10 ECU_ADDRESS 0x0000 /* @ECU_Address@VaLCWS_position_zone_in@ */ /end MEASUREMENT
/begin MEASUREMENT VaLCWS_orientation_in "" SBYTE BSDS_subsystem_integrated_CM_int8 0 0 -128 127 ARRAY_SIZE 10 ECU_ADDRESS 0x0000 /* @ECU_Address@VaLCWS_orientation_in@ */ /end MEASUREMENT
/begin MEASUREMENT VaLCWS_motion_status_in "" SBYTE BSDS_subsystem_integrated_CM_int8 0 0 -128 127 ARRAY_SIZE 10 ECU_ADDRESS 0x0000 /* @ECU_Address@VaLCWS_motion_status_in@ */ /end MEASUREMENT
/begin MEASUREMENT VfBSDS_gear_in "" UBYTE BSDS_subsystem_integrated_CM_uint8 0 0 0 255 ECU_ADDRESS 0x0000 /* @ECU_Address@VfBSDS_gear_in@ */ /end MEASUREMENT
/begin MEASUREMENT VaLCWS_type_in "" UBYTE BSDS_subsystem_integrated_CM_uint8 0 0 0 255 ARRAY_SIZE 10 ECU_ADDRESS 0x0000 /* @ECU_Address@VaLCWS_type_in@ */ /end MEASUREMENT
/begin MEASUREMENT ViBSDS_bswR "" UBYTE BSDS_subsystem_integrated_CM_uint8 0 0 0 255 ECU_ADDRESS 0x0000 /* @ECU_Address@ViBSDS_bswR@ */ /end MEASUREMENT
/begin MEASUREMENT ViBSDS_bswL "" UBYTE BSDS_subsystem_integrated_CM_uint8 0 0 0 255 ECU_ADDRESS 0x0000 /* @ECU_Address@ViBSDS_bswL@ */ /end MEASUREMENT
/begin MEASUREMENT VeBSDS_LturnON "" UBYTE BSDS_subsystem_integrated_CM_boolean 0 0 0 1 ECU_ADDRESS 0x0000 /* @ECU_Address@VeBSDS_LturnON@ */ /end MEASUREMENT
/begin MEASUREMENT VeBSDS_RturnON "" UBYTE BSDS_subsystem_integrated_CM_boolean 0 0 0 1 ECU_ADDRESS 0x0000 /* @ECU_Address@VeBSDS_RturnON@ */ /end MEASUREMENT
/begin MEASUREMENT VeBSDS_active_status "" UBYTE BSDS_subsystem_integrated_CM_EnumBSDS_Active_Status 0 0 0 5 ECU_ADDRESS 0x0000 /* @ECU_Address@VeBSDS_active_status@ */ /end MEASUREMENT
/begin MEASUREMENT VeBSDS_right_warning_status_out "" UBYTE BSDS_subsystem_integrated_CM_EnumBSDS_Warning_Status 0 0 0 2 ECU_ADDRESS 0x0000 /* @ECU_Address@VeBSDS_right_warning_status_out@ */ /end MEASUREMENT
/begin MEASUREMENT VeBSDS_left_warning_status_out "" UBYTE BSDS_subsystem_integrated_CM_EnumBSDS_Warning_Status 0 0 0 2 ECU_ADDRESS 0x0000 /* @ECU_Address@VeBSDS_left_warning_status_out@ */ /end MEASUREMENT
/begin MEASUREMENT VeBSDS_right_warning_status "" UBYTE BSDS_subsystem_integrated_CM_EnumBSDS_Warning_Status 0 0 0 2 ECU_ADDRESS 0x0000 /* @ECU_Address@VeBSDS_right_warning_status@ */ /end MEASUREMENT
/begin MEASUREMENT VeBSDS_left_warning_status "" UBYTE BSDS_subsystem_integrated_CM_EnumBSDS_Warning_Status 0 0 0 2 ECU_ADDRESS 0x0000 /* @ECU_Address@VeBSDS_left_warning_status@ */ /end MEASUREMENT
/begin MEASUREMENT ViBSDS_bswLL "" UBYTE BSDS_subsystem_integrated_CM_EnumBSDS_warningArea 0 0 0 4 ECU_ADDRESS 0x0000 /* @ECU_Address@ViBSDS_bswLL@ */ /end MEASUREMENT
/begin COMPU_METHOD BSDS_subsystem_integrated_CM_single "Q = V" RAT_FUNC "%8.6" "" COEFFS 0 1 0 0 0 1 /end COMPU_METHOD
/begin COMPU_METHOD BSDS_subsystem_integrated_CM_single_m_s "Q = V" RAT_FUNC "%8.6" "m/s" COEFFS 0 1 0 0 0 1 /end COMPU_METHOD
/begin COMPU_METHOD BSDS_subsystem_integrated_CM_boolean "Q = V" RAT_FUNC "%1.0" "" COEFFS 0 1 0 0 0 1 /end COMPU_METHOD
/begin COMPU_METHOD BSDS_subsystem_integrated_CM_int32 "Q = V" RAT_FUNC "%10.0" "" COEFFS 0 1 0 0 0 1 /end COMPU_METHOD
/begin COMPU_METHOD BSDS_subsystem_integrated_CM_uint16 "Q = V" RAT_FUNC "%5.0" "" COEFFS 0 1 0 0 0 1 /end COMPU_METHOD
/begin COMPU_METHOD BSDS_subsystem_integrated_CM_int8 "Q = V" RAT_FUNC "%3.0" "" COEFFS 0 1 0 0 0 1 /end COMPU_METHOD
/begin COMPU_METHOD BSDS_subsystem_integrated_CM_uint8 "Q = V" RAT_FUNC "%3.0" "" COEFFS 0 1 0 0 0 1 /end COMPU_METHOD
/begin COMPU_METHOD BSDS_subsystem_integrated_CM_EnumBSDS_Active_Status "Enumerated data type: EnumBSDS_Active_Status" TAB_VERB "%0.6" "" COMPU_TAB_REF VTAB_FOR_BSDS_subsystem_integrated_CM_EnumBSDS_Active_Status /end COMPU_METHOD
/begin COMPU_VTAB VTAB_FOR_BSDS_subsystem_integrated_CM_EnumBSDS_Active_Status "Enumerated data type: EnumBSDS_Active_Status" TAB_VERB 6 0 "BSDS_NONE" 1 "BSDS_OFF" 2 "BSDS_INACTIVE" 3 "BSDS_ERROR" 4 "BSDS_ACTIVE" 5 "BSDS_SELF_CHECK" /end COMPU_VTAB
/begin COMPU_METHOD BSDS_subsystem_integrated_CM_EnumBSDS_Warning_Status "Enumerated data type: EnumBSDS_Warning_Status" TAB_VERB "%0.6" "" COMPU_TAB_REF VTAB_FOR_BSDS_subsystem_integrated_CM_EnumBSDS_Warning_Status /end COMPU_METHOD
/begin COMPU_VTAB VTAB_FOR_BSDS_subsystem_integrated_CM_EnumBSDS_Warning_Status "Enumerated data type: EnumBSDS_Warning_Status" TAB_VERB 3 0 "BSDS_NO_WARNING" 1 "BSDS_WARNING_LOW_LEVEL" 2 "BSDS_WARNING_HIGH_LEVEL" /end COMPU_VTAB
/begin COMPU_METHOD BSDS_subsystem_integrated_CM_EnumBSDS_warningArea "Enumerated data type: EnumBSDS_warningArea" TAB_VERB "%0.6" "" COMPU_TAB_REF VTAB_FOR_BSDS_subsystem_integrated_CM_EnumBSDS_warningArea /end COMPU_METHOD
/begin COMPU_VTAB VTAB_FOR_BSDS_subsystem_integrated_CM_EnumBSDS_warningArea "Enumerated data type: EnumBSDS_warningArea" TAB_VERB 5 0 "WARNING_HLEVEL_AREA" 1 "WARNING_S_AREA" 2 "WARNING_L_AREA" 3 "MAY_WARNING_AREA" 4 "NO_WARNING_AREA" /end COMPU_VTAB
/begin GROUP BSDS_subsystem_integrated "BSDS_subsystem_integrated" /* Root */ ROOT /begin SUB_GROUP Root_BSDS_Subsystem /end SUB_GROUP /end GROUP
/begin GROUP Root_BSDS_Subsystem "BSDS_subsystem_integrated/BSDS_Subsystem"
 /begin SUB_GROUP S1_CalcLBSDEnabledSubsystem S1_CalcRBSDEnabledSubsystem S1_DtmnEnabledSubsystem S1_input_Subsystem S1_output_Subsystem /end SUB_GROUP
/end GROUP
/begin GROUP S1_CalcLBSDEnabledSubsystem "BSDS_subsystem_integrated/BSDS_Subsystem/CalcLBSDEnabledSubsystem"
 /begin REF_MEASUREMENT VeBSDS_left_warning_status ViBSDS_bswL ViBSDS_bswLL ViBSDS_bswL_ID /end REF_MEASUREMENT
/end GROUP
/begin GROUP S1_CalcRBSDEnabledSubsystem "BSDS_subsystem_integrated/BSDS_Subsystem/CalcRBSDEnabledSubsystem" /begin REF_MEASUREMENT VeBSDS_right_warning_status ViBSDS_bswR ViBSDS_bswR_ID /end REF_MEASUREMENT /end GROUP
/begin GROUP S1_DtmnEnabledSubsystem "BSDS_subsystem_integrated/BSDS_Subsystem/DtmnEnabledSubsystem" /begin REF_CHARACTERISTIC KbBSDS_Sensor_Error KbBSDS_Sensor_Work /end REF_CHARACTERISTIC /end GROUP
/begin GROUP S1_input_Subsystem "BSDS_subsystem_integrated/BSDS_Subsystem/input_Subsystem"
 /begin SUB_GROUP S5_Calibration_Subsystem S5_CvrtInput_Subsystem S5_CvrtObtVecFunctionEnabled /end SUB_GROUP
/end GROUP
/begin GROUP S1_output_Subsystem "BSDS_subsystem_integrated/BSDS_Subsystem/output_Subsystem"
 /begin REF_MEASUREMENT VeBSDS_active_status VeBSDS_left_warning_status_out VeBSDS_right_warning_status_out /end REF_MEASUREMENT
/end GROUP
/begin GROUP S5_Calibration_Subsystem "BSDS_subsystem_integrated/BSDS_Subsystem/input_Subsystem/Calibration_Subsystem"
 /begin REF_CHARACTERISTIC KbBSDS_Switch KbBSDS_configBSD KfBSDS_Ang_DisbleStrAngleThrshMax KfBSDS_Ang_EnbleStrAngleThrshMax KfBSDS_c_DisbleCurveThrshMax KfBSDS_c_EnbleCurveThrshMax KfBSDS_d_BSDLargerZone_BackDis KfBSDS_d_BSDLargerZone_FarDis KfBSDS_d_BSDLargerZone_FrontDis KfBSDS_d_BSDLargerZone_NearDis KfBSDS_d_BSDZone_BackDis KfBSDS_d_BSDZone_Eye95Dis KfBSDS_d_BSDZone_FarDis KfBSDS_d_BSDZone_FrontDis KfBSDS_d_BSDZone_NearDis KfBSDS_d_VehCenterFront KfBSDS_d_VehCenterRear KfBSDS_d_VehLenth KfBSDS_d_VehWidth KfBSDS_r_ObtWidthProportion KfBSDS_t_WarnSustainedTime KfBSDS_v_DisbleVehSpdThrshHi KfBSDS_v_DisbleVehSpdThrshLo KfBSDS_v_EnbleVehSpdThrshHi KfBSDS_v_EnbleVehSpdThrshLo KfBSDS_v_LatSpdThr KfBSDS_v_OncomRelSpdThrshHi_in KfBSDS_v_OncomRelSpdThrshHi_out KfBSDS_v_staticSpdThr /end REF_CHARACTERISTIC
/end GROUP
/begin GROUP S5_CvrtInput_Subsystem "BSDS_subsystem_integrated/BSDS_Subsystem/input_Subsystem/CvrtInput_Subsystem" /begin REF_CHARACTERISTIC KbBSDS_curve /end REF_CHARACTERISTIC
 /begin REF_MEASUREMENT VeBSDS_LturnON VeBSDS_RturnON VfBSDS_curvature VfBSDS_gear_in VfBSDS_speed_in /end REF_MEASUREMENT
/end GROUP
/begin GROUP S5_CvrtObtVecFunctionEnabled "BSDS_subsystem_integrated/BSDS_Subsystem/input_Subsystem/CvrtObtVecFunctionEnabled"
 /begin REF_MEASUREMENT VaLCWS_Obt VaLCWS_Vx_in VaLCWS_Vy_in VaLCWS_heading_in VaLCWS_id_in VaLCWS_motion_status_in VaLCWS_nearest_point_rel_x_in VaLCWS_nearest_point_rel_y_in VaLCWS_obt_lenth_in VaLCWS_obt_width_in VaLCWS_orientation_in VaLCWS_position_zone_in VaLCWS_type_in VaLCWS_x_in VaLCWS_y_in VfBSDS_veh_vx VnLCWS_num_L VnLCWS_num_R VnLCWS_num_in /end REF_MEASUREMENT
/end GROUP
/end MODULE
/end PROJECT
/* (add any file trailer comments here) */
/* EOF BSDS_subsystem_integrated.a2l */
