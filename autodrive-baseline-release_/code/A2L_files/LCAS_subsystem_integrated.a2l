/******************************************************************************
* ASAP2 file: LCAS_subsystem_integrated.a2l
* Code generation for model "LCAS_subsystem_integrated".
* Model version : 1.452
* Simulink Coder version : 8.13 (R2017b) 24-Jul-2017
* C source code generated on : Mon Jun 8 17:19:15 2020
* Target selection: ert.tlc
* Embedded hardware selection: Infineon->TriCore
* Code generation objectives:
* 1. MISRA C:2012 guidelines
* 2. Safety precaution
* 3. Execution efficiency
* 4. RAM efficiency
* 5. ROM efficiency
* Validation result: Not run
* (add additional file header information here)
******************************************************************************/ ASAP2_VERSION 1 31
/* Version 1.31 */
/begin PROJECT ProjectName "Project Comment Goes Here"
/begin HEADER "Header Comments go here" /end HEADER
/begin MODULE ModuleName "Module Comment Goes Here"
/begin MOD_PAR "MOD PAR Comment Goes Here" /end MOD_PAR
/begin MOD_COMMON "Mod Common Comment Here" BYTE_ORDER MSB_LAST /end MOD_COMMON
/begin RECORD_LAYOUT Scalar_BOOLEAN FNC_VALUES 1 UBYTE COLUMN_DIR DIRECT /end RECORD_LAYOUT
/begin RECORD_LAYOUT Scalar_UBYTE FNC_VALUES 1 UBYTE COLUMN_DIR DIRECT /end RECORD_LAYOUT
/begin RECORD_LAYOUT Scalar_BYTE FNC_VALUES 1 SBYTE COLUMN_DIR DIRECT /end RECORD_LAYOUT
/begin RECORD_LAYOUT Scalar_UWORD FNC_VALUES 1 UWORD COLUMN_DIR DIRECT /end RECORD_LAYOUT
/begin RECORD_LAYOUT Scalar_SWORD FNC_VALUES 1 SWORD COLUMN_DIR DIRECT /end RECORD_LAYOUT
/begin RECORD_LAYOUT Scalar_ULONG FNC_VALUES 1 ULONG COLUMN_DIR DIRECT /end RECORD_LAYOUT
/begin RECORD_LAYOUT Scalar_LONG FNC_VALUES 1 SLONG COLUMN_DIR DIRECT /end RECORD_LAYOUT
/begin RECORD_LAYOUT Scalar_FLOAT32_IEEE FNC_VALUES 1 FLOAT32_IEEE COLUMN_DIR DIRECT /end RECORD_LAYOUT
/begin RECORD_LAYOUT Scalar_FLOAT64_IEEE FNC_VALUES 1 FLOAT64_IEEE COLUMN_DIR DIRECT /end RECORD_LAYOUT
/begin RECORD_LAYOUT Lookup1D_BOOLEAN FNC_VALUES 1 UBYTE COLUMN_DIR DIRECT /end RECORD_LAYOUT
/begin RECORD_LAYOUT Lookup1D_X_BOOLEAN AXIS_PTS_X 1 UBYTE INDEX_INCR DIRECT /end RECORD_LAYOUT
/begin RECORD_LAYOUT Lookup1D_BYTE FNC_VALUES 1 SBYTE COLUMN_DIR DIRECT /end RECORD_LAYOUT
/begin RECORD_LAYOUT Lookup1D_X_BYTE AXIS_PTS_X 1 SBYTE INDEX_INCR DIRECT /end RECORD_LAYOUT
/begin RECORD_LAYOUT Lookup1D_UBYTE FNC_VALUES 1 UBYTE COLUMN_DIR DIRECT /end RECORD_LAYOUT
/begin RECORD_LAYOUT Lookup1D_X_UBYTE AXIS_PTS_X 1 UBYTE INDEX_INCR DIRECT /end RECORD_LAYOUT
/begin RECORD_LAYOUT Lookup1D_UWORD FNC_VALUES 1 UWORD COLUMN_DIR DIRECT /end RECORD_LAYOUT
/begin RECORD_LAYOUT Lookup1D_X_UWORD AXIS_PTS_X 1 UWORD INDEX_INCR DIRECT /end RECORD_LAYOUT
/begin RECORD_LAYOUT Lookup1D_WORD FNC_VALUES 1 SWORD COLUMN_DIR DIRECT /end RECORD_LAYOUT
/begin RECORD_LAYOUT Lookup1D_X_WORD AXIS_PTS_X 1 SWORD INDEX_INCR DIRECT /end RECORD_LAYOUT
/begin RECORD_LAYOUT Lookup1D_ULONG FNC_VALUES 1 ULONG COLUMN_DIR DIRECT /end RECORD_LAYOUT
/begin RECORD_LAYOUT Lookup1D_X_ULONG AXIS_PTS_X 1 ULONG INDEX_INCR DIRECT /end RECORD_LAYOUT
/begin RECORD_LAYOUT Lookup1D_SLONG FNC_VALUES 1 SLONG COLUMN_DIR DIRECT /end RECORD_LAYOUT
/begin RECORD_LAYOUT Lookup1D_X_LONG AXIS_PTS_X 1 SLONG INDEX_INCR DIRECT /end RECORD_LAYOUT
/begin RECORD_LAYOUT Lookup1D_FLOAT32_IEEE FNC_VALUES 1 FLOAT32_IEEE COLUMN_DIR DIRECT /end RECORD_LAYOUT
/begin RECORD_LAYOUT Lookup1D_X_FLOAT32_IEEE AXIS_PTS_X 1 FLOAT32_IEEE INDEX_INCR DIRECT /end RECORD_LAYOUT
/begin RECORD_LAYOUT Lookup1D_FLOAT64_IEEE FNC_VALUES 1 FLOAT64_IEEE COLUMN_DIR DIRECT /end RECORD_LAYOUT
/begin RECORD_LAYOUT Lookup1D_X_FLOAT64_IEEE AXIS_PTS_X 1 FLOAT64_IEEE INDEX_INCR DIRECT /end RECORD_LAYOUT
/begin RECORD_LAYOUT Lookup2D_BOOLEAN FNC_VALUES 1 UBYTE COLUMN_DIR DIRECT /end RECORD_LAYOUT
/begin RECORD_LAYOUT Lookup2D_X_BOOLEAN AXIS_PTS_X 1 UBYTE INDEX_INCR DIRECT /end RECORD_LAYOUT
/begin RECORD_LAYOUT Lookup2D_UBYTE FNC_VALUES 1 UBYTE COLUMN_DIR DIRECT /end RECORD_LAYOUT
/begin RECORD_LAYOUT Lookup2D_X_UBYTE AXIS_PTS_X 1 UBYTE INDEX_INCR DIRECT /end RECORD_LAYOUT
/begin RECORD_LAYOUT Lookup2D_BYTE FNC_VALUES 1 SBYTE COLUMN_DIR DIRECT /end RECORD_LAYOUT
/begin RECORD_LAYOUT Lookup2D_X_BYTE AXIS_PTS_X 1 SBYTE INDEX_INCR DIRECT /end RECORD_LAYOUT
/begin RECORD_LAYOUT Lookup2D_UWORD FNC_VALUES 1 UWORD COLUMN_DIR DIRECT /end RECORD_LAYOUT
/begin RECORD_LAYOUT Lookup2D_X_UWORD AXIS_PTS_X 1 UWORD INDEX_INCR DIRECT /end RECORD_LAYOUT
/begin RECORD_LAYOUT Lookup2D_WORD FNC_VALUES 1 SWORD COLUMN_DIR DIRECT /end RECORD_LAYOUT
/begin RECORD_LAYOUT Lookup2D_X_WORD AXIS_PTS_X 1 SWORD INDEX_INCR DIRECT /end RECORD_LAYOUT
/begin RECORD_LAYOUT Lookup2D_ULONG FNC_VALUES 1 ULONG COLUMN_DIR DIRECT /end RECORD_LAYOUT
/begin RECORD_LAYOUT Lookup2D_X_ULONG AXIS_PTS_X 1 ULONG INDEX_INCR DIRECT /end RECORD_LAYOUT
/begin RECORD_LAYOUT Lookup2D_LONG FNC_VALUES 1 SLONG COLUMN_DIR DIRECT /end RECORD_LAYOUT
/begin RECORD_LAYOUT Lookup2D_X_LONG AXIS_PTS_X 1 SLONG INDEX_INCR DIRECT /end RECORD_LAYOUT
/begin RECORD_LAYOUT Lookup2D_FLOAT32_IEEE FNC_VALUES 1 FLOAT32_IEEE COLUMN_DIR DIRECT /end RECORD_LAYOUT
/begin RECORD_LAYOUT Lookup2D_X_FLOAT32_IEEE AXIS_PTS_X 1 FLOAT32_IEEE INDEX_INCR DIRECT /end RECORD_LAYOUT
/begin RECORD_LAYOUT Lookup2D_FLOAT64_IEEE FNC_VALUES 1 FLOAT64_IEEE COLUMN_DIR DIRECT /end RECORD_LAYOUT
/begin RECORD_LAYOUT Lookup2D_X_FLOAT64_IEEE AXIS_PTS_X 1 FLOAT64_IEEE INDEX_INCR DIRECT /end RECORD_LAYOUT
/begin CHARACTERISTIC KfLCAS_Ang_DisbleStrAngleThrshMax "" VALUE 0x0000 /* @ECU_Address@KfLCAS_Ang_DisbleStrAngleThrshMax@ */ Scalar_FLOAT32_IEEE 0 LCAS_subsystem_integrated_CM_single 0.0 12.0 /end CHARACTERISTIC
/begin CHARACTERISTIC KfLCAS_Ang_EnbleStrAngleThrshMax "" VALUE 0x0000 /* @ECU_Address@KfLCAS_Ang_EnbleStrAngleThrshMax@ */ Scalar_FLOAT32_IEEE 0 LCAS_subsystem_integrated_CM_single 0.0 12.0 /end CHARACTERISTIC
/begin CHARACTERISTIC KfLCAS_c_DisbleCurveThrshMax "" VALUE 0x0000 /* @ECU_Address@KfLCAS_c_DisbleCurveThrshMax@ */ Scalar_FLOAT32_IEEE 0 LCAS_subsystem_integrated_CM_single 0.001 0.1 /end CHARACTERISTIC
/begin CHARACTERISTIC KfLCAS_c_EnbleCurveThrshMax "" VALUE 0x0000 /* @ECU_Address@KfLCAS_c_EnbleCurveThrshMax@ */ Scalar_FLOAT32_IEEE 0 LCAS_subsystem_integrated_CM_single 0.001 0.1 /end CHARACTERISTIC
/begin CHARACTERISTIC KfLCAS_d_CVLargerZone_FrontDis "" VALUE 0x0000 /* @ECU_Address@KfLCAS_d_CVLargerZone_FrontDis@ */ Scalar_FLOAT32_IEEE 0 LCAS_subsystem_integrated_CM_single 0.0 3.0 /end CHARACTERISTIC
/begin CHARACTERISTIC KfLCAS_d_CVLargerZone_NearDis "" VALUE 0x0000 /* @ECU_Address@KfLCAS_d_CVLargerZone_NearDis@ */ Scalar_FLOAT32_IEEE 0 LCAS_subsystem_integrated_CM_single -0.5 0.5 /end CHARACTERISTIC
/begin CHARACTERISTIC KfLCAS_d_CVZone_FarDis "" VALUE 0x0000 /* @ECU_Address@KfLCAS_d_CVZone_FarDis@ */ Scalar_FLOAT32_IEEE 0 LCAS_subsystem_integrated_CM_single 3.0 6.0 /end CHARACTERISTIC
/begin CHARACTERISTIC KfLCAS_d_CVZone_FrontDis "" VALUE 0x0000 /* @ECU_Address@KfLCAS_d_CVZone_FrontDis@ */ Scalar_FLOAT32_IEEE 0 LCAS_subsystem_integrated_CM_single 0.0 3.0 /end CHARACTERISTIC
/begin CHARACTERISTIC KfLCAS_d_CVZone_NearDis "" VALUE 0x0000 /* @ECU_Address@KfLCAS_d_CVZone_NearDis@ */ Scalar_FLOAT32_IEEE 0 LCAS_subsystem_integrated_CM_single -0.5 0.5 /end CHARACTERISTIC
/begin CHARACTERISTIC KfLCAS_d_VehCenterFront "" VALUE 0x0000 /* @ECU_Address@KfLCAS_d_VehCenterFront@ */ Scalar_FLOAT32_IEEE 0 LCAS_subsystem_integrated_CM_single 0.0 4.0 /end CHARACTERISTIC
/begin CHARACTERISTIC KfLCAS_d_VehCenterRear "" VALUE 0x0000 /* @ECU_Address@KfLCAS_d_VehCenterRear@ */ Scalar_FLOAT32_IEEE 0 LCAS_subsystem_integrated_CM_single 0.0 4.0 /end CHARACTERISTIC
/begin CHARACTERISTIC KfLCAS_d_VehLenth "" VALUE 0x0000 /* @ECU_Address@KfLCAS_d_VehLenth@ */ Scalar_FLOAT32_IEEE 0 LCAS_subsystem_integrated_CM_single 0.0 20.0 /end CHARACTERISTIC
/begin CHARACTERISTIC KfLCAS_d_VehWidth "" VALUE 0x0000 /* @ECU_Address@KfLCAS_d_VehWidth@ */ Scalar_FLOAT32_IEEE 0 LCAS_subsystem_integrated_CM_single 0.0 10.0 /end CHARACTERISTIC
/begin CHARACTERISTIC KfLCAS_r_ObtWidthProportion "" VALUE 0x0000 /* @ECU_Address@KfLCAS_r_ObtWidthProportion@ */ Scalar_FLOAT32_IEEE 0 LCAS_subsystem_integrated_CM_single 0.0 1.0 /end CHARACTERISTIC
/begin CHARACTERISTIC KfLCAS_t_TTCLargerThrsh_LowLevel "" VALUE 0x0000 /* @ECU_Address@KfLCAS_t_TTCLargerThrsh_LowLevel@ */ Scalar_FLOAT32_IEEE 0 LCAS_subsystem_integrated_CM_single 3.0 7.5 /end CHARACTERISTIC
/begin CHARACTERISTIC KfLCAS_t_TTCThrshLowLevel "" VALUE 0x0000 /* @ECU_Address@KfLCAS_t_TTCThrshLowLevel@ */ Scalar_FLOAT32_IEEE 0 LCAS_subsystem_integrated_CM_single 3.0 7.5 /end CHARACTERISTIC
/begin CHARACTERISTIC KfLCAS_t_WarnSustainedTime "" VALUE 0x0000 /* @ECU_Address@KfLCAS_t_WarnSustainedTime@ */ Scalar_FLOAT32_IEEE 0 LCAS_subsystem_integrated_CM_single 0.0 10.0 /end CHARACTERISTIC
/begin CHARACTERISTIC KfLCAS_v_DisbleVehSpdThrshHi "" VALUE 0x0000 /* @ECU_Address@KfLCAS_v_DisbleVehSpdThrshHi@ */ Scalar_FLOAT32_IEEE 0 LCAS_subsystem_integrated_CM_single 0.0 100.0 /end CHARACTERISTIC
/begin CHARACTERISTIC KfLCAS_v_DisbleVehSpdThrshLo "" VALUE 0x0000 /* @ECU_Address@KfLCAS_v_DisbleVehSpdThrshLo@ */ Scalar_FLOAT32_IEEE 0 LCAS_subsystem_integrated_CM_single -5.0 20.0 /end CHARACTERISTIC
/begin CHARACTERISTIC KfLCAS_v_EnbleVehSpdThrshHi "" VALUE 0x0000 /* @ECU_Address@KfLCAS_v_EnbleVehSpdThrshHi@ */ Scalar_FLOAT32_IEEE 0 LCAS_subsystem_integrated_CM_single 0.0 100.0 /end CHARACTERISTIC
/begin CHARACTERISTIC KfLCAS_v_EnbleVehSpdThrshLo "" VALUE 0x0000 /* @ECU_Address@KfLCAS_v_EnbleVehSpdThrshLo@ */ Scalar_FLOAT32_IEEE 0 LCAS_subsystem_integrated_CM_single -5.0 20.0 /end CHARACTERISTIC
/begin CHARACTERISTIC KfLCAS_v_LatSpdThr "" VALUE 0x0000 /* @ECU_Address@KfLCAS_v_LatSpdThr@ */ Scalar_FLOAT32_IEEE 0 LCAS_subsystem_integrated_CM_single_m_s 0.0 20.0 /end CHARACTERISTIC
/begin CHARACTERISTIC KfLCAS_v_staticSpdThr "" VALUE 0x0000 /* @ECU_Address@KfLCAS_v_staticSpdThr@ */ Scalar_FLOAT32_IEEE 0 LCAS_subsystem_integrated_CM_single 0.0 10.0 /end CHARACTERISTIC
/begin CHARACTERISTIC KfLCAS_d_CVLargerZone_FarDis "" VALUE 0x0000 /* @ECU_Address@KfLCAS_d_CVLargerZone_FarDis@ */ Scalar_BYTE 0 LCAS_subsystem_integrated_CM_int8 3.0 6.0 /end CHARACTERISTIC
/begin CHARACTERISTIC KbLCAS_Sensor_Error "" VALUE 0x0000 /* @ECU_Address@KbLCAS_Sensor_Error@ */ Scalar_BOOLEAN 0 LCAS_subsystem_integrated_CM_boolean 0.0 1.0 /end CHARACTERISTIC
/begin CHARACTERISTIC KbLCAS_Sensor_Work "" VALUE 0x0000 /* @ECU_Address@KbLCAS_Sensor_Work@ */ Scalar_BOOLEAN 0 LCAS_subsystem_integrated_CM_boolean 0.0 1.0 /end CHARACTERISTIC
/begin CHARACTERISTIC KbLCAS_Switch "" VALUE 0x0000 /* @ECU_Address@KbLCAS_Switch@ */ Scalar_BOOLEAN 0 LCAS_subsystem_integrated_CM_boolean 0.0 1.0 /end CHARACTERISTIC
/begin CHARACTERISTIC KbLCAS_configLCA "" VALUE 0x0000 /* @ECU_Address@KbLCAS_configLCA@ */ Scalar_BOOLEAN 0 LCAS_subsystem_integrated_CM_boolean 0.0 1.0 /end CHARACTERISTIC
/begin CHARACTERISTIC KbLCAS_curve "" VALUE 0x0000 /* @ECU_Address@KbLCAS_curve@ */ Scalar_BOOLEAN 0 LCAS_subsystem_integrated_CM_boolean 0.0 1.0 /end CHARACTERISTIC
/begin MEASUREMENT VfLCAS_curvature "" FLOAT32_IEEE LCAS_subsystem_integrated_CM_single 0 0 -3.4E+38 3.4E+38 ECU_ADDRESS 0x0000 /* @ECU_Address@VfLCAS_curvature@ */ /end MEASUREMENT
/begin MEASUREMENT VfLCAS_speed_in "" FLOAT32_IEEE LCAS_subsystem_integrated_CM_single 0 0 -3.4E+38 3.4E+38 ECU_ADDRESS 0x0000 /* @ECU_Address@VfLCAS_speed_in@ */ /end MEASUREMENT
/begin MEASUREMENT VaLCAS_Obt "" FLOAT32_IEEE LCAS_subsystem_integrated_CM_single 0 0 -3.4E+38 3.4E+38 /* Array Size */ ARRAY_SIZE 16 ECU_ADDRESS 0x0000 /* @ECU_Address@VaLCAS_Obt@ */ /end MEASUREMENT
/begin MEASUREMENT ViLCAS_cvwR_ID "" SLONG LCAS_subsystem_integrated_CM_int32 0 0 -2147483648 2147483647 ECU_ADDRESS 0x0000 /* @ECU_Address@ViLCAS_cvwR_ID@ */ /end MEASUREMENT
/begin MEASUREMENT ViLCAS_cvwL_ID "" SLONG LCAS_subsystem_integrated_CM_int32 0 0 -2147483648 2147483647 ECU_ADDRESS 0x0000 /* @ECU_Address@ViLCAS_cvwL_ID@ */ /end MEASUREMENT
/begin MEASUREMENT VnLCAS_num_R "" UWORD LCAS_subsystem_integrated_CM_uint16 0 0 0 65535 ECU_ADDRESS 0x0000 /* @ECU_Address@VnLCAS_num_R@ */ /end MEASUREMENT
/begin MEASUREMENT VnLCAS_num_L "" UWORD LCAS_subsystem_integrated_CM_uint16 0 0 0 65535 ECU_ADDRESS 0x0000 /* @ECU_Address@VnLCAS_num_L@ */ /end MEASUREMENT
/begin MEASUREMENT VfLCAS_gear_in "" UBYTE LCAS_subsystem_integrated_CM_uint8 0 0 0 255 ECU_ADDRESS 0x0000 /* @ECU_Address@VfLCAS_gear_in@ */ /end MEASUREMENT
/begin MEASUREMENT ViLCAS_cvwR "" UBYTE LCAS_subsystem_integrated_CM_uint8 0 0 0 255 ECU_ADDRESS 0x0000 /* @ECU_Address@ViLCAS_cvwR@ */ /end MEASUREMENT
/begin MEASUREMENT ViLCAS_cvwL "" UBYTE LCAS_subsystem_integrated_CM_uint8 0 0 0 255 ECU_ADDRESS 0x0000 /* @ECU_Address@ViLCAS_cvwL@ */ /end MEASUREMENT
/begin MEASUREMENT VeLCAS_active_status "" UBYTE LCAS_subsystem_integrated_CM_EnumLCAS_Active_Status 0 0 0 5 ECU_ADDRESS 0x0000 /* @ECU_Address@VeLCAS_active_status@ */ /end MEASUREMENT
/begin MEASUREMENT VeLCAS_right_warning_status_out "" UBYTE LCAS_subsystem_integrated_CM_EnumLCAS_Warning_Status 0 0 0 2 ECU_ADDRESS 0x0000 /* @ECU_Address@VeLCAS_right_warning_status_out@ */ /end MEASUREMENT
/begin MEASUREMENT VeLCAS_left_warning_status_out "" UBYTE LCAS_subsystem_integrated_CM_EnumLCAS_Warning_Status 0 0 0 2 ECU_ADDRESS 0x0000 /* @ECU_Address@VeLCAS_left_warning_status_out@ */ /end MEASUREMENT
/begin MEASUREMENT VeLCAS_right_warning_status "" UBYTE LCAS_subsystem_integrated_CM_EnumLCAS_Warning_Status 0 0 0 2 ECU_ADDRESS 0x0000 /* @ECU_Address@VeLCAS_right_warning_status@ */ /end MEASUREMENT
/begin MEASUREMENT VeLCAS_left_warning_status "" UBYTE LCAS_subsystem_integrated_CM_EnumLCAS_Warning_Status 0 0 0 2 ECU_ADDRESS 0x0000 /* @ECU_Address@VeLCAS_left_warning_status@ */ /end MEASUREMENT
/begin COMPU_METHOD LCAS_subsystem_integrated_CM_single "Q = V" RAT_FUNC "%8.6" "" COEFFS 0 1 0 0 0 1 /end COMPU_METHOD
/begin COMPU_METHOD LCAS_subsystem_integrated_CM_single_m_s "Q = V" RAT_FUNC "%8.6" "m/s" COEFFS 0 1 0 0 0 1 /end COMPU_METHOD
/begin COMPU_METHOD LCAS_subsystem_integrated_CM_int8 "Q = V" RAT_FUNC "%3.0" "" COEFFS 0 1 0 0 0 1 /end COMPU_METHOD
/begin COMPU_METHOD LCAS_subsystem_integrated_CM_boolean "Q = V" RAT_FUNC "%1.0" "" COEFFS 0 1 0 0 0 1 /end COMPU_METHOD
/begin COMPU_METHOD LCAS_subsystem_integrated_CM_int32 "Q = V" RAT_FUNC "%10.0" "" COEFFS 0 1 0 0 0 1 /end COMPU_METHOD
/begin COMPU_METHOD LCAS_subsystem_integrated_CM_uint16 "Q = V" RAT_FUNC "%5.0" "" COEFFS 0 1 0 0 0 1 /end COMPU_METHOD
/begin COMPU_METHOD LCAS_subsystem_integrated_CM_uint8 "Q = V" RAT_FUNC "%3.0" "" COEFFS 0 1 0 0 0 1 /end COMPU_METHOD
/begin COMPU_METHOD LCAS_subsystem_integrated_CM_EnumLCAS_Active_Status "Enumerated data type: EnumLCAS_Active_Status" TAB_VERB "%0.6" "" /* Conversion Table */ COMPU_TAB_REF VTAB_FOR_LCAS_subsystem_integrated_CM_EnumLCAS_Active_Status /end COMPU_METHOD
/begin COMPU_VTAB /* Name of Table */ VTAB_FOR_LCAS_subsystem_integrated_CM_EnumLCAS_Active_Status "Enumerated data type: EnumLCAS_Active_Status" TAB_VERB /* Number of Elements */ 6 0 "LCAS_NONE" 1 "LCAS_OFF" 2 "LCAS_INACTIVE" 3 "LCAS_ERROR" 4 "LCAS_ACTIVE" 5 "LCAS_SELF_CHECK" /end COMPU_VTAB
/begin COMPU_METHOD LCAS_subsystem_integrated_CM_EnumLCAS_Warning_Status "Enumerated data type: EnumLCAS_Warning_Status" TAB_VERB "%0.6" "" /* Conversion Table */ COMPU_TAB_REF VTAB_FOR_LCAS_subsystem_integrated_CM_EnumLCAS_Warning_Status /end COMPU_METHOD
/begin COMPU_VTAB /* Name of Table */ VTAB_FOR_LCAS_subsystem_integrated_CM_EnumLCAS_Warning_Status "Enumerated data type: EnumLCAS_Warning_Status" TAB_VERB /* Number of Elements */ 3 0 "LCAS_NO_WARNING" 1 "LCAS_WARNING_LOW_LEVEL" 2 "LCAS_WARNING_HIGH_LEVEL" /end COMPU_VTAB
/begin GROUP LCAS_subsystem_integrated "LCAS_subsystem_integrated" /* Root */ ROOT /begin SUB_GROUP Root_LCAS_Subsystem /end SUB_GROUP /end GROUP
/begin GROUP Root_LCAS_Subsystem "LCAS_subsystem_integrated/LCAS_Subsystem"
 /begin SUB_GROUP S1_CalcLLCAEnabledSubsystem S1_CalcRLCAEnabledSubsystem S1_DtmnLCAEnabledSubsystem S1_LCAS_input_Subsystem S1_LCAS_output_Subsystem /end SUB_GROUP
/end GROUP
/begin GROUP S1_CalcLLCAEnabledSubsystem "LCAS_subsystem_integrated/LCAS_Subsystem/CalcLLCAEnabledSubsystem" /begin REF_MEASUREMENT VeLCAS_left_warning_status ViLCAS_cvwL ViLCAS_cvwL_ID /end REF_MEASUREMENT /end GROUP
/begin GROUP S1_CalcRLCAEnabledSubsystem "LCAS_subsystem_integrated/LCAS_Subsystem/CalcRLCAEnabledSubsystem" /begin REF_MEASUREMENT VeLCAS_right_warning_status ViLCAS_cvwR ViLCAS_cvwR_ID /end REF_MEASUREMENT /end GROUP
/begin GROUP S1_DtmnLCAEnabledSubsystem "LCAS_subsystem_integrated/LCAS_Subsystem/DtmnLCAEnabledSubsystem" /begin REF_CHARACTERISTIC KbLCAS_Sensor_Error KbLCAS_Sensor_Work /end REF_CHARACTERISTIC /end GROUP
/begin GROUP S1_LCAS_input_Subsystem "LCAS_subsystem_integrated/LCAS_Subsystem/LCAS_input_Subsystem"
 /begin SUB_GROUP S5_LCAS_Calibration_Subsystem S5_LCAS_CvrtInput_Subsystem S5_LCAS_CvrtObtVecFunctionEnabled /end SUB_GROUP
/end GROUP
/begin GROUP S1_LCAS_output_Subsystem "LCAS_subsystem_integrated/LCAS_Subsystem/LCAS_output_Subsystem"
 /begin REF_MEASUREMENT VeLCAS_active_status VeLCAS_left_warning_status_out VeLCAS_right_warning_status_out /end REF_MEASUREMENT
/end GROUP
/begin GROUP S5_LCAS_Calibration_Subsystem "LCAS_subsystem_integrated/LCAS_Subsystem/LCAS_input_Subsystem/LCAS_Calibration_Subsystem"
 /begin REF_CHARACTERISTIC KbLCAS_Switch KbLCAS_configLCA KfLCAS_Ang_DisbleStrAngleThrshMax KfLCAS_Ang_EnbleStrAngleThrshMax KfLCAS_c_DisbleCurveThrshMax KfLCAS_c_EnbleCurveThrshMax KfLCAS_d_CVLargerZone_FarDis KfLCAS_d_CVLargerZone_FrontDis KfLCAS_d_CVLargerZone_NearDis KfLCAS_d_CVZone_FarDis KfLCAS_d_CVZone_FrontDis KfLCAS_d_CVZone_NearDis KfLCAS_d_VehCenterFront KfLCAS_d_VehCenterRear KfLCAS_d_VehLenth KfLCAS_d_VehWidth KfLCAS_r_ObtWidthProportion KfLCAS_t_TTCLargerThrsh_LowLevel KfLCAS_t_TTCThrshLowLevel KfLCAS_t_WarnSustainedTime KfLCAS_v_DisbleVehSpdThrshHi KfLCAS_v_DisbleVehSpdThrshLo KfLCAS_v_EnbleVehSpdThrshHi KfLCAS_v_EnbleVehSpdThrshLo KfLCAS_v_LatSpdThr KfLCAS_v_staticSpdThr /end REF_CHARACTERISTIC
/end GROUP
/begin GROUP S5_LCAS_CvrtInput_Subsystem "LCAS_subsystem_integrated/LCAS_Subsystem/LCAS_input_Subsystem/LCAS_CvrtInput_Subsystem" /begin REF_CHARACTERISTIC KbLCAS_curve /end REF_CHARACTERISTIC /begin REF_MEASUREMENT VfLCAS_curvature VfLCAS_gear_in VfLCAS_speed_in /end REF_MEASUREMENT /end GROUP
/begin GROUP S5_LCAS_CvrtObtVecFunctionEnabled "LCAS_subsystem_integrated/LCAS_Subsystem/LCAS_input_Subsystem/LCAS_CvrtObtVecFunctionEnabled" /begin REF_MEASUREMENT VaLCAS_Obt VnLCAS_num_L VnLCAS_num_R /end REF_MEASUREMENT /end GROUP
/end MODULE
/end PROJECT
/* (add any file trailer comments here) */
/* EOF LCAS_subsystem_integrated.a2l */
