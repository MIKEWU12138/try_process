/******************************************************************************
* ASAP2 file: COMM_subsystem_integrated.a2l
* Code generation for model "COMM_subsystem_integrated".
* Model version : 1.1787
* Simulink Coder version : 8.13 (R2017b) 24-Jul-2017
* C source code generated on : Wed Jun 10 09:16:41 2020
* Target selection: ert.tlc
* Embedded hardware selection: Infineon->TriCore
* Code generation objectives:
* 1. MISRA C:2012 guidelines
* 2. Safety precaution
* 3. Execution efficiency
* 4. RAM efficiency
* 5. ROM efficiency
* Validation result: Not run
* (add additional file header information here)
******************************************************************************/ ASAP2_VERSION 1 31
/* Version 1.31 */
/begin PROJECT ProjectName "Project Comment Goes Here"
/begin HEADER "Header Comments go here" /end HEADER
/begin MODULE ModuleName "Module Comment Goes Here"
/begin MOD_PAR "MOD PAR Comment Goes Here" /end MOD_PAR
/begin MOD_COMMON "Mod Common Comment Here" BYTE_ORDER MSB_LAST /end MOD_COMMON
/begin RECORD_LAYOUT Scalar_BOOLEAN FNC_VALUES 1 UBYTE COLUMN_DIR DIRECT /end RECORD_LAYOUT
/begin RECORD_LAYOUT Scalar_UBYTE FNC_VALUES 1 UBYTE COLUMN_DIR DIRECT /end RECORD_LAYOUT
/begin RECORD_LAYOUT Scalar_BYTE FNC_VALUES 1 SBYTE COLUMN_DIR DIRECT /end RECORD_LAYOUT
/begin RECORD_LAYOUT Scalar_UWORD FNC_VALUES 1 UWORD COLUMN_DIR DIRECT /end RECORD_LAYOUT
/begin RECORD_LAYOUT Scalar_SWORD FNC_VALUES 1 SWORD COLUMN_DIR DIRECT /end RECORD_LAYOUT
/begin RECORD_LAYOUT Scalar_ULONG FNC_VALUES 1 ULONG COLUMN_DIR DIRECT /end RECORD_LAYOUT
/begin RECORD_LAYOUT Scalar_LONG FNC_VALUES 1 SLONG COLUMN_DIR DIRECT /end RECORD_LAYOUT
/begin RECORD_LAYOUT Scalar_FLOAT32_IEEE FNC_VALUES 1 FLOAT32_IEEE COLUMN_DIR DIRECT /end RECORD_LAYOUT
/begin RECORD_LAYOUT Scalar_FLOAT64_IEEE FNC_VALUES 1 FLOAT64_IEEE COLUMN_DIR DIRECT /end RECORD_LAYOUT
/begin RECORD_LAYOUT Lookup1D_BOOLEAN FNC_VALUES 1 UBYTE COLUMN_DIR DIRECT /end RECORD_LAYOUT
/begin RECORD_LAYOUT Lookup1D_X_BOOLEAN AXIS_PTS_X 1 UBYTE INDEX_INCR DIRECT /end RECORD_LAYOUT
/begin RECORD_LAYOUT Lookup1D_BYTE FNC_VALUES 1 SBYTE COLUMN_DIR DIRECT /end RECORD_LAYOUT
/begin RECORD_LAYOUT Lookup1D_X_BYTE AXIS_PTS_X 1 SBYTE INDEX_INCR DIRECT /end RECORD_LAYOUT
/begin RECORD_LAYOUT Lookup1D_UBYTE FNC_VALUES 1 UBYTE COLUMN_DIR DIRECT /end RECORD_LAYOUT
/begin RECORD_LAYOUT Lookup1D_X_UBYTE AXIS_PTS_X 1 UBYTE INDEX_INCR DIRECT /end RECORD_LAYOUT
/begin RECORD_LAYOUT Lookup1D_UWORD FNC_VALUES 1 UWORD COLUMN_DIR DIRECT /end RECORD_LAYOUT
/begin RECORD_LAYOUT Lookup1D_X_UWORD AXIS_PTS_X 1 UWORD INDEX_INCR DIRECT /end RECORD_LAYOUT
/begin RECORD_LAYOUT Lookup1D_WORD FNC_VALUES 1 SWORD COLUMN_DIR DIRECT /end RECORD_LAYOUT
/begin RECORD_LAYOUT Lookup1D_X_WORD AXIS_PTS_X 1 SWORD INDEX_INCR DIRECT /end RECORD_LAYOUT
/begin RECORD_LAYOUT Lookup1D_ULONG FNC_VALUES 1 ULONG COLUMN_DIR DIRECT /end RECORD_LAYOUT
/begin RECORD_LAYOUT Lookup1D_X_ULONG AXIS_PTS_X 1 ULONG INDEX_INCR DIRECT /end RECORD_LAYOUT
/begin RECORD_LAYOUT Lookup1D_SLONG FNC_VALUES 1 SLONG COLUMN_DIR DIRECT /end RECORD_LAYOUT
/begin RECORD_LAYOUT Lookup1D_X_LONG AXIS_PTS_X 1 SLONG INDEX_INCR DIRECT /end RECORD_LAYOUT
/begin RECORD_LAYOUT Lookup1D_FLOAT32_IEEE FNC_VALUES 1 FLOAT32_IEEE COLUMN_DIR DIRECT /end RECORD_LAYOUT
/begin RECORD_LAYOUT Lookup1D_X_FLOAT32_IEEE AXIS_PTS_X 1 FLOAT32_IEEE INDEX_INCR DIRECT /end RECORD_LAYOUT
/begin RECORD_LAYOUT Lookup1D_FLOAT64_IEEE FNC_VALUES 1 FLOAT64_IEEE COLUMN_DIR DIRECT /end RECORD_LAYOUT
/begin RECORD_LAYOUT Lookup1D_X_FLOAT64_IEEE AXIS_PTS_X 1 FLOAT64_IEEE INDEX_INCR DIRECT /end RECORD_LAYOUT
/begin RECORD_LAYOUT Lookup2D_BOOLEAN FNC_VALUES 1 UBYTE COLUMN_DIR DIRECT /end RECORD_LAYOUT
/begin RECORD_LAYOUT Lookup2D_X_BOOLEAN AXIS_PTS_X 1 UBYTE INDEX_INCR DIRECT /end RECORD_LAYOUT
/begin RECORD_LAYOUT Lookup2D_UBYTE FNC_VALUES 1 UBYTE COLUMN_DIR DIRECT /end RECORD_LAYOUT
/begin RECORD_LAYOUT Lookup2D_X_UBYTE AXIS_PTS_X 1 UBYTE INDEX_INCR DIRECT /end RECORD_LAYOUT
/begin RECORD_LAYOUT Lookup2D_BYTE FNC_VALUES 1 SBYTE COLUMN_DIR DIRECT /end RECORD_LAYOUT
/begin RECORD_LAYOUT Lookup2D_X_BYTE AXIS_PTS_X 1 SBYTE INDEX_INCR DIRECT /end RECORD_LAYOUT
/begin RECORD_LAYOUT Lookup2D_UWORD FNC_VALUES 1 UWORD COLUMN_DIR DIRECT /end RECORD_LAYOUT
/begin RECORD_LAYOUT Lookup2D_X_UWORD AXIS_PTS_X 1 UWORD INDEX_INCR DIRECT /end RECORD_LAYOUT
/begin RECORD_LAYOUT Lookup2D_WORD FNC_VALUES 1 SWORD COLUMN_DIR DIRECT /end RECORD_LAYOUT
/begin RECORD_LAYOUT Lookup2D_X_WORD AXIS_PTS_X 1 SWORD INDEX_INCR DIRECT /end RECORD_LAYOUT
/begin RECORD_LAYOUT Lookup2D_ULONG FNC_VALUES 1 ULONG COLUMN_DIR DIRECT /end RECORD_LAYOUT
/begin RECORD_LAYOUT Lookup2D_X_ULONG AXIS_PTS_X 1 ULONG INDEX_INCR DIRECT /end RECORD_LAYOUT
/begin RECORD_LAYOUT Lookup2D_LONG FNC_VALUES 1 SLONG COLUMN_DIR DIRECT /end RECORD_LAYOUT
/begin RECORD_LAYOUT Lookup2D_X_LONG AXIS_PTS_X 1 SLONG INDEX_INCR DIRECT /end RECORD_LAYOUT
/begin RECORD_LAYOUT Lookup2D_FLOAT32_IEEE FNC_VALUES 1 FLOAT32_IEEE COLUMN_DIR DIRECT /end RECORD_LAYOUT
/begin RECORD_LAYOUT Lookup2D_X_FLOAT32_IEEE AXIS_PTS_X 1 FLOAT32_IEEE INDEX_INCR DIRECT /end RECORD_LAYOUT
/begin RECORD_LAYOUT Lookup2D_FLOAT64_IEEE FNC_VALUES 1 FLOAT64_IEEE COLUMN_DIR DIRECT /end RECORD_LAYOUT
/begin RECORD_LAYOUT Lookup2D_X_FLOAT64_IEEE AXIS_PTS_X 1 FLOAT64_IEEE INDEX_INCR DIRECT /end RECORD_LAYOUT
/begin CHARACTERISTIC KcCOMM_BrakePedalMax "" VALUE 0x0000 /* @ECU_Address@KcCOMM_BrakePedalMax@ */ Scalar_FLOAT32_IEEE 0 COMM_subsystem_integrated_CM_single -3.4E+38 3.4E+38 /end CHARACTERISTIC
/begin CHARACTERISTIC KcCOMM_BrakePedalMin "" VALUE 0x0000 /* @ECU_Address@KcCOMM_BrakePedalMin@ */ Scalar_FLOAT32_IEEE 0 COMM_subsystem_integrated_CM_single -3.4E+38 3.4E+38 /end CHARACTERISTIC
/begin CHARACTERISTIC KcCOMM_FirstGearRatio "Gear ratio in 1st gear." VALUE 0x0000 /* @ECU_Address@KcCOMM_FirstGearRatio@ */ Scalar_FLOAT32_IEEE 0 COMM_subsystem_integrated_CM_single -3.4E+38 3.4E+38 /end CHARACTERISTIC
/begin CHARACTERISTIC KcCOMM_GasPedalMax "" VALUE 0x0000 /* @ECU_Address@KcCOMM_GasPedalMax@ */ Scalar_FLOAT32_IEEE 0 COMM_subsystem_integrated_CM_single -3.4E+38 3.4E+38 /end CHARACTERISTIC
/begin CHARACTERISTIC KcCOMM_GasPedalMaxEPB "" VALUE 0x0000 /* @ECU_Address@KcCOMM_GasPedalMaxEPB@ */ Scalar_FLOAT32_IEEE 0 COMM_subsystem_integrated_CM_single -3.4E+38 3.4E+38 /end CHARACTERISTIC
/begin CHARACTERISTIC KcCOMM_GasPedalMin "" VALUE 0x0000 /* @ECU_Address@KcCOMM_GasPedalMin@ */ Scalar_FLOAT32_IEEE 0 COMM_subsystem_integrated_CM_single -3.4E+38 3.4E+38 /end CHARACTERISTIC
/begin CHARACTERISTIC KcCOMM_GasPedalMinEPB "" VALUE 0x0000 /* @ECU_Address@KcCOMM_GasPedalMinEPB@ */ Scalar_FLOAT32_IEEE 0 COMM_subsystem_integrated_CM_single -3.4E+38 3.4E+38 /end CHARACTERISTIC
/begin CHARACTERISTIC KcCOMM_GasPedalRampEPB "" VALUE 0x0000 /* @ECU_Address@KcCOMM_GasPedalRampEPB@ */ Scalar_FLOAT32_IEEE 0 COMM_subsystem_integrated_CM_single -3.4E+38 3.4E+38 /end CHARACTERISTIC
/begin CHARACTERISTIC KcCOMM_Test_Cmd_AccPelPosAct "" VALUE 0x0000 /* @ECU_Address@KcCOMM_Test_Cmd_AccPelPosAct@ */ Scalar_FLOAT32_IEEE 0 COMM_subsystem_integrated_CM_single -3.4E+38 3.4E+38 /end CHARACTERISTIC
/begin CHARACTERISTIC KcCOMM_Test_Cmd_BrkPelPosAct "" VALUE 0x0000 /* @ECU_Address@KcCOMM_Test_Cmd_BrkPelPosAct@ */ Scalar_FLOAT32_IEEE 0 COMM_subsystem_integrated_CM_single -3.4E+38 3.4E+38 /end CHARACTERISTIC
/begin CHARACTERISTIC KcCOMM_Test_Cmd_StrAngle "" VALUE 0x0000 /* @ECU_Address@KcCOMM_Test_Cmd_StrAngle@ */ Scalar_FLOAT32_IEEE 0 COMM_subsystem_integrated_CM_single -3.4E+38 3.4E+38 /end CHARACTERISTIC
/begin CHARACTERISTIC KcCOMM_Test_Cmd_StrAngleSpd "" VALUE 0x0000 /* @ECU_Address@KcCOMM_Test_Cmd_StrAngleSpd@ */ Scalar_FLOAT32_IEEE 0 COMM_subsystem_integrated_CM_single -3.4E+38 3.4E+38 /end CHARACTERISTIC
/begin CHARACTERISTIC KcCOMM_Test_Decs_Acc_Value "" VALUE 0x0000 /* @ECU_Address@KcCOMM_Test_Decs_Acc_Value@ */ Scalar_FLOAT32_IEEE 0 COMM_subsystem_integrated_CM_single -3.4E+38 3.4E+38 /end CHARACTERISTIC
/begin CHARACTERISTIC KcCOMM_Test_Decs_Breake_Value "" VALUE 0x0000 /* @ECU_Address@KcCOMM_Test_Decs_Breake_Value@ */ Scalar_FLOAT32_IEEE 0 COMM_subsystem_integrated_CM_single -3.4E+38 3.4E+38 /end CHARACTERISTIC
/begin CHARACTERISTIC KcCOMM_Test_Tar_vehiclespd "" VALUE 0x0000 /* @ECU_Address@KcCOMM_Test_Tar_vehiclespd@ */ Scalar_FLOAT32_IEEE 0 COMM_subsystem_integrated_CM_single -3.4E+38 3.4E+38 /end CHARACTERISTIC
/begin CHARACTERISTIC KfACCS_d_VEH_WheelDiameter "This is whell diameter" VALUE 0x0000 /* @ECU_Address@KfACCS_d_VEH_WheelDiameter@ */ Scalar_FLOAT32_IEEE 0 COMM_subsystem_integrated_CM_single_mm 0.0 2000.0 /end CHARACTERISTIC
/begin CHARACTERISTIC KfCOMM_Ang_VEH_AngOrigin2FrontWheel "This is the angle between origin to front axle and origin to front wheel" VALUE 0x0000 /* @ECU_Address@KfCOMM_Ang_VEH_AngOrigin2FrontWheel@ */ Scalar_FLOAT32_IEEE 0 COMM_subsystem_integrated_CM_single_rad -3.14 3.14 /end CHARACTERISTIC
/begin CHARACTERISTIC KfCOMM_VEH_Mass "Vehicle mass" VALUE 0x0000 /* @ECU_Address@KfCOMM_VEH_Mass@ */ Scalar_FLOAT32_IEEE 0 COMM_subsystem_integrated_CM_single_kg 0.0 100000.0 /end CHARACTERISTIC
/begin CHARACTERISTIC KfCOMM_VEH_StiffnessFront "This is cornering stiffness of front wheel" VALUE 0x0000 /* @ECU_Address@KfCOMM_VEH_StiffnessFront@ */ Scalar_FLOAT32_IEEE 0 COMM_subsystem_integrated_CM_single_N_deg 0.0 100000.0 /end CHARACTERISTIC
/begin CHARACTERISTIC KfCOMM_VEH_StiffnessRear "This is cornering stiffness of rear wheel" VALUE 0x0000 /* @ECU_Address@KfCOMM_VEH_StiffnessRear@ */ Scalar_FLOAT32_IEEE 0 COMM_subsystem_integrated_CM_single_N_deg 0.0 1.0E+6 /end CHARACTERISTIC
/begin CHARACTERISTIC KfCOMM_VEH_YawInertia_Z "Moment of inertia of the whole vehicle around z axis" VALUE 0x0000 /* @ECU_Address@KfCOMM_VEH_YawInertia_Z@ */ Scalar_FLOAT32_IEEE 0 COMM_subsystem_integrated_CM_single_kg_m2 0.0 100000.0 /end CHARACTERISTIC
/begin CHARACTERISTIC KfCOMM_a_VCULongAccOffset "Offset to override Longitudinal Acceleration." VALUE 0x0000 /* @ECU_Address@KfCOMM_a_VCULongAccOffset@ */ Scalar_FLOAT32_IEEE 0 COMM_subsystem_integrated_CM_single -3.4E+38 3.4E+38 /end CHARACTERISTIC
/begin CHARACTERISTIC KfCOMM_d_VEH_DisCentorid2Front "This is the distance between Cetroid and Front surface" VALUE 0x0000 /* @ECU_Address@KfCOMM_d_VEH_DisCentorid2Front@ */ Scalar_FLOAT32_IEEE 0 COMM_subsystem_integrated_CM_single_mm 0.0 10000.0 /end CHARACTERISTIC
/begin CHARACTERISTIC KfCOMM_d_VEH_DisFront2Rear "This is distance between two axes" VALUE 0x0000 /* @ECU_Address@KfCOMM_d_VEH_DisFront2Rear@ */ Scalar_FLOAT32_IEEE 0 COMM_subsystem_integrated_CM_single_mm 0.0 10000.0 /end CHARACTERISTIC
/begin CHARACTERISTIC KfCOMM_d_VEH_DisLeft2Right "This is the distance between left wheel and right wheel" VALUE 0x0000 /* @ECU_Address@KfCOMM_d_VEH_DisLeft2Right@ */ Scalar_FLOAT32_IEEE 0 COMM_subsystem_integrated_CM_single_mm 0.0 5000.0 /end CHARACTERISTIC
/begin CHARACTERISTIC KfCOMM_d_VEH_DisOrigin2End "This is the distance between the cordinate origin and the rear surface" VALUE 0x0000 /* @ECU_Address@KfCOMM_d_VEH_DisOrigin2End@ */ Scalar_FLOAT32_IEEE 0 COMM_subsystem_integrated_CM_single_mm 0.0 10000.0 /end CHARACTERISTIC
/begin CHARACTERISTIC KfCOMM_d_VEH_DisOrigin2FrontWheel "" VALUE 0x0000 /* @ECU_Address@KfCOMM_d_VEH_DisOrigin2FrontWheel@ */ Scalar_FLOAT32_IEEE 0 COMM_subsystem_integrated_CM_single_mm 0.0 10000.0 /end CHARACTERISTIC
/begin CHARACTERISTIC KfCOMM_d_VEH_DisOrigin2Head "This is the distance between the coordinate origin and the front surface" VALUE 0x0000 /* @ECU_Address@KfCOMM_d_VEH_DisOrigin2Head@ */ Scalar_FLOAT32_IEEE 0 COMM_subsystem_integrated_CM_single_mm 0.0 10000.0 /end CHARACTERISTIC
/begin CHARACTERISTIC KfCOMM_d_VEH_DisOrigin2RearAxle "This is the distance between the cordinate origin and the rear axle" VALUE 0x0000 /* @ECU_Address@KfCOMM_d_VEH_DisOrigin2RearAxle@ */ Scalar_FLOAT32_IEEE 0 COMM_subsystem_integrated_CM_single_mm 0.0 10000.0 /end CHARACTERISTIC
/begin CHARACTERISTIC KfCOMM_d_VEH_Length "This is vehicle length" VALUE 0x0000 /* @ECU_Address@KfCOMM_d_VEH_Length@ */ Scalar_FLOAT32_IEEE 0 COMM_subsystem_integrated_CM_single_mm 0.0 20000.0 /end CHARACTERISTIC
/begin CHARACTERISTIC KfCOMM_d_VEH_MinTurnRadius "Minimum turning radius" VALUE 0x0000 /* @ECU_Address@KfCOMM_d_VEH_MinTurnRadius@ */ Scalar_FLOAT32_IEEE 0 COMM_subsystem_integrated_CM_single_m 0.0 30.0 /end CHARACTERISTIC
/begin CHARACTERISTIC KfCOMM_d_VEH_Width "Vehicle's width" VALUE 0x0000 /* @ECU_Address@KfCOMM_d_VEH_Width@ */ Scalar_FLOAT32_IEEE 0 COMM_subsystem_integrated_CM_single_mm 0.0 5000.0 /end CHARACTERISTIC
/begin CHARACTERISTIC KfCOMM_r_VCULongAccSlope "Slope to override Longitudinal Acceleration." VALUE 0x0000 /* @ECU_Address@KfCOMM_r_VCULongAccSlope@ */ Scalar_FLOAT32_IEEE 0 COMM_subsystem_integrated_CM_single -3.4E+38 3.4E+38 /end CHARACTERISTIC
/begin CHARACTERISTIC KcCOMM_Test_Cmd_ATOModEnable "" VALUE 0x0000 /* @ECU_Address@KcCOMM_Test_Cmd_ATOModEnable@ */ Scalar_UBYTE 0 COMM_subsystem_integrated_CM_uint8 0 255 /end CHARACTERISTIC
/begin CHARACTERISTIC KcCOMM_Test_Cmd_TgtSft "" VALUE 0x0000 /* @ECU_Address@KcCOMM_Test_Cmd_TgtSft@ */ Scalar_UBYTE 0 COMM_subsystem_integrated_CM_uint8 0 255 /end CHARACTERISTIC
/begin CHARACTERISTIC KcCOMM_Test_Decs_Acc_Req "" VALUE 0x0000 /* @ECU_Address@KcCOMM_Test_Decs_Acc_Req@ */ Scalar_UBYTE 0 COMM_subsystem_integrated_CM_uint8 0 255 /end CHARACTERISTIC
/begin CHARACTERISTIC KcCOMM_Test_mode "" VALUE 0x0000 /* @ECU_Address@KcCOMM_Test_mode@ */ Scalar_UBYTE 0 COMM_subsystem_integrated_CM_uint8 0 255 /end CHARACTERISTIC
/begin CHARACTERISTIC KcCOMM_TorqCtrlPriority_Active "The priority of the Torque Override Control Mode send to VCU in ADV active state.
      0 - Highest priority.
      1 - High priority.
      2 - Medium priority.
      3 - Low priority." VALUE 0x0000 /* @ECU_Address@KcCOMM_TorqCtrlPriority_Active@ */ Scalar_UBYTE 0 COMM_subsystem_integrated_CM_uint8 0 255 /end CHARACTERISTIC
/begin CHARACTERISTIC KcCOMM_TorqCtrlPriority_Default "The priority of the Torque Override Control Mode send to VCU in default state.
      0 - Highest priority.
      1 - High priority.
      2 - Medium priority.
      3 - Low priority." VALUE 0x0000 /* @ECU_Address@KcCOMM_TorqCtrlPriority_Default@ */ Scalar_UBYTE 0 COMM_subsystem_integrated_CM_uint8 0 255 /end CHARACTERISTIC
/begin CHARACTERISTIC KeCOMM_Test_Cmd_ParkingCtrlValue "" VALUE 0x0000 /* @ECU_Address@KeCOMM_Test_Cmd_ParkingCtrlValue@ */ Scalar_UBYTE 0 COMM_subsystem_integrated_CM_uint8 0 255 /end CHARACTERISTIC
/begin CHARACTERISTIC KeCOMM_VehicleCANbusConfig "Vehicle Platform and CAN Bus Configuration.
      1 - JAC#1;
      2 - JAC#2 or iVISTA;
      3 - ICPV;
      4 - GLB;
      5 - FAW;
      6 - HZBus;
      7 - USdemo." VALUE 0x0000 /* @ECU_Address@KeCOMM_VehicleCANbusConfig@ */ Scalar_UBYTE 0 COMM_subsystem_integrated_CM_uint8 0 255 /end CHARACTERISTIC
/begin CHARACTERISTIC KbCOMM_Test_BckFogLamp_Req "" VALUE 0x0000 /* @ECU_Address@KbCOMM_Test_BckFogLamp_Req@ */ Scalar_BOOLEAN 0 COMM_subsystem_integrated_CM_boolean 0 1 /end CHARACTERISTIC
/begin CHARACTERISTIC KbCOMM_Test_BrakePrechargeRequest "Test mode value for brake boost precharge request." VALUE 0x0000 /* @ECU_Address@KbCOMM_Test_BrakePrechargeRequest@ */ Scalar_BOOLEAN 0 COMM_subsystem_integrated_CM_boolean 0 1 /end CHARACTERISTIC
/begin CHARACTERISTIC KbCOMM_Test_Cmd_AccPelEnable "" VALUE 0x0000 /* @ECU_Address@KbCOMM_Test_Cmd_AccPelEnable@ */ Scalar_BOOLEAN 0 COMM_subsystem_integrated_CM_boolean 0 1 /end CHARACTERISTIC
/begin CHARACTERISTIC KbCOMM_Test_Cmd_BrakeLightReq "" VALUE 0x0000 /* @ECU_Address@KbCOMM_Test_Cmd_BrakeLightReq@ */ Scalar_BOOLEAN 0 COMM_subsystem_integrated_CM_boolean 0 1 /end CHARACTERISTIC
/begin CHARACTERISTIC KbCOMM_Test_Cmd_BrkPelEnable "" VALUE 0x0000 /* @ECU_Address@KbCOMM_Test_Cmd_BrkPelEnable@ */ Scalar_BOOLEAN 0 COMM_subsystem_integrated_CM_boolean 0 1 /end CHARACTERISTIC
/begin CHARACTERISTIC KbCOMM_Test_Cmd_ParkingCtrlEnable "" VALUE 0x0000 /* @ECU_Address@KbCOMM_Test_Cmd_ParkingCtrlEnable@ */ Scalar_BOOLEAN 0 COMM_subsystem_integrated_CM_boolean 0 1 /end CHARACTERISTIC
/begin CHARACTERISTIC KbCOMM_Test_Cmd_TgtSftEnable "" VALUE 0x0000 /* @ECU_Address@KbCOMM_Test_Cmd_TgtSftEnable@ */ Scalar_BOOLEAN 0 COMM_subsystem_integrated_CM_boolean 0 1 /end CHARACTERISTIC
/begin CHARACTERISTIC KbCOMM_Test_Decs_DippedBeam_Req "" VALUE 0x0000 /* @ECU_Address@KbCOMM_Test_Decs_DippedBeam_Req@ */ Scalar_BOOLEAN 0 COMM_subsystem_integrated_CM_boolean 0 1 /end CHARACTERISTIC
/begin CHARACTERISTIC KbCOMM_Test_Decs_HighBeam_Req "" VALUE 0x0000 /* @ECU_Address@KbCOMM_Test_Decs_HighBeam_Req@ */ Scalar_BOOLEAN 0 COMM_subsystem_integrated_CM_boolean 0 1 /end CHARACTERISTIC
/begin CHARACTERISTIC KbCOMM_Test_Decs_LftLmp_Req "" VALUE 0x0000 /* @ECU_Address@KbCOMM_Test_Decs_LftLmp_Req@ */ Scalar_BOOLEAN 0 COMM_subsystem_integrated_CM_boolean 0 1 /end CHARACTERISTIC
/begin CHARACTERISTIC KbCOMM_Test_Decs_Light_Req "" VALUE 0x0000 /* @ECU_Address@KbCOMM_Test_Decs_Light_Req@ */ Scalar_BOOLEAN 0 COMM_subsystem_integrated_CM_boolean 0 1 /end CHARACTERISTIC
/begin CHARACTERISTIC KbCOMM_Test_Decs_RihtLmp_Req "" VALUE 0x0000 /* @ECU_Address@KbCOMM_Test_Decs_RihtLmp_Req@ */ Scalar_BOOLEAN 0 COMM_subsystem_integrated_CM_boolean 0 1 /end CHARACTERISTIC
/begin CHARACTERISTIC KbCOMM_Test_Decs_iBCM_Req "" VALUE 0x0000 /* @ECU_Address@KbCOMM_Test_Decs_iBCM_Req@ */ Scalar_BOOLEAN 0 COMM_subsystem_integrated_CM_boolean 0 1 /end CHARACTERISTIC
/begin CHARACTERISTIC KbCOMM_Test_FrontFogLamp_Req "" VALUE 0x0000 /* @ECU_Address@KbCOMM_Test_FrontFogLamp_Req@ */ Scalar_BOOLEAN 0 COMM_subsystem_integrated_CM_boolean 0 1 /end CHARACTERISTIC
/begin CHARACTERISTIC KbCOMM_Test_Horn_Req "" VALUE 0x0000 /* @ECU_Address@KbCOMM_Test_Horn_Req@ */ Scalar_BOOLEAN 0 COMM_subsystem_integrated_CM_boolean 0 1 /end CHARACTERISTIC
/begin CHARACTERISTIC KbCOMM_Test_Over_Speed "SLEW value for Over Speed." VALUE 0x0000 /* @ECU_Address@KbCOMM_Test_Over_Speed@ */ Scalar_BOOLEAN 0 COMM_subsystem_integrated_CM_boolean 0 1 /end CHARACTERISTIC
/begin CHARACTERISTIC KbCOMM_Test_SlowDown_Indication "SLEW value for SpeedUp_Indication." VALUE 0x0000 /* @ECU_Address@KbCOMM_Test_SlowDown_Indication@ */ Scalar_BOOLEAN 0 COMM_subsystem_integrated_CM_boolean 0 1 /end CHARACTERISTIC
/begin CHARACTERISTIC KbCOMM_Test_SpeedUp_Indication "SLEW value for SpeedUp_Indication." VALUE 0x0000 /* @ECU_Address@KbCOMM_Test_SpeedUp_Indication@ */ Scalar_BOOLEAN 0 COMM_subsystem_integrated_CM_boolean 0 1 /end CHARACTERISTIC
/begin CHARACTERISTIC KbCOMM_Test_Stop_Request "" VALUE 0x0000 /* @ECU_Address@KbCOMM_Test_Stop_Request@ */ Scalar_BOOLEAN 0 COMM_subsystem_integrated_CM_boolean 0 1 /end CHARACTERISTIC
/begin CHARACTERISTIC KbCOMM_Test_WarnLight_Req "" VALUE 0x0000 /* @ECU_Address@KbCOMM_Test_WarnLight_Req@ */ Scalar_BOOLEAN 0 COMM_subsystem_integrated_CM_boolean 0 1 /end CHARACTERISTIC
/begin CHARACTERISTIC KbCOMM_Test_driveoff_Req "" VALUE 0x0000 /* @ECU_Address@KbCOMM_Test_driveoff_Req@ */ Scalar_BOOLEAN 0 COMM_subsystem_integrated_CM_boolean 0 1 /end CHARACTERISTIC
/begin CHARACTERISTIC KbCOMM_VEH_UseNewConfig "This calibartion can change to a new vehicle configure which can be calibrated" VALUE 0x0000 /* @ECU_Address@KbCOMM_VEH_UseNewConfig@ */ Scalar_BOOLEAN 0 COMM_subsystem_integrated_CM_boolean 0.0 1.0 /end CHARACTERISTIC
/begin CHARACTERISTIC KcCOMM_Test_Cmd_EPSXBW_En "" VALUE 0x0000 /* @ECU_Address@KcCOMM_Test_Cmd_EPSXBW_En@ */ Scalar_BOOLEAN 0 COMM_subsystem_integrated_CM_boolean 0 1 /end CHARACTERISTIC
/begin CHARACTERISTIC KcCOMM_Test_Cmd_EPSXBW_En_ovr "" VALUE 0x0000 /* @ECU_Address@KcCOMM_Test_Cmd_EPSXBW_En_ovr@ */ Scalar_BOOLEAN 0 COMM_subsystem_integrated_CM_boolean 0 1 /end CHARACTERISTIC
/begin CHARACTERISTIC KcCOMM_Test_Cmd_StrAngle_ovr "" VALUE 0x0000 /* @ECU_Address@KcCOMM_Test_Cmd_StrAngle_ovr@ */ Scalar_BOOLEAN 0 COMM_subsystem_integrated_CM_boolean 0 1 /end CHARACTERISTIC
/begin CHARACTERISTIC KcCOMM_Test_Decs_Acc_Req_ovr "" VALUE 0x0000 /* @ECU_Address@KcCOMM_Test_Decs_Acc_Req_ovr@ */ Scalar_BOOLEAN 0 COMM_subsystem_integrated_CM_boolean 0 1 /end CHARACTERISTIC
/begin CHARACTERISTIC KcCOMM_Test_Decs_Acc_Value_ovr "" VALUE 0x0000 /* @ECU_Address@KcCOMM_Test_Decs_Acc_Value_ovr@ */ Scalar_BOOLEAN 0 COMM_subsystem_integrated_CM_boolean 0 1 /end CHARACTERISTIC
/begin CHARACTERISTIC KcCOMM_Test_Decs_Breake_Req "" VALUE 0x0000 /* @ECU_Address@KcCOMM_Test_Decs_Breake_Req@ */ Scalar_BOOLEAN 0 COMM_subsystem_integrated_CM_boolean 0 1 /end CHARACTERISTIC
/begin CHARACTERISTIC KcCOMM_Test_Decs_Breake_Req_ovr "" VALUE 0x0000 /* @ECU_Address@KcCOMM_Test_Decs_Breake_Req_ovr@ */ Scalar_BOOLEAN 0 COMM_subsystem_integrated_CM_boolean 0 1 /end CHARACTERISTIC
/begin CHARACTERISTIC KcCOMM_Test_Decs_Breake_Value_ovr "" VALUE 0x0000 /* @ECU_Address@KcCOMM_Test_Decs_Breake_Value_ovr@ */ Scalar_BOOLEAN 0 COMM_subsystem_integrated_CM_boolean 0 1 /end CHARACTERISTIC
/begin MEASUREMENT VbHWIO_DriverModeComd "Drive Mode Command from HWIO." UBYTE COMM_subsystem_integrated_CM_boolean 0 0 0 1 ECU_ADDRESS 0x0000 /* @ECU_Address@VbHWIO_DriverModeComd@ */ /end MEASUREMENT
/begin MEASUREMENT VbHWIO_LeftTurningLightState "Left Turning Light State from HWIO." UBYTE COMM_subsystem_integrated_CM_boolean 0 0 0 1 ECU_ADDRESS 0x0000 /* @ECU_Address@VbHWIO_LeftTurningLightState@ */ /end MEASUREMENT
/begin MEASUREMENT VbHWIO_RightTurningLightState "Right Turning Light State from HWIO." UBYTE COMM_subsystem_integrated_CM_boolean 0 0 0 1 ECU_ADDRESS 0x0000 /* @ECU_Address@VbHWIO_RightTurningLightState@ */ /end MEASUREMENT
/begin MEASUREMENT VbHWIO_ACC_MainSwitch "ACC Main Switch from HWIO." UBYTE COMM_subsystem_integrated_CM_boolean 0 0 0 1 ECU_ADDRESS 0x0000 /* @ECU_Address@VbHWIO_ACC_MainSwitch@ */ /end MEASUREMENT
/begin MEASUREMENT VbHWIO_ACC_ResumeSwitch "ACC Resume Switch from HWIO." UBYTE COMM_subsystem_integrated_CM_boolean 0 0 0 1 ECU_ADDRESS 0x0000 /* @ECU_Address@VbHWIO_ACC_ResumeSwitch@ */ /end MEASUREMENT
/begin MEASUREMENT VbHWIO_ACC_SetSwitch "ACC Set Switch from HWIO." UBYTE COMM_subsystem_integrated_CM_boolean 0 0 0 1 ECU_ADDRESS 0x0000 /* @ECU_Address@VbHWIO_ACC_SetSwitch@ */ /end MEASUREMENT
/begin MEASUREMENT VbHWIO_ACC_TimeGapPlus "ACC Time Gap Plus from HWIO." UBYTE COMM_subsystem_integrated_CM_boolean 0 0 0 1 ECU_ADDRESS 0x0000 /* @ECU_Address@VbHWIO_ACC_TimeGapPlus@ */ /end MEASUREMENT
/begin MEASUREMENT VbHWIO_ACC_TimeGapMinus "ACC Time Gap Minus from HWIO." UBYTE COMM_subsystem_integrated_CM_boolean 0 0 0 1 ECU_ADDRESS 0x0000 /* @ECU_Address@VbHWIO_ACC_TimeGapMinus@ */ /end MEASUREMENT
/begin MEASUREMENT VbHWIO_ACC_CancelSwitch "ACC Cancel Switch from HWIO." UBYTE COMM_subsystem_integrated_CM_boolean 0 0 0 1 ECU_ADDRESS 0x0000 /* @ECU_Address@VbHWIO_ACC_CancelSwitch@ */ /end MEASUREMENT
/begin MEASUREMENT VfCOMM_ADCU_BrakeDecelValue "" FLOAT32_IEEE COMM_subsystem_integrated_CM_single 0 0 -3.4E+38 3.4E+38 ECU_ADDRESS 0x0000 /* @ECU_Address@VfCOMM_ADCU_BrakeDecelValue@ */ /end MEASUREMENT
/begin MEASUREMENT VfCOMM_ADCU_PowerAccelValue "" FLOAT32_IEEE COMM_subsystem_integrated_CM_single 0 0 -3.4E+38 3.4E+38 ECU_ADDRESS 0x0000 /* @ECU_Address@VfCOMM_ADCU_PowerAccelValue@ */ /end MEASUREMENT
/begin MEASUREMENT VfCOMM_ADCU_SteeringAngleValue "" FLOAT32_IEEE COMM_subsystem_integrated_CM_single 0 0 -3.4E+38 3.4E+38 ECU_ADDRESS 0x0000 /* @ECU_Address@VfCOMM_ADCU_SteeringAngleValue@ */ /end MEASUREMENT
/begin MEASUREMENT VfCOMM_ADCU_TargetVehicleSpeed "" FLOAT32_IEEE COMM_subsystem_integrated_CM_single 0 0 -3.4E+38 3.4E+38 ECU_ADDRESS 0x0000 /* @ECU_Address@VfCOMM_ADCU_TargetVehicleSpeed@ */ /end MEASUREMENT
/begin MEASUREMENT VfCOMM_ADCU_PowerTorqueValue "" FLOAT32_IEEE COMM_subsystem_integrated_CM_single 0 0 -3.4E+38 3.4E+38 ECU_ADDRESS 0x0000 /* @ECU_Address@VfCOMM_ADCU_PowerTorqueValue@ */ /end MEASUREMENT
/begin MEASUREMENT VfCOMM_ADCU_BrakePressureValue "" FLOAT32_IEEE COMM_subsystem_integrated_CM_single 0 0 -3.4E+38 3.4E+38 ECU_ADDRESS 0x0000 /* @ECU_Address@VfCOMM_ADCU_BrakePressureValue@ */ /end MEASUREMENT
/begin MEASUREMENT VfCOMM_max_gas_pedal_EPB "" FLOAT32_IEEE COMM_subsystem_integrated_CM_single 0 0 -3.4E+38 3.4E+38 ECU_ADDRESS 0x0000 /* @ECU_Address@VfCOMM_max_gas_pedal_EPB@ */ /end MEASUREMENT
/begin MEASUREMENT VfCOMM_TCU_ActualGearRatio "" FLOAT32_IEEE COMM_subsystem_integrated_CM_single 0 0 -3.4E+38 3.4E+38 ECU_ADDRESS 0x0000 /* @ECU_Address@VfCOMM_TCU_ActualGearRatio@ */ /end MEASUREMENT
/begin MEASUREMENT VfCOMM_VDC_YawRate "" FLOAT32_IEEE COMM_subsystem_integrated_CM_single 0 0 -3.4E+38 3.4E+38 ECU_ADDRESS 0x0000 /* @ECU_Address@VfCOMM_VDC_YawRate@ */ /end MEASUREMENT
/begin MEASUREMENT VfCOMM_VDC_VehicleSpeed "" FLOAT32_IEEE COMM_subsystem_integrated_CM_single 0 0 -3.4E+38 3.4E+38 ECU_ADDRESS 0x0000 /* @ECU_Address@VfCOMM_VDC_VehicleSpeed@ */ /end MEASUREMENT
/begin MEASUREMENT VfCOMM_VDC_WheelSpeed_RR1 "" FLOAT32_IEEE COMM_subsystem_integrated_CM_single 0 0 -3.4E+38 3.4E+38 ECU_ADDRESS 0x0000 /* @ECU_Address@VfCOMM_VDC_WheelSpeed_RR1@ */ /end MEASUREMENT
/begin MEASUREMENT VfCOMM_VDC_LongAcceleration "" FLOAT32_IEEE COMM_subsystem_integrated_CM_single 0 0 -3.4E+38 3.4E+38 ECU_ADDRESS 0x0000 /* @ECU_Address@VfCOMM_VDC_LongAcceleration@ */ /end MEASUREMENT
/begin MEASUREMENT VfCOMM_VDC_LateralAcceleration "" FLOAT32_IEEE COMM_subsystem_integrated_CM_single 0 0 -3.4E+38 3.4E+38 ECU_ADDRESS 0x0000 /* @ECU_Address@VfCOMM_VDC_LateralAcceleration@ */ /end MEASUREMENT
/begin MEASUREMENT VfCOMM_VDC_WheelSpeed_RR2 "" FLOAT32_IEEE COMM_subsystem_integrated_CM_single 0 0 -3.4E+38 3.4E+38 ECU_ADDRESS 0x0000 /* @ECU_Address@VfCOMM_VDC_WheelSpeed_RR2@ */ /end MEASUREMENT
/begin MEASUREMENT VfCOMM_VDC_WheelSpeed_RL1 "" FLOAT32_IEEE COMM_subsystem_integrated_CM_single 0 0 -3.4E+38 3.4E+38 ECU_ADDRESS 0x0000 /* @ECU_Address@VfCOMM_VDC_WheelSpeed_RL1@ */ /end MEASUREMENT
/begin MEASUREMENT VfCOMM_VDC_WheelSpeed_RL2 "" FLOAT32_IEEE COMM_subsystem_integrated_CM_single 0 0 -3.4E+38 3.4E+38 ECU_ADDRESS 0x0000 /* @ECU_Address@VfCOMM_VDC_WheelSpeed_RL2@ */ /end MEASUREMENT
/begin MEASUREMENT VfCOMM_EPS_TargetSteeringAngleEcho "" FLOAT32_IEEE COMM_subsystem_integrated_CM_single 0 0 -3.4E+38 3.4E+38 ECU_ADDRESS 0x0000 /* @ECU_Address@VfCOMM_EPS_TargetSteeringAngleEcho@ */ /end MEASUREMENT
/begin MEASUREMENT VfCOMM_EPS_ActualSteeringAngle "" FLOAT32_IEEE COMM_subsystem_integrated_CM_single 0 0 -3.4E+38 3.4E+38 ECU_ADDRESS 0x0000 /* @ECU_Address@VfCOMM_EPS_ActualSteeringAngle@ */ /end MEASUREMENT
/begin MEASUREMENT VfCOMM_EPS_SteeringAngleRate "" FLOAT32_IEEE COMM_subsystem_integrated_CM_single 0 0 -3.4E+38 3.4E+38 ECU_ADDRESS 0x0000 /* @ECU_Address@VfCOMM_EPS_SteeringAngleRate@ */ /end MEASUREMENT
/begin MEASUREMENT VfCOMM_VDC_WheelSpeed_FR "" FLOAT32_IEEE COMM_subsystem_integrated_CM_single 0 0 -3.4E+38 3.4E+38 ECU_ADDRESS 0x0000 /* @ECU_Address@VfCOMM_VDC_WheelSpeed_FR@ */ /end MEASUREMENT
/begin MEASUREMENT VfCOMM_VDC_WheelSpeed_FL "" FLOAT32_IEEE COMM_subsystem_integrated_CM_single 0 0 -3.4E+38 3.4E+38 ECU_ADDRESS 0x0000 /* @ECU_Address@VfCOMM_VDC_WheelSpeed_FL@ */ /end MEASUREMENT
/begin MEASUREMENT VfCOMM_VCU_VirtualAccelPedalPosition "" FLOAT32_IEEE COMM_subsystem_integrated_CM_single 0 0 -3.4E+38 3.4E+38 ECU_ADDRESS 0x0000 /* @ECU_Address@VfCOMM_VCU_VirtualAccelPedalPosition@ */ /end MEASUREMENT
/begin MEASUREMENT VfCOMM_EMS_EngineSpeed "" FLOAT32_IEEE COMM_subsystem_integrated_CM_single 0 0 -3.4E+38 3.4E+38 ECU_ADDRESS 0x0000 /* @ECU_Address@VfCOMM_EMS_EngineSpeed@ */ /end MEASUREMENT
/begin MEASUREMENT VfCOMM_PCU_DriverDemandTorque "" FLOAT32_IEEE COMM_subsystem_integrated_CM_single 0 0 -3.4E+38 3.4E+38 ECU_ADDRESS 0x0000 /* @ECU_Address@VfCOMM_PCU_DriverDemandTorque@ */ /end MEASUREMENT
/begin MEASUREMENT VfCOMM_PCU_ActualEngineTorque "" FLOAT32_IEEE COMM_subsystem_integrated_CM_single 0 0 -3.4E+38 3.4E+38 ECU_ADDRESS 0x0000 /* @ECU_Address@VfCOMM_PCU_ActualEngineTorque@ */ /end MEASUREMENT
/begin MEASUREMENT VfCOMM_EMS_CatalystTankLevel "" FLOAT32_IEEE COMM_subsystem_integrated_CM_single 0 0 -3.4E+38 3.4E+38 ECU_ADDRESS 0x0000 /* @ECU_Address@VfCOMM_EMS_CatalystTankLevel@ */ /end MEASUREMENT
/begin MEASUREMENT VfCOMM_VCU_ActualAccelPedalPosition "" FLOAT32_IEEE COMM_subsystem_integrated_CM_single 0 0 -3.4E+38 3.4E+38 ECU_ADDRESS 0x0000 /* @ECU_Address@VfCOMM_VCU_ActualAccelPedalPosition@ */ /end MEASUREMENT
/begin MEASUREMENT VfCOMM_VCU_TargetAccelPedalPostionEcho "" FLOAT32_IEEE COMM_subsystem_integrated_CM_single 0 0 -3.4E+38 3.4E+38 ECU_ADDRESS 0x0000 /* @ECU_Address@VfCOMM_VCU_TargetAccelPedalPostionEcho@ */ /end MEASUREMENT
/begin MEASUREMENT VfCOMM_PCU_BatterySOC "" FLOAT32_IEEE COMM_subsystem_integrated_CM_single 0 0 -3.4E+38 3.4E+38 ECU_ADDRESS 0x0000 /* @ECU_Address@VfCOMM_PCU_BatterySOC@ */ /end MEASUREMENT
/begin MEASUREMENT VfCOMM_PCU_MotorSpeed "" FLOAT32_IEEE COMM_subsystem_integrated_CM_single 0 0 -3.4E+38 3.4E+38 ECU_ADDRESS 0x0000 /* @ECU_Address@VfCOMM_PCU_MotorSpeed@ */ /end MEASUREMENT
/begin MEASUREMENT VfCOMM_PCU_MotorActualTorque "" FLOAT32_IEEE COMM_subsystem_integrated_CM_single 0 0 -3.4E+38 3.4E+38 ECU_ADDRESS 0x0000 /* @ECU_Address@VfCOMM_PCU_MotorActualTorque@ */ /end MEASUREMENT
/begin MEASUREMENT VfCOMM_PCU_EngineTorqueLoss "" FLOAT32_IEEE COMM_subsystem_integrated_CM_single 0 0 -3.4E+38 3.4E+38 ECU_ADDRESS 0x0000 /* @ECU_Address@VfCOMM_PCU_EngineTorqueLoss@ */ /end MEASUREMENT
/begin MEASUREMENT VfCOMM_EPS_SteeringWheelTorque "" FLOAT32_IEEE COMM_subsystem_integrated_CM_single 0 0 -3.4E+38 3.4E+38 ECU_ADDRESS 0x0000 /* @ECU_Address@VfCOMM_EPS_SteeringWheelTorque@ */ /end MEASUREMENT
/begin MEASUREMENT VfCOMM_VCU_TargetBrakePedalEcho "" FLOAT32_IEEE COMM_subsystem_integrated_CM_single 0 0 -3.4E+38 3.4E+38 ECU_ADDRESS 0x0000 /* @ECU_Address@VfCOMM_VCU_TargetBrakePedalEcho@ */ /end MEASUREMENT
/begin MEASUREMENT VfCOMM_VCU_ActualBrakePedalPosition "" FLOAT32_IEEE COMM_subsystem_integrated_CM_single 0 0 -3.4E+38 3.4E+38 ECU_ADDRESS 0x0000 /* @ECU_Address@VfCOMM_VCU_ActualBrakePedalPosition@ */ /end MEASUREMENT
/begin MEASUREMENT VfCOMM_ESP_MasterCylinderPress "" FLOAT32_IEEE COMM_subsystem_integrated_CM_single 0 0 -3.4E+38 3.4E+38 ECU_ADDRESS 0x0000 /* @ECU_Address@VfCOMM_ESP_MasterCylinderPress@ */ /end MEASUREMENT
/begin MEASUREMENT VfCOMM_VDC_WheelEncoderCounter_RL "" ULONG COMM_subsystem_integrated_CM_uint32 0 0 0 4294967295 ECU_ADDRESS 0x0000 /* @ECU_Address@VfCOMM_VDC_WheelEncoderCounter_RL@ */ /end MEASUREMENT
/begin MEASUREMENT VfCOMM_VDC_WheelEncoderCounter_RR "" ULONG COMM_subsystem_integrated_CM_uint32 0 0 0 4294967295 ECU_ADDRESS 0x0000 /* @ECU_Address@VfCOMM_VDC_WheelEncoderCounter_RR@ */ /end MEASUREMENT
/begin MEASUREMENT VfCOMM_EMS_EngineCoolantTemperature "" SWORD COMM_subsystem_integrated_CM_int16 0 0 -32768 32767 ECU_ADDRESS 0x0000 /* @ECU_Address@VfCOMM_EMS_EngineCoolantTemperature@ */ /end MEASUREMENT
/begin MEASUREMENT VfCOMM_EMS_EngineOilPressure "" UWORD COMM_subsystem_integrated_CM_uint16 0 0 0 65535 ECU_ADDRESS 0x0000 /* @ECU_Address@VfCOMM_EMS_EngineOilPressure@ */ /end MEASUREMENT
/begin MEASUREMENT VeCOMM_VCU_AutoToManualTips "\"Reason for not being able to enter automatic driving status (16 bits represent different conditions (starting from 1):
      
      Bit 1: comfort can bus off;
      
      Bit 2: power can bus off:
      
      Bit 3: adv control mode message timeout
      
      Bit 4: adv torque request message CS / LS fault;
      
      Bit 5: pull down the handbrake switch;
      
      Bit 6: The Trailer hand brake switch is pulled down;
      
      Bit 7: Cruise activation;
      
      Bit 8: when the accelerator is depressed, it is greater than a certain threshold;
      
      Bit 9: when the accelerator pedal fails;
      
      Bit 10: the brake pedal is depressed;
      
      Bit 11: brake pedal failure;
      
      Bit 12: intelligent driving function shielding. \"" UWORD COMM_subsystem_integrated_CM_uint16 0 0 0 65535 ECU_ADDRESS 0x0000 /* @ECU_Address@VeCOMM_VCU_AutoToManualTips@ */ /end MEASUREMENT
/begin MEASUREMENT VfCOMM_ESP_BrakeAirTankPressure "" UWORD COMM_subsystem_integrated_CM_uint16 0 0 0 65535 ECU_ADDRESS 0x0000 /* @ECU_Address@VfCOMM_ESP_BrakeAirTankPressure@ */ /end MEASUREMENT
/begin MEASUREMENT VeCOMM_ADCU_TargetGearValue "Target Gear (0:Neutral;1-12:ForwardGears;13:Reverse;14Park;15:Invalid)" UBYTE COMM_subsystem_integrated_CM_uint8 0 0 0 255 ECU_ADDRESS 0x0000 /* @ECU_Address@VeCOMM_ADCU_TargetGearValue@ */ /end MEASUREMENT
/begin MEASUREMENT VeCOMM_ADCU_ParkingControlValue "Park control status (0: release; 1: clamp)" UBYTE COMM_subsystem_integrated_CM_uint8 0 0 0 255 ECU_ADDRESS 0x0000 /* @ECU_Address@VeCOMM_ADCU_ParkingControlValue@ */ /end MEASUREMENT
/begin MEASUREMENT VeCOMM_TCU_TargetGearPositionEcho "Target gear received by TCU from ADCU (0: neutral; 1-12: forwardgears; 13: reverse; 14park; 15: invalid)" UBYTE COMM_subsystem_integrated_CM_uint8 0 0 0 255 ECU_ADDRESS 0x0000 /* @ECU_Address@VeCOMM_TCU_TargetGearPositionEcho@ */ /end MEASUREMENT
/begin MEASUREMENT VeCOMM_TCU_ShiftLevelPosition "ShiftLevelPosition£¨PRNDL£©£¨0£ºPark;1:Reverse;2:Neutral;3:Drive£©" UBYTE COMM_subsystem_integrated_CM_uint8 0 0 0 255 ECU_ADDRESS 0x0000 /* @ECU_Address@VeCOMM_TCU_ShiftLevelPosition@ */ /end MEASUREMENT
/begin MEASUREMENT VeCOMM_TCU_ActualGearPosition "Actual gear(0:Neutral;1-12:ForwardGears;13:Reverse;14Park;15:Invalid)
      " UBYTE COMM_subsystem_integrated_CM_uint8 0 0 0 255 ECU_ADDRESS 0x0000 /* @ECU_Address@VeCOMM_TCU_ActualGearPosition@ */ /end MEASUREMENT
/begin MEASUREMENT VeCOMM_EPS_SteeringModeEcho "Target corner status received by EPS from ADCU (0: driver; 1: steeringangle; 2: steeringwheeltorque)" UBYTE COMM_subsystem_integrated_CM_uint8 0 0 0 255 ECU_ADDRESS 0x0000 /* @ECU_Address@VeCOMM_EPS_SteeringModeEcho@ */ /end MEASUREMENT
/begin MEASUREMENT VeCOMM_EMS_StartStopStatus "
      0-Reset Start/Stop not active(any engine condition possible)
      " UBYTE COMM_subsystem_integrated_CM_uint8 0 0 0 255 ECU_ADDRESS 0x0000 /* @ECU_Address@VeCOMM_EMS_StartStopStatus@ */ /end MEASUREMENT
/begin MEASUREMENT VeCOMM_EMS_EngineState "Engine status (0: keyoff; 1: ACC; 2: Keyon; 3: crank; 4: run)" UBYTE COMM_subsystem_integrated_CM_uint8 0 0 0 255 ECU_ADDRESS 0x0000 /* @ECU_Address@VeCOMM_EMS_EngineState@ */ /end MEASUREMENT
/begin MEASUREMENT VeCOMM_PCU_PowertrainFaultLevel "Power system fault level (0: nofault)" UBYTE COMM_subsystem_integrated_CM_uint8 0 0 0 255 ECU_ADDRESS 0x0000 /* @ECU_Address@VeCOMM_PCU_PowertrainFaultLevel@ */ /end MEASUREMENT
/begin MEASUREMENT VeCOMM_EPS_FaultLevel "Steering performance fault level (0: nofault)" UBYTE COMM_subsystem_integrated_CM_uint8 0 0 0 255 ECU_ADDRESS 0x0000 /* @ECU_Address@VeCOMM_EPS_FaultLevel@ */ /end MEASUREMENT
/begin MEASUREMENT VeCOMM_BCM_CruiseControlStatus "Cruise control status" UBYTE COMM_subsystem_integrated_CM_uint8 0 0 0 255 ECU_ADDRESS 0x0000 /* @ECU_Address@VeCOMM_BCM_CruiseControlStatus@ */ /end MEASUREMENT
/begin MEASUREMENT VeCOMM_BCM_DriveMode "
      BCM_DM_TargetModeReq£¨0£ºNormal£»1£ºSport£»2£ºEco£»other£ºReserve£©
      " UBYTE COMM_subsystem_integrated_CM_uint8 0 0 0 255 ECU_ADDRESS 0x0000 /* @ECU_Address@VeCOMM_BCM_DriveMode@ */ /end MEASUREMENT
/begin MEASUREMENT VeCOMM_ESP_SystemFaultStatus "ESP system fault status (0: normal)" UBYTE COMM_subsystem_integrated_CM_uint8 0 0 0 255 ECU_ADDRESS 0x0000 /* @ECU_Address@VeCOMM_ESP_SystemFaultStatus@ */ /end MEASUREMENT
/begin MEASUREMENT VeCOMM_EPB_SystemFaultStatus "ESP system fault status (0: normal)" UBYTE COMM_subsystem_integrated_CM_uint8 0 0 0 255 ECU_ADDRESS 0x0000 /* @ECU_Address@VeCOMM_EPB_SystemFaultStatus@ */ /end MEASUREMENT
/begin MEASUREMENT VeCOMM_EPB_ActualControlStatus "EPB actual control status (0: release)" UBYTE COMM_subsystem_integrated_CM_uint8 0 0 0 255 ECU_ADDRESS 0x0000 /* @ECU_Address@VeCOMM_EPB_ActualControlStatus@ */ /end MEASUREMENT
/begin MEASUREMENT VbCOMM_ADCU_EmergencyLightRequest "" UBYTE COMM_subsystem_integrated_CM_boolean 0 0 0 1 ECU_ADDRESS 0x0000 /* @ECU_Address@VbCOMM_ADCU_EmergencyLightRequest@ */ /end MEASUREMENT
/begin MEASUREMENT VbCOMM_ADCU_RightTurningLightRequest "" UBYTE COMM_subsystem_integrated_CM_boolean 0 0 0 1 ECU_ADDRESS 0x0000 /* @ECU_Address@VbCOMM_ADCU_RightTurningLightRequest@ */ /end MEASUREMENT
/begin MEASUREMENT VbCOMM_ADCU_PositionLightRequest "" UBYTE COMM_subsystem_integrated_CM_boolean 0 0 0 1 ECU_ADDRESS 0x0000 /* @ECU_Address@VbCOMM_ADCU_PositionLightRequest@ */ /end MEASUREMENT
/begin MEASUREMENT VbCOMM_ADCU_LeftTurningLightRequest "" UBYTE COMM_subsystem_integrated_CM_boolean 0 0 0 1 ECU_ADDRESS 0x0000 /* @ECU_Address@VbCOMM_ADCU_LeftTurningLightRequest@ */ /end MEASUREMENT
/begin MEASUREMENT VbCOMM_ADCU_HornRequest "" UBYTE COMM_subsystem_integrated_CM_boolean 0 0 0 1 ECU_ADDRESS 0x0000 /* @ECU_Address@VbCOMM_ADCU_HornRequest@ */ /end MEASUREMENT
/begin MEASUREMENT VbCOMM_ADCU_HighBeamRequest "" UBYTE COMM_subsystem_integrated_CM_boolean 0 0 0 1 ECU_ADDRESS 0x0000 /* @ECU_Address@VbCOMM_ADCU_HighBeamRequest@ */ /end MEASUREMENT
/begin MEASUREMENT VbCOMM_ADCU_FrontFogLightRequest "" UBYTE COMM_subsystem_integrated_CM_boolean 0 0 0 1 ECU_ADDRESS 0x0000 /* @ECU_Address@VbCOMM_ADCU_FrontFogLightRequest@ */ /end MEASUREMENT
/begin MEASUREMENT VbCOMM_ADCU_LowBeamRequest "" UBYTE COMM_subsystem_integrated_CM_boolean 0 0 0 1 ECU_ADDRESS 0x0000 /* @ECU_Address@VbCOMM_ADCU_LowBeamRequest@ */ /end MEASUREMENT
/begin MEASUREMENT VbCOMM_ADCU_BrakeLightRequest "" UBYTE COMM_subsystem_integrated_CM_boolean 0 0 0 1 ECU_ADDRESS 0x0000 /* @ECU_Address@VbCOMM_ADCU_BrakeLightRequest@ */ /end MEASUREMENT
/begin MEASUREMENT VbCOMM_ADCU_BackFogLghtRequest "" UBYTE COMM_subsystem_integrated_CM_boolean 0 0 0 1 ECU_ADDRESS 0x0000 /* @ECU_Address@VbCOMM_ADCU_BackFogLghtRequest@ */ /end MEASUREMENT
/begin MEASUREMENT VbCOMM_ADCU_AutodriveEnable "" UBYTE COMM_subsystem_integrated_CM_boolean 0 0 0 1 ECU_ADDRESS 0x0000 /* @ECU_Address@VbCOMM_ADCU_AutodriveEnable@ */ /end MEASUREMENT
/begin MEASUREMENT VbCOMM_ADCU_BCMControlEnable "" UBYTE COMM_subsystem_integrated_CM_boolean 0 0 0 1 ECU_ADDRESS 0x0000 /* @ECU_Address@VbCOMM_ADCU_BCMControlEnable@ */ /end MEASUREMENT
/begin MEASUREMENT VbCOMM_ADCU_TargetGearEnable "" UBYTE COMM_subsystem_integrated_CM_boolean 0 0 0 1 ECU_ADDRESS 0x0000 /* @ECU_Address@VbCOMM_ADCU_TargetGearEnable@ */ /end MEASUREMENT
/begin MEASUREMENT VbCOMM_ADCU_SteeringAngleEnable "" UBYTE COMM_subsystem_integrated_CM_boolean 0 0 0 1 ECU_ADDRESS 0x0000 /* @ECU_Address@VbCOMM_ADCU_SteeringAngleEnable@ */ /end MEASUREMENT
/begin MEASUREMENT VbCOMM_ADCU_ParkingPressureRequest "" UBYTE COMM_subsystem_integrated_CM_boolean 0 0 0 1 ECU_ADDRESS 0x0000 /* @ECU_Address@VbCOMM_ADCU_ParkingPressureRequest@ */ /end MEASUREMENT
/begin MEASUREMENT VbCOMM_ADCU_LaunchRequest "" UBYTE COMM_subsystem_integrated_CM_boolean 0 0 0 1 ECU_ADDRESS 0x0000 /* @ECU_Address@VbCOMM_ADCU_LaunchRequest@ */ /end MEASUREMENT
/begin MEASUREMENT VbCOMM_ADCU_ParkingControlEnable "" UBYTE COMM_subsystem_integrated_CM_boolean 0 0 0 1 ECU_ADDRESS 0x0000 /* @ECU_Address@VbCOMM_ADCU_ParkingControlEnable@ */ /end MEASUREMENT
/begin MEASUREMENT VbCOMM_ADCU_PowerEnable "" UBYTE COMM_subsystem_integrated_CM_boolean 0 0 0 1 ECU_ADDRESS 0x0000 /* @ECU_Address@VbCOMM_ADCU_PowerEnable@ */ /end MEASUREMENT
/begin MEASUREMENT VbCOMM_ADCU_BrakeEnable "" UBYTE COMM_subsystem_integrated_CM_boolean 0 0 0 1 ECU_ADDRESS 0x0000 /* @ECU_Address@VbCOMM_ADCU_BrakeEnable@ */ /end MEASUREMENT
/begin MEASUREMENT VbCOMM_ADCU_SpeedDownIndicator "" UBYTE COMM_subsystem_integrated_CM_boolean 0 0 0 1 ECU_ADDRESS 0x0000 /* @ECU_Address@VbCOMM_ADCU_SpeedDownIndicator@ */ /end MEASUREMENT
/begin MEASUREMENT VbCOMM_ADCU_SpeedUpIndicator "" UBYTE COMM_subsystem_integrated_CM_boolean 0 0 0 1 ECU_ADDRESS 0x0000 /* @ECU_Address@VbCOMM_ADCU_SpeedUpIndicator@ */ /end MEASUREMENT
/begin MEASUREMENT VbCOMM_ADCU_OverSpeedWarning "" UBYTE COMM_subsystem_integrated_CM_boolean 0 0 0 1 ECU_ADDRESS 0x0000 /* @ECU_Address@VbCOMM_ADCU_OverSpeedWarning@ */ /end MEASUREMENT
/begin MEASUREMENT VbCOMM_VDC_YawRateValid "" UBYTE COMM_subsystem_integrated_CM_boolean 0 0 0 1 ECU_ADDRESS 0x0000 /* @ECU_Address@VbCOMM_VDC_YawRateValid@ */ /end MEASUREMENT
/begin MEASUREMENT VbCOMM_VDC_LongAccelerationValid "" UBYTE COMM_subsystem_integrated_CM_boolean 0 0 0 1 ECU_ADDRESS 0x0000 /* @ECU_Address@VbCOMM_VDC_LongAccelerationValid@ */ /end MEASUREMENT
/begin MEASUREMENT VbCOMM_EPS_SteeringWheelTorqueValid "" UBYTE COMM_subsystem_integrated_CM_boolean 0 0 0 1 ECU_ADDRESS 0x0000 /* @ECU_Address@VbCOMM_EPS_SteeringWheelTorqueValid@ */ /end MEASUREMENT
/begin MEASUREMENT VbCOMM_VDC_LateralAccelerationValid "" UBYTE COMM_subsystem_integrated_CM_boolean 0 0 0 1 ECU_ADDRESS 0x0000 /* @ECU_Address@VbCOMM_VDC_LateralAccelerationValid@ */ /end MEASUREMENT
/begin MEASUREMENT VbCOMM_EPS_SteeringControlResponse_LDW "" UBYTE COMM_subsystem_integrated_CM_boolean 0 0 0 1 ECU_ADDRESS 0x0000 /* @ECU_Address@VbCOMM_EPS_SteeringControlResponse_LDW@ */ /end MEASUREMENT
/begin MEASUREMENT VbCOMM_EPS_SteeringControlResponse_LCC "" UBYTE COMM_subsystem_integrated_CM_boolean 0 0 0 1 ECU_ADDRESS 0x0000 /* @ECU_Address@VbCOMM_EPS_SteeringControlResponse_LCC@ */ /end MEASUREMENT
/begin MEASUREMENT VbCOMM_VDC_WheelSpeed_RR1Valid "" UBYTE COMM_subsystem_integrated_CM_boolean 0 0 0 1 ECU_ADDRESS 0x0000 /* @ECU_Address@VbCOMM_VDC_WheelSpeed_RR1Valid@ */ /end MEASUREMENT
/begin MEASUREMENT VbCOMM_VDC_WheelSpeed_RR2Valid "" UBYTE COMM_subsystem_integrated_CM_boolean 0 0 0 1 ECU_ADDRESS 0x0000 /* @ECU_Address@VbCOMM_VDC_WheelSpeed_RR2Valid@ */ /end MEASUREMENT
/begin MEASUREMENT VbCOMM_VDC_WheelSpeed_RL1Valid "" UBYTE COMM_subsystem_integrated_CM_boolean 0 0 0 1 ECU_ADDRESS 0x0000 /* @ECU_Address@VbCOMM_VDC_WheelSpeed_RL1Valid@ */ /end MEASUREMENT
/begin MEASUREMENT VbCOMM_VDC_WheelSpeed_FLValid "" UBYTE COMM_subsystem_integrated_CM_boolean 0 0 0 1 ECU_ADDRESS 0x0000 /* @ECU_Address@VbCOMM_VDC_WheelSpeed_FLValid@ */ /end MEASUREMENT
/begin MEASUREMENT VbCOMM_VDC_WheelSpeed_RL2Valid "" UBYTE COMM_subsystem_integrated_CM_boolean 0 0 0 1 ECU_ADDRESS 0x0000 /* @ECU_Address@VbCOMM_VDC_WheelSpeed_RL2Valid@ */ /end MEASUREMENT
/begin MEASUREMENT VbCOMM_VDC_WheelSpeed_FRValid "" UBYTE COMM_subsystem_integrated_CM_boolean 0 0 0 1 ECU_ADDRESS 0x0000 /* @ECU_Address@VbCOMM_VDC_WheelSpeed_FRValid@ */ /end MEASUREMENT
/begin MEASUREMENT VbCOMM_EMS_EngineSpeedValid "" UBYTE COMM_subsystem_integrated_CM_boolean 0 0 0 1 ECU_ADDRESS 0x0000 /* @ECU_Address@VbCOMM_EMS_EngineSpeedValid@ */ /end MEASUREMENT
/begin MEASUREMENT VbCOMM_VCU_VirtualAccelPedalValid "" UBYTE COMM_subsystem_integrated_CM_boolean 0 0 0 1 ECU_ADDRESS 0x0000 /* @ECU_Address@VbCOMM_VCU_VirtualAccelPedalValid@ */ /end MEASUREMENT
/begin MEASUREMENT VbCOMM_VCU_AccelPedalOverride "" UBYTE COMM_subsystem_integrated_CM_boolean 0 0 0 1 ECU_ADDRESS 0x0000 /* @ECU_Address@VbCOMM_VCU_AccelPedalOverride@ */ /end MEASUREMENT
/begin MEASUREMENT VbCOMM_EMS_CoolantLevelLow "" UBYTE COMM_subsystem_integrated_CM_boolean 0 0 0 1 ECU_ADDRESS 0x0000 /* @ECU_Address@VbCOMM_EMS_CoolantLevelLow@ */ /end MEASUREMENT
/begin MEASUREMENT VbCOMM_PCU_PowerControlResponse "" UBYTE COMM_subsystem_integrated_CM_boolean 0 0 0 1 ECU_ADDRESS 0x0000 /* @ECU_Address@VbCOMM_PCU_PowerControlResponse@ */ /end MEASUREMENT
/begin MEASUREMENT VbCOMM_VCU_AccelPedalValid "" UBYTE COMM_subsystem_integrated_CM_boolean 0 0 0 1 ECU_ADDRESS 0x0000 /* @ECU_Address@VbCOMM_VCU_AccelPedalValid@ */ /end MEASUREMENT
/begin MEASUREMENT VbCOMM_EPS_HandsOnWheelDetected "" UBYTE COMM_subsystem_integrated_CM_boolean 0 0 0 1 ECU_ADDRESS 0x0000 /* @ECU_Address@VbCOMM_EPS_HandsOnWheelDetected@ */ /end MEASUREMENT
/begin MEASUREMENT VbCOMM_EPS_HandsOffWheelDetected "" UBYTE COMM_subsystem_integrated_CM_boolean 0 0 0 1 ECU_ADDRESS 0x0000 /* @ECU_Address@VbCOMM_EPS_HandsOffWheelDetected@ */ /end MEASUREMENT
/begin MEASUREMENT VbCOMM_VCU_AutodriveMainSwitch "" UBYTE COMM_subsystem_integrated_CM_boolean 0 0 0 1 ECU_ADDRESS 0x0000 /* @ECU_Address@VbCOMM_VCU_AutodriveMainSwitch@ */ /end MEASUREMENT
/begin MEASUREMENT VbCOMM_BCM_CruiseSwLimitMain "" UBYTE COMM_subsystem_integrated_CM_boolean 0 0 0 1 ECU_ADDRESS 0x0000 /* @ECU_Address@VbCOMM_BCM_CruiseSwLimitMain@ */ /end MEASUREMENT
/begin MEASUREMENT VbCOMM_BCM_DriverSeatBelt "" UBYTE COMM_subsystem_integrated_CM_boolean 0 0 0 1 ECU_ADDRESS 0x0000 /* @ECU_Address@VbCOMM_BCM_DriverSeatBelt@ */ /end MEASUREMENT
/begin MEASUREMENT VbCOMM_BCM_DriverSeatBeltValid "" UBYTE COMM_subsystem_integrated_CM_boolean 0 0 0 1 ECU_ADDRESS 0x0000 /* @ECU_Address@VbCOMM_BCM_DriverSeatBeltValid@ */ /end MEASUREMENT
/begin MEASUREMENT VbCOMM_BCM_TurningLightEcho "" UBYTE COMM_subsystem_integrated_CM_boolean 0 0 0 1 ECU_ADDRESS 0x0000 /* @ECU_Address@VbCOMM_BCM_TurningLightEcho@ */ /end MEASUREMENT
/begin MEASUREMENT VbCOMM_BCM_LowBeamSwitch "" UBYTE COMM_subsystem_integrated_CM_boolean 0 0 0 1 ECU_ADDRESS 0x0000 /* @ECU_Address@VbCOMM_BCM_LowBeamSwitch@ */ /end MEASUREMENT
/begin MEASUREMENT VbCOMM_BCM_HighBeamSwitch "" UBYTE COMM_subsystem_integrated_CM_boolean 0 0 0 1 ECU_ADDRESS 0x0000 /* @ECU_Address@VbCOMM_BCM_HighBeamSwitch@ */ /end MEASUREMENT
/begin MEASUREMENT VbCOMM_BCM_BrakeLightStatus "" UBYTE COMM_subsystem_integrated_CM_boolean 0 0 0 1 ECU_ADDRESS 0x0000 /* @ECU_Address@VbCOMM_BCM_BrakeLightStatus@ */ /end MEASUREMENT
/begin MEASUREMENT VbCOMM_BCM_LeftTurningLightState "" UBYTE COMM_subsystem_integrated_CM_boolean 0 0 0 1 ECU_ADDRESS 0x0000 /* @ECU_Address@VbCOMM_BCM_LeftTurningLightState@ */ /end MEASUREMENT
/begin MEASUREMENT VbCOMM_BCM_RightTurningLightState "" UBYTE COMM_subsystem_integrated_CM_boolean 0 0 0 1 ECU_ADDRESS 0x0000 /* @ECU_Address@VbCOMM_BCM_RightTurningLightState@ */ /end MEASUREMENT
/begin MEASUREMENT VbCOMM_VCU_AutodriveActiveStatus "" UBYTE COMM_subsystem_integrated_CM_boolean 0 0 0 1 ECU_ADDRESS 0x0000 /* @ECU_Address@VbCOMM_VCU_AutodriveActiveStatus@ */ /end MEASUREMENT
/begin MEASUREMENT VbCOMM_BCM_IgnitionKeyState "" UBYTE COMM_subsystem_integrated_CM_boolean 0 0 0 1 ECU_ADDRESS 0x0000 /* @ECU_Address@VbCOMM_BCM_IgnitionKeyState@ */ /end MEASUREMENT
/begin MEASUREMENT VbCOMM_BCM_DriverDoorStatus "" UBYTE COMM_subsystem_integrated_CM_boolean 0 0 0 1 ECU_ADDRESS 0x0000 /* @ECU_Address@VbCOMM_BCM_DriverDoorStatus@ */ /end MEASUREMENT
/begin MEASUREMENT VbCOMM_BCM_PassengerDoorStatus "" UBYTE COMM_subsystem_integrated_CM_boolean 0 0 0 1 ECU_ADDRESS 0x0000 /* @ECU_Address@VbCOMM_BCM_PassengerDoorStatus@ */ /end MEASUREMENT
/begin MEASUREMENT VbCOMM_BCM_FrontHoodStatus "" UBYTE COMM_subsystem_integrated_CM_boolean 0 0 0 1 ECU_ADDRESS 0x0000 /* @ECU_Address@VbCOMM_BCM_FrontHoodStatus@ */ /end MEASUREMENT
/begin MEASUREMENT VbCOMM_BCM_RearRightDoorStatus "" UBYTE COMM_subsystem_integrated_CM_boolean 0 0 0 1 ECU_ADDRESS 0x0000 /* @ECU_Address@VbCOMM_BCM_RearRightDoorStatus@ */ /end MEASUREMENT
/begin MEASUREMENT VbCOMM_BCM_RearLeftDoorStatus "" UBYTE COMM_subsystem_integrated_CM_boolean 0 0 0 1 ECU_ADDRESS 0x0000 /* @ECU_Address@VbCOMM_BCM_RearLeftDoorStatus@ */ /end MEASUREMENT
/begin MEASUREMENT VbCOMM_BCM_BackTrunkStatus "" UBYTE COMM_subsystem_integrated_CM_boolean 0 0 0 1 ECU_ADDRESS 0x0000 /* @ECU_Address@VbCOMM_BCM_BackTrunkStatus@ */ /end MEASUREMENT
/begin MEASUREMENT VbCOMM_BCM_WiperSwitch "" UBYTE COMM_subsystem_integrated_CM_boolean 0 0 0 1 ECU_ADDRESS 0x0000 /* @ECU_Address@VbCOMM_BCM_WiperSwitch@ */ /end MEASUREMENT
/begin MEASUREMENT VbCOMM_BCM_ControlResponse "" UBYTE COMM_subsystem_integrated_CM_boolean 0 0 0 1 ECU_ADDRESS 0x0000 /* @ECU_Address@VbCOMM_BCM_ControlResponse@ */ /end MEASUREMENT
/begin MEASUREMENT VbCOMM_BCM_CruiseSwValid "" UBYTE COMM_subsystem_integrated_CM_boolean 0 0 0 1 ECU_ADDRESS 0x0000 /* @ECU_Address@VbCOMM_BCM_CruiseSwValid@ */ /end MEASUREMENT
/begin MEASUREMENT VbCOMM_BCM_CruiseSwResume "" UBYTE COMM_subsystem_integrated_CM_boolean 0 0 0 1 ECU_ADDRESS 0x0000 /* @ECU_Address@VbCOMM_BCM_CruiseSwResume@ */ /end MEASUREMENT
/begin MEASUREMENT VbCOMM_BCM_CruiseSwSet "" UBYTE COMM_subsystem_integrated_CM_boolean 0 0 0 1 ECU_ADDRESS 0x0000 /* @ECU_Address@VbCOMM_BCM_CruiseSwSet@ */ /end MEASUREMENT
/begin MEASUREMENT VbCOMM_BCM_CruiseSwTimeGapPlus "" UBYTE COMM_subsystem_integrated_CM_boolean 0 0 0 1 ECU_ADDRESS 0x0000 /* @ECU_Address@VbCOMM_BCM_CruiseSwTimeGapPlus@ */ /end MEASUREMENT
/begin MEASUREMENT VbCOMM_BCM_CruiseSwTimeGapMinus "" UBYTE COMM_subsystem_integrated_CM_boolean 0 0 0 1 ECU_ADDRESS 0x0000 /* @ECU_Address@VbCOMM_BCM_CruiseSwTimeGapMinus@ */ /end MEASUREMENT
/begin MEASUREMENT VbCOMM_BCM_CruiseSwMain "" UBYTE COMM_subsystem_integrated_CM_boolean 0 0 0 1 ECU_ADDRESS 0x0000 /* @ECU_Address@VbCOMM_BCM_CruiseSwMain@ */ /end MEASUREMENT
/begin MEASUREMENT VbCOMM_ESP_TCSActive "" UBYTE COMM_subsystem_integrated_CM_boolean 0 0 0 1 ECU_ADDRESS 0x0000 /* @ECU_Address@VbCOMM_ESP_TCSActive@ */ /end MEASUREMENT
/begin MEASUREMENT VbCOMM_ESP_ABSActive "" UBYTE COMM_subsystem_integrated_CM_boolean 0 0 0 1 ECU_ADDRESS 0x0000 /* @ECU_Address@VbCOMM_ESP_ABSActive@ */ /end MEASUREMENT
/begin MEASUREMENT VbCOMM_EPB_AutoholdStatus "" UBYTE COMM_subsystem_integrated_CM_boolean 0 0 0 1 ECU_ADDRESS 0x0000 /* @ECU_Address@VbCOMM_EPB_AutoholdStatus@ */ /end MEASUREMENT
/begin MEASUREMENT VbCOMM_EPB_ParkingControlResponse "" UBYTE COMM_subsystem_integrated_CM_boolean 0 0 0 1 ECU_ADDRESS 0x0000 /* @ECU_Address@VbCOMM_EPB_ParkingControlResponse@ */ /end MEASUREMENT
/begin MEASUREMENT VbCOMM_EPB_SwitchStatus "" UBYTE COMM_subsystem_integrated_CM_boolean 0 0 0 1 ECU_ADDRESS 0x0000 /* @ECU_Address@VbCOMM_EPB_SwitchStatus@ */ /end MEASUREMENT
/begin MEASUREMENT VbCOMM_VCU_BrakePedalValid "" UBYTE COMM_subsystem_integrated_CM_boolean 0 0 0 1 ECU_ADDRESS 0x0000 /* @ECU_Address@VbCOMM_VCU_BrakePedalValid@ */ /end MEASUREMENT
/begin MEASUREMENT VbCOMM_ESP_BrakeControlResponse "" UBYTE COMM_subsystem_integrated_CM_boolean 0 0 0 1 ECU_ADDRESS 0x0000 /* @ECU_Address@VbCOMM_ESP_BrakeControlResponse@ */ /end MEASUREMENT
/begin MEASUREMENT VbCOMM_VCU_ActualBrakePedalSwitch "" UBYTE COMM_subsystem_integrated_CM_boolean 0 0 0 1 ECU_ADDRESS 0x0000 /* @ECU_Address@VbCOMM_VCU_ActualBrakePedalSwitch@ */ /end MEASUREMENT
/begin MEASUREMENT VbCOMM_ESP_MasterCylinderPressValid "" UBYTE COMM_subsystem_integrated_CM_boolean 0 0 0 1 ECU_ADDRESS 0x0000 /* @ECU_Address@VbCOMM_ESP_MasterCylinderPressValid@ */ /end MEASUREMENT
/begin COMPU_METHOD COMM_subsystem_integrated_CM_single "Q = V" RAT_FUNC "%8.6" "" COEFFS 0 1 0 0 0 1 /end COMPU_METHOD
/begin COMPU_METHOD COMM_subsystem_integrated_CM_single_mm "Q = V" RAT_FUNC "%8.6" "mm" COEFFS 0 1 0 0 0 1 /end COMPU_METHOD
/begin COMPU_METHOD COMM_subsystem_integrated_CM_single_rad "Q = V" RAT_FUNC "%8.6" "rad" COEFFS 0 1 0 0 0 1 /end COMPU_METHOD
/begin COMPU_METHOD COMM_subsystem_integrated_CM_single_kg "Q = V" RAT_FUNC "%8.6" "kg" COEFFS 0 1 0 0 0 1 /end COMPU_METHOD
/begin COMPU_METHOD COMM_subsystem_integrated_CM_single_N_deg "Q = V" RAT_FUNC "%8.6" "N/deg" COEFFS 0 1 0 0 0 1 /end COMPU_METHOD
/begin COMPU_METHOD COMM_subsystem_integrated_CM_single_kg_m2 "Q = V" RAT_FUNC "%8.6" "kg*m2" COEFFS 0 1 0 0 0 1 /end COMPU_METHOD
/begin COMPU_METHOD COMM_subsystem_integrated_CM_single_m "Q = V" RAT_FUNC "%8.6" "m" COEFFS 0 1 0 0 0 1 /end COMPU_METHOD
/begin COMPU_METHOD COMM_subsystem_integrated_CM_uint8 "Q = V" RAT_FUNC "%3.0" "" COEFFS 0 1 0 0 0 1 /end COMPU_METHOD
/begin COMPU_METHOD COMM_subsystem_integrated_CM_boolean "Q = V" RAT_FUNC "%1.0" "" COEFFS 0 1 0 0 0 1 /end COMPU_METHOD
/begin COMPU_METHOD COMM_subsystem_integrated_CM_uint32 "Q = V" RAT_FUNC "%10.0" "" COEFFS 0 1 0 0 0 1 /end COMPU_METHOD
/begin COMPU_METHOD COMM_subsystem_integrated_CM_int16 "Q = V" RAT_FUNC "%5.0" "" COEFFS 0 1 0 0 0 1 /end COMPU_METHOD
/begin COMPU_METHOD COMM_subsystem_integrated_CM_uint16 "Q = V" RAT_FUNC "%5.0" "" COEFFS 0 1 0 0 0 1 /end COMPU_METHOD
/begin GROUP COMM_subsystem_integrated "COMM_subsystem_integrated" /* Root */ ROOT /begin SUB_GROUP Root_Receive Root_Transmit /end SUB_GROUP
 /begin REF_MEASUREMENT VbHWIO_ACC_CancelSwitch VbHWIO_ACC_MainSwitch VbHWIO_ACC_ResumeSwitch VbHWIO_ACC_SetSwitch VbHWIO_ACC_TimeGapMinus VbHWIO_ACC_TimeGapPlus VbHWIO_DriverModeComd VbHWIO_LeftTurningLightState VbHWIO_RightTurningLightState /end REF_MEASUREMENT
/end GROUP
/begin GROUP Root_Receive "COMM_subsystem_integrated/Receive" /begin SUB_GROUP S1_Subsystem S1_iEV7S_New S1_iVISTA_New /end SUB_GROUP /begin REF_CHARACTERISTIC KbCOMM_VEH_UseNewConfig KeCOMM_VehicleCANbusConfig /end REF_CHARACTERISTIC
 /begin REF_MEASUREMENT VbCOMM_BCM_BackTrunkStatus VbCOMM_BCM_BrakeLightStatus VbCOMM_BCM_ControlResponse VbCOMM_BCM_CruiseSwLimitMain VbCOMM_BCM_CruiseSwMain VbCOMM_BCM_CruiseSwResume VbCOMM_BCM_CruiseSwSet VbCOMM_BCM_CruiseSwTimeGapMinus VbCOMM_BCM_CruiseSwTimeGapPlus VbCOMM_BCM_CruiseSwValid VbCOMM_BCM_DriverDoorStatus VbCOMM_BCM_DriverSeatBelt VbCOMM_BCM_DriverSeatBeltValid VbCOMM_BCM_FrontHoodStatus VbCOMM_BCM_HighBeamSwitch VbCOMM_BCM_IgnitionKeyState VbCOMM_BCM_LeftTurningLightState VbCOMM_BCM_LowBeamSwitch VbCOMM_BCM_PassengerDoorStatus VbCOMM_BCM_RearLeftDoorStatus VbCOMM_BCM_RearRightDoorStatus VbCOMM_BCM_RightTurningLightState VbCOMM_BCM_TurningLightEcho VbCOMM_BCM_WiperSwitch VbCOMM_EMS_CoolantLevelLow VbCOMM_EMS_EngineSpeedValid VbCOMM_EPB_AutoholdStatus VbCOMM_EPB_ParkingControlResponse VbCOMM_EPB_SwitchStatus VbCOMM_EPS_HandsOffWheelDetected VbCOMM_EPS_HandsOnWheelDetected VbCOMM_EPS_SteeringControlResponse_LCC VbCOMM_EPS_SteeringControlResponse_LDW VbCOMM_EPS_SteeringWheelTorqueValid VbCOMM_ESP_ABSActive VbCOMM_ESP_BrakeControlResponse VbCOMM_ESP_MasterCylinderPressValid VbCOMM_ESP_TCSActive VbCOMM_PCU_PowerControlResponse VbCOMM_VCU_AccelPedalOverride VbCOMM_VCU_AccelPedalValid VbCOMM_VCU_ActualBrakePedalSwitch VbCOMM_VCU_AutodriveActiveStatus VbCOMM_VCU_AutodriveMainSwitch VbCOMM_VCU_BrakePedalValid VbCOMM_VCU_VirtualAccelPedalValid VbCOMM_VDC_LateralAccelerationValid VbCOMM_VDC_LongAccelerationValid VbCOMM_VDC_WheelSpeed_FLValid VbCOMM_VDC_WheelSpeed_FRValid VbCOMM_VDC_WheelSpeed_RL1Valid VbCOMM_VDC_WheelSpeed_RL2Valid VbCOMM_VDC_WheelSpeed_RR1Valid VbCOMM_VDC_WheelSpeed_RR2Valid VbCOMM_VDC_YawRateValid VeCOMM_BCM_CruiseControlStatus VeCOMM_BCM_DriveMode VeCOMM_EMS_EngineState VeCOMM_EMS_StartStopStatus VeCOMM_EPB_ActualControlStatus VeCOMM_EPB_SystemFaultStatus VeCOMM_EPS_FaultLevel VeCOMM_EPS_SteeringModeEcho VeCOMM_ESP_SystemFaultStatus VeCOMM_PCU_PowertrainFaultLevel VeCOMM_TCU_ActualGearPosition VeCOMM_TCU_ShiftLevelPosition VeCOMM_TCU_TargetGearPositionEcho VeCOMM_VCU_AutoToManualTips VfCOMM_EMS_CatalystTankLevel VfCOMM_EMS_EngineCoolantTemperature VfCOMM_EMS_EngineOilPressure VfCOMM_EMS_EngineSpeed VfCOMM_EPS_ActualSteeringAngle VfCOMM_EPS_SteeringAngleRate VfCOMM_EPS_SteeringWheelTorque VfCOMM_EPS_TargetSteeringAngleEcho VfCOMM_ESP_BrakeAirTankPressure VfCOMM_ESP_MasterCylinderPress VfCOMM_PCU_ActualEngineTorque VfCOMM_PCU_BatterySOC VfCOMM_PCU_DriverDemandTorque VfCOMM_PCU_EngineTorqueLoss VfCOMM_PCU_MotorActualTorque VfCOMM_PCU_MotorSpeed VfCOMM_TCU_ActualGearRatio VfCOMM_VCU_ActualAccelPedalPosition VfCOMM_VCU_ActualBrakePedalPosition VfCOMM_VCU_TargetAccelPedalPostionEcho VfCOMM_VCU_TargetBrakePedalEcho VfCOMM_VCU_VirtualAccelPedalPosition VfCOMM_VDC_LateralAcceleration VfCOMM_VDC_LongAcceleration VfCOMM_VDC_VehicleSpeed VfCOMM_VDC_WheelEncoderCounter_RL VfCOMM_VDC_WheelEncoderCounter_RR VfCOMM_VDC_WheelSpeed_FL VfCOMM_VDC_WheelSpeed_FR VfCOMM_VDC_WheelSpeed_RL1 VfCOMM_VDC_WheelSpeed_RL2 VfCOMM_VDC_WheelSpeed_RR1 VfCOMM_VDC_WheelSpeed_RR2 VfCOMM_VDC_YawRate /end REF_MEASUREMENT
/end GROUP
/begin GROUP Root_Transmit "COMM_subsystem_integrated/Transmit" /begin SUB_GROUP S2_FAW_New S2_ICPV_New S2_Test_Mode_New /end SUB_GROUP
 /begin REF_CHARACTERISTIC KcCOMM_Test_Cmd_EPSXBW_En KcCOMM_Test_Cmd_EPSXBW_En_ovr KcCOMM_Test_Cmd_StrAngle KcCOMM_Test_Cmd_StrAngle_ovr KcCOMM_Test_Decs_Acc_Req KcCOMM_Test_Decs_Acc_Req_ovr KcCOMM_Test_Decs_Acc_Value KcCOMM_Test_Decs_Acc_Value_ovr KcCOMM_Test_Decs_Breake_Req KcCOMM_Test_Decs_Breake_Req_ovr KcCOMM_Test_Decs_Breake_Value KcCOMM_Test_Decs_Breake_Value_ovr KcCOMM_Test_mode KeCOMM_VehicleCANbusConfig /end REF_CHARACTERISTIC
 /begin REF_MEASUREMENT VbCOMM_ADCU_AutodriveEnable VbCOMM_ADCU_BCMControlEnable VbCOMM_ADCU_BackFogLghtRequest VbCOMM_ADCU_BrakeEnable VbCOMM_ADCU_BrakeLightRequest VbCOMM_ADCU_EmergencyLightRequest VbCOMM_ADCU_FrontFogLightRequest VbCOMM_ADCU_HighBeamRequest VbCOMM_ADCU_HornRequest VbCOMM_ADCU_LaunchRequest VbCOMM_ADCU_LeftTurningLightRequest VbCOMM_ADCU_LowBeamRequest VbCOMM_ADCU_OverSpeedWarning VbCOMM_ADCU_ParkingControlEnable VbCOMM_ADCU_ParkingPressureRequest VbCOMM_ADCU_PositionLightRequest VbCOMM_ADCU_PowerEnable VbCOMM_ADCU_RightTurningLightRequest VbCOMM_ADCU_SpeedDownIndicator VbCOMM_ADCU_SpeedUpIndicator VbCOMM_ADCU_SteeringAngleEnable VbCOMM_ADCU_TargetGearEnable VeCOMM_ADCU_ParkingControlValue VeCOMM_ADCU_TargetGearValue VfCOMM_ADCU_BrakeDecelValue VfCOMM_ADCU_BrakePressureValue VfCOMM_ADCU_PowerAccelValue VfCOMM_ADCU_PowerTorqueValue VfCOMM_ADCU_SteeringAngleValue VfCOMM_ADCU_TargetVehicleSpeed /end REF_MEASUREMENT
/end GROUP
/begin GROUP S1_Subsystem "COMM_subsystem_integrated/Receive/Subsystem"
 /begin REF_CHARACTERISTIC KfACCS_d_VEH_WheelDiameter KfCOMM_Ang_VEH_AngOrigin2FrontWheel KfCOMM_VEH_Mass KfCOMM_VEH_StiffnessFront KfCOMM_VEH_StiffnessRear KfCOMM_VEH_YawInertia_Z KfCOMM_d_VEH_DisCentorid2Front KfCOMM_d_VEH_DisFront2Rear KfCOMM_d_VEH_DisLeft2Right KfCOMM_d_VEH_DisOrigin2End KfCOMM_d_VEH_DisOrigin2FrontWheel KfCOMM_d_VEH_DisOrigin2Head KfCOMM_d_VEH_DisOrigin2RearAxle KfCOMM_d_VEH_Length KfCOMM_d_VEH_MinTurnRadius KfCOMM_d_VEH_Width /end REF_CHARACTERISTIC
/end GROUP
/begin GROUP S1_iEV7S_New "COMM_subsystem_integrated/Receive/iEV7S_New" /begin REF_CHARACTERISTIC KfCOMM_a_VCULongAccOffset KfCOMM_r_VCULongAccSlope /end REF_CHARACTERISTIC /end GROUP
/begin GROUP S1_iVISTA_New "COMM_subsystem_integrated/Receive/iVISTA_New" /begin REF_CHARACTERISTIC KfCOMM_a_VCULongAccOffset KfCOMM_r_VCULongAccSlope /end REF_CHARACTERISTIC /end GROUP
/begin GROUP S2_FAW_New "COMM_subsystem_integrated/Transmit/FAW New" /begin SUB_GROUP S40_Command_Mapping /end SUB_GROUP /begin REF_CHARACTERISTIC KcCOMM_FirstGearRatio /end REF_CHARACTERISTIC /end GROUP
/begin GROUP S2_ICPV_New "COMM_subsystem_integrated/Transmit/ICPV New" /begin SUB_GROUP S41_EPB_clamped S41_EPB_released S41_EPB_releasing /end SUB_GROUP
 /begin REF_CHARACTERISTIC KcCOMM_BrakePedalMax KcCOMM_BrakePedalMin KcCOMM_GasPedalMax KcCOMM_GasPedalMin /end REF_CHARACTERISTIC
 /begin REF_MEASUREMENT VfCOMM_max_gas_pedal_EPB /end REF_MEASUREMENT
/end GROUP
/begin GROUP S2_Test_Mode_New "COMM_subsystem_integrated/Transmit/Test_Mode_New"
 /begin REF_CHARACTERISTIC KbCOMM_Test_BckFogLamp_Req KbCOMM_Test_BrakePrechargeRequest KbCOMM_Test_Cmd_AccPelEnable KbCOMM_Test_Cmd_BrakeLightReq KbCOMM_Test_Cmd_BrkPelEnable KbCOMM_Test_Cmd_ParkingCtrlEnable KbCOMM_Test_Cmd_TgtSftEnable KbCOMM_Test_Decs_DippedBeam_Req KbCOMM_Test_Decs_HighBeam_Req KbCOMM_Test_Decs_LftLmp_Req KbCOMM_Test_Decs_Light_Req KbCOMM_Test_Decs_RihtLmp_Req KbCOMM_Test_Decs_iBCM_Req KbCOMM_Test_FrontFogLamp_Req KbCOMM_Test_Horn_Req KbCOMM_Test_Over_Speed KbCOMM_Test_SlowDown_Indication KbCOMM_Test_SpeedUp_Indication KbCOMM_Test_Stop_Request KbCOMM_Test_WarnLight_Req KbCOMM_Test_driveoff_Req KcCOMM_Test_Cmd_ATOModEnable KcCOMM_Test_Cmd_AccPelPosAct KcCOMM_Test_Cmd_BrkPelPosAct KcCOMM_Test_Cmd_EPSXBW_En KcCOMM_Test_Cmd_StrAngle KcCOMM_Test_Cmd_StrAngleSpd KcCOMM_Test_Cmd_TgtSft KcCOMM_Test_Decs_Acc_Value KcCOMM_Test_Decs_Breake_Value KcCOMM_Test_Tar_vehiclespd KeCOMM_Test_Cmd_ParkingCtrlValue /end REF_CHARACTERISTIC
/end GROUP
/begin GROUP S40_Command_Mapping "COMM_subsystem_integrated/Transmit/FAW New/Command_Mapping" /begin SUB_GROUP S46_T03 /end SUB_GROUP /begin REF_CHARACTERISTIC KbCOMM_Test_Decs_iBCM_Req /end REF_CHARACTERISTIC /end GROUP
/begin GROUP S41_EPB_clamped "COMM_subsystem_integrated/Transmit/ICPV New/EPB_clamped" /begin REF_CHARACTERISTIC KcCOMM_GasPedalMinEPB /end REF_CHARACTERISTIC /end GROUP
/begin GROUP S41_EPB_released "COMM_subsystem_integrated/Transmit/ICPV New/EPB_released" /begin REF_CHARACTERISTIC KcCOMM_GasPedalMax KcCOMM_GasPedalRampEPB /end REF_CHARACTERISTIC /end GROUP
/begin GROUP S41_EPB_releasing "COMM_subsystem_integrated/Transmit/ICPV New/EPB_releasing" /begin REF_CHARACTERISTIC KcCOMM_GasPedalMaxEPB KcCOMM_GasPedalRampEPB /end REF_CHARACTERISTIC /end GROUP
/begin GROUP S46_T03 "COMM_subsystem_integrated/Transmit/FAW New/Command_Mapping/T03"
 /begin REF_CHARACTERISTIC KcCOMM_TorqCtrlPriority_Active KcCOMM_TorqCtrlPriority_Default /end REF_CHARACTERISTIC
/end GROUP
/end MODULE
/end PROJECT
/* (add any file trailer comments here) */
/* EOF COMM_subsystem_integrated.a2l */
